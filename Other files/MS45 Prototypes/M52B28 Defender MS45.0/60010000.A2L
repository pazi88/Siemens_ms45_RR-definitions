ASAP2_VERSION 1 31
/begin PROJECT MS45 "Rover Motorsteuerung V6"
/begin HEADER "_default_HeaderComment" PROJECT_NO _50 /end HEADER
/begin MODULE _default_ModuleName "_default_ModuleLongIdentifier"
/begin MOD_COMMON "_default_ModCommonComment" DEPOSIT ABSOLUTE BYTE_ORDER MSB_FIRST ALIGNMENT_BYTE 1 ALIGNMENT_WORD 2 ALIGNMENT_LONG 4 ALIGNMENT_FLOAT32_IEEE 4 ALIGNMENT_FLOAT64_IEEE 8 /end MOD_COMMON
/begin CHARACTERISTIC C_CYCNR_HYS_PUC "Cycle counter to reset the LV_PUC engine speed hysteresis " VALUE 0x67b70 _REC_VAL_20_u2 655.35 _CNV_A_R_LINEAR_____4_CM 0. 65535. FORMAT "%5.0" /end CHARACTERISTIC
/begin CHARACTERISTIC C_CYCNR_HYS_PUC_ST "Cycle counter to reset the LV_PUC engine speed hysteresis in cold condition" VALUE 0x67b72 _REC_VAL_20_u2 655.35 _CNV_A_R_LINEAR_____4_CM 0. 65535. FORMAT "%5.0" /end CHARACTERISTIC
/begin CHARACTERISTIC C_EFF_IGA_THD_1 "Threshold ignition efficiency for deactivation spark retard" VALUE 0x67b76 _REC_VAL_20_u2 1.99996948 _CNV_A_R_LINEAR_____5_CM 0. 1.99996948 FORMAT "%7.5" /end CHARACTERISTIC
/begin CHARACTERISTIC C_EOI_LIM "Latest possible EOI" VALUE 0x67b80 _REC_VAL_20_u2 720. _CNV_A_R_LINEAR_____6_CM 0. 720. FORMAT "%6.2" /end CHARACTERISTIC
/begin CHARACTERISTIC C_IGA_INI "Init value for ignition angle" VALUE 0x67bc0 _REC_VAL_20_u1 95.625 _CNV_A_R_LINEAR_____11_CM -23.625 72. FORMAT "%5.1" /end CHARACTERISTIC
/begin CHARACTERISTIC C_MTCPWM_I_MAX_POS "Limitation of I-share upwards" VALUE 0x67bf2 _REC_VAL_20_s2 199.99694824 _CNV_A_R_LINEAR_____12_CM -100. 99.99694824 FORMAT "%8.3" /end CHARACTERISTIC
/begin CHARACTERISTIC C_N_DIF_MAX_IS "Engine speed hysteresis before Idle Speed (LV_IS)" VALUE 0x67c00 _REC_VAL_20_u2 408. _CNV_A_R_LINEAR_____0_CM 0. 8160. FORMAT "%4.0" /end CHARACTERISTIC
/begin CHARACTERISTIC C_N_GRD_MIN "engine speed  gradient threshold for activating the intercept function" VALUE 0x67c0f _REC_VAL_20_s1 204.8 _CNV_A_R_LINEAR_____14_CM -4096. 0. FORMAT "%7.0" /end CHARACTERISTIC
/begin CHARACTERISTIC C_N_MAX_BOL_ST "Engine speed threshold to detect LV_ST or LV_PL from LV_IS" VALUE 0x67c15 _REC_VAL_20_u1 408. _CNV_A_R_LINEAR_____15_CM 0. 8160. FORMAT "%4.0" /end CHARACTERISTIC
/begin CHARACTERISTIC C_N_MAX_FL_DLY "Maximum engine speed for Full load recognition" VALUE 0x67c16 _REC_VAL_20_u1 8160. _CNV_A_R_LINEAR_____15_CM 0. 8160. FORMAT "%4.0" /end CHARACTERISTIC
/begin CHARACTERISTIC C_N_MAX_INF "Maximum engine speed possible below the intercept" VALUE 0x67c18 _REC_VAL_20_u1 408. _CNV_A_R_LINEAR_____15_CM 0. 8160. FORMAT "%4.0" /end CHARACTERISTIC
/begin CHARACTERISTIC C_N_MAX_TPS_AD "" VALUE 0x67c1b _REC_VAL_20_u1 8160. _CNV_A_R_LINEAR_____15_CM 0. 8160. FORMAT "%4.0" /end CHARACTERISTIC
/begin CHARACTERISTIC C_N_MIN_FL_DLY "Minimum engine speed for Full load recognition" VALUE 0x67c21 _REC_VAL_20_u1 8160. _CNV_A_R_LINEAR_____15_CM 0. 8160. FORMAT "%4.0" /end CHARACTERISTIC
/begin CHARACTERISTIC C_PV_COR_IS "Threshold for IS-detection" VALUE 0x67c2b _REC_VAL_20_u1 99.609375 _CNV_A_R_LINEAR_____16_CM 0. 99.609375 FORMAT "%5.2" /end CHARACTERISTIC
/begin CHARACTERISTIC C_PV_COR_IS_HYS "Hysteresis for IS-detection" VALUE 0x67c2c _REC_VAL_20_u1 99.609375 _CNV_A_R_LINEAR_____16_CM 0. 99.609375 FORMAT "%5.2" /end CHARACTERISTIC
/begin CHARACTERISTIC C_T_MAX_FL_DLY "Time after Start- Threshold value for Full load recognition" VALUE 0x67c5c _REC_VAL_20_u2 6553.5 _CNV_A_R_LINEAR_____18_CM 0. 6553.5 FORMAT "%5.1" /end CHARACTERISTIC
/begin CHARACTERISTIC C_T_MAX_REST "Time delay after switching on from LV_ST to detect LV_REST" VALUE 0x67c5e _REC_VAL_20_u1 25.4 _CNV_A_R_LINEAR_____20_CM 1. 255. FORMAT "%4.0" /end CHARACTERISTIC
/begin CHARACTERISTIC C_T_MIN_PU "Minimum delay time of PUC activation after entry of PU" VALUE 0x67c68 _REC_VAL_20_u2 655.35 _CNV_A_R_LINEAR_____21_CM 0. 655.35 FORMAT "%6.2" /end CHARACTERISTIC
/begin CHARACTERISTIC C_T_TI_DLY_FL_1 "Delay time Full load" VALUE 0x67c80 _REC_VAL_20_u2 655.35 _CNV_A_R_LINEAR_____21_CM 0. 655.35 FORMAT "%6.2" /end CHARACTERISTIC
/begin CHARACTERISTIC C_T_TI_DLY_FL_2 "Delay time Full load" VALUE 0x67c82 _REC_VAL_20_u2 655.35 _CNV_A_R_LINEAR_____21_CM 0. 655.35 FORMAT "%6.2" /end CHARACTERISTIC
/begin CHARACTERISTIC C_T_TI_DLY_FL_AT_1 "Delay time Full load AT" VALUE 0x67c84 _REC_VAL_20_u2 655.35 _CNV_A_R_LINEAR_____21_CM 0. 655.35 FORMAT "%6.2" /end CHARACTERISTIC
/begin CHARACTERISTIC C_T_TI_DLY_FL_AT_2 "Delay time Full load AT" VALUE 0x67c86 _REC_VAL_20_u2 655.35 _CNV_A_R_LINEAR_____21_CM 0. 655.35 FORMAT "%6.2" /end CHARACTERISTIC
/begin CHARACTERISTIC C_TCO_DIF_MAX_REST "Coolant temperature threshold to detect LV_REST" VALUE 0x67c9e _REC_VAL_20_u1 0.6 _CNV_A_R_LINEAR_____23_CM 0. 60. FORMAT "%4.1" /end CHARACTERISTIC
/begin CHARACTERISTIC C_TCO_MAX_TPS_AD "" VALUE 0x67ca7 _REC_VAL_20_u1 190.5 _CNV_A_R_LINEAR_____22_CM -48. 142.5 FORMAT "%5.1" /end CHARACTERISTIC
/begin CHARACTERISTIC C_TCO_MIN_FL "Minimum temperature for FL" VALUE 0x67cab _REC_VAL_20_u1 28.575 _CNV_A_R_LINEAR_____22_CM -48. 142.5 FORMAT "%5.1" /end CHARACTERISTIC
/begin CHARACTERISTIC C_TCO_MIN_PUC_ST "Coolant temperature to select the LV_PUC engine speed hysteresis" VALUE 0x67cac _REC_VAL_20_u1 28.575 _CNV_A_R_LINEAR_____22_CM -48. 142.5 FORMAT "%5.1" /end CHARACTERISTIC
/begin CHARACTERISTIC C_TCO_MIN_TPS_AD "" VALUE 0x67cad _REC_VAL_20_u1 190.5 _CNV_A_R_LINEAR_____22_CM -48. 142.5 FORMAT "%5.1" /end CHARACTERISTIC
/begin CHARACTERISTIC C_TD_INI "initial value for dwell time control" VALUE 0x67cb8 _REC_VAL_20_u2 10. _CNV_A_R_LINEAR_____24_CM 0. 10. FORMAT "%5.2" /end CHARACTERISTIC
/begin CHARACTERISTIC C_TD_T_MPL "Minimum time between two ignition" VALUE 0x67cba _REC_VAL_20_u1 1.02 _CNV_A_R_LINEAR_____24_CM 0. 1.02 FORMAT "%5.3" /end CHARACTERISTIC
/begin CHARACTERISTIC C_TIA_MIN_TPS_AD "" VALUE 0x67ce0 _REC_VAL_20_u1 190.5 _CNV_A_R_LINEAR_____22_CM -48. 142.5 FORMAT "%4.1" /end CHARACTERISTIC
/begin CHARACTERISTIC C_TPS_AD_DIAG_ENA "" VALUE 0x67cec _REC_VAL_20_u2 32767.5 _CNV_A_R_LINEAR_____33_CM 0. 32767.5 FORMAT "%6.1" /end CHARACTERISTIC
/begin CHARACTERISTIC C_V_TPS_SP_BOL_1 "" VALUE 0x67d56 _REC_VAL_20_u1 4.98046875 _CNV_A_R_LINEAR_____40_CM 0. 4.98046875 FORMAT "%3.2" /end CHARACTERISTIC
/begin CHARACTERISTIC C_V_TPS_SP_BOL_2 "" VALUE 0x67d57 _REC_VAL_20_u1 4.98046875 _CNV_A_R_LINEAR_____40_CM 0. 4.98046875 FORMAT "%3.2" /end CHARACTERISTIC
/begin CHARACTERISTIC C_VB_MIN_TPS_AD "" VALUE 0x67d5d _REC_VAL_20_u1 25.8984 _CNV_A_R_LINEAR_____42_CM 0. 25.8984 FORMAT "%3.1" /end CHARACTERISTIC
/begin CHARACTERISTIC C_VS_MIN_FL "Minimum velocity for FL" VALUE 0x67d78 _REC_VAL_20_u1 25.5 _CNV_A_R_LINEAR_____43_CM 0. 255. FORMAT "%3.0" /end CHARACTERISTIC
/begin MEASUREMENT EFF_IGA_SP "Setpoint ignition efficiency" UWORD _CNV_A_R_LINEAR_____5_CM 1 100. 0. 1.99996948 ECU_ADDRESS 0x3fc8dc FORMAT "%7.5" /end MEASUREMENT
/begin MEASUREMENT TPS_DIF "gradient of controller deviation" UWORD _CNV_A_R_LINEAR_____47_CM 1 100. -119.5 119.5 ECU_ADDRESS 0x3fcdc0 FORMAT "%8.3" /end MEASUREMENT
/begin AXIS_PTS ldp_iga_dif_eff_iga "" 0x6155c IGA_DIF_REF _REC_AXS_20_u1 -95.625 _CNV_A_R_LINEAR_____49_CM 16 0. -95.625 FORMAT "%5.1" /end AXIS_PTS
/begin AXIS_PTS ldp_lamb_sp_iga_ref_lamb "" 0x615a2 LAMB_SP _REC_AXS_20_u2 31.99902344 _CNV_A_R_LINEAR_____50_CM 8 0. 31.99902344 FORMAT "%7.4" /end AXIS_PTS
/begin AXIS_PTS ldp_maf_iga_dif_min_bas "" 0x615f4 MAF _REC_AXS_20_u1 1389. _CNV_A_R_LINEAR_____51_CM 6 0. 1389. FORMAT "%4.0" /end AXIS_PTS
/begin AXIS_PTS ldp_n_iga_dif_min_bas "" 0x61781 N_32 _REC_AXS_20_u1 8160. _CNV_A_R_LINEAR_____15_CM 12 0. 8160. FORMAT "%4.0" /end AXIS_PTS
/begin AXIS_PTS ldp_tco_iga_dif_min_tco "" 0x618d3 TCO _REC_AXS_20_u1 190.5 _CNV_A_R_LINEAR_____22_CM 8 -48. 142.5 FORMAT "%5.1" /end AXIS_PTS
/begin AXIS_PTS ldp_tco_st_iga_t_ch "" 0x618f7 TCO_ST _REC_AXS_20_u1 28.575 _CNV_A_R_LINEAR_____22_CM 8 -48. 142.5 FORMAT "%5.1" /end AXIS_PTS
/begin AXIS_PTS ldpm_gr_at_3 "" 0x61b12 GR_AT _REC_AXS_20_u1 255. _CNV_A_R_LINEAR_____13_CM 13 0. 255. FORMAT "%3.0" /end AXIS_PTS
/begin AXIS_PTS ldpm_gr_mt_3 "" 0x61b3c GR_MT _REC_AXS_20_u1 255. _CNV_A_R_LINEAR_____13_CM 13 0. 255. FORMAT "%3.0" /end AXIS_PTS
/begin AXIS_PTS ldpm_maf_100 "" 0x61b4a MAF _REC_AXS_20_u2 1389. _CNV_A_R_LINEAR_____56_CM 12 0. 1389. FORMAT "%4.0" /end AXIS_PTS
/begin AXIS_PTS ldpm_n_2_3 "" 0x61c0e N _REC_AXS_20_u2 816. _CNV_A_R_LINEAR_____0_CM 16 0. 8160. FORMAT "%4.0" /end AXIS_PTS
/begin AXIS_PTS ldpm_tco_1_6 "" 0x61cf4 TCO _REC_AXS_20_u1 28.575 _CNV_A_R_LINEAR_____22_CM 6 -48. 142.5 FORMAT "%5.1" /end AXIS_PTS
/begin CHARACTERISTIC ID_IGA_T_CH__TCO_ST "Activation time after start to switch on the injection time correction for catalyst heating (CH)" CURVE 0x6541a _REC_CUR_20_u2_u1 655.35 _CNV_A_R_LINEAR_____18_CM 0. 6553.5 FORMAT "%5.1"
 /begin AXIS_DESCR COM_AXIS TCO_ST _CNV_A_R_LINEAR_____22_CM 8 -48. 142.5 FORMAT "%5.1" AXIS_PTS_REF ldp_tco_st_iga_t_ch /end AXIS_DESCR
/end CHARACTERISTIC
/begin CHARACTERISTIC ID_N_ACCOUT_MIN_PUC__TCO__GR_AT "LV_PUC engine speed threshold with air conditioned compressor active" MAP 0x65738 _REC_MAP_20_u1_u1_u1 8160. _CNV_A_R_LINEAR_____15_CM 0. 8160. FORMAT "%4.0"
 /begin AXIS_DESCR COM_AXIS TCO _CNV_A_R_LINEAR_____22_CM 6 -48. 142.5 FORMAT "%5.1" AXIS_PTS_REF ldpm_tco_1_6 /end AXIS_DESCR
 /begin AXIS_DESCR COM_AXIS GR_AT _CNV_A_R_LINEAR_____13_CM 13 0. 255. FORMAT "%3.0" AXIS_PTS_REF ldpm_gr_at_3 /end AXIS_DESCR
/end CHARACTERISTIC
/begin CHARACTERISTIC ID_N_ACCOUT_MIN_PUC__TCO__GR_MT "LV_PUC engine speed threshold with air conditioned compressor active" MAP 0x65786 _REC_MAP_20_u1_u1_u1 8160. _CNV_A_R_LINEAR_____15_CM 0. 8160. FORMAT "%4.0"
 /begin AXIS_DESCR COM_AXIS TCO _CNV_A_R_LINEAR_____22_CM 6 -48. 142.5 FORMAT "%5.1" AXIS_PTS_REF ldpm_tco_1_6 /end AXIS_DESCR
 /begin AXIS_DESCR COM_AXIS GR_MT _CNV_A_R_LINEAR_____13_CM 13 0. 255. FORMAT "%3.0" AXIS_PTS_REF ldpm_gr_mt_3 /end AXIS_DESCR
/end CHARACTERISTIC
/begin CHARACTERISTIC ID_N_HYS_MAX_PUC__GR_AT "Engine speed hysteresis set entering LV_PUC" CURVE 0x657de _REC_CUR_20_u1_u1 8160. _CNV_A_R_LINEAR_____15_CM 0. 8160. FORMAT "%4.0"
 /begin AXIS_DESCR COM_AXIS GR_AT _CNV_A_R_LINEAR_____13_CM 13 0. 255. FORMAT "%3.0" AXIS_PTS_REF ldpm_gr_at_3 /end AXIS_DESCR
/end CHARACTERISTIC
/begin CHARACTERISTIC ID_N_HYS_MAX_PUC__GR_MT "Engine speed hysteresis set entering LV_PUC" CURVE 0x657eb _REC_CUR_20_u1_u1 8160. _CNV_A_R_LINEAR_____15_CM 0. 8160. FORMAT "%4.0"
 /begin AXIS_DESCR COM_AXIS GR_MT _CNV_A_R_LINEAR_____13_CM 13 0. 255. FORMAT "%3.0" AXIS_PTS_REF ldpm_gr_mt_3 /end AXIS_DESCR
/end CHARACTERISTIC
/begin CHARACTERISTIC ID_N_HYS_MIN_PUC__GR_AT "Engine speed hysteresis reset when C_CYCNR_HYS_PUC_xx achieved" CURVE 0x657f8 _REC_CUR_20_u1_u1 8160. _CNV_A_R_LINEAR_____15_CM 0. 8160. FORMAT "%4.0"
 /begin AXIS_DESCR COM_AXIS GR_AT _CNV_A_R_LINEAR_____13_CM 13 0. 255. FORMAT "%3.0" AXIS_PTS_REF ldpm_gr_at_3 /end AXIS_DESCR
/end CHARACTERISTIC
/begin CHARACTERISTIC ID_N_HYS_MIN_PUC__GR_MT "Engine speed hysteresis reset when C_CYCNR_HYS_PUC_xx achieved" CURVE 0x65805 _REC_CUR_20_u1_u1 8160. _CNV_A_R_LINEAR_____15_CM 0. 8160. FORMAT "%4.0"
 /begin AXIS_DESCR COM_AXIS GR_MT _CNV_A_R_LINEAR_____13_CM 13 0. 255. FORMAT "%3.0" AXIS_PTS_REF ldpm_gr_mt_3 /end AXIS_DESCR
/end CHARACTERISTIC
/begin CHARACTERISTIC ID_N_HYS_PUC_ST__GR_AT "Engine speed hysteresis set entering LV_PUC in cold condition" CURVE 0x65812 _REC_CUR_20_u1_u1 8160. _CNV_A_R_LINEAR_____15_CM 0. 8160. FORMAT "%4.0"
 /begin AXIS_DESCR COM_AXIS GR_AT _CNV_A_R_LINEAR_____13_CM 13 0. 255. FORMAT "%3.0" AXIS_PTS_REF ldpm_gr_at_3 /end AXIS_DESCR
/end CHARACTERISTIC
/begin CHARACTERISTIC ID_N_HYS_PUC_ST__GR_MT "Engine speed hysteresis set entering LV_PUC in cold condition" CURVE 0x6581f _REC_CUR_20_u1_u1 8160. _CNV_A_R_LINEAR_____15_CM 0. 8160. FORMAT "%4.0"
 /begin AXIS_DESCR COM_AXIS GR_MT _CNV_A_R_LINEAR_____13_CM 13 0. 255. FORMAT "%3.0" AXIS_PTS_REF ldpm_gr_mt_3 /end AXIS_DESCR
/end CHARACTERISTIC
/begin CHARACTERISTIC ID_N_MIN_PUC__TCO__GR_AT "LV_PUC engine speed threshold" MAP 0x6582c _REC_MAP_20_u1_u1_u1 8160. _CNV_A_R_LINEAR_____15_CM 0. 8160. FORMAT "%4.0"
 /begin AXIS_DESCR COM_AXIS TCO _CNV_A_R_LINEAR_____22_CM 6 -48. 142.5 FORMAT "%5.1" AXIS_PTS_REF ldpm_tco_1_6 /end AXIS_DESCR
 /begin AXIS_DESCR COM_AXIS GR_AT _CNV_A_R_LINEAR_____13_CM 13 0. 255. FORMAT "%3.0" AXIS_PTS_REF ldpm_gr_at_3 /end AXIS_DESCR
/end CHARACTERISTIC
/begin CHARACTERISTIC ID_N_MIN_PUC__TCO__GR_MT "LV_PUC engine speed threshold" MAP 0x6587a _REC_MAP_20_u1_u1_u1 8160. _CNV_A_R_LINEAR_____15_CM 0. 8160. FORMAT "%4.0"
 /begin AXIS_DESCR COM_AXIS TCO _CNV_A_R_LINEAR_____22_CM 6 -48. 142.5 FORMAT "%5.1" AXIS_PTS_REF ldpm_tco_1_6 /end AXIS_DESCR
 /begin AXIS_DESCR COM_AXIS GR_MT _CNV_A_R_LINEAR_____13_CM 13 0. 255. FORMAT "%3.0" AXIS_PTS_REF ldpm_gr_mt_3 /end AXIS_DESCR
/end CHARACTERISTIC
/begin CHARACTERISTIC IP_IGA_DIF_MIN_BAS__N__MAF "Basic minimum ignition angle difference value" MAP 0x65efc _REC_MAP_20_u1_u1_u1 -95.625 _CNV_A_R_LINEAR_____49_CM 0. -95.625 FORMAT "%5.1"
 /begin AXIS_DESCR COM_AXIS N_32 _CNV_A_R_LINEAR_____15_CM 12 0. 8160. FORMAT "%4.0" AXIS_PTS_REF ldp_n_iga_dif_min_bas /end AXIS_DESCR
 /begin AXIS_DESCR COM_AXIS MAF _CNV_A_R_LINEAR_____51_CM 6 0. 1389. FORMAT "%4.0" AXIS_PTS_REF ldp_maf_iga_dif_min_bas /end AXIS_DESCR
/end CHARACTERISTIC
/begin CHARACTERISTIC IP_IGA_DIF_SP__EFF_IGA_SP "Setpoint spark retard for torque setpoint" CURVE 0x65f4c _REC_CUR_20_u1_u2 -95.625 _CNV_A_R_LINEAR_____49_CM 0. -95.625 FORMAT "%5.1"
 /begin AXIS_DESCR COM_AXIS EFF_IGA_SP _CNV_A_R_LINEAR_____5_CM 16 0. 1.99996948 FORMAT "%7.5" AXIS_PTS_REF ldp_eff_iga_sp_iga_dif_sp /end AXIS_DESCR
/end CHARACTERISTIC
/begin CHARACTERISTIC IP_IGA_REF "Basic reference ignition angle at max. spread" MAP 0x65f74 _REC_MAP_20_u1_u1_u2 4.78125 _CNV_A_R_LINEAR_____11_CM -23.625 72. FORMAT "%5.1"
 /begin AXIS_DESCR COM_AXIS N_32 _CNV_A_R_LINEAR_____15_CM 16 0. 8160. FORMAT "%4.0" AXIS_PTS_REF ldpm_n_32_100 /end AXIS_DESCR
 /begin AXIS_DESCR COM_AXIS MAF _CNV_A_R_LINEAR_____56_CM 12 0. 1389. FORMAT "%4.0" AXIS_PTS_REF ldpm_maf_100 /end AXIS_DESCR
/end CHARACTERISTIC
/begin CHARACTERISTIC IP_IGA_REF_LAMB__LAMB_SP "additive lambda setpoint correction of IGA_REF" CURVE 0x660ca _REC_CUR_20_u1_u2 95.625 _CNV_A_R_LINEAR_____61_CM -48. 47.625 FORMAT "%5.1"
 /begin AXIS_DESCR COM_AXIS LAMB_SP _CNV_A_R_LINEAR_____50_CM 8 0. 31.99902344 FORMAT "%7.4" AXIS_PTS_REF ldp_lamb_sp_iga_ref_lamb /end AXIS_DESCR
/end CHARACTERISTIC
/begin CHARACTERISTIC IP_MTCPWM_D__TPS_DIF_GRD "Position controller D-share" CURVE 0x669b2 _REC_CUR_20_u2_u2 799.987793 _CNV_A_R_LINEAR_____62_CM -400. 399.987793 FORMAT "%7.2"
 /begin AXIS_DESCR COM_AXIS TPS_DIF_GRD _CNV_A_R_LINEAR_____47_CM 8 -119.5 119.5 FORMAT "%8.3" AXIS_PTS_REF ldp_tps_dif_grd__mtcpwm_d /end AXIS_DESCR
/end CHARACTERISTIC
/begin CHARACTERISTIC IP_MTCPWM_I__TPS_DIF "Position controller I-share" CURVE 0x669c2 _REC_CUR_20_u2_u2 199.99694824 _CNV_A_R_LINEAR_____63_CM -100. 99.99694824 FORMAT "%8.3"
 /begin AXIS_DESCR COM_AXIS TPS_DIF _CNV_A_R_LINEAR_____47_CM 8 -119.5 119.5 FORMAT "%8.3" AXIS_PTS_REF ldp_tps_dif__mtcpwm_i /end AXIS_DESCR
/end CHARACTERISTIC
/begin CHARACTERISTIC IP_MTCPWM_P__TPS_DIF "Position controller P-share" CURVE 0x669d2 _REC_CUR_20_u2_u2 799.987793 _CNV_A_R_LINEAR_____62_CM -400. 399.987793 FORMAT "%7.2"
 /begin AXIS_DESCR COM_AXIS TPS_DIF _CNV_A_R_LINEAR_____47_CM 8 -119.5 119.5 FORMAT "%8.3" AXIS_PTS_REF ldp_tps_dif__mtcpwm_p /end AXIS_DESCR
/end CHARACTERISTIC
/begin CHARACTERISTIC IP_MTCPWM_VB_FAC__VB "Battery voltage correction" CURVE 0x669e2 _REC_CUR_20_u1_u1 1.99220002 _CNV_A_R_LINEAR_____64_CM 0. 1.99220002 FORMAT "%5.3"
 /begin AXIS_DESCR COM_AXIS VB _CNV_A_R_LINEAR_____42_CM 8 0. 25.8984 FORMAT "%3.1" AXIS_PTS_REF ldp_vb__mtcpwm_vb_fac /end AXIS_DESCR
/end CHARACTERISTIC
/begin CHARACTERISTIC IP_TD__VB "Dwell time correction versus battery voltage" CURVE 0x672a6 _REC_CUR_20_u2_u1 10. _CNV_A_R_LINEAR_____24_CM 0. 10. FORMAT "%5.2"
 /begin AXIS_DESCR COM_AXIS VB _CNV_A_R_LINEAR_____42_CM 8 0. 25.8984 FORMAT "%3.1" AXIS_PTS_REF ldpm_vb_td /end AXIS_DESCR
/end CHARACTERISTIC
/begin CHARACTERISTIC IP_TD_MPL__VB "Dwell time for multiple spark" CURVE 0x672b6 _REC_CUR_20_u2_u1 50. _CNV_A_R_LINEAR_____24_CM 0. 50. FORMAT "%7.4"
 /begin AXIS_DESCR COM_AXIS VB _CNV_A_R_LINEAR_____42_CM 8 0. 25.8984 FORMAT "%3.1" AXIS_PTS_REF ldpm_vb_td /end AXIS_DESCR
/end CHARACTERISTIC
/begin MEASUREMENT EFF_IGA_AV "Ignition efficiency actual ignition angle" UWORD _CNV_A_R_LINEAR_____5_CM 1 100. 0. 1.99996948 ECU_ADDRESS 0x3fc8d6 FORMAT "%7.5" /end MEASUREMENT
/begin MEASUREMENT EFF_IGA_BAS_COR "Ignition efficiency  basic ignition angle" UWORD _CNV_A_R_LINEAR_____5_CM 1 100. 0. 1.99996948 ECU_ADDRESS 0x3fc8d4 FORMAT "%7.5" /end MEASUREMENT
/begin MEASUREMENT EFF_IGA_MIN "Ignition efficiency minimum ignition angle" UWORD _CNV_A_R_LINEAR_____5_CM 1 100. 0. 1.99996948 ECU_ADDRESS 0x3fc8d8 FORMAT "%7.5" /end MEASUREMENT
/begin MEASUREMENT EFF_IGA_SP_1 "Setpoint ignition efficiency" UWORD _CNV_A_R_LINEAR_____5_CM 1 100. 0. 1.99996948 ECU_ADDRESS 0x3fc8de FORMAT "%7.5" /end MEASUREMENT
/begin MEASUREMENT IGA_DIF_BAS "Difference of basic ignition angle to reference ignition angle" UBYTE _CNV_A_R_LINEAR_____49_CM 1 100. 0. -95.625 ECU_ADDRESS 0x3fd877 FORMAT "%5.1" /end MEASUREMENT
/begin MEASUREMENT IGA_DIF_MIN "Difference of minimum ignition angle to reference ignition angle" UBYTE _CNV_A_R_LINEAR_____49_CM 1 100. 0. -95.625 ECU_ADDRESS 0x3fd889 FORMAT "%5.1" /end MEASUREMENT
/begin MEASUREMENT IGA_DIF_SP "Setpoint subtrahend ignition angle" UBYTE _CNV_A_R_LINEAR_____6_CM 1 100. 0. 95.625 ECU_ADDRESS 0x3fd899 FORMAT "%5.2" /end MEASUREMENT
/begin MEASUREMENT IGA_IGC_0 "Ignition angle applied on cylinder CYL" UBYTE _CNV_A_R_LINEAR_____11_CM 1 100. -23.625 72. ECU_ADDRESS 0x3fd867 FORMAT "%5.1" /end MEASUREMENT
/begin MEASUREMENT IGA_IGC_1 "Ignition angle applied on cylinder CYL" UBYTE _CNV_A_R_LINEAR_____11_CM 1 100. -23.625 72. ECU_ADDRESS 0x3fd868 FORMAT "%5.1" /end MEASUREMENT
/begin MEASUREMENT IGA_IGC_2 "Ignition angle applied on cylinder CYL" UBYTE _CNV_A_R_LINEAR_____11_CM 1 100. -23.625 72. ECU_ADDRESS 0x3fd869 FORMAT "%5.1" /end MEASUREMENT
/begin MEASUREMENT IGA_IGC_3 "Ignition angle applied on cylinder CYL" UBYTE _CNV_A_R_LINEAR_____11_CM 1 100. -23.625 72. ECU_ADDRESS 0x3fd86a FORMAT "%5.1" /end MEASUREMENT
/begin MEASUREMENT IGA_IGC_4 "Ignition angle applied on cylinder CYL" UBYTE _CNV_A_R_LINEAR_____11_CM 1 100. -23.625 72. ECU_ADDRESS 0x3fd86b FORMAT "%5.1" /end MEASUREMENT
/begin MEASUREMENT IGA_IGC_5 "Ignition angle applied on cylinder CYL" UBYTE _CNV_A_R_LINEAR_____11_CM 1 100. -23.625 72. ECU_ADDRESS 0x3fd86c FORMAT "%5.1" /end MEASUREMENT
/begin MEASUREMENT IGA_REF_COR "corrected reference ignition angle" UBYTE _CNV_A_R_LINEAR_____11_CM 1 100. -23.625 72. ECU_ADDRESS 0x3fd88b FORMAT "%5.1" /end MEASUREMENT
/begin MEASUREMENT IGA_REF_LAMB_COR "additive Lambda correction of IGA_REF" SBYTE _CNV_A_R_LINEAR_____6_CM 1 100. -48. 47.625 ECU_ADDRESS 0x3fd88d FORMAT "%5.1" /end MEASUREMENT
/begin MEASUREMENT IGA_REF_TEMP_COR "additive temperature correction of IGA_REF" SBYTE _CNV_A_R_LINEAR_____6_CM 1 100. -48. 47.625 ECU_ADDRESS 0x3fd88c FORMAT "%5.1" /end MEASUREMENT
/begin MEASUREMENT IGA_SP "Setpoint ignition angle from torque management" UBYTE _CNV_A_R_LINEAR_____11_CM 1 100. -23.625 72. ECU_ADDRESS 0x3fd898 FORMAT "%5.1" /end MEASUREMENT
/begin MEASUREMENT IGA_SP_MAX_1 "Maximum ignition angle depending on torque intervention" UBYTE _CNV_A_R_LINEAR_____11_CM 1 100. -23.625 72. ECU_ADDRESS 0x3fd876 FORMAT "%5.1" /end MEASUREMENT
/begin MEASUREMENT LV_FL_RAW "LV condition a) is fullfilled" UBYTE _CNV_S_2_RANGE______74_CM 1 100. 0. 1. ECU_ADDRESS 0x3fd405 /end MEASUREMENT
/begin MEASUREMENT LV_MPL_IGA_ACT "Status for multiple advance active" UBYTE _CNV_S_2_RANGE______76_CM 1 100. 0. 1. ECU_ADDRESS 0x3fd4b0 BIT_MASK 0x1 /end MEASUREMENT
/begin MEASUREMENT LV_TQ_IGA_ACT "Logical variable torque intervention by spark retard is active" UBYTE _CNV_S_2_RANGE______74_CM 1 100. 0. 1. ECU_ADDRESS 0x3fd4ae /end MEASUREMENT
/begin MEASUREMENT LV_TQ_IGA_REQ "Logical variable torque intervention by spark retard is request" UBYTE _CNV_S_2_RANGE______74_CM 1 100. 0. 1. ECU_ADDRESS 0x3fd4af BIT_MASK 0x1 /end MEASUREMENT
/begin MEASUREMENT LV_WUP "Warm up functions active" UBYTE _CNV_S_2_RANGE______76_CM 1 100. 0. 1. ECU_ADDRESS 0x3fd40c BIT_MASK 0x1 /end MEASUREMENT
/begin MEASUREMENT MTCPWM_ADD "Duty cycle of the feed-forward-control" SWORD _CNV_A_R_LINEAR_____12_CM 1 100. -100. 99.99694824 ECU_ADDRESS 0x3fcdc8 FORMAT "%8.3" /end MEASUREMENT
/begin MEASUREMENT MTCPWM_CTL "Duty cycle of the PID-controller" SLONG _CNV_A_R_LINEAR_____78_CM 1 100. -400. 400. ECU_ADDRESS 0x3fc19c FORMAT "%8.3" /end MEASUREMENT
/begin MEASUREMENT MTCPWM_D "Duty cycle of the D-share" SWORD _CNV_A_R_LINEAR_____79_CM 1 100. -400. 399.987793 ECU_ADDRESS 0x3fcdce FORMAT "%7.2" /end MEASUREMENT
/begin MEASUREMENT MTCPWM_P "Duty cycle of the P-share" SWORD _CNV_A_R_LINEAR_____79_CM 1 100. -400. 399.987793 ECU_ADDRESS 0x3fcdca FORMAT "%7.2" /end MEASUREMENT
/begin MEASUREMENT TCO_REST "Coolant temperature, stored to detect a re-start" UBYTE _CNV_A_R_LINEAR_____22_CM 1 100. -48. 142.5 ECU_ADDRESS 0x3fd7f0 FORMAT "%3.0" /end MEASUREMENT
/begin MEASUREMENT TD_MPL "Dwell time with multiple spark" UWORD _CNV_A_R_LINEAR_____24_CM 1 100. 0. 50. ECU_ADDRESS 0x3fc8e4 FORMAT "%7.4" /end MEASUREMENT
/begin MEASUREMENT TD_MPL_DLY "Spark duration" UBYTE _CNV_A_R_LINEAR_____24_CM 1 100. 0. 1.02 ECU_ADDRESS 0x3fc8e6 FORMAT "%5.3" /end MEASUREMENT
/begin MEASUREMENT LV_ST "Engine operating state \"Start\"" UBYTE _CNV_S_2_RANGE______76_CM 1 100. 0. 1. ECU_ADDRESS 0x3fd47d BIT_MASK 0x1 /end MEASUREMENT
/begin MEASUREMENT LV_IS "Engine operating state \"Idle Speed\"" UBYTE _CNV_S_2_RANGE______74_CM 1 100. 0. 1. ECU_ADDRESS 0x3fd47f BIT_MASK 0x1 /end MEASUREMENT
/begin MEASUREMENT LV_REST "Auxiliary function \"Re-start\"" UBYTE _CNV_S_2_RANGE______74_CM 1 100. 0. 1. ECU_ADDRESS 0x3fd417 BIT_MASK 0x1 /end MEASUREMENT
/begin MEASUREMENT LV_ST_END "Engine operating state \"Start\" not active" UBYTE _CNV_S_2_RANGE______74_CM 1 100. 0. 1. ECU_ADDRESS 0x3fd47e BIT_MASK 0x1 /end MEASUREMENT
/begin MEASUREMENT T_AST "Time after start" UWORD _CNV_A_R_LINEAR_____18_CM 1 100. 0. 6553.5 ECU_ADDRESS 0x3fc708 FORMAT "%6.1" /end MEASUREMENT
/begin MEASUREMENT LV_PU "Engine operating state \"Trailing throttle\"" UBYTE _CNV_S_2_RANGE______74_CM 1 100. 0. 1. ECU_ADDRESS 0x3fd481 BIT_MASK 0x1 /end MEASUREMENT
/begin MEASUREMENT LV_PL "Engine operating state „Part Load\"" UBYTE _CNV_S_2_RANGE______74_CM 1 100. 0. 1. ECU_ADDRESS 0x3fd480 BIT_MASK 0x1 /end MEASUREMENT
/begin MEASUREMENT MFF_SP "Mass fuel flow setpoint after combustion selection" UWORD _CNV_A_R_LINEAR_____56_CM 1 100. 0. 1389. ECU_ADDRESS 0x3fc6ac FORMAT "%7.2" /end MEASUREMENT
/begin MEASUREMENT SOI_HOM "start of injection for homogeneous combustion mode" UWORD _CNV_A_R_LINEAR_____6_CM 1 100. 0. 720. ECU_ADDRESS 0x3fc674 FORMAT "%6.2" /end MEASUREMENT
/begin MEASUREMENT EOI_HOM "end of injection for homogeneous combustion mode" UWORD _CNV_A_R_LINEAR_____6_CM 1 100. 0. 720. ECU_ADDRESS 0x3faa48 FORMAT "%6.2" /end MEASUREMENT
/begin MEASUREMENT EOI_HOM_CLC "calculated end of injection for homogeneous combustion mode" UWORD _CNV_A_R_LINEAR_____6_CM 1 100. 0. 720. ECU_ADDRESS 0x3fc694 FORMAT "%6.2" /end MEASUREMENT
/begin MEASUREMENT EOI_TCO "Temperature correction for end of injection" UWORD _CNV_A_R_LINEAR_____6_CM 1 100. 0. 720. ECU_ADDRESS 0x3fc696 FORMAT "%6.2" /end MEASUREMENT
/begin MEASUREMENT TI_HOM_MAX_CST "Maximum injection time to fulfill required C_SOI_MIN_CST_H_PRS / C_SOI_MIN_CST_L_PRS" UWORD _CNV_A_R_LINEAR_____24_CM 1 100. 0. 262.14 ECU_ADDRESS 0x3fc676 FORMAT "%7.3" /end MEASUREMENT
/begin CHARACTERISTIC LC_EOI_HOM_MAN "switch for using the manual setpoint for EOI" VALUE 0x67d83 _REC_VAL_20_u1 1. _CNV_S_2_RANGE______76_CM 0. 1. /end CHARACTERISTIC
/begin CHARACTERISTIC C_EOI_HOM_MAN "manual setpoint for EOI" VALUE 0x67b7e _REC_VAL_20_u2 720. _CNV_A_R_LINEAR_____6_CM 0. 720. FORMAT "%6.2" /end CHARACTERISTIC
/begin CHARACTERISTIC C_SOI_MIN_CST_L_PRS "minimum start of injection angle during low pressure start" VALUE 0x67c3a _REC_VAL_20_u2 720. _CNV_A_R_LINEAR_____6_CM 0. 720. FORMAT "%6.2" /end CHARACTERISTIC
/begin CHARACTERISTIC C_SOI_MIN_CST_H_PRS "minimum start of injection angle during high pressure start" VALUE 0x67c38 _REC_VAL_20_u2 720. _CNV_A_R_LINEAR_____6_CM 0. 720. FORMAT "%6.2" /end CHARACTERISTIC
/begin MEASUREMENT IGA_ST "Basic ignition angle at start" UBYTE _CNV_A_R_LINEAR_____11_CM 1 100. -23.625 72. ECU_ADDRESS 0x3fd89a FORMAT "%5.1" /end MEASUREMENT
/begin CHARACTERISTIC ID_T_CH_TI__TCO_ST "max. duration of catalyst heating function" CURVE 0x658e6 _REC_CUR_20_u2_u1 6553.5 _CNV_A_R_LINEAR_____18_CM 0. 6553.5 FORMAT "%5.1"
 /begin AXIS_DESCR COM_AXIS TCO_ST _CNV_A_R_LINEAR_____22_CM 8 -48. 142.5 FORMAT "%5.1" AXIS_PTS_REF ldpm_tco_st_5 /end AXIS_DESCR
/end CHARACTERISTIC
/begin CHARACTERISTIC IP_EOI_H_PRS_CST "Basic map end of injection at high pressure cold start" CURVE 0x65b94 _REC_CUR_20_u2_u1 720. _CNV_A_R_LINEAR_____6_CM 0. 720. FORMAT "%6.2"
 /begin AXIS_DESCR COM_AXIS TCO _CNV_A_R_LINEAR_____22_CM 8 -48. 142.5 FORMAT "%5.1" AXIS_PTS_REF ldpm_tco__eoi_tco /end AXIS_DESCR
/end CHARACTERISTIC
/begin CHARACTERISTIC IP_EOI_L_PRS_CST "Basic map end of injection at low pressure cold start" CURVE 0x65ba4 _REC_CUR_20_u2_u1 720. _CNV_A_R_LINEAR_____6_CM 0. 720. FORMAT "%6.2"
 /begin AXIS_DESCR COM_AXIS TCO _CNV_A_R_LINEAR_____22_CM 8 -48. 142.5 FORMAT "%5.1" AXIS_PTS_REF ldpm_tco__eoi_tco /end AXIS_DESCR
/end CHARACTERISTIC
/begin CHARACTERISTIC IP_EOI_BAS "Basic map end of injection" MAP 0x65b4c _REC_MAP_20_u2_u1_u2 720. _CNV_A_R_LINEAR_____6_CM 0. 720. FORMAT "%6.2"
 /begin AXIS_DESCR COM_AXIS N_32 _CNV_A_R_LINEAR_____15_CM 6 0. 8160. FORMAT "%4.0" AXIS_PTS_REF ldp_n_32__eoi_bas /end AXIS_DESCR
 /begin AXIS_DESCR COM_AXIS TI_HOM_1 _CNV_A_R_LINEAR_____24_CM 6 0. 262.14 FORMAT "%7.3" AXIS_PTS_REF ldp_ti_hom__eoi_bas /end AXIS_DESCR
/end CHARACTERISTIC
/begin AXIS_PTS ldpm_tco__eoi_tco "" 0x61d27 TCO _REC_AXS_20_u1 19.05 _CNV_A_R_LINEAR_____22_CM 8 -48. 142.5 FORMAT "%5.1" /end AXIS_PTS
/begin AXIS_PTS ldp_ti_hom__eoi_bas "" 0x6191a TI_HOM _REC_AXS_20_u2 26.214 _CNV_A_R_LINEAR_____24_CM 6 0. 262.14 FORMAT "%7.3" /end AXIS_PTS
/begin CHARACTERISTIC IP_EOI_TCO "Coolant temperature correction EOI" CURVE 0x65bb4 _REC_CUR_20_u2_u1 720. _CNV_A_R_LINEAR_____6_CM 0. 720. FORMAT "%6.2"
 /begin AXIS_DESCR COM_AXIS TCO _CNV_A_R_LINEAR_____22_CM 8 -48. 142.5 FORMAT "%5.1" AXIS_PTS_REF ldpm_tco__eoi_tco /end AXIS_DESCR
/end CHARACTERISTIC
/begin MEASUREMENT EOI_BAS "Basic map end of injection versus engine speed and injection time" UWORD _CNV_A_R_LINEAR_____6_CM 1 100. 0. 720. ECU_ADDRESS 0x3fc692 FORMAT "%6.2" /end MEASUREMENT
/begin CHARACTERISTIC C_CYCNR_AD2_DEC_KNK "Cycle counter for adjustment into retard direction" VALUE 0x67b6c _REC_VAL_20_u2 65535. _CNV_A_R_LINEAR_____4_CM 0. 65535. FORMAT "%5.0" /end CHARACTERISTIC
/begin CHARACTERISTIC IP_MAF_MIN_KNK "Air-mass Threshold Release KNK" MAP 0x66632 _REC_MAP_20_u1_u1_u1 1389. _CNV_A_R_LINEAR_____51_CM 0. 1389. FORMAT "%4.0"
 /begin AXIS_DESCR COM_AXIS N_32 _CNV_A_R_LINEAR_____15_CM 8 0. 8160. FORMAT "%4.0" AXIS_PTS_REF ldpm_n_3_9 /end AXIS_DESCR
 /begin AXIS_DESCR COM_AXIS TCO _CNV_A_R_LINEAR_____22_CM 4 -48. 142.5 FORMAT "%3.0" AXIS_PTS_REF ldp_tco__maf_min_knk /end AXIS_DESCR
/end CHARACTERISTIC
/begin CHARACTERISTIC IP_IGA_MAX_KNK "Maximum value for spark retard" MAP 0x65f64 _REC_MAP_20_u1_u1_u1 48. _CNV_A_R_LINEAR_____61_CM -48. 0. FORMAT "%5.1"
 /begin AXIS_DESCR COM_AXIS N_KNK _CNV_A_R_LINEAR_____15_CM 4 0. 8160. FORMAT "%4.0" AXIS_PTS_REF ldpm_n_fil_frq_knk /end AXIS_DESCR
 /begin AXIS_DESCR COM_AXIS MAF_KNK _CNV_A_R_LINEAR_____51_CM 4 0. 1389. FORMAT "%4.0" AXIS_PTS_REF ldpm_maf_1_9 /end AXIS_DESCR
/end CHARACTERISTIC
/begin AXIS_PTS ldp_tco__maf_min_knk "" 0x6189f TCO _REC_AXS_20_u1 190.5 _CNV_A_R_LINEAR_____22_CM 4 -48. 142.5 FORMAT "%3.0" /end AXIS_PTS
/begin AXIS_PTS ldpm_maf_iga_ad "" 0x61b9e MAF_KNK _REC_AXS_20_u1 1389. _CNV_A_R_LINEAR_____51_CM 6 0. 1389. FORMAT "%7.2" /end AXIS_PTS
/begin AXIS_PTS ldpm_maf_knkwb "" 0x61bc0 MAF_KNK _REC_AXS_20_u1 1389. _CNV_A_R_LINEAR_____51_CM 2 0. 1389. FORMAT "%4.0" /end AXIS_PTS
/begin AXIS_PTS ldpm_n_fil_frq_knk "" 0x61c97 N_KNK _REC_AXS_20_u1 8160. _CNV_A_R_LINEAR_____15_CM 4 0. 8160. FORMAT "%4.0" /end AXIS_PTS
/begin AXIS_PTS ldpm_n_iga_ad "" 0x61cbc N_KNK _REC_AXS_20_u1 8160. _CNV_A_R_LINEAR_____15_CM 10 0. 8160. FORMAT "%4.0" /end AXIS_PTS
/begin AXIS_PTS ldpm_n_knkwb "" 0x61cc7 N_KNK _REC_AXS_20_u1 8160. _CNV_A_R_LINEAR_____15_CM 10 0. 8160. FORMAT "%4.0" /end AXIS_PTS
/begin CHARACTERISTIC ID_CYCNR_FAC_TRA_KNK "Cycle counter during which the Load Dynamic Function stays active after triggering" CURVE 0x64fec _REC_CUR_20_u1_u1 255. _CNV_A_R_LINEAR_____13_CM 0. 255. FORMAT "%3.0"
 /begin AXIS_DESCR COM_AXIS N_KNK _CNV_A_R_LINEAR_____15_CM 4 0. 8160. FORMAT "%4.0" AXIS_PTS_REF ldpm_n_6_4 /end AXIS_DESCR
/end CHARACTERISTIC
/begin CHARACTERISTIC ID_FAC_THD_KNK_1 "Knock Factor Table Cyl. 2" MAP 0x650be _REC_MAP_20_u1_u1_u1 7.96875 _CNV_A_R_LINEAR_____118_CM 0. 7.96875 FORMAT "%4.2"
 /begin AXIS_DESCR COM_AXIS N_KNK _CNV_A_R_LINEAR_____15_CM 16 0. 8160. FORMAT "%4.0" AXIS_PTS_REF ldpm_n_2_9 /end AXIS_DESCR
 /begin AXIS_DESCR COM_AXIS MAF_KNK _CNV_A_R_LINEAR_____51_CM 4 0. 1389. FORMAT "%4.0" AXIS_PTS_REF ldpm_maf_1_9 /end AXIS_DESCR
/end CHARACTERISTIC
/begin CHARACTERISTIC ID_FAC_THD_KNK_2 "Knock Factor Table Cyl. 3" MAP 0x650fe _REC_MAP_20_u1_u1_u1 7.96875 _CNV_A_R_LINEAR_____118_CM 0. 7.96875 FORMAT "%4.2"
 /begin AXIS_DESCR COM_AXIS N_KNK _CNV_A_R_LINEAR_____15_CM 16 0. 8160. FORMAT "%4.0" AXIS_PTS_REF ldpm_n_2_9 /end AXIS_DESCR
 /begin AXIS_DESCR COM_AXIS MAF_KNK _CNV_A_R_LINEAR_____51_CM 4 0. 1389. FORMAT "%4.0" AXIS_PTS_REF ldpm_maf_1_9 /end AXIS_DESCR
/end CHARACTERISTIC
/begin CHARACTERISTIC ID_FAC_THD_KNK_3 "Knock Factor Table Cyl. 4" MAP 0x6513e _REC_MAP_20_u1_u1_u1 7.96875 _CNV_A_R_LINEAR_____118_CM 0. 7.96875 FORMAT "%4.2"
 /begin AXIS_DESCR COM_AXIS N_KNK _CNV_A_R_LINEAR_____15_CM 16 0. 8160. FORMAT "%4.0" AXIS_PTS_REF ldpm_n_2_9 /end AXIS_DESCR
 /begin AXIS_DESCR COM_AXIS MAF_KNK _CNV_A_R_LINEAR_____51_CM 4 0. 1389. FORMAT "%4.0" AXIS_PTS_REF ldpm_maf_1_9 /end AXIS_DESCR
/end CHARACTERISTIC
/begin CHARACTERISTIC ID_FIL_FRQ_KNK_1 "Knock Filter Frequency and Reference Filter Frequency Cyl.2" CURVE 0x65236 _REC_CUR_20_u1_u1 12. _CNV_S_9_RANGE_FIL__119_CM 0. 12.
 /begin AXIS_DESCR COM_AXIS N_KNK _CNV_A_R_LINEAR_____15_CM 4 0. 8160. FORMAT "%4.0" AXIS_PTS_REF ldpm_n_fil_frq_knk /end AXIS_DESCR
/end CHARACTERISTIC
/begin CHARACTERISTIC ID_FIL_FRQ_KNK_2 "Knock Filter Frequency and Reference Filter Frequency Cyl.3" CURVE 0x6523a _REC_CUR_20_u1_u1 12. _CNV_S_9_RANGE_FIL__119_CM 0. 12.
 /begin AXIS_DESCR COM_AXIS N_KNK _CNV_A_R_LINEAR_____15_CM 4 0. 8160. FORMAT "%4.0" AXIS_PTS_REF ldpm_n_fil_frq_knk /end AXIS_DESCR
/end CHARACTERISTIC
/begin CHARACTERISTIC ID_FIL_FRQ_KNK_3 "Knock Filter Frequency and Reference Filter Frequency Cyl.4" CURVE 0x6523e _REC_CUR_20_u1_u1 12. _CNV_S_9_RANGE_FIL__119_CM 0. 12.
 /begin AXIS_DESCR COM_AXIS N_KNK _CNV_A_R_LINEAR_____15_CM 4 0. 8160. FORMAT "%4.0" AXIS_PTS_REF ldpm_n_fil_frq_knk /end AXIS_DESCR
/end CHARACTERISTIC
/begin CHARACTERISTIC ID_IGA_AD1_KNK_SIZE "Table for the definition of the size and the LDP division of adaptation table circuit 1" MAP 0x653d7 _REC_MAP_20_u1_u1_u1 48. _CNV_A_R_LINEAR_____61_CM -48. 0. FORMAT "%6.2"
 /begin AXIS_DESCR COM_AXIS N_KNK _CNV_A_R_LINEAR_____15_CM 10 0. 8160. FORMAT "%4.0" AXIS_PTS_REF ldpm_n_iga_ad /end AXIS_DESCR
 /begin AXIS_DESCR COM_AXIS MAF_KNK _CNV_A_R_LINEAR_____51_CM 6 0. 1389. FORMAT "%7.2" AXIS_PTS_REF ldpm_maf_iga_ad /end AXIS_DESCR
/end CHARACTERISTIC
/begin CHARACTERISTIC ID_IGA_DEC_KNK_1 "Spark retard at recognised knocking, Intensity 1" CURVE 0x65413 _REC_CUR_20_u1_u1 47.25 _CNV_A_R_LINEAR_____120_CM 0.375 47.625 FORMAT "%4.1"
 /begin AXIS_DESCR COM_AXIS N_KNK _CNV_A_R_LINEAR_____15_CM 3 0. 8160. FORMAT "%4.0" AXIS_PTS_REF ldpm_n_4_9 /end AXIS_DESCR
/end CHARACTERISTIC
/begin CHARACTERISTIC ID_IGA_DEC_KNK_2 "Spark retard at recognised knocking, Intensity 2" CURVE 0x65416 _REC_CUR_20_u1_u1 47.25 _CNV_A_R_LINEAR_____120_CM 0.375 47.625 FORMAT "%4.1"
 /begin AXIS_DESCR COM_AXIS N_KNK _CNV_A_R_LINEAR_____15_CM 3 0. 8160. FORMAT "%4.0" AXIS_PTS_REF ldpm_n_4_9 /end AXIS_DESCR
/end CHARACTERISTIC
/begin CHARACTERISTIC ID_IGA_TPS_GRD_TRA_KNK "" CURVE 0x6542a _REC_CUR_20_u1_u1 2987.5 _CNV_A_R_LINEAR_____81_CM 0. 2987.5 FORMAT "%6.1"
 /begin AXIS_DESCR COM_AXIS N_32 _CNV_A_R_LINEAR_____15_CM 4 0. 8160. FORMAT "%4.0" AXIS_PTS_REF ldpm_n_17 /end AXIS_DESCR
/end CHARACTERISTIC
/begin CHARACTERISTIC ID_KNK_THD_ADD "Knock summand" CURVE 0x6542e _REC_CUR_20_s1_u1 5.0999999 _CNV_A_R_LINEAR_____121_CM -2.55999994 2.53999996 FORMAT "%4.2"
 /begin AXIS_DESCR COM_AXIS N_KNK _CNV_A_R_LINEAR_____15_CM 16 0. 8160. FORMAT "%4.0" AXIS_PTS_REF ldpm_n_2_9 /end AXIS_DESCR
/end CHARACTERISTIC
/begin CHARACTERISTIC ID_KNKWB_1 "Beginning of Measurement Window Cyl.2" MAP 0x65452 _REC_MAP_20_u1_u1_u1 102. _CNV_A_R_LINEAR_____122_CM 6. 108. FORMAT "%3.0"
 /begin AXIS_DESCR COM_AXIS N_KNK _CNV_A_R_LINEAR_____15_CM 10 0. 8160. FORMAT "%4.0" AXIS_PTS_REF ldpm_n_knkwb /end AXIS_DESCR
 /begin AXIS_DESCR COM_AXIS MAF_KNK _CNV_A_R_LINEAR_____51_CM 2 0. 1389. FORMAT "%4.0" AXIS_PTS_REF ldpm_maf_knkwb /end AXIS_DESCR
/end CHARACTERISTIC
/begin CHARACTERISTIC ID_KNKWB_2 "Beginning of Measurement Window Cyl.3" MAP 0x65466 _REC_MAP_20_u1_u1_u1 102. _CNV_A_R_LINEAR_____122_CM 6. 108. FORMAT "%3.0"
 /begin AXIS_DESCR COM_AXIS N_KNK _CNV_A_R_LINEAR_____15_CM 10 0. 8160. FORMAT "%4.0" AXIS_PTS_REF ldpm_n_knkwb /end AXIS_DESCR
 /begin AXIS_DESCR COM_AXIS MAF_KNK _CNV_A_R_LINEAR_____51_CM 2 0. 1389. FORMAT "%4.0" AXIS_PTS_REF ldpm_maf_knkwb /end AXIS_DESCR
/end CHARACTERISTIC
/begin CHARACTERISTIC ID_KNKWB_3 "Beginning of Measurement Window Cyl.4" MAP 0x6547a _REC_MAP_20_u1_u1_u1 102. _CNV_A_R_LINEAR_____122_CM 6. 108. FORMAT "%3.0"
 /begin AXIS_DESCR COM_AXIS N_KNK _CNV_A_R_LINEAR_____15_CM 10 0. 8160. FORMAT "%4.0" AXIS_PTS_REF ldpm_n_knkwb /end AXIS_DESCR
 /begin AXIS_DESCR COM_AXIS MAF_KNK _CNV_A_R_LINEAR_____51_CM 2 0. 1389. FORMAT "%4.0" AXIS_PTS_REF ldpm_maf_knkwb /end AXIS_DESCR
/end CHARACTERISTIC
/begin CHARACTERISTIC ID_KNKWE_0 "End of Measurement Window Cyl.1" MAP 0x654b6 _REC_MAP_20_u1_u1_u1 108. _CNV_A_R_LINEAR_____122_CM 6. 114. FORMAT "%3.0"
 /begin AXIS_DESCR COM_AXIS N_KNK _CNV_A_R_LINEAR_____15_CM 10 0. 8160. FORMAT "%4.0" AXIS_PTS_REF ldpm_n_knkwb /end AXIS_DESCR
 /begin AXIS_DESCR COM_AXIS MAF_KNK _CNV_A_R_LINEAR_____51_CM 2 0. 1389. FORMAT "%4.0" AXIS_PTS_REF ldpm_maf_knkwb /end AXIS_DESCR
/end CHARACTERISTIC
/begin CHARACTERISTIC ID_KNKWE_1 "End of Measurement Window Cyl.2" MAP 0x654ca _REC_MAP_20_u1_u1_u1 108. _CNV_A_R_LINEAR_____122_CM 6. 114. FORMAT "%3.0"
 /begin AXIS_DESCR COM_AXIS N_KNK _CNV_A_R_LINEAR_____15_CM 10 0. 8160. FORMAT "%4.0" AXIS_PTS_REF ldpm_n_knkwb /end AXIS_DESCR
 /begin AXIS_DESCR COM_AXIS MAF_KNK _CNV_A_R_LINEAR_____51_CM 2 0. 1389. FORMAT "%4.0" AXIS_PTS_REF ldpm_maf_knkwb /end AXIS_DESCR
/end CHARACTERISTIC
/begin CHARACTERISTIC ID_KNKWE_2 "End of Measurement Window Cyl.3" MAP 0x654de _REC_MAP_20_u1_u1_u1 108. _CNV_A_R_LINEAR_____122_CM 6. 114. FORMAT "%3.0"
 /begin AXIS_DESCR COM_AXIS N_KNK _CNV_A_R_LINEAR_____15_CM 10 0. 8160. FORMAT "%4.0" AXIS_PTS_REF ldpm_n_knkwb /end AXIS_DESCR
 /begin AXIS_DESCR COM_AXIS MAF_KNK _CNV_A_R_LINEAR_____51_CM 2 0. 1389. FORMAT "%4.0" AXIS_PTS_REF ldpm_maf_knkwb /end AXIS_DESCR
/end CHARACTERISTIC
/begin CHARACTERISTIC ID_MAF_MIN_AD_KNK "Air-mass Threshold for Knock Adaptation" CURVE 0x6552e _REC_CUR_20_u1_u1 1389. _CNV_A_R_LINEAR_____51_CM 0. 1389. FORMAT "%4.0"
 /begin AXIS_DESCR COM_AXIS N_KNK _CNV_A_R_LINEAR_____15_CM 10 0. 8160. FORMAT "%4.0" AXIS_PTS_REF ldpm_n_iga_ad /end AXIS_DESCR
/end CHARACTERISTIC
/begin CHARACTERISTIC ID_N_GRD_MAX_KNK__N "Speed Gradient for dynamic identification" CURVE 0x657d4 _REC_CUR_20_u1_u1 4064. _CNV_A_R_LINEAR_____14_CM 0. 4064. FORMAT "%4.0"
 /begin AXIS_DESCR COM_AXIS N_KNK _CNV_A_R_LINEAR_____15_CM 10 0. 8160. FORMAT "%4.0" AXIS_PTS_REF ldpm_n_iga_ad /end AXIS_DESCR
/end CHARACTERISTIC
/begin CHARACTERISTIC IP_FAC_IGA_MAX_KNK "Weighting factor for the max. spark retard against coolant" CURVE 0x65bd4 _REC_CUR_20_u1_u1 0.9960940000000002 _CNV_A_R_LINEAR_____8_CM 0. 0.996094 FORMAT "%5.3"
 /begin AXIS_DESCR COM_AXIS TCO _CNV_A_R_LINEAR_____22_CM 8 -48. 142.5 FORMAT "%6.2" AXIS_PTS_REF ldp_tco__fac_iga_tco_knk /end AXIS_DESCR
/end CHARACTERISTIC
/begin CHARACTERISTIC IP_IGA_INC_KNK "Re-set Increment KNK" CURVE 0x65f5c _REC_CUR_20_u2_u1 47.99707032000001 _CNV_A_R_LINEAR_____123_CM 1.46484e-003 47.99853516 FORMAT "%8.5"
 /begin AXIS_DESCR COM_AXIS N_KNK _CNV_A_R_LINEAR_____15_CM 4 0. 8160. FORMAT "%4.0" AXIS_PTS_REF ldpm_n_fil_frq_knk /end AXIS_DESCR
/end CHARACTERISTIC
/begin MEASUREMENT IGA_AD1_KNK_0 "Actual adaptation value for Cyl. x (Adaptation circuit 1)" UBYTE _CNV_A_R_LINEAR_____61_CM 1 100. -48. 0. ECU_ADDRESS 0x3fc978 FORMAT "%5.1" /end MEASUREMENT
/begin MEASUREMENT IGA_AD1_KNK_1 "Actual adaptation value for Cyl. x (Adaptation circuit 1)" UBYTE _CNV_A_R_LINEAR_____61_CM 1 100. -48. 0. ECU_ADDRESS 0x3fc97a FORMAT "%5.1" /end MEASUREMENT
/begin MEASUREMENT IGA_AD1_KNK_2 "Actual adaptation value for Cyl. x (Adaptation circuit 1)" UBYTE _CNV_A_R_LINEAR_____61_CM 1 100. -48. 0. ECU_ADDRESS 0x3fc97c FORMAT "%5.1" /end MEASUREMENT
/begin MEASUREMENT IGA_AD1_KNK_3 "Actual adaptation value for Cyl. x (Adaptation circuit 1)" UBYTE _CNV_A_R_LINEAR_____61_CM 1 100. -48. 0. ECU_ADDRESS 0x3fc97e FORMAT "%5.1" /end MEASUREMENT
/begin MEASUREMENT IGA_AD1_KNK_4 "Actual adaptation value for Cyl. x (Adaptation circuit 1)" UBYTE _CNV_A_R_LINEAR_____61_CM 1 100. -48. 0. ECU_ADDRESS 0x3fc980 FORMAT "%5.1" /end MEASUREMENT
/begin MEASUREMENT IGA_AD1_KNK_5 "Actual adaptation value for Cyl. x (Adaptation circuit 1)" UBYTE _CNV_A_R_LINEAR_____61_CM 1 100. -48. 0. ECU_ADDRESS 0x3fc982 FORMAT "%5.1" /end MEASUREMENT
/begin MEASUREMENT IGA_AD2_KNK "Adaptation spark retard due to adaptation circuit 2" UBYTE _CNV_A_R_LINEAR_____61_CM 1 100. -48. 0. ECU_ADDRESS 0x3fd900 FORMAT "%4.1" /end MEASUREMENT
/begin MEASUREMENT IGA_KNK_0 "Spark retard through knock control without adaptation(cylinder individual)" UBYTE _CNV_A_R_LINEAR_____61_CM 1 100. -48. 0. ECU_ADDRESS 0x3fc984 FORMAT "%7.3" /end MEASUREMENT
/begin MEASUREMENT IGA_KNK_1 "Spark retard through knock control without adaptation(cylinder individual)" UBYTE _CNV_A_R_LINEAR_____61_CM 1 100. -48. 0. ECU_ADDRESS 0x3fc986 FORMAT "%7.3" /end MEASUREMENT
/begin MEASUREMENT IGA_KNK_2 "Spark retard through knock control without adaptation(cylinder individual)" UBYTE _CNV_A_R_LINEAR_____61_CM 1 100. -48. 0. ECU_ADDRESS 0x3fc988 FORMAT "%7.3" /end MEASUREMENT
/begin MEASUREMENT IGA_KNK_3 "Spark retard through knock control without adaptation(cylinder individual)" UBYTE _CNV_A_R_LINEAR_____61_CM 1 100. -48. 0. ECU_ADDRESS 0x3fc98a FORMAT "%7.3" /end MEASUREMENT
/begin MEASUREMENT IGA_KNK_4 "Spark retard through knock control without adaptation(cylinder individual)" UBYTE _CNV_A_R_LINEAR_____61_CM 1 100. -48. 0. ECU_ADDRESS 0x3fc98c FORMAT "%7.3" /end MEASUREMENT
/begin MEASUREMENT IGA_KNK_5 "Spark retard through knock control without adaptation(cylinder individual)" UBYTE _CNV_A_R_LINEAR_____61_CM 1 100. -48. 0. ECU_ADDRESS 0x3fc98e FORMAT "%7.3" /end MEASUREMENT
/begin MEASUREMENT KNK_THD_0 "Knock Threshold cylinder x" UBYTE _CNV_A_R_LINEAR_____40_CM 1 100. 0. 4.98046875 ECU_ADDRESS 0x3fd918 /end MEASUREMENT
/begin MEASUREMENT KNK_THD_1 "Knock Threshold cylinder x" UBYTE _CNV_A_R_LINEAR_____40_CM 1 100. 0. 4.98046875 ECU_ADDRESS 0x3fd919 FORMAT "%5.3" /end MEASUREMENT
/begin MEASUREMENT KNK_THD_2 "Knock Threshold cylinder x" UBYTE _CNV_A_R_LINEAR_____40_CM 1 100. 0. 4.98046875 ECU_ADDRESS 0x3fd91a FORMAT "%5.3" /end MEASUREMENT
/begin MEASUREMENT KNK_THD_3 "Knock Threshold cylinder x" UBYTE _CNV_A_R_LINEAR_____40_CM 1 100. 0. 4.98046875 ECU_ADDRESS 0x3fd91b FORMAT "%5.3" /end MEASUREMENT
/begin MEASUREMENT KNK_THD_4 "Knock Threshold cylinder x" UBYTE _CNV_A_R_LINEAR_____40_CM 1 100. 0. 4.98046875 ECU_ADDRESS 0x3fd91c /end MEASUREMENT
/begin MEASUREMENT KNK_THD_5 "Knock Threshold cylinder x" UBYTE _CNV_A_R_LINEAR_____40_CM 1 100. 0. 4.98046875 ECU_ADDRESS 0x3fd91d /end MEASUREMENT
/begin MEASUREMENT KNKS_0 "" UWORD _CNV_A_R_LINEAR_____99_CM 1 100. 0. 4.99992371 ECU_ADDRESS 0x3fd318 FORMAT "%7.5" /end MEASUREMENT
/begin MEASUREMENT KNKS_1 "" UWORD _CNV_A_R_LINEAR_____99_CM 1 100. 0. 4.99992371 ECU_ADDRESS 0x3fd31a FORMAT "%7.5" /end MEASUREMENT
/begin MEASUREMENT KNKS_2 "" UWORD _CNV_A_R_LINEAR_____99_CM 1 100. 0. 4.99992371 ECU_ADDRESS 0x3fd31c FORMAT "%7.5" /end MEASUREMENT
/begin MEASUREMENT KNKS_3 "" UWORD _CNV_A_R_LINEAR_____99_CM 1 100. 0. 4.99992371 ECU_ADDRESS 0x3fd31e FORMAT "%7.5" /end MEASUREMENT
/begin MEASUREMENT KNKS_4 "" UWORD _CNV_A_R_LINEAR_____99_CM 1 100. 0. 4.99992371 ECU_ADDRESS 0x3fd320 FORMAT "%7.5" /end MEASUREMENT
/begin MEASUREMENT KNKS_5 "" UWORD _CNV_A_R_LINEAR_____99_CM 1 100. 0. 4.99992371 ECU_ADDRESS 0x3fd322 FORMAT "%7.5" /end MEASUREMENT
/begin MEASUREMENT KNKS_CMD_FIL_0 "Knock Filter Frequency and Reference Filter Frequency Cyl.x" UBYTE _CNV_S_9_RANGE_FIL__119_CM 1 100. 0. 12. ECU_ADDRESS 0x3fd8e2 /end MEASUREMENT
/begin MEASUREMENT KNKS_CMD_FIL_1 "Knock Filter Frequency and Reference Filter Frequency Cyl.x" UBYTE _CNV_S_9_RANGE_FIL__119_CM 1 100. 0. 12. ECU_ADDRESS 0x3fd8e3 /end MEASUREMENT
/begin MEASUREMENT KNKS_CMD_FIL_2 "Knock Filter Frequency and Reference Filter Frequency Cyl.x" UBYTE _CNV_S_9_RANGE_FIL__119_CM 1 100. 0. 12. ECU_ADDRESS 0x3fd8e4 /end MEASUREMENT
/begin MEASUREMENT KNKS_CMD_FIL_3 "Knock Filter Frequency and Reference Filter Frequency Cyl.x" UBYTE _CNV_S_9_RANGE_FIL__119_CM 1 100. 0. 12. ECU_ADDRESS 0x3fd8e5 /end MEASUREMENT
/begin MEASUREMENT KNKS_CMD_FIL_4 "Knock Filter Frequency and Reference Filter Frequency Cyl.x" UBYTE _CNV_S_9_RANGE_FIL__119_CM 1 100. 0. 12. ECU_ADDRESS 0x3fd8e6 /end MEASUREMENT
/begin MEASUREMENT KNKS_CMD_FIL_5 "Knock Filter Frequency and Reference Filter Frequency Cyl.x" UBYTE _CNV_S_9_RANGE_FIL__119_CM 1 100. 0. 12. ECU_ADDRESS 0x3fd8e7 /end MEASUREMENT
/begin MEASUREMENT KNKS_CMD_GAIN_0 "Amplification precontrol Cyl.x" UBYTE _CNV_S_7_RANGE_GAIN_124_R_CM 1 100. 0. 7. ECU_ADDRESS 0x3fd8e8 /end MEASUREMENT
/begin MEASUREMENT KNKS_CMD_GAIN_1 "Amplification precontrol Cyl.x" UBYTE _CNV_S_7_RANGE_GAIN_124_R_CM 1 100. 0. 7. ECU_ADDRESS 0x3fd8e9 /end MEASUREMENT
/begin MEASUREMENT KNKS_CMD_GAIN_2 "Amplification precontrol Cyl.x" UBYTE _CNV_S_7_RANGE_GAIN_124_R_CM 1 100. 0. 7. ECU_ADDRESS 0x3fd8ea /end MEASUREMENT
/begin MEASUREMENT KNKS_CMD_GAIN_3 "Amplification precontrol Cyl.x" UBYTE _CNV_S_7_RANGE_GAIN_124_R_CM 1 100. 0. 7. ECU_ADDRESS 0x3fd8eb /end MEASUREMENT
/begin MEASUREMENT KNKS_CMD_GAIN_4 "Amplification precontrol Cyl.x" UBYTE _CNV_S_7_RANGE_GAIN_124_R_CM 1 100. 0. 7. ECU_ADDRESS 0x3fd8ec /end MEASUREMENT
/begin MEASUREMENT KNKS_CMD_GAIN_5 "Amplification precontrol Cyl.x" UBYTE _CNV_S_7_RANGE_GAIN_124_R_CM 1 100. 0. 7. ECU_ADDRESS 0x3fd8ed /end MEASUREMENT
/begin MEASUREMENT KNKWB_0 "Beginning of Measurement Window Cyl.x" UBYTE _CNV_A_R_LINEAR_____125_CM 1 100. 6. 108. ECU_ADDRESS 0x3fd8ee FORMAT "%2.0" /end MEASUREMENT
/begin MEASUREMENT KNKWB_1 "Beginning of Measurement Window Cyl.x" UBYTE _CNV_A_R_LINEAR_____126_CM 1 100. 6. 108. ECU_ADDRESS 0x3fd8ef FORMAT "%2.0" /end MEASUREMENT
/begin MEASUREMENT KNKWB_2 "Beginning of Measurement Window Cyl.x" UBYTE _CNV_A_R_LINEAR_____127_CM 1 100. 6. 108. ECU_ADDRESS 0x3fd8f0 FORMAT "%2.0" /end MEASUREMENT
/begin MEASUREMENT KNKWB_3 "Beginning of Measurement Window Cyl.x" UBYTE _CNV_A_R_LINEAR_____128_CM 1 100. 6. 108. ECU_ADDRESS 0x3fd8f1 FORMAT "%2.0" /end MEASUREMENT
/begin MEASUREMENT KNKWB_4 "Beginning of Measurement Window Cyl.x" UBYTE _CNV_A_R_LINEAR_____129_CM 1 100. 6. 108. ECU_ADDRESS 0x3fd8f2 FORMAT "%2.0" /end MEASUREMENT
/begin MEASUREMENT KNKWB_5 "Beginning of Measurement Window Cyl.x" UBYTE _CNV_A_R_LINEAR_____130_CM 1 100. 6. 108. ECU_ADDRESS 0x3fd8f3 FORMAT "%2.0" /end MEASUREMENT
/begin MEASUREMENT KNKWE_0 "End of Measurement Window Cyl.x" UBYTE _CNV_A_R_LINEAR_____125_CM 1 100. 6. 114. ECU_ADDRESS 0x3fd8f4 FORMAT "%2.0" /end MEASUREMENT
/begin MEASUREMENT KNKWE_1 "End of Measurement Window Cyl.x" UBYTE _CNV_A_R_LINEAR_____126_CM 1 100. 6. 114. ECU_ADDRESS 0x3fd8f5 FORMAT "%2.0" /end MEASUREMENT
/begin MEASUREMENT KNKWE_2 "End of Measurement Window Cyl.x" UBYTE _CNV_A_R_LINEAR_____127_CM 1 100. 6. 114. ECU_ADDRESS 0x3fd8f6 FORMAT "%2.0" /end MEASUREMENT
/begin MEASUREMENT KNKWE_3 "End of Measurement Window Cyl.x" UBYTE _CNV_A_R_LINEAR_____128_CM 1 100. 6. 114. ECU_ADDRESS 0x3fd8f7 FORMAT "%2.0" /end MEASUREMENT
/begin MEASUREMENT KNKWE_4 "End of Measurement Window Cyl.x" UBYTE _CNV_A_R_LINEAR_____129_CM 1 100. 6. 114. ECU_ADDRESS 0x3fd8f8 FORMAT "%2.0" /end MEASUREMENT
/begin MEASUREMENT KNKWE_5 "End of Measurement Window Cyl.x" UBYTE _CNV_A_R_LINEAR_____130_CM 1 100. 6. 114. ECU_ADDRESS 0x3fd8f9 FORMAT "%2.0" /end MEASUREMENT
/begin MEASUREMENT LV_KNK_AD1_ENA "Knock adaptation circuit 1 enabled" UBYTE _CNV_S_2_RANGE______76_CM 1 100. 0. 1. ECU_ADDRESS 0x3fd4d7 BIT_MASK 0x1 /end MEASUREMENT
/begin MEASUREMENT LV_KNK_AD2_ENA "Knock adaptation circuit 2 enabled" UBYTE _CNV_S_2_RANGE______76_CM 1 100. 0. 1. ECU_ADDRESS 0x3fd4d8 BIT_MASK 0x1 /end MEASUREMENT
/begin MEASUREMENT LV_KNK_CTL_ENA "Boolean for knock control enabled" UBYTE _CNV_S_2_RANGE______76_CM 1 100. 0. 1. ECU_ADDRESS 0x3fd4d9 BIT_MASK 0x1 /end MEASUREMENT
/begin MEASUREMENT LV_KNK_TRA_MAF "Logical variable for Load Dynamic Function active or passive" UBYTE _CNV_S_2_RANGE______76_CM 1 100. 0. 1. ECU_ADDRESS 0x3fd4d6 BIT_MASK 0x1 /end MEASUREMENT
/begin MEASUREMENT MAF_KNK "Mass air flow with hysteresis" UBYTE _CNV_A_R_LINEAR_____51_CM 1 100. 0. 1389. ECU_ADDRESS 0x3fd90d FORMAT "%7.2" /end MEASUREMENT
/begin MEASUREMENT N_KNK "Engine speed with hysteresis" UBYTE _CNV_A_R_LINEAR_____15_CM 1 100. 0. 8160. ECU_ADDRESS 0x3fd91e FORMAT "%4.0" /end MEASUREMENT
/begin MEASUREMENT NL_0 "Floating mean value of the noise signal" UWORD _CNV_A_R_LINEAR_____99_CM 1 100. 0. 4.99992371 ECU_ADDRESS 0x3fc96c FORMAT "%7.5" /end MEASUREMENT
/begin MEASUREMENT NL_1 "Floating mean value of the noise signal" UWORD _CNV_A_R_LINEAR_____99_CM 1 100. 0. 4.99992371 ECU_ADDRESS 0x3fc96e FORMAT "%7.5" /end MEASUREMENT
/begin MEASUREMENT NL_2 "Floating mean value of the noise signal" UWORD _CNV_A_R_LINEAR_____99_CM 1 100. 0. 4.99992371 ECU_ADDRESS 0x3fc970 FORMAT "%7.5" /end MEASUREMENT
/begin MEASUREMENT NL_3 "Floating mean value of the noise signal" UWORD _CNV_A_R_LINEAR_____99_CM 1 100. 0. 4.99992371 ECU_ADDRESS 0x3fc972 FORMAT "%7.5" /end MEASUREMENT
/begin MEASUREMENT NL_4 "Floating mean value of the noise signal" UWORD _CNV_A_R_LINEAR_____99_CM 1 100. 0. 4.99992371 ECU_ADDRESS 0x3fc974 FORMAT "%7.5" /end MEASUREMENT
/begin MEASUREMENT NL_5 "Floating mean value of the noise signal" UWORD _CNV_A_R_LINEAR_____99_CM 1 100. 0. 4.99992371 ECU_ADDRESS 0x3fc976 FORMAT "%7.5" /end MEASUREMENT
/begin CHARACTERISTIC C_CYCNR_AD2_INC_KNK "Cycle counter for adjustment into advance direction" VALUE 0x67b6e _REC_VAL_20_u2 65535. _CNV_A_R_LINEAR_____4_CM 0. 65535. FORMAT "%5.0" /end CHARACTERISTIC
/begin CHARACTERISTIC C_FAC_TRA_KNK "correction factor for load dynamic active" VALUE 0x67b95 _REC_VAL_20_u1 6.96875 _CNV_A_R_LINEAR_____118_CM 1. 7.96875 FORMAT "%5.3" /end CHARACTERISTIC
/begin CHARACTERISTIC C_IGA_AD1_FAC_DEC_KNK "Factor to control the speed of knock adaptation circuit 1 in retard direction" VALUE 0x67bb3 _REC_VAL_20_u1 0.9960940000000002 _CNV_A_R_LINEAR_____8_CM 0. 0.996094 FORMAT "%5.3" /end CHARACTERISTIC
/begin CHARACTERISTIC C_IGA_AD1_FAC_FAST_KNK "factor for fast knock adaptation" VALUE 0x67bb4 _REC_VAL_20_u1 3.984375 _CNV_A_R_LINEAR_____131_CM 0. 3.984375 FORMAT "%5.3" /end CHARACTERISTIC
/begin CHARACTERISTIC C_IGA_AD1_FAC_INC_KNK "Factor to control the speed of knock adaptation circuit 1 in advance direction" VALUE 0x67bb5 _REC_VAL_20_u1 0.9960940000000002 _CNV_A_R_LINEAR_____8_CM 0. 0.996094 FORMAT "%5.3" /end CHARACTERISTIC
/begin CHARACTERISTIC C_IGA_AD1_INC_KNK "Increment of adapted retardation values during post operating phase" VALUE 0x67bb6 _REC_VAL_20_u1 48. _CNV_A_R_LINEAR_____6_CM 0. 48. FORMAT "%4.1" /end CHARACTERISTIC
/begin CHARACTERISTIC C_IGA_AD1_LGRD_NEG_KNK "Change limitation in retard direction for adaptation circuit 1 while crossing from one operating point to another" VALUE 0x67bb7 _REC_VAL_20_u1 11.90625 _CNV_A_R_LINEAR_____132_CM 9.375e-002 12. /end CHARACTERISTIC
/begin CHARACTERISTIC C_IGA_AD1_LGRD_POS_KNK "Change limitation in advance direction for adaptation circuit 1 while crossing from one operating point to another" VALUE 0x67bb8 _REC_VAL_20_u1 11.90625 _CNV_A_R_LINEAR_____132_CM 9.375e-002 12. /end CHARACTERISTIC
/begin CHARACTERISTIC C_IGA_AD1_THD_DEC_KNK "" VALUE 0x67bb9 _REC_VAL_20_s1 24. _CNV_A_R_LINEAR_____6_CM -12. 12. FORMAT "%3.1" /end CHARACTERISTIC
/begin CHARACTERISTIC C_IGA_AD1_THD_FAST_KNK "" VALUE 0x67bba _REC_VAL_20_u1 23.625 _CNV_A_R_LINEAR_____6_CM 0.375 24. FORMAT "%3.1" /end CHARACTERISTIC
/begin CHARACTERISTIC C_IGA_AD1_THD_INC_KNK "" VALUE 0x67bbb _REC_VAL_20_u1 23.625 _CNV_A_R_LINEAR_____61_CM -24. -0.375 FORMAT "%3.1" /end CHARACTERISTIC
/begin CHARACTERISTIC C_IGA_AD2_MAX_KNK "maximum threshold of IGA_AD2_KNK in retard direction" VALUE 0x67bbc _REC_VAL_20_u1 48. _CNV_A_R_LINEAR_____61_CM -48. 0. FORMAT "%4.1" /end CHARACTERISTIC
/begin CHARACTERISTIC C_IGA_AD2_THD_DEC_KNK "Threshold for adjustment of adaptive ignition angle into retard direction" VALUE 0x67bbd _REC_VAL_20_u1 48. _CNV_A_R_LINEAR_____61_CM -48. 0. FORMAT "%4.1" /end CHARACTERISTIC
/begin CHARACTERISTIC C_IGA_AD2_THD_INC_KNK "Threshold for adjustment of adaptive ignition angle into advance direction" VALUE 0x67bbe _REC_VAL_20_u1 48. _CNV_A_R_LINEAR_____61_CM -48. 0. FORMAT "%4.1" /end CHARACTERISTIC
/begin CHARACTERISTIC C_IGA_DIF_MIN_MAX_KNK "Control excursion limit valid for spark advance and spark retard " VALUE 0x67bbf _REC_VAL_20_u1 48. _CNV_A_R_LINEAR_____6_CM 0. 48. FORMAT "%4.1" /end CHARACTERISTIC
/begin CHARACTERISTIC C_IGA_LGRD_3 "gradient limitation when  underspending knock load threshold" VALUE 0x67bc2 _REC_VAL_20_u2 47.625 _CNV_A_R_LINEAR_____133_CM 0.375 48. /end CHARACTERISTIC
/begin CHARACTERISTIC C_KNK_THD_MAX "Maximum knock threshold" VALUE 0x67bc4 _REC_VAL_20_u1 4.98046875 _CNV_A_R_LINEAR_____40_CM 0. 4.98046875 FORMAT "%4.2" /end CHARACTERISTIC
/begin CHARACTERISTIC C_MAF_IGA_HYS_KNK "Air-Mass Hysteresis for Knock Control" VALUE 0x67bda _REC_VAL_20_u1 1389. _CNV_A_R_LINEAR_____51_CM 0. 1389. FORMAT "%4.0" /end CHARACTERISTIC
/begin CHARACTERISTIC C_N_IGA_HYS_KNK "Speed Hysteresis for Knock Control" VALUE 0x67c12 _REC_VAL_20_u1 8160. _CNV_A_R_LINEAR_____15_CM 0. 8160. FORMAT "%4.0" /end CHARACTERISTIC
/begin CHARACTERISTIC C_NL_CRLC "Averaging Constant for Noise Value Calculation" VALUE 0x67c28 _REC_VAL_20_u1 0.9960940000000002 _CNV_A_R_LINEAR_____8_CM 0. 0.996094 FORMAT "%5.3" /end CHARACTERISTIC
/begin CHARACTERISTIC C_NL_CRLC_TRA "Averaging Constant for Noise Value Calculation for Transient Case" VALUE 0x67c29 _REC_VAL_20_u1 0.9960940000000002 _CNV_A_R_LINEAR_____8_CM 0. 0.996094 FORMAT "%5.3" /end CHARACTERISTIC
/begin CHARACTERISTIC C_NL_MIN "Minimum noise value" VALUE 0x67c2a _REC_VAL_20_u1 4.98046875 _CNV_A_R_LINEAR_____40_CM 0. 4.98046875 FORMAT "%5.3" /end CHARACTERISTIC
/begin CHARACTERISTIC C_SWI_AD_KNK "calculation of adaptation circuit 1 and 2 enabled" VALUE 0x67c3c _REC_VAL_20_u1 1. _CNV_A_R_LINEAR_____17_CM 0. 1. FORMAT "%2.0" /end CHARACTERISTIC
/begin CHARACTERISTIC C_TCO_MAX_AD2_KNK "" VALUE 0x67ca3 _REC_VAL_20_u1 190.5 _CNV_A_R_LINEAR_____22_CM -48. 142.5 FORMAT "%3.0" /end CHARACTERISTIC
/begin CHARACTERISTIC C_TCO_MIN_AD2_KNK "" VALUE 0x67ca8 _REC_VAL_20_u1 190.5 _CNV_A_R_LINEAR_____22_CM -48. 142.5 FORMAT "%3.0" /end CHARACTERISTIC
/begin MEASUREMENT IGA_REF_VVT_COR "additive valve timing correction of IGA_REF" SBYTE _CNV_A_R_LINEAR_____6_CM 1 100. -48. 47.625 ECU_ADDRESS 0x3fd88e FORMAT "%5.1" /end MEASUREMENT
/begin MEASUREMENT IGA_REF_EGR_COR "additive EGR correction of IGA_REF" SBYTE _CNV_A_R_LINEAR_____6_CM 1 100. -48. 47.625 ECU_ADDRESS 0x3fd88f FORMAT "%5.1" /end MEASUREMENT
/begin AXIS_PTS ldp_n_iga_ref_temp "" 0x6178e N_32 _REC_AXS_20_u1 8160. _CNV_A_R_LINEAR_____15_CM 8 0. 8160. FORMAT "%4.0" /end AXIS_PTS
/begin AXIS_PTS ldp_maf_iga_ref_temp "" 0x615fb MAF _REC_AXS_20_u1 1389. _CNV_A_R_LINEAR_____51_CM 6 0. 1389. FORMAT "%4.0" /end AXIS_PTS
/begin CHARACTERISTIC IP_IGA_REF_TEMP__N__MAF "Max. reference ignition angle adjustment due to temperature influence" MAP 0x660d2 _REC_MAP_20_u1_u1_u1 95.625 _CNV_A_R_LINEAR_____61_CM -48. 47.625 FORMAT "%5.1"
 /begin AXIS_DESCR COM_AXIS N_32 _CNV_A_R_LINEAR_____15_CM 8 0. 8160. FORMAT "%4.0" AXIS_PTS_REF ldp_n_iga_ref_temp /end AXIS_DESCR
 /begin AXIS_DESCR COM_AXIS MAF _CNV_A_R_LINEAR_____51_CM 6 0. 1389. FORMAT "%4.0" AXIS_PTS_REF ldp_maf_iga_ref_temp /end AXIS_DESCR
/end CHARACTERISTIC
/begin CHARACTERISTIC IP_IGA_REF_VVT__N__MAF "basis for additive valve timing correction of IGA_REF" MAP 0x66126 _REC_MAP_20_u1_u1_u1 95.625 _CNV_A_R_LINEAR_____61_CM -48. 47.625 FORMAT "%5.1"
 /begin AXIS_DESCR COM_AXIS N_32 _CNV_A_R_LINEAR_____15_CM 16 0. 8160. FORMAT "%4.0" AXIS_PTS_REF ldp_n__iga_ref_vvt /end AXIS_DESCR
 /begin AXIS_DESCR COM_AXIS MAF _CNV_A_R_LINEAR_____51_CM 12 0. 1389. FORMAT "%4.0" AXIS_PTS_REF ldp_maf__iga_ref_vvt /end AXIS_DESCR
/end CHARACTERISTIC
/begin AXIS_PTS ldp_tia__iga_ref_temp_fac "" 0x6192f TIA _REC_AXS_20_u1 190.5 _CNV_A_R_LINEAR_____22_CM 6 -48. 142.5 FORMAT "%5.1" /end AXIS_PTS
/begin CHARACTERISTIC IP_IGA_REF_TEMP_FAC "Correction factor for reference IGA temperature correction" MAP 0x66102 _REC_MAP_20_u1_u1_u1 0.99610001 _CNV_A_R_LINEAR_____68_CM 0. 0.99610001 FORMAT "%5.3"
 /begin AXIS_DESCR COM_AXIS TIA _CNV_A_R_LINEAR_____22_CM 6 -48. 142.5 FORMAT "%5.1" AXIS_PTS_REF ldp_tia__iga_ref_temp_fac /end AXIS_DESCR
 /begin AXIS_DESCR COM_AXIS TCO _CNV_A_R_LINEAR_____22_CM 6 -48. 142.5 FORMAT "%5.1" AXIS_PTS_REF ldp_tco__iga_ref_temp_fac /end AXIS_DESCR
/end CHARACTERISTIC
/begin AXIS_PTS ldp_n__iga_ref_vvt "" 0x61683 N_32 _REC_AXS_20_u1 8160. _CNV_A_R_LINEAR_____15_CM 16 0. 8160. FORMAT "%4.0" /end AXIS_PTS
/begin AXIS_PTS ldp_maf__iga_ref_vvt "" 0x615bb MAF _REC_AXS_20_u1 1389. _CNV_A_R_LINEAR_____51_CM 12 0. 1389. FORMAT "%4.0" /end AXIS_PTS
/begin AXIS_PTS ldpm_maf_ip_egr_ratio "" 0x61ba6 MAF _REC_AXS_20_u2 1389. _CNV_A_R_LINEAR_____56_CM 12 0. 1389. FORMAT "%7.2" /end AXIS_PTS
/begin CHARACTERISTIC IP_IGA_REF_EGR_FAC "factor for EGR correction of IGA_REF" MAP 0x6603a _REC_MAP_20_u1_u1_u2 1.9921875 _CNV_A_R_LINEAR_____67_CM 0. 1.9921875 FORMAT "%5.3"
 /begin AXIS_DESCR COM_AXIS N_32 _CNV_A_R_LINEAR_____15_CM 12 0. 8160. FORMAT "%4.0" AXIS_PTS_REF ldpm_n_32_ip_egr_ratio /end AXIS_DESCR
 /begin AXIS_DESCR COM_AXIS MAF _CNV_A_R_LINEAR_____56_CM 12 0. 1389. FORMAT "%7.2" AXIS_PTS_REF ldpm_maf_ip_egr_ratio /end AXIS_DESCR
/end CHARACTERISTIC
/begin AXIS_PTS ldpm_n_17 "" 0x61bf6 N_32 _REC_AXS_20_u1 8160. _CNV_A_R_LINEAR_____15_CM 4 0. 8160. FORMAT "%4.0" /end AXIS_PTS
/begin MEASUREMENT IGA_BAS_COR_KNK_ADD "Basic corrected ignition angle knock  mean value IGA_MV_ADJ_KNK included" UBYTE _CNV_A_R_LINEAR_____11_CM 1 100. -23.625 72. ECU_ADDRESS 0x3fd875 FORMAT "%5.1" /end MEASUREMENT
/begin AXIS_PTS ldp_tco__fac_iga_tco_knk "" 0x61854 TCO _REC_AXS_20_u1 190.5 _CNV_A_R_LINEAR_____22_CM 8 -48. 142.5 FORMAT "%6.2" /end AXIS_PTS
/begin MEASUREMENT IGA_BAS_TEMP_COR "additive temperature correction of IGA_BAS_IVVT" SBYTE _CNV_A_R_LINEAR_____6_CM 1 100. -48. 47.625 ECU_ADDRESS 0x3fd87c FORMAT "%5.1" /end MEASUREMENT
/begin MEASUREMENT IGA_BAS_LAMB_COR "additive LAMBDA correction of IGA_BAS_IVVT" SBYTE _CNV_A_R_LINEAR_____6_CM 1 100. -48. 47.625 ECU_ADDRESS 0x3fd87e FORMAT "%5.1" /end MEASUREMENT
/begin AXIS_PTS ldp_lamb_sp__iga_bas_lamb "" 0x61590 LAMB_SP _REC_AXS_20_u2 31.99902344 _CNV_A_R_LINEAR_____50_CM 8 0. 31.99902344 FORMAT "%7.4" /end AXIS_PTS
/begin CHARACTERISTIC IP_IGA_BAS_LAMB_LAMB_SP "additive lambda setpoint correction of IGA_BAS" CURVE 0x65ea0 _REC_CUR_20_u1_u2 4.78125 _CNV_A_R_LINEAR_____61_CM -48. 47.625 FORMAT "%5.1"
 /begin AXIS_DESCR COM_AXIS LAMB_SP _CNV_A_R_LINEAR_____50_CM 8 0. 31.99902344 FORMAT "%7.4" AXIS_PTS_REF ldp_lamb_sp__iga_bas_lamb /end AXIS_DESCR
/end CHARACTERISTIC
/begin AXIS_PTS ldpm_n_st "" 0x61cd2 N_32 _REC_AXS_20_u2 8160. _CNV_A_R_LINEAR_____0_CM 8 0. 8160. FORMAT "%4.0" /end AXIS_PTS
/begin AXIS_PTS ldpm_n_h_prs_st "" 0x61c9c N_32 _REC_AXS_20_u2 8160. _CNV_A_R_LINEAR_____0_CM 8 0. 8160. FORMAT "%4.0" /end AXIS_PTS
/begin AXIS_PTS ldpm_tco_h_prs "" 0x61d39 TCO _REC_AXS_20_u1 190.5 _CNV_A_R_LINEAR_____22_CM 6 -48. 142.5 FORMAT "%5.1" /end AXIS_PTS
/begin CHARACTERISTIC IP_IGA_ST "Basic ignition angle at start" MAP 0x661e6 _REC_MAP_20_u1_u2_u1 4.78125 _CNV_A_R_LINEAR_____11_CM -23.625 72. FORMAT "%5.1"
 /begin AXIS_DESCR COM_AXIS N_32 _CNV_A_R_LINEAR_____0_CM 8 0. 8160. FORMAT "%4.0" AXIS_PTS_REF ldpm_n_st /end AXIS_DESCR
 /begin AXIS_DESCR COM_AXIS TCO _CNV_A_R_LINEAR_____22_CM 6 -48. 142.5 FORMAT "%5.1" AXIS_PTS_REF ldpm_tco_1 /end AXIS_DESCR
/end CHARACTERISTIC
/begin CHARACTERISTIC IP_IGA_ST_H_PRS "Basic ignition angle during high pressure start" MAP 0x66216 _REC_MAP_20_u1_u2_u1 4.78125 _CNV_A_R_LINEAR_____11_CM -23.625 72. FORMAT "%5.1"
 /begin AXIS_DESCR COM_AXIS N_32 _CNV_A_R_LINEAR_____0_CM 8 0. 8160. FORMAT "%4.0" AXIS_PTS_REF ldpm_n_h_prs_st /end AXIS_DESCR
 /begin AXIS_DESCR COM_AXIS TCO _CNV_A_R_LINEAR_____22_CM 6 -48. 142.5 FORMAT "%5.1" AXIS_PTS_REF ldpm_tco_h_prs /end AXIS_DESCR
/end CHARACTERISTIC
/begin AXIS_PTS ldpm_tco_9 "" 0x61d1d TCO _REC_AXS_20_u1 28.575 _CNV_A_R_LINEAR_____22_CM 9 -48. 142.5 FORMAT "%5.1" /end AXIS_PTS
/begin CHARACTERISTIC IP_IGA_REF_EGR "basis for EGR correection of IGA_REF" CURVE 0x66034 _REC_CUR_20_u1_u2 95.625 _CNV_A_R_LINEAR_____61_CM -48. 47.625 FORMAT "%5.1"
 /begin AXIS_DESCR COM_AXIS EGR_RATIO _CNV_A_R_LINEAR_____144_CM 6 0. 99.99847412 AXIS_PTS_REF ldp_egr_ratio_sp__iga_ref_egr /end AXIS_DESCR
/end CHARACTERISTIC
/begin AXIS_PTS ldp_eff_iga_sp_iga_dif_sp "" 0x614b8 EFF_IGA_SP _REC_AXS_20_u2 1.99996948 _CNV_A_R_LINEAR_____5_CM 16 0. 1.99996948 FORMAT "%7.5" /end AXIS_PTS
/begin AXIS_PTS ldp_egr_ratio_sp__iga_ref_egr "" 0x614da EGR_RATIO _REC_AXS_20_u2 99.99847412 _CNV_A_R_LINEAR_____144_CM 6 0. 99.99847412 /end AXIS_PTS
/begin CHARACTERISTIC ID_KNKWE_3 "End of Measurement Window Cyl.4" MAP 0x654f2 _REC_MAP_20_u1_u1_u1 108. _CNV_A_R_LINEAR_____122_CM 6. 114. FORMAT "%3.0"
 /begin AXIS_DESCR COM_AXIS N_KNK _CNV_A_R_LINEAR_____15_CM 10 0. 8160. FORMAT "%4.0" AXIS_PTS_REF ldpm_n_knkwb /end AXIS_DESCR
 /begin AXIS_DESCR COM_AXIS MAF_KNK _CNV_A_R_LINEAR_____51_CM 2 0. 1389. FORMAT "%4.0" AXIS_PTS_REF ldpm_maf_knkwb /end AXIS_DESCR
/end CHARACTERISTIC
/begin CHARACTERISTIC ID_KNKWE_5 "End of Measurement Window Cyl.6" MAP 0x6551a _REC_MAP_20_u1_u1_u1 108. _CNV_A_R_LINEAR_____122_CM 6. 114. FORMAT "%3.0"
 /begin AXIS_DESCR COM_AXIS N_KNK _CNV_A_R_LINEAR_____15_CM 10 0. 8160. FORMAT "%4.0" AXIS_PTS_REF ldpm_n_knkwb /end AXIS_DESCR
 /begin AXIS_DESCR COM_AXIS MAF_KNK _CNV_A_R_LINEAR_____51_CM 2 0. 1389. FORMAT "%4.0" AXIS_PTS_REF ldpm_maf_knkwb /end AXIS_DESCR
/end CHARACTERISTIC
/begin CHARACTERISTIC ID_KNKWB_0 "Beginning of Measurement Window Cyl.1" MAP 0x6543e _REC_MAP_20_u1_u1_u1 102. _CNV_A_R_LINEAR_____122_CM 6. 108. FORMAT "%3.0"
 /begin AXIS_DESCR COM_AXIS N_KNK _CNV_A_R_LINEAR_____15_CM 10 0. 8160. FORMAT "%4.0" AXIS_PTS_REF ldpm_n_knkwb /end AXIS_DESCR
 /begin AXIS_DESCR COM_AXIS MAF_KNK _CNV_A_R_LINEAR_____51_CM 2 0. 1389. FORMAT "%4.0" AXIS_PTS_REF ldpm_maf_knkwb /end AXIS_DESCR
/end CHARACTERISTIC
/begin CHARACTERISTIC ID_KNKWB_5 "Beginning of Measurement Window Cyl.6" MAP 0x654a2 _REC_MAP_20_u1_u1_u1 102. _CNV_A_R_LINEAR_____122_CM 6. 108. FORMAT "%3.0"
 /begin AXIS_DESCR COM_AXIS N_KNK _CNV_A_R_LINEAR_____15_CM 10 0. 8160. FORMAT "%4.0" AXIS_PTS_REF ldpm_n_knkwb /end AXIS_DESCR
 /begin AXIS_DESCR COM_AXIS MAF_KNK _CNV_A_R_LINEAR_____51_CM 2 0. 1389. FORMAT "%4.0" AXIS_PTS_REF ldpm_maf_knkwb /end AXIS_DESCR
/end CHARACTERISTIC
/begin CHARACTERISTIC ID_FIL_FRQ_KNK_0 "Knock Filter Frequency and Reference Filter Frequency Cyl.1" CURVE 0x65232 _REC_CUR_20_u1_u1 12. _CNV_S_9_RANGE_FIL__119_CM 0. 12.
 /begin AXIS_DESCR COM_AXIS N_KNK _CNV_A_R_LINEAR_____15_CM 4 0. 8160. FORMAT "%4.0" AXIS_PTS_REF ldpm_n_fil_frq_knk /end AXIS_DESCR
/end CHARACTERISTIC
/begin CHARACTERISTIC ID_FAC_THD_KNK_0 "Knock Factor Table Cyl. 1" MAP 0x6507e _REC_MAP_20_u1_u1_u1 7.96875 _CNV_A_R_LINEAR_____118_CM 0. 7.96875 FORMAT "%4.2"
 /begin AXIS_DESCR COM_AXIS N_KNK _CNV_A_R_LINEAR_____15_CM 16 0. 8160. FORMAT "%4.0" AXIS_PTS_REF ldpm_n_2_9 /end AXIS_DESCR
 /begin AXIS_DESCR COM_AXIS MAF_KNK _CNV_A_R_LINEAR_____51_CM 4 0. 1389. FORMAT "%4.0" AXIS_PTS_REF ldpm_maf_1_9 /end AXIS_DESCR
/end CHARACTERISTIC
/begin MEASUREMENT LV_TI_CH "Auxiliary Function \" Catalyst Heating Injection\"." UBYTE _CNV_S_2_RANGE______74_CM 1 100. 0. 1. ECU_ADDRESS 0x3fd40e BIT_MASK 0x1 /end MEASUREMENT
/begin MEASUREMENT LV_TI_RIS "Basic function \"Reactivation fuel feed at idle\"" UBYTE _CNV_S_2_RANGE______76_CM 1 100. 0. 1. ECU_ADDRESS 0x3fd410 /end MEASUREMENT
/begin MEASUREMENT LV_TI_RPU "Basic function \"Reactivation fuel feed at trailing throttle\"" UBYTE _CNV_S_2_RANGE______76_CM 1 100. 0. 1. ECU_ADDRESS 0x3fd411 /end MEASUREMENT
/begin MEASUREMENT LV_TI_RPL "Basic function \"Reactivation fuel feed at part load\"" UBYTE _CNV_S_2_RANGE______76_CM 1 100. 0. 1. ECU_ADDRESS 0x3fd412 /end MEASUREMENT
/begin MEASUREMENT LV_TI_RAE "Basic function \"Reactivation fuel feed at acceleration enrichment\"" UBYTE _CNV_S_2_RANGE______76_CM 1 100. 0. 1. ECU_ADDRESS 0x3fd413 /end MEASUREMENT
/begin MEASUREMENT LV_FL "Basic function FL" UBYTE _CNV_S_2_RANGE______76_CM 1 100. 0. 1. ECU_ADDRESS 0x3fd403 BIT_MASK 0x1 /end MEASUREMENT
/begin CHARACTERISTIC ID_KNKWB_4 "Beginning of Measurement Window Cyl.5" MAP 0x6548e _REC_MAP_20_u1_u1_u1 102. _CNV_A_R_LINEAR_____122_CM 6. 108. FORMAT "%3.0"
 /begin AXIS_DESCR COM_AXIS N_KNK _CNV_A_R_LINEAR_____15_CM 10 0. 8160. FORMAT "%4.0" AXIS_PTS_REF ldpm_n_knkwb /end AXIS_DESCR
 /begin AXIS_DESCR COM_AXIS MAF_KNK _CNV_A_R_LINEAR_____51_CM 2 0. 1389. FORMAT "%4.0" AXIS_PTS_REF ldpm_maf_knkwb /end AXIS_DESCR
/end CHARACTERISTIC
/begin CHARACTERISTIC ID_KNKWE_4 "End of Measurement Window Cyl.5" MAP 0x65506 _REC_MAP_20_u1_u1_u1 108. _CNV_A_R_LINEAR_____122_CM 6. 114. FORMAT "%3.0"
 /begin AXIS_DESCR COM_AXIS N_KNK _CNV_A_R_LINEAR_____15_CM 10 0. 8160. FORMAT "%4.0" AXIS_PTS_REF ldpm_n_knkwb /end AXIS_DESCR
 /begin AXIS_DESCR COM_AXIS MAF_KNK _CNV_A_R_LINEAR_____51_CM 2 0. 1389. FORMAT "%4.0" AXIS_PTS_REF ldpm_maf_knkwb /end AXIS_DESCR
/end CHARACTERISTIC
/begin CHARACTERISTIC ID_FIL_FRQ_KNK_4 "Knock Filter Frequency and Reference Filter Frequency Cyl.5" CURVE 0x65242 _REC_CUR_20_u1_u1 12. _CNV_S_9_RANGE_FIL__119_CM 0. 12.
 /begin AXIS_DESCR COM_AXIS N_KNK _CNV_A_R_LINEAR_____15_CM 4 0. 8160. FORMAT "%4.0" AXIS_PTS_REF ldpm_n_fil_frq_knk /end AXIS_DESCR
/end CHARACTERISTIC
/begin CHARACTERISTIC ID_FIL_FRQ_KNK_5 "Knock Filter Frequency and Reference Filter Frequency Cyl.6" CURVE 0x65246 _REC_CUR_20_u1_u1 12. _CNV_S_9_RANGE_FIL__119_CM 0. 12.
 /begin AXIS_DESCR COM_AXIS N_KNK _CNV_A_R_LINEAR_____15_CM 4 0. 8160. FORMAT "%4.0" AXIS_PTS_REF ldpm_n_fil_frq_knk /end AXIS_DESCR
/end CHARACTERISTIC
/begin AXIS_PTS ldpm_n_3_9 "" 0x61c85 N_32 _REC_AXS_20_u1 8160. _CNV_A_R_LINEAR_____15_CM 8 0. 8160. FORMAT "%4.0" /end AXIS_PTS
/begin AXIS_PTS ldpm_maf_1_9 "" 0x61b64 MAF_KNK _REC_AXS_20_u1 69.45 _CNV_A_R_LINEAR_____51_CM 4 0. 1389. FORMAT "%4.0" /end AXIS_PTS
/begin AXIS_PTS ldpm_n_2_9 "" 0x61c30 N _REC_AXS_20_u1 8160. _CNV_A_R_LINEAR_____15_CM 16 0. 8160. FORMAT "%4.0" /end AXIS_PTS
/begin CHARACTERISTIC ID_FAC_THD_KNK_4 "Knock Factor Table Cyl. 5" MAP 0x6517e _REC_MAP_20_u1_u1_u1 7.96875 _CNV_A_R_LINEAR_____118_CM 0. 7.96875 FORMAT "%4.2"
 /begin AXIS_DESCR COM_AXIS N_KNK _CNV_A_R_LINEAR_____15_CM 16 0. 8160. FORMAT "%4.0" AXIS_PTS_REF ldpm_n_2_9 /end AXIS_DESCR
 /begin AXIS_DESCR COM_AXIS MAF_KNK _CNV_A_R_LINEAR_____51_CM 4 0. 1389. FORMAT "%4.0" AXIS_PTS_REF ldpm_maf_1_9 /end AXIS_DESCR
/end CHARACTERISTIC
/begin AXIS_PTS ldpm_n_6_4 "" 0x61c92 N_KNK _REC_AXS_20_u1 8160. _CNV_A_R_LINEAR_____15_CM 4 0. 8160. FORMAT "%4.0" /end AXIS_PTS
/begin AXIS_PTS ldpm_n_4_9 "" 0x61c8e N_KNK _REC_AXS_20_u1 8160. _CNV_A_R_LINEAR_____15_CM 3 0. 8160. FORMAT "%4.0" /end AXIS_PTS
/begin CHARACTERISTIC ID_FAC_THD_KNK_5 "Knock Factor Table Cyl. 6" MAP 0x651be _REC_MAP_20_u1_u1_u1 7.96875 _CNV_A_R_LINEAR_____118_CM 0. 7.96875 FORMAT "%4.2"
 /begin AXIS_DESCR COM_AXIS N_KNK _CNV_A_R_LINEAR_____15_CM 16 0. 8160. FORMAT "%4.0" AXIS_PTS_REF ldpm_n_2_9 /end AXIS_DESCR
 /begin AXIS_DESCR COM_AXIS MAF_KNK _CNV_A_R_LINEAR_____51_CM 4 0. 1389. FORMAT "%4.0" AXIS_PTS_REF ldpm_maf_1_9 /end AXIS_DESCR
/end CHARACTERISTIC
/begin MEASUREMENT LV_PUC "engine operating state \"trailing throttle fuel cut off \"" UBYTE _CNV_S_2_RANGE______74_CM 1 100. 0. 1. ECU_ADDRESS 0x3fd482 BIT_MASK 0x1 /end MEASUREMENT
/begin MEASUREMENT LV_PUC_REQ "Engine operating state \"Trailing throttle\" for torque structure" UBYTE _CNV_S_2_RANGE______74_CM 1 100. 0. 1. ECU_ADDRESS 0x3fd483 BIT_MASK 0x1 /end MEASUREMENT
/begin CHARACTERISTIC C_MAF_MIN_KNK_AD2 "min. mass air for adaption circuit 2" VALUE 0x67be2 _REC_VAL_20_u1 416.7 _CNV_A_R_LINEAR_____51_CM 0. 1389. FORMAT "%4.0" /end CHARACTERISTIC
/begin MEASUREMENT KNK_CTL_DIS "knock control disabled due to malfunctions" UBYTE _CNV_S_2_RANGE______76_CM 1 100. 0. 1. ECU_ADDRESS 0x3fd8fb /end MEASUREMENT
/begin MEASUREMENT LV_KNK_AD_RD_ENA "reading from adaptation table enabled" UBYTE _CNV_S_2_RANGE______76_CM 1 100. 0. 1. ECU_ADDRESS 0x3fd8fa /end MEASUREMENT
/begin MEASUREMENT KNK_AD1_DIS "adaptation circuit 1 disabled" UBYTE _CNV_S_2_RANGE______76_CM 1 100. 0. 1. ECU_ADDRESS 0x3fd8fc /end MEASUREMENT
/begin MEASUREMENT KNK_AD2_DIS "adaptation circuit 2 disabled" UBYTE _CNV_S_2_RANGE______76_CM 1 100. 0. 1. ECU_ADDRESS 0x3fd8fd /end MEASUREMENT
/begin AXIS_PTS ldpm_vb_td "" 0x61d78 VB _REC_AXS_20_u1 25.8984 _CNV_A_R_LINEAR_____42_CM 8 0. 25.8984 FORMAT "%3.1" /end AXIS_PTS
/begin AXIS_PTS ldpm_n_32_ip_egr_ratio "" 0x61c71 N_32 _REC_AXS_20_u1 8160. _CNV_A_R_LINEAR_____15_CM 12 0. 8160. FORMAT "%4.0" /end AXIS_PTS
/begin AXIS_PTS ldpm_n_14 "" 0x61bcc N _REC_AXS_20_u2 8160. _CNV_A_R_LINEAR_____0_CM 20 0. 8160. FORMAT "%4.0" /end AXIS_PTS
/begin AXIS_PTS ldpm_tco_st_5 "" 0x61d49 TCO_ST _REC_AXS_20_u1 190.5 _CNV_A_R_LINEAR_____22_CM 8 -48. 142.5 FORMAT "%5.1" /end AXIS_PTS
/begin MEASUREMENT LV_CH "Auxiliary Function \" Catalyst Heating Spark\"." UBYTE _CNV_S_2_RANGE______76_CM 1 100. 0. 1. ECU_ADDRESS 0x3fd40d BIT_MASK 0x1 /end MEASUREMENT
/begin MEASUREMENT LV_KNK_TRA_N "Logical variable for Engine Speed Dynamic Function active or passive" UBYTE _CNV_S_2_RANGE______76_CM 1 100. 0. 1. ECU_ADDRESS 0x3fd4d5 BIT_MASK 0x1 /end MEASUREMENT
/begin MEASUREMENT IGA_ADJ_KNK_0_ "Total spark retard through knock control with adaptation (cylinder individual)" UBYTE _CNV_A_R_LINEAR_____61_CM 1 100. -48. 0. ECU_ADDRESS 0x3fd901 FORMAT "%5.1" /end MEASUREMENT
/begin MEASUREMENT IGA_ADJ_KNK_1_ "Total spark retard through knock control with adaptation (cylinder individual)" UBYTE _CNV_A_R_LINEAR_____61_CM 1 100. -48. 0. ECU_ADDRESS 0x3fd902 FORMAT "%5.1" /end MEASUREMENT
/begin MEASUREMENT IGA_ADJ_KNK_2_ "Total spark retard through knock control with adaptation (cylinder individual)" UBYTE _CNV_A_R_LINEAR_____61_CM 1 100. -48. 0. ECU_ADDRESS 0x3fd903 FORMAT "%5.1" /end MEASUREMENT
/begin MEASUREMENT IGA_ADJ_KNK_3_ "Total spark retard through knock control with adaptation (cylinder individual)" UBYTE _CNV_A_R_LINEAR_____61_CM 1 100. -48. 0. ECU_ADDRESS 0x3fd904 FORMAT "%5.1" /end MEASUREMENT
/begin MEASUREMENT IGA_ADJ_KNK_4_ "Total spark retard through knock control with adaptation (cylinder individual)" UBYTE _CNV_A_R_LINEAR_____61_CM 1 100. -48. 0. ECU_ADDRESS 0x3fd905 FORMAT "%5.1" /end MEASUREMENT
/begin MEASUREMENT IGA_ADJ_KNK_5_ "Total spark retard through knock control with adaptation (cylinder individual)" UBYTE _CNV_A_R_LINEAR_____61_CM 1 100. -48. 0. ECU_ADDRESS 0x3fd906 FORMAT "%5.1" /end MEASUREMENT
/begin MEASUREMENT IGA_ADJ_MAX_KNK "Total spark retard through knock control with adaptation (cylinder individual)" UBYTE _CNV_A_R_LINEAR_____61_CM 1 100. -48. 0. ECU_ADDRESS 0x3fd921 FORMAT "%5.3" /end MEASUREMENT
/begin MEASUREMENT IGA_ADJ_MAX_KNK_DIAG "spark retard through knock control with adaptation (cylinder individual)" UBYTE _CNV_A_R_LINEAR_____61_CM 1 100. -48. 0. ECU_ADDRESS 0x3fd907 FORMAT "%5.3" /end MEASUREMENT
/begin MEASUREMENT DLY_IGA_ADJ_KNK_DIAG "inhibition time for knock adaptation" UBYTE _CNV_A_R_LINEAR_____18_CM 1 100. 0. 25.5 ECU_ADDRESS 0x3fd908 FORMAT "%4.1" /end MEASUREMENT
/begin MEASUREMENT IGA_MV_ADJ_KNK "meanvalue of actual retard adjustment with adaptation values" UBYTE _CNV_A_R_LINEAR_____61_CM 1 100. -48. 0. ECU_ADDRESS 0x3fd90a FORMAT "%4.1" /end MEASUREMENT
/begin MEASUREMENT IGA_AV_MV "Mean value of actual ignition angle" UBYTE _CNV_A_R_LINEAR_____11_CM 1 100. -23.625 72. ECU_ADDRESS 0x3fd86d FORMAT "%5.1" /end MEASUREMENT
/begin CHARACTERISTIC C_TCO_AD_MAX_KNK "maximum TCO threshold for knock adaption circuit 2" VALUE 0x67c99 _REC_VAL_20_u1 28.575 _CNV_A_R_LINEAR_____22_CM -48. 142.5 FORMAT "%5.1" /end CHARACTERISTIC
/begin MEASUREMENT CYL_ID_KNK "cylinder number for knock control" UBYTE _CNV_A_R_LINEAR_____13_CM 1 100. 0. 255. ECU_ADDRESS 0x3fd90b FORMAT "%3.0" /end MEASUREMENT
/begin CHARACTERISTIC ID_GAIN_KNK_5 "Amplification precontrol Cyl.6" MAP 0x6538a _REC_MAP_20_u1_u1_u1 7. _CNV_S_7_RANGE_GAIN_124_R_CM 0. 7.
 /begin AXIS_DESCR COM_AXIS N_KNK _CNV_A_R_LINEAR_____15_CM 16 0. 8160. FORMAT "%4.0" AXIS_PTS_REF ldpm_n_2_9 /end AXIS_DESCR
 /begin AXIS_DESCR COM_AXIS MAF_KNK _CNV_A_R_LINEAR_____51_CM 4 0. 1389. FORMAT "%4.0" AXIS_PTS_REF ldpm_maf_1_9 /end AXIS_DESCR
/end CHARACTERISTIC
/begin CHARACTERISTIC ID_GAIN_KNK_0 "Amplification precontrol Cyl.1" MAP 0x6524a _REC_MAP_20_u1_u1_u1 7. _CNV_S_7_RANGE_GAIN_124_R_CM 0. 7.
 /begin AXIS_DESCR COM_AXIS N_KNK _CNV_A_R_LINEAR_____15_CM 16 0. 8160. FORMAT "%4.0" AXIS_PTS_REF ldpm_n_2_9 /end AXIS_DESCR
 /begin AXIS_DESCR COM_AXIS MAF_KNK _CNV_A_R_LINEAR_____51_CM 4 0. 1389. FORMAT "%4.0" AXIS_PTS_REF ldpm_maf_1_9 /end AXIS_DESCR
/end CHARACTERISTIC
/begin CHARACTERISTIC ID_GAIN_KNK_1 "Amplification precontrol Cyl.2" MAP 0x6528a _REC_MAP_20_u1_u1_u1 7. _CNV_S_7_RANGE_GAIN_124_R_CM 0. 7.
 /begin AXIS_DESCR COM_AXIS N_KNK _CNV_A_R_LINEAR_____15_CM 16 0. 8160. FORMAT "%4.0" AXIS_PTS_REF ldpm_n_2_9 /end AXIS_DESCR
 /begin AXIS_DESCR COM_AXIS MAF_KNK _CNV_A_R_LINEAR_____51_CM 4 0. 1389. FORMAT "%4.0" AXIS_PTS_REF ldpm_maf_1_9 /end AXIS_DESCR
/end CHARACTERISTIC
/begin CHARACTERISTIC ID_GAIN_KNK_2 "Amplification precontrol Cyl.3" MAP 0x652ca _REC_MAP_20_u1_u1_u1 7. _CNV_S_7_RANGE_GAIN_124_R_CM 0. 7.
 /begin AXIS_DESCR COM_AXIS N_KNK _CNV_A_R_LINEAR_____15_CM 16 0. 8160. FORMAT "%4.0" AXIS_PTS_REF ldpm_n_2_9 /end AXIS_DESCR
 /begin AXIS_DESCR COM_AXIS MAF_KNK _CNV_A_R_LINEAR_____51_CM 4 0. 1389. FORMAT "%4.0" AXIS_PTS_REF ldpm_maf_1_9 /end AXIS_DESCR
/end CHARACTERISTIC
/begin CHARACTERISTIC ID_GAIN_KNK_3 "Amplification precontrol Cyl.4" MAP 0x6530a _REC_MAP_20_u1_u1_u1 7. _CNV_S_7_RANGE_GAIN_124_R_CM 0. 7.
 /begin AXIS_DESCR COM_AXIS N_KNK _CNV_A_R_LINEAR_____15_CM 16 0. 8160. FORMAT "%4.0" AXIS_PTS_REF ldpm_n_2_9 /end AXIS_DESCR
 /begin AXIS_DESCR COM_AXIS MAF_KNK _CNV_A_R_LINEAR_____51_CM 4 0. 1389. FORMAT "%4.0" AXIS_PTS_REF ldpm_maf_1_9 /end AXIS_DESCR
/end CHARACTERISTIC
/begin CHARACTERISTIC ID_GAIN_KNK_4 "Amplification precontrol Cyl.5" MAP 0x6534a _REC_MAP_20_u1_u1_u1 7. _CNV_S_7_RANGE_GAIN_124_R_CM 0. 7.
 /begin AXIS_DESCR COM_AXIS N_KNK _CNV_A_R_LINEAR_____15_CM 16 0. 8160. FORMAT "%4.0" AXIS_PTS_REF ldpm_n_2_9 /end AXIS_DESCR
 /begin AXIS_DESCR COM_AXIS MAF_KNK _CNV_A_R_LINEAR_____51_CM 4 0. 1389. FORMAT "%4.0" AXIS_PTS_REF ldpm_maf_1_9 /end AXIS_DESCR
/end CHARACTERISTIC
/begin CHARACTERISTIC IGA_AD1_KNK_5__N__MAF "" MAP 0x3fdb47 _REC_MAP_20_u1_u1_u1 48. _CNV_A_R_LINEAR_____61_CM -48. 0. READ_ONLY FORMAT "%6.2"
 /begin AXIS_DESCR COM_AXIS N_KNK _CNV_A_R_LINEAR_____15_CM 10 0. 8160. FORMAT "%4.0" AXIS_PTS_REF ldpm_n_iga_ad /end AXIS_DESCR
 /begin AXIS_DESCR COM_AXIS MAF_KNK _CNV_A_R_LINEAR_____51_CM 6 0. 1389. FORMAT "%7.2" AXIS_PTS_REF ldpm_maf_iga_ad /end AXIS_DESCR
/end CHARACTERISTIC
/begin CHARACTERISTIC IGA_AD1_KNK_4__N__MAF "" MAP 0x3fdb0b _REC_MAP_20_u1_u1_u1 48. _CNV_A_R_LINEAR_____61_CM -48. 0. READ_ONLY FORMAT "%6.2"
 /begin AXIS_DESCR COM_AXIS N_KNK _CNV_A_R_LINEAR_____15_CM 10 0. 8160. FORMAT "%4.0" AXIS_PTS_REF ldpm_n_iga_ad /end AXIS_DESCR
 /begin AXIS_DESCR COM_AXIS MAF_KNK _CNV_A_R_LINEAR_____51_CM 6 0. 1389. FORMAT "%7.2" AXIS_PTS_REF ldpm_maf_iga_ad /end AXIS_DESCR
/end CHARACTERISTIC
/begin CHARACTERISTIC IGA_AD1_KNK_3__N__MAF "" MAP 0x3fdacf _REC_MAP_20_u1_u1_u1 48. _CNV_A_R_LINEAR_____61_CM -48. 0. READ_ONLY FORMAT "%6.2"
 /begin AXIS_DESCR COM_AXIS N_KNK _CNV_A_R_LINEAR_____15_CM 10 0. 8160. FORMAT "%4.0" AXIS_PTS_REF ldpm_n_iga_ad /end AXIS_DESCR
 /begin AXIS_DESCR COM_AXIS MAF_KNK _CNV_A_R_LINEAR_____51_CM 6 0. 1389. FORMAT "%7.2" AXIS_PTS_REF ldpm_maf_iga_ad /end AXIS_DESCR
/end CHARACTERISTIC
/begin CHARACTERISTIC IGA_AD1_KNK_2__N__MAF "" MAP 0x3fda93 _REC_MAP_20_u1_u1_u1 48. _CNV_A_R_LINEAR_____61_CM -48. 0. READ_ONLY FORMAT "%6.2"
 /begin AXIS_DESCR COM_AXIS N_KNK _CNV_A_R_LINEAR_____15_CM 10 0. 8160. FORMAT "%4.0" AXIS_PTS_REF ldpm_n_iga_ad /end AXIS_DESCR
 /begin AXIS_DESCR COM_AXIS MAF_KNK _CNV_A_R_LINEAR_____51_CM 6 0. 1389. FORMAT "%7.2" AXIS_PTS_REF ldpm_maf_iga_ad /end AXIS_DESCR
/end CHARACTERISTIC
/begin CHARACTERISTIC IGA_AD1_KNK_1__N__MAF "" MAP 0x3fda57 _REC_MAP_20_u1_u1_u1 48. _CNV_A_R_LINEAR_____61_CM -48. 0. READ_ONLY FORMAT "%6.2"
 /begin AXIS_DESCR COM_AXIS N_KNK _CNV_A_R_LINEAR_____15_CM 10 0. 8160. FORMAT "%4.0" AXIS_PTS_REF ldpm_n_iga_ad /end AXIS_DESCR
 /begin AXIS_DESCR COM_AXIS MAF_KNK _CNV_A_R_LINEAR_____51_CM 6 0. 1389. FORMAT "%7.2" AXIS_PTS_REF ldpm_maf_iga_ad /end AXIS_DESCR
/end CHARACTERISTIC
/begin CHARACTERISTIC IGA_AD1_KNK_0__N__MAF "" MAP 0x3fda1b _REC_MAP_20_u1_u1_u1 48. _CNV_A_R_LINEAR_____61_CM -48. 0. READ_ONLY FORMAT "%6.2"
 /begin AXIS_DESCR COM_AXIS N_KNK _CNV_A_R_LINEAR_____15_CM 10 0. 8160. FORMAT "%4.0" AXIS_PTS_REF ldpm_n_iga_ad /end AXIS_DESCR
 /begin AXIS_DESCR COM_AXIS MAF_KNK _CNV_A_R_LINEAR_____51_CM 6 0. 1389. FORMAT "%7.2" AXIS_PTS_REF ldpm_maf_iga_ad /end AXIS_DESCR
/end CHARACTERISTIC
/begin MEASUREMENT LV_IGA_AND_INJ_SWI "Logical control variable for igintion and injection switch" UBYTE _CNV_S_2_RANGE______74_CM 1 100. 0. 1. ECU_ADDRESS 0x3faa4c BIT_MASK 0x1 /end MEASUREMENT
/begin CHARACTERISTIC C_IGA_AS_CYL_0 "Spark retard by application system cyl. 0" VALUE 0x67c53 _REC_VAL_20_s1 4.78125 _CNV_A_R_LINEAR_____6_CM -48. 47.625 FORMAT "%5.1" /end CHARACTERISTIC
/begin CHARACTERISTIC C_IGA_AS_CYL_1 "Spark retard by application system cyl. 1" VALUE 0x67c54 _REC_VAL_20_s1 4.78125 _CNV_A_R_LINEAR_____6_CM -48. 47.625 FORMAT "%5.1" /end CHARACTERISTIC
/begin CHARACTERISTIC C_IGA_AS_CYL_2 "Spark retard by application system cyl. 2" VALUE 0x67c55 _REC_VAL_20_s1 4.78125 _CNV_A_R_LINEAR_____6_CM -48. 47.625 FORMAT "%5.1" /end CHARACTERISTIC
/begin CHARACTERISTIC C_IGA_AS_CYL_3 "Spark retard by application system cyl. 3" VALUE 0x67c56 _REC_VAL_20_s1 4.78125 _CNV_A_R_LINEAR_____6_CM -48. 47.625 FORMAT "%5.1" /end CHARACTERISTIC
/begin CHARACTERISTIC C_IGA_AS_CYL_4 "Spark retard by application system cyl. 4" VALUE 0x67c57 _REC_VAL_20_s1 4.78125 _CNV_A_R_LINEAR_____6_CM -48. 47.625 FORMAT "%5.1" /end CHARACTERISTIC
/begin CHARACTERISTIC C_IGA_AS_CYL_5 "Spark retard by application system cyl. 5" VALUE 0x67c58 _REC_VAL_20_s1 4.78125 _CNV_A_R_LINEAR_____6_CM -48. 47.625 FORMAT "%5.1" /end CHARACTERISTIC
/begin CHARACTERISTIC C_TD_AS "Application intervention" VALUE 0x67c7e _REC_VAL_20_s1 16.32 _CNV_A_R_LINEAR_____102_CM -8.192 8.128 FORMAT "%6.2" /end CHARACTERISTIC
/begin MEASUREMENT IGA_0 "Basic ignition angle application correction and knock control included" UBYTE _CNV_A_R_LINEAR_____11_CM 1 100. -23.625 72. ECU_ADDRESS 0x3fd86f FORMAT "%5.1" /end MEASUREMENT
/begin MEASUREMENT IGA_1 "Basic ignition angle application correction and knock control included" UBYTE _CNV_A_R_LINEAR_____11_CM 1 100. -23.625 72. ECU_ADDRESS 0x3fd870 FORMAT "%5.1" /end MEASUREMENT
/begin MEASUREMENT IGA_2 "Basic ignition angle application correction and knock control included" UBYTE _CNV_A_R_LINEAR_____11_CM 1 100. -23.625 72. ECU_ADDRESS 0x3fd871 FORMAT "%5.1" /end MEASUREMENT
/begin MEASUREMENT IGA_3 "Basic ignition angle application correction and knock control included" UBYTE _CNV_A_R_LINEAR_____11_CM 1 100. -23.625 72. ECU_ADDRESS 0x3fd872 FORMAT "%5.1" /end MEASUREMENT
/begin MEASUREMENT IGA_4 "Basic ignition angle application correction and knock control included" UBYTE _CNV_A_R_LINEAR_____11_CM 1 100. -23.625 72. ECU_ADDRESS 0x3fd873 FORMAT "%5.1" /end MEASUREMENT
/begin MEASUREMENT IGA_5 "Basic ignition angle application correction and knock control included" UBYTE _CNV_A_R_LINEAR_____11_CM 1 100. -23.625 72. ECU_ADDRESS 0x3fd874 FORMAT "%5.1" /end MEASUREMENT
/begin CHARACTERISTIC C_N_MIN_FL "Minimum engine speed for FL" VALUE 0x67c20 _REC_VAL_20_u1 816. _CNV_A_R_LINEAR_____15_CM 0. 8160. FORMAT "%4.0" /end CHARACTERISTIC
/begin CHARACTERISTIC C_TPS_SP_SPR_CHK_UP "TPS_SP for limp home spring test on the adaptation routine" VALUE 0x67f38 _REC_VAL_20_u2 119.5 _CNV_A_R_LINEAR_____34_CM 0. 119.5 FORMAT "%7.3" /end CHARACTERISTIC
/begin CHARACTERISTIC C_T_MIN_FL_DLY "Time after Start- Threshold for Full load recognition" VALUE 0x67c66 _REC_VAL_20_u2 6553.5 _CNV_A_R_LINEAR_____18_CM 0. 6553.5 FORMAT "%5.1" /end CHARACTERISTIC
/begin MEASUREMENT LV_INF "Basic function \" Intercept \"" UBYTE _CNV_S_2_RANGE______74_CM 1 100. 0. 1. ECU_ADDRESS 0x3fd404 BIT_MASK 0x1 /end MEASUREMENT
/begin MEASUREMENT MTCPWM_I "Duty cycle of the I-share" SWORD _CNV_A_R_LINEAR_____12_CM 1 100. -100. 99.99694824 ECU_ADDRESS 0x3fcdcc FORMAT "%8.3" /end MEASUREMENT
/begin MEASUREMENT MTCPWM_I_ADD "Manipulated previous I-share" SWORD _CNV_A_R_LINEAR_____12_CM 1 100. -100. 99.99694824 ECU_ADDRESS 0x3fcdd4 FORMAT "%8.3" /end MEASUREMENT
/begin MEASUREMENT TPS_SP_LIH_DIF "Difference between TPS_SP and TPS_LIH" UWORD _CNV_A_R_LINEAR_____47_CM 1 100. -119.5 119.5 ECU_ADDRESS 0x3fcdc6 FORMAT "%8.3" /end MEASUREMENT
/begin CHARACTERISTIC C_TPS_SP_LIH_DIF_HYS "Hysteresis for detection of direction change" VALUE 0x67f6c _REC_VAL_20_u2 119.5 _CNV_A_R_LINEAR_____34_CM 0. 119.5 FORMAT "%7.3" /end CHARACTERISTIC
/begin CHARACTERISTIC C_MTCPWM_I_MAX_NEG "Limitation of I-share downwards" VALUE 0x67bf0 _REC_VAL_20_s2 199.99694824 _CNV_A_R_LINEAR_____12_CM -100. 99.99694824 FORMAT "%8.3" /end CHARACTERISTIC
/begin CHARACTERISTIC C_MTCPWM_I_ADD "Init value for I-Part while TPS_SP_LIH_DIF is crossing LH" VALUE 0x67f6e _REC_VAL_20_s2 199.99694824 _CNV_A_R_LINEAR_____12_CM -100. 99.99694824 FORMAT "%8.3" /end CHARACTERISTIC
/begin CHARACTERISTIC C_MTCPWM_ADD_FIL "Filter parameter" VALUE 0x67f70 _REC_VAL_20_u1 0.9960940000000002 _CNV_A_R_LINEAR_____8_CM 0. 0.996094 FORMAT "%5.3" /end CHARACTERISTIC
/begin CHARACTERISTIC IP_MTCPWM_I_FAC__TPS_AV_LIH_DIF "Angle dependent I-part manipulation" CURVE 0x67f71 _REC_CUR_20_u1_u2 7.96875 _CNV_A_R_LINEAR_____118_CM 0. 7.96875 FORMAT "%4.2"
 /begin AXIS_DESCR COM_AXIS TPS_AV_LIH_DIF _CNV_A_R_LINEAR_____47_CM 8 -119.5 119.5 FORMAT "%8.3" AXIS_PTS_REF ldp_tps_av_lih_dif_mtcpwm_i /end AXIS_DESCR
/end CHARACTERISTIC
/begin CHARACTERISTIC IP_MTCPWM_ADD__TPS_SP_LIH_DIF "Setpoint dependent Feed Forward Value" CURVE 0x67f7a _REC_CUR_20_u2_u2 199.99694824 _CNV_A_R_LINEAR_____63_CM -100. 99.99694824 FORMAT "%8.3"
 /begin AXIS_DESCR COM_AXIS TPS_SP_LIH_DIF _CNV_A_R_LINEAR_____47_CM 8 -119.5 119.5 FORMAT "%8.3" AXIS_PTS_REF ldp_tps_sp_lih_dif__mtcpwm_add /end AXIS_DESCR
/end CHARACTERISTIC
/begin MEASUREMENT MTCPWM_VB_FAC "Battery voltage correction" UBYTE _CNV_A_R_LINEAR_____64_CM 1 100. 0. 1.99220002 ECU_ADDRESS 0x3fd940 FORMAT "%5.3" /end MEASUREMENT
/begin MEASUREMENT LV_TI_REAC "Basic function \"Reactivation fuel feed\"" UBYTE _CNV_S_2_RANGE______76_CM 1 100. 0. 1. ECU_ADDRESS 0x3fd40f /end MEASUREMENT
/begin MEASUREMENT T_PU "Time elapsed into LV_PU" UWORD _CNV_A_R_LINEAR_____21_CM 1 100. 0. 655.35 ECU_ADDRESS 0x3fc7f0 FORMAT "%5.2" /end MEASUREMENT
/begin CHARACTERISTIC IP_CYC_CAST__TCO "Cycle counter to define the duration of the start phase characterised by LV_ST" CURVE 0x6820a _REC_CUR_20_u2_u1 65535. _CNV_A_R_LINEAR_____17_CM 0. 65535. FORMAT "%5.0"
 /begin AXIS_DESCR COM_AXIS TCO _CNV_A_R_LINEAR_____22_CM 9 -48. 142.5 FORMAT "%5.1" AXIS_PTS_REF ldpm_tco_9 /end AXIS_DESCR
/end CHARACTERISTIC
/begin CHARACTERISTIC C_T_MAX_PU "Maximum delay time of PUC activation after entry of PU" VALUE 0x67c1e _REC_VAL_20_u2 655.35 _CNV_A_R_LINEAR_____21_CM 0. 655.35 FORMAT "%6.2" /end CHARACTERISTIC
/begin CHARACTERISTIC LC_INH_DT_PU "Manual inhibition bit for deactivation drivetrain impact for controlling transition to PUC" VALUE 0x6821c _REC_VAL_20_u1 1. _CNV_S_2_RANGE______74_CM 0. 1. /end CHARACTERISTIC
/begin CHARACTERISTIC C_TCO_MAX_MPL "Max. Coolant Temp. at start to have  multiple spark" VALUE 0x67ca5 _REC_VAL_20_u1 190.5 _CNV_A_R_LINEAR_____22_CM -48. 142.5 FORMAT "%5.1" /end CHARACTERISTIC
/begin CHARACTERISTIC C_VB_MAX_MPL "Max. Battery voltage to have multiple spark (requested valve 16V)" VALUE 0x6885e _REC_VAL_20_u1 25.8984 _CNV_A_R_LINEAR_____42_CM 0. 25.8984 FORMAT "%3.1" /end CHARACTERISTIC
/begin MEASUREMENT LV_KNK "Logical variable for recognition of knock" UBYTE _CNV_S_2_RANGE______76_CM 1 100. 0. 1. ECU_ADDRESS 0x3fd4da BIT_MASK 0x1 /end MEASUREMENT
/begin MEASUREMENT LV_AFL_CH "LV for activation SA or catalyst heating lambda coordination" UBYTE _CNV_S_2_RANGE______76_CM 1 100. 0. 1. ECU_ADDRESS 0x3fd41d BIT_MASK 0x1 /end MEASUREMENT
/begin AXIS_PTS ldpm_maf_2 "" 0x61b6a MAF _REC_AXS_20_u2 69.45 _CNV_A_R_LINEAR_____56_CM 16 0. 1389. FORMAT "%4.0" /end AXIS_PTS
/begin CHARACTERISTIC LC_TQ_IGA_INH "Logical constant inhibition torque intervention by spark retard" VALUE 0x67d8d _REC_VAL_20_u1 1. _CNV_A_R_LINEAR_____13_CM 0. 1. FORMAT "%1.0" /end CHARACTERISTIC
/begin CHARACTERISTIC ID_TPS_GRD_TRA_KNK "Throttle Position Gradient for Load Dynamic Recognition" CURVE 0x659e4 _REC_CUR_20_u1_u1 2987.5 _CNV_A_R_LINEAR_____81_CM 0. 2987.5 FORMAT "%6.1"
 /begin AXIS_DESCR COM_AXIS N_KNK _CNV_A_R_LINEAR_____15_CM 4 0. 8160. FORMAT "%4.0" AXIS_PTS_REF ldpm_n_6_4 /end AXIS_DESCR
/end CHARACTERISTIC
/begin MEASUREMENT IGA_BAS_COR "Corrected basic ignition angle" UBYTE _CNV_A_R_LINEAR_____11_CM 1 100. -23.625 72. ECU_ADDRESS 0x3fd87b FORMAT "%5.1" /end MEASUREMENT
/begin AXIS_PTS ldpm_tco_1 "" 0x61ced TCO _REC_AXS_20_u1 190.5 _CNV_A_R_LINEAR_____22_CM 6 -48. 142.5 FORMAT "%5.1" /end AXIS_PTS
/begin CHARACTERISTIC C_EOI_AS "EOI-correction of application system" VALUE 0x67b7c _REC_VAL_20_s2 1440. _CNV_A_R_LINEAR_____6_CM -720. 720. FORMAT "%6.1" /end CHARACTERISTIC
/begin CHARACTERISTIC LC_EOI_COR_IVVT_VVL "switch to activate (1) or deactivate (0) the EOI-correction for inlet-CWM-position and variable valve lift" VALUE 0x68f50 _REC_VAL_20_u1 1. _CNV_A_R_LINEAR_____17_CM 0. 1. FORMAT "%2.0" /end CHARACTERISTIC
/begin AXIS_PTS ldp_vlft_av__cam_op_in_vvl "" 0x61ff2 VLFT_AV _REC_AXS_20_u2 65.535 _CNV_A_R_LINEAR_____182_CM 6 0. 65.535 /end AXIS_PTS
/begin CHARACTERISTIC IP_CAM_OP_IN_VVL__VLFT_AV "inlet valve opening angle vs. actual inlet valve lift" CURVE 0x68f52 _REC_CUR_20_u2_u2 1535.9765625 _CNV_A_R_LINEAR_____187_CM -768. 767.9765625 FORMAT "%7.2"
 /begin AXIS_DESCR COM_AXIS ONLINE_DUMMY _CNV_A_R_LINEAR_____182_CM 6 0. 65.535 AXIS_PTS_REF ldp_vlft_av__cam_op_in_vvl /end AXIS_DESCR
/end CHARACTERISTIC
/begin CHARACTERISTIC ID_TPS_GRD_BOL_AE__N__TPS_AV "Throttle position gradient threshold" MAP 0x659cc _REC_MAP_20_u1_u1_u2 298.75 _CNV_A_R_LINEAR_____81_CM 0. 2987.5 FORMAT "%4.0"
 /begin AXIS_DESCR COM_AXIS N_32 _CNV_A_R_LINEAR_____15_CM 6 0. 8160. FORMAT "%4.0" AXIS_PTS_REF ldp_n_23 /end AXIS_DESCR
 /begin AXIS_DESCR COM_AXIS TPS_AV _CNV_A_R_LINEAR_____34_CM 4 0. 119.5 FORMAT "%7.3" AXIS_PTS_REF ldp_tps_av_id_tps_grd_bol_ae /end AXIS_DESCR
/end CHARACTERISTIC
/begin AXIS_PTS ldp_tps_av_id_tps_grd_bol_ae "" 0x619a6 TPS_AV _REC_AXS_20_u2 11.95 _CNV_A_R_LINEAR_____34_CM 4 0. 119.5 FORMAT "%7.3" /end AXIS_PTS
/begin MEASUREMENT TD "Nominal dwell time" UWORD _CNV_A_R_LINEAR_____24_CM 1 100. 0. 50. ECU_ADDRESS 0x3fc8e0 FORMAT "%7.4" /end MEASUREMENT
/begin MEASUREMENT TD_MAX_WDT "Maximum executable dwell time" UWORD _CNV_A_R_LINEAR_____24_CM 1 100. 0. 50. ECU_ADDRESS 0x3fc8e2 FORMAT "%7.4" /end MEASUREMENT
/begin MEASUREMENT IGA_DIF_AV "Difference of actual ignition angle to reference ignition angle" UBYTE _CNV_A_R_LINEAR_____49_CM 1 100. 0. -95.625 ECU_ADDRESS 0x3fd878 FORMAT "%5.1" /end MEASUREMENT
/begin MEASUREMENT IGA_DIF_BAS_KNK_FIL "Difference of IGA_BAS_COR_KNK_FIL to reference ignition angle" UBYTE _CNV_A_R_LINEAR_____49_CM 1 100. 0. -95.625 ECU_ADDRESS 0x3fd86e FORMAT "%5.1" /end MEASUREMENT
/begin MEASUREMENT IGA_BAS_COR_KNK_FIL "Corrected basic ignition angle with mean knock correction" UBYTE _CNV_A_R_LINEAR_____11_CM 1 100. -23.625 72. ECU_ADDRESS 0x3fd87a FORMAT "%5.1" /end MEASUREMENT
/begin MEASUREMENT EFF_IGA_BAS_COR_KNK_FIL "Ignition efficiency referenced to IGA_BAS_COR_KNK_FIL" UWORD _CNV_A_R_LINEAR_____5_CM 1 100. 0. 1.99996948 ECU_ADDRESS 0x3fc8da FORMAT "%7.5" /end MEASUREMENT
/begin CHARACTERISTIC C_IGA_AS "Spark retard by application system global" VALUE 0x67c52 _REC_VAL_20_s1 95.625 _CNV_A_R_LINEAR_____6_CM -48. 47.625 FORMAT "%5.1" /end CHARACTERISTIC
/begin CHARACTERISTIC C_CRLC_IGA_KNK "Correlation constant knock correction filter" VALUE 0x691b4 _REC_VAL_20_u1 0.9960940000000002 _CNV_A_R_LINEAR_____8_CM 0. 0.996094 FORMAT "%5.3" /end CHARACTERISTIC
/begin MEASUREMENT TPS_DIF_GRD "Controller deviation" UWORD _CNV_A_R_LINEAR_____47_CM 1 100. -119.5 119.5 ECU_ADDRESS 0x3fcdd0 /end MEASUREMENT
/begin MEASUREMENT T_MTCPWM_CLOSE_ACT "time counter for closing condition" UWORD _CNV_A_R_LINEAR_____198_CM 1 100. 0. 5110. ECU_ADDRESS 0x3fcdc2 FORMAT "%5.0" /end MEASUREMENT
/begin MEASUREMENT TPS_SP_CTL "throttle position setpoint ( + or - )" SWORD _CNV_A_R_LINEAR_____199_CM 1 100. -119.5 119.5 ECU_ADDRESS 0x3fcdd2 FORMAT "%8.3" /end MEASUREMENT
/begin MEASUREMENT LV_TPS_SP_POS "position detection of TPS-setpoint (0: below LIH; 1: above LIH)" UBYTE _CNV_S_2_RANGE______74_CM 1 100. 0. 1. ECU_ADDRESS 0x3fd503 /end MEASUREMENT
/begin MEASUREMENT LV_TPS_CHG_POS "detection of changed direction from LV_TPS_SP_POS" UBYTE _CNV_S_2_RANGE______74_CM 1 100. 0. 1. ECU_ADDRESS 0x3fd504 /end MEASUREMENT
/begin AXIS_PTS ldp_tps_dif__mtcpwm_p "" 0x61994 TPS_DIF _REC_AXS_20_u2 239. _CNV_A_R_LINEAR_____47_CM 8 -119.5 119.5 FORMAT "%8.3" /end AXIS_PTS
/begin AXIS_PTS ldp_tps_dif__mtcpwm_i "" 0x61982 TPS_DIF _REC_AXS_20_u2 239. _CNV_A_R_LINEAR_____47_CM 8 -119.5 119.5 FORMAT "%8.3" /end AXIS_PTS
/begin AXIS_PTS ldp_tps_av_lih_dif_mtcpwm_i "" 0x61dd6 TPS_AV_LIH_DIF _REC_AXS_20_u2 239. _CNV_A_R_LINEAR_____47_CM 8 -119.5 119.5 FORMAT "%8.3" /end AXIS_PTS
/begin AXIS_PTS ldp_tps_dif_grd__mtcpwm_d "" 0x61970 TPS_DIF_GRD _REC_AXS_20_u2 239. _CNV_A_R_LINEAR_____47_CM 8 -119.5 119.5 FORMAT "%8.3" /end AXIS_PTS
/begin AXIS_PTS ldp_tps_sp_lih_dif__mtcpwm_add "" 0x61de8 TPS_SP_LIH_DIF _REC_AXS_20_u2 239. _CNV_A_R_LINEAR_____47_CM 8 -119.5 119.5 FORMAT "%8.3" /end AXIS_PTS
/begin AXIS_PTS ldp_vb__mtcpwm_vb_fac "" 0x61abc VB _REC_AXS_20_u1 25.8984 _CNV_A_R_LINEAR_____42_CM 8 0. 25.8984 FORMAT "%3.1" /end AXIS_PTS
/begin CHARACTERISTIC C_T_MTCPWM_CLOSE_ACT_MAX "Timer threshold for switching to closing duty cycle" VALUE 0x6922e _REC_VAL_20_u2 5. _CNV_A_R_LINEAR_____19_CM 0. 5. FORMAT "%5.3" /end CHARACTERISTIC
/begin CHARACTERISTIC C_MTCPWM_CLOSE_MAX "duty cycle limitation at bottom mechanical limit" VALUE 0x69232 _REC_VAL_20_s2 199.99694824 _CNV_A_R_LINEAR_____12_CM -100. 99.99694824 FORMAT "%8.3" /end CHARACTERISTIC
/begin CHARACTERISTIC C_TPS_SP_STOP_HYS "setpoint hysteresis for closing throttle" VALUE 0x69234 _REC_VAL_20_u2 119.5 _CNV_A_R_LINEAR_____34_CM 0. 119.5 FORMAT "%7.3" /end CHARACTERISTIC
/begin CHARACTERISTIC C_TPS_SP_STOP_MAX "threshold for testing duty cycle on value" VALUE 0x69236 _REC_VAL_20_u2 119.5 _CNV_A_R_LINEAR_____34_CM 0. 119.5 FORMAT "%7.3" /end CHARACTERISTIC
/begin CHARACTERISTIC C_MTCPWM_I_INI "initialization of MTCPWM_I" VALUE 0x69238 _REC_VAL_20_s2 199.99694824 _CNV_A_R_LINEAR_____12_CM -100. 99.99694824 FORMAT "%8.3" /end CHARACTERISTIC
/begin CHARACTERISTIC C_TPS_SP_LGRD_STOP "max. admissable gradient of throtle setpoint in the range of the top and bottom stop" VALUE 0x6923a _REC_VAL_20_u2 119.5 _CNV_A_R_LINEAR_____200_CM 0. 119.5 FORMAT "%7.3" /end CHARACTERISTIC
/begin CHARACTERISTIC C_TPS_SP_CTL_MAX "limitation of TPS_SP_CTL" VALUE 0x6923c _REC_VAL_20_s2 119.5 _CNV_A_R_LINEAR_____199_CM -119.5 0. FORMAT "%8.3" /end CHARACTERISTIC
/begin CHARACTERISTIC C_MTCPWM_CLOSE "closing duty cycle" VALUE 0x69230 _REC_VAL_20_s2 199.99694824 _CNV_A_R_LINEAR_____12_CM -100. 99.99694824 FORMAT "%8.3" /end CHARACTERISTIC
/begin CHARACTERISTIC C_MTCPWM_HYS "hysteresis to prevent MTCPWM-switching according to VB-changes" VALUE 0x6923e _REC_VAL_20_u2 100. _CNV_A_R_LINEAR_____201_CM 0. 100. FORMAT "%7.3" /end CHARACTERISTIC
/begin AXIS_PTS ldpm_n_32_100 "" 0x61c41 N_32 _REC_AXS_20_u1 8160. _CNV_A_R_LINEAR_____15_CM 16 0. 8160. FORMAT "%4.0" /end AXIS_PTS
/begin MEASUREMENT MTCPWM "Duty cycle of the ETC Position Controller" SWORD _CNV_A_R_LINEAR_____12_CM 1 100. -100. 99.99694824 ECU_ADDRESS 0x3fcdbe FORMAT "%8.3" /end MEASUREMENT
/begin MEASUREMENT LV_MTCPWM_CLOSE_ACT "logical variable (is set, if closing duty cycle is active" UBYTE _CNV_S_2_RANGE______74_CM 1 100. 0. 1. ECU_ADDRESS 0x3fd502 /end MEASUREMENT
/begin MEASUREMENT LV_AST "Auxiliary function \"After-start\"" UBYTE _CNV_S_2_RANGE______74_CM 1 100. 0. 1. ECU_ADDRESS 0x3fd542 BIT_MASK 0x1 /end MEASUREMENT
/begin AXIS_PTS ldp_n_23 "" 0x61610 N_32 _REC_AXS_20_u1 816. _CNV_A_R_LINEAR_____15_CM 6 0. 8160. FORMAT "%4.0" /end AXIS_PTS
/begin MEASUREMENT IGA_BAS_IVVT_OFS "additive basic ignition angle of influences of valve overlap" UBYTE _CNV_A_R_LINEAR_____11_CM 1 100. -23.625 72. ECU_ADDRESS 0x3fd87f FORMAT "%5.1" /end MEASUREMENT
/begin MEASUREMENT IGA_BAS_IVVT "basic ignition angle including influences of IVVT" UBYTE _CNV_A_R_LINEAR_____11_CM 1 100. -23.625 72. ECU_ADDRESS 0x3fd87d FORMAT "%5.1" /end MEASUREMENT
/begin MEASUREMENT IGA_BAS_RON "basic ignition angle of RON factor" UBYTE _CNV_A_R_LINEAR_____11_CM 1 100. -23.625 72. ECU_ADDRESS 0x3fd880 FORMAT "%5.1" /end MEASUREMENT
/begin CHARACTERISTIC IP_IGA_BAS_ADD_MIN__IVVT__N__MAF "Basic ignition offset VO min" MAP 0x6849d _REC_MAP_20_u1_u2_u2 95.625 _CNV_A_R_LINEAR_____11_CM -23.625 72. FORMAT "%5.1"
 /begin AXIS_DESCR COM_AXIS N _CNV_A_R_LINEAR_____0_CM 20 0. 8160. FORMAT "%4.0" AXIS_PTS_REF ldpm_n_14 /end AXIS_DESCR
 /begin AXIS_DESCR COM_AXIS MAF _CNV_A_R_LINEAR_____56_CM 16 0. 1389. FORMAT "%4.0" AXIS_PTS_REF ldpm_maf_2 /end AXIS_DESCR
/end CHARACTERISTIC
/begin CHARACTERISTIC IP_IGA_BAS_ADD_MAX__IVVT__N__MAF "Basic ignition angle offset VO max" MAP 0x6835d _REC_MAP_20_u1_u2_u2 95.625 _CNV_A_R_LINEAR_____11_CM -23.625 72. FORMAT "%5.1"
 /begin AXIS_DESCR COM_AXIS N _CNV_A_R_LINEAR_____0_CM 20 0. 8160. FORMAT "%4.0" AXIS_PTS_REF ldpm_n_14 /end AXIS_DESCR
 /begin AXIS_DESCR COM_AXIS MAF _CNV_A_R_LINEAR_____56_CM 16 0. 1389. FORMAT "%4.0" AXIS_PTS_REF ldpm_maf_2 /end AXIS_DESCR
/end CHARACTERISTIC
/begin CHARACTERISTIC IP_IGA_BAS_RON_98__N__MAF "Basic ignition angle for RON 98" MAP 0x685dd _REC_MAP_20_u1_u2_u2 95.625 _CNV_A_R_LINEAR_____11_CM -23.625 72. FORMAT "%5.1"
 /begin AXIS_DESCR COM_AXIS N _CNV_A_R_LINEAR_____0_CM 20 0. 8160. FORMAT "%4.0" AXIS_PTS_REF ldpm_n_14 /end AXIS_DESCR
 /begin AXIS_DESCR COM_AXIS MAF _CNV_A_R_LINEAR_____56_CM 16 0. 1389. FORMAT "%4.0" AXIS_PTS_REF ldpm_maf_2 /end AXIS_DESCR
/end CHARACTERISTIC
/begin CHARACTERISTIC IP_IGA_BAS_RON_91__N__MAF "Basic ignition angle for RON 91" MAP 0x6821d _REC_MAP_20_u1_u2_u2 95.625 _CNV_A_R_LINEAR_____11_CM -23.625 72. FORMAT "%5.1"
 /begin AXIS_DESCR COM_AXIS N _CNV_A_R_LINEAR_____0_CM 20 0. 8160. FORMAT "%4.0" AXIS_PTS_REF ldpm_n_14 /end AXIS_DESCR
 /begin AXIS_DESCR COM_AXIS MAF _CNV_A_R_LINEAR_____56_CM 16 0. 1389. FORMAT "%4.0" AXIS_PTS_REF ldpm_maf_2 /end AXIS_DESCR
/end CHARACTERISTIC
/begin CHARACTERISTIC IP_IGA_BAS__N__MAF "Basic ignition angle IVVT passive" MAP 0x6871d _REC_MAP_20_u1_u2_u2 95.625 _CNV_A_R_LINEAR_____11_CM -23.625 72. FORMAT "%5.1"
 /begin AXIS_DESCR COM_AXIS N _CNV_A_R_LINEAR_____0_CM 20 0. 8160. FORMAT "%4.0" AXIS_PTS_REF ldpm_n_14 /end AXIS_DESCR
 /begin AXIS_DESCR COM_AXIS MAF _CNV_A_R_LINEAR_____56_CM 16 0. 1389. FORMAT "%4.0" AXIS_PTS_REF ldpm_maf_2 /end AXIS_DESCR
/end CHARACTERISTIC
/begin CHARACTERISTIC C_IGA_BAS_ADD_MIN "IGA min offset (VANOS)" VALUE 0x6885d _REC_VAL_20_u1 95.625 _CNV_A_R_LINEAR_____11_CM -23.625 72. FORMAT "%5.1" /end CHARACTERISTIC
/begin CHARACTERISTIC C_IGA_BAS_ADD_MAX "IGA max offset (VANOS)" VALUE 0x69269 _REC_VAL_20_u1 95.625 _CNV_A_R_LINEAR_____11_CM -23.625 72. FORMAT "%5.1" /end CHARACTERISTIC
/begin CHARACTERISTIC IP_IGA_BAS_TEMP_COR__TCO__TIA "Maximum ignition angle correction for temperature effects" MAP 0x65ed8 _REC_MAP_20_u1_u1_u1 95.625 _CNV_A_R_LINEAR_____61_CM -48. 47.625 FORMAT "%5.1"
 /begin AXIS_DESCR COM_AXIS TCO _CNV_A_R_LINEAR_____22_CM 6 -48. 142.5 FORMAT "%5.1" AXIS_PTS_REF ldp_tco__iga_bas_temp_cor /end AXIS_DESCR
 /begin AXIS_DESCR COM_AXIS TIA _CNV_A_R_LINEAR_____22_CM 6 -48. 142.5 FORMAT "%5.1" AXIS_PTS_REF ldp_tia__iga_bas_temp_cor /end AXIS_DESCR
/end CHARACTERISTIC
/begin AXIS_PTS ldp_tco__iga_bas_temp_cor "" 0x61878 TCO _REC_AXS_20_u1 190.5 _CNV_A_R_LINEAR_____22_CM 6 -48. 142.5 FORMAT "%5.1" /end AXIS_PTS
/begin AXIS_PTS ldp_tia__iga_bas_temp_cor "" 0x61928 TIA _REC_AXS_20_u1 28.575 _CNV_A_R_LINEAR_____22_CM 6 -48. 142.5 FORMAT "%5.1" /end AXIS_PTS
/begin AXIS_PTS ldpm_n_32_fac_iga_pos_neg "" 0x61778 N_32 _REC_AXS_20_u1 8160. _CNV_A_R_LINEAR_____15_CM 8 0. 8160. FORMAT "%4.0" /end AXIS_PTS
/begin AXIS_PTS ldp_maf_fac_iga_pos_neg "" 0x615b4 MAF _REC_AXS_20_u1 1389. _CNV_A_R_LINEAR_____51_CM 6 0. 1389. FORMAT "%4.0" /end AXIS_PTS
/begin CHARACTERISTIC IP_FAC_IGA_POS__N_32__MAF "Weighting factor on ignition angle correction for temperature effects" MAP 0x65ea8 _REC_MAP_20_u1_u1_u1 0.9960940000000002 _CNV_A_R_LINEAR_____8_CM 0. 0.996094 FORMAT "%5.3"
 /begin AXIS_DESCR COM_AXIS N_32 _CNV_A_R_LINEAR_____15_CM 8 0. 8160. FORMAT "%4.0" AXIS_PTS_REF ldpm_n_32_fac_iga_pos_neg /end AXIS_DESCR
 /begin AXIS_DESCR COM_AXIS MAF _CNV_A_R_LINEAR_____51_CM 6 0. 1389. FORMAT "%4.0" AXIS_PTS_REF ldp_maf_fac_iga_pos_neg /end AXIS_DESCR
/end CHARACTERISTIC
/begin CHARACTERISTIC IP_FAC_IGA_NEG__N_32__MAF "Weighting factor on ignition angle correction for temperature effects" MAP 0x6926a _REC_MAP_20_u1_u1_u1 0.9960940000000002 _CNV_A_R_LINEAR_____8_CM 0. 0.996094 FORMAT "%5.3"
 /begin AXIS_DESCR COM_AXIS N_32 _CNV_A_R_LINEAR_____15_CM 8 0. 8160. FORMAT "%4.0" AXIS_PTS_REF ldpm_n_32_fac_iga_pos_neg /end AXIS_DESCR
 /begin AXIS_DESCR COM_AXIS MAF _CNV_A_R_LINEAR_____51_CM 6 0. 1389. FORMAT "%4.0" AXIS_PTS_REF ldp_maf_fac_iga_pos_neg /end AXIS_DESCR
/end CHARACTERISTIC
/begin MEASUREMENT FAC_RON_AD "Adaptive RON factor" UWORD _CNV_A_R_LINEAR_____2_CM 1 100. 0. 0.99998474 ECU_ADDRESS 0x3fc966 FORMAT "%7.5" /end MEASUREMENT
/begin CHARACTERISTIC C_TCO_AD_MIN_KNK "minimum TCO threshold for knock adaption circuit 2" VALUE 0x67c9b _REC_VAL_20_u1 28.575 _CNV_A_R_LINEAR_____22_CM -48. 142.5 FORMAT "%5.1" /end CHARACTERISTIC
/begin CHARACTERISTIC C_TCO_AD_MIN_RON "Bottom limit TCO" VALUE 0x692a2 _REC_VAL_20_u1 190.5 _CNV_A_R_LINEAR_____22_CM -48. 142.5 FORMAT "%5.1" /end CHARACTERISTIC
/begin CHARACTERISTIC C_CYCNR_AD_RTD_KNK "Number of combustion cycles for  RON adjustment" VALUE 0x692a4 _REC_VAL_20_u2 65535. _CNV_A_R_LINEAR_____206_CM 0. 65535. FORMAT "%5.0" /end CHARACTERISTIC
/begin CHARACTERISTIC C_IGA_MIN_AD "MIN limit IGA for RON adjustment" VALUE 0x692a6 _REC_VAL_20_u1 48. _CNV_A_R_LINEAR_____61_CM -48. 0. FORMAT "%5.1" /end CHARACTERISTIC
/begin CHARACTERISTIC C_IGA_MAX_AD "MAX limit IGA for RON adjustment" VALUE 0x692a7 _REC_VAL_20_u1 48. _CNV_A_R_LINEAR_____61_CM -48. 0. FORMAT "%5.1" /end CHARACTERISTIC
/begin CHARACTERISTIC C_CYCNR_FAC_RON "Adjustment value for RON incrementation  " VALUE 0x692a8 _REC_VAL_20_u1 254. _CNV_A_R_LINEAR_____17_CM 1. 255. FORMAT "%3.0" /end CHARACTERISTIC
/begin CHARACTERISTIC C_TCO_FAC_RON_MIN "TCO-Threshold RON Factor  changing after initialisation cold" VALUE 0x692a9 _REC_VAL_20_u1 190.5 _CNV_A_R_LINEAR_____22_CM -48. 142.5 FORMAT "%5.1" /end CHARACTERISTIC
/begin CHARACTERISTIC C_TCO_FAC_RON_MAX "TCO-Threshold RON Factor  changing after initialisation hot" VALUE 0x692aa _REC_VAL_20_u1 190.5 _CNV_A_R_LINEAR_____22_CM -48. 142.5 FORMAT "%5.1" /end CHARACTERISTIC
/begin CHARACTERISTIC C_FAC_RON_AD_COLD "Factor moving to ® RON_98 after ECU initialisation" VALUE 0x692ab _REC_VAL_20_u1 1.99220002 _CNV_A_R_LINEAR_____64_CM 0. 1.99220002 FORMAT "%5.3" /end CHARACTERISTIC
/begin CHARACTERISTIC C_FAC_RON_AD_HOT "Factor moving to ® RON_91 after ECU initialisation" VALUE 0x692ac _REC_VAL_20_u1 1.99220002 _CNV_A_R_LINEAR_____64_CM 0. 1.99220002 FORMAT "%5.3" /end CHARACTERISTIC
/begin AXIS_PTS ldpm_n_32 "" 0x620b0 N_32 _REC_AXS_20_u1 8160. _CNV_A_R_LINEAR_____15_CM 4 0. 8160. FORMAT "%4.0" /end AXIS_PTS
/begin AXIS_PTS ldp_n_32__maf_min_knk_ad_2 "" 0x620b5 N_32 _REC_AXS_20_u1 8160. _CNV_A_R_LINEAR_____15_CM 16 0. 8160. FORMAT "%4.0" /end AXIS_PTS
/begin AXIS_PTS ldp_tia__ip_fac_ron_ad_max "" 0x620c6 TIA _REC_AXS_20_u1 190.5 _CNV_A_R_LINEAR_____22_CM 4 -48. 142.5 FORMAT "%5.1" /end AXIS_PTS
/begin AXIS_PTS ldp_tco__ip_fac_ron_ad_max "" 0x620cb TCO _REC_AXS_20_u1 190.5 _CNV_A_R_LINEAR_____22_CM 4 -48. 142.5 FORMAT "%5.1" /end AXIS_PTS
/begin CHARACTERISTIC ID_MAF_MIN_KNK_AD_2__N_32 "MAF-theshold for activation  RON-adaptation" CURVE 0x692ad _REC_CUR_20_u1_u1 1389. _CNV_A_R_LINEAR_____51_CM 0. 1389. FORMAT "%4.0"
 /begin AXIS_DESCR COM_AXIS N_32 _CNV_A_R_LINEAR_____15_CM 16 0. 8160. FORMAT "%4.0" AXIS_PTS_REF ldp_n_32__maf_min_knk_ad_2 /end AXIS_DESCR
/end CHARACTERISTIC
/begin CHARACTERISTIC IP_FAC_RON_INC__N "RON-factor increment " CURVE 0x692be _REC_CUR_20_u2_u1 0.99998474 _CNV_A_R_LINEAR_____2_CM 0. 0.99998474 FORMAT "%7.5"
 /begin AXIS_DESCR COM_AXIS N_32 _CNV_A_R_LINEAR_____15_CM 4 0. 8160. FORMAT "%4.0" AXIS_PTS_REF ldpm_n_32 /end AXIS_DESCR
/end CHARACTERISTIC
/begin CHARACTERISTIC IP_FAC_RON_DEC__N "RON factor decrement" CURVE 0x692c6 _REC_CUR_20_u2_u1 0.99998474 _CNV_A_R_LINEAR_____2_CM 0. 0.99998474 FORMAT "%7.5"
 /begin AXIS_DESCR COM_AXIS N_32 _CNV_A_R_LINEAR_____15_CM 4 0. 8160. FORMAT "%4.0" AXIS_PTS_REF ldpm_n_32 /end AXIS_DESCR
/end CHARACTERISTIC
/begin CHARACTERISTIC IP_FAC_RON_AD_MAX__TIA__TCO "Threshold for RON Factor = 1 recognition for the whole  driving cycle" MAP 0x692ce _REC_MAP_20_u1_u1_u1 0.9960940000000002 _CNV_A_R_LINEAR_____8_CM 0. 0.996094 FORMAT "%5.3"
 /begin AXIS_DESCR COM_AXIS TIA _CNV_A_R_LINEAR_____22_CM 4 -48. 142.5 FORMAT "%5.1" AXIS_PTS_REF ldp_tia__ip_fac_ron_ad_max /end AXIS_DESCR
 /begin AXIS_DESCR COM_AXIS TCO _CNV_A_R_LINEAR_____22_CM 4 -48. 142.5 FORMAT "%5.1" AXIS_PTS_REF ldp_tco__ip_fac_ron_ad_max /end AXIS_DESCR
/end CHARACTERISTIC
/begin CHARACTERISTIC IPM_EFF_IGA__IGA_DIF "Basic Ignition Efficiency" CURVE 0x65a4c _REC_CUR_20_u2_u1 1.99996948 _CNV_A_R_LINEAR_____5_CM 0. 1.99996948 FORMAT "%7.5"
 /begin AXIS_DESCR COM_AXIS IGA_DIF_MIN _CNV_A_R_LINEAR_____49_CM 16 0. -95.625 FORMAT "%5.1" AXIS_PTS_REF ldp_iga_dif_eff_iga /end AXIS_DESCR
/end CHARACTERISTIC
/begin MEASUREMENT IGA_MIN "Minimum ignition Angle" UBYTE _CNV_A_R_LINEAR_____11_CM 1 100. -23.625 72. ECU_ADDRESS 0x3fd888 FORMAT "%5.1" /end MEASUREMENT
/begin MEASUREMENT IGA_MIN_TEG "minimum ignition angle" UBYTE _CNV_A_R_LINEAR_____11_CM 1 100. -23.625 72. ECU_ADDRESS 0x3fd8a8 FORMAT "%5.1" /end MEASUREMENT
/begin MEASUREMENT IGA_DIF_MIN_TEG "Difference of minimum ignition angle with reference one - TEG correction included" UBYTE _CNV_A_R_LINEAR_____49_CM 1 100. 0. -95.625 ECU_ADDRESS 0x3fd8a9 FORMAT "%5.1" /end MEASUREMENT
/begin MEASUREMENT EFF_IGA_MIN_TEG "Ignition efficiency minimum ignition angle with TEG correction" UWORD _CNV_A_R_LINEAR_____5_CM 1 100. 0. 1.99996948 ECU_ADDRESS 0x3fc8ec FORMAT "%7.5" /end MEASUREMENT
/begin MEASUREMENT TEG_DYN_HYS "Temperature of exhaust gas with hysterisis for IGA_MIN limitation" UWORD _CNV_A_R_LINEAR_____94_CM 1 100. 0. 2047. ECU_ADDRESS 0x3fd8ac FORMAT "%7.2" /end MEASUREMENT
/begin CHARACTERISTIC C_TEG_MAX_IGA_HYS "Hysterisis on exhaust gas temperature for spark retard control" VALUE 0x692de _REC_VAL_20_u2 2047. _CNV_A_R_LINEAR_____94_CM 0. 2047. FORMAT "%7.2" /end CHARACTERISTIC
/begin CHARACTERISTIC C_TEG_MAX_IGA "Maximum allowable exhaust gas temperature for spark retard control" VALUE 0x692e0 _REC_VAL_20_u2 2047. _CNV_A_R_LINEAR_____94_CM 0. 2047. FORMAT "%7.2" /end CHARACTERISTIC
/begin AXIS_PTS ldp_teg_dyn_hys "" 0x620d0 TEG_DYN_HYS _REC_AXS_20_u2 2047. _CNV_A_R_LINEAR_____94_CM 16 0. 2047. FORMAT "%7.2" /end AXIS_PTS
/begin CHARACTERISTIC IP_IGA_DIF_MIN_TCO__TCO "TCO correction for minimum ignition angle" CURVE 0x65f44 _REC_CUR_20_u1_u1 95.625 _CNV_A_R_LINEAR_____61_CM -48. 47.625 FORMAT "%5.1"
 /begin AXIS_DESCR COM_AXIS TCO _CNV_A_R_LINEAR_____22_CM 8 -48. 142.5 FORMAT "%5.1" AXIS_PTS_REF ldp_tco_iga_dif_min_tco /end AXIS_DESCR
/end CHARACTERISTIC
/begin CHARACTERISTIC IP_IGA_DIF_MIN_TEG__TEG "Minimum ignition angle versus exhaust gas temperature" CURVE 0x692e2 _REC_CUR_20_u1_u2 -95.625 _CNV_A_R_LINEAR_____49_CM 0. -95.625 FORMAT "%5.1"
 /begin AXIS_DESCR COM_AXIS TEG_DYN_HYS _CNV_A_R_LINEAR_____94_CM 16 0. 2047. FORMAT "%7.2" AXIS_PTS_REF ldp_teg_dyn_hys /end AXIS_DESCR
/end CHARACTERISTIC
/begin MEASUREMENT MAF_SP "MAF setpoint output for inverse air path" UWORD _CNV_A_R_LINEAR_____56_CM 1 100. 0. 1389. ECU_ADDRESS 0x3fc270 FORMAT "%6.2" /end MEASUREMENT
/begin CHARACTERISTIC ID_PV_MAX_FL__N "PWG-demand for Full load recognition" CURVE 0x658d6 _REC_CUR_20_u1_u2 9.9609375 _CNV_A_R_LINEAR_____16_CM 0. 99.609375 FORMAT "%5.2"
 /begin AXIS_DESCR COM_AXIS N _CNV_A_R_LINEAR_____0_CM 16 0. 8160. FORMAT "%4.0" AXIS_PTS_REF ldpm_n_2_3 /end AXIS_DESCR
/end CHARACTERISTIC
/begin CHARACTERISTIC LC_IGA_ST_ENA "Logical constant for seperated start ignition angle" VALUE 0x67d84 _REC_VAL_20_u1 1. _CNV_A_R_LINEAR_____13_CM 0. 1. FORMAT "%1.0" /end CHARACTERISTIC
/begin AXIS_PTS ldp_tco__iga_ref_temp_fac "" 0x6187f TCO _REC_AXS_20_u1 190.5 _CNV_A_R_LINEAR_____22_CM 6 -48. 142.5 FORMAT "%5.1" /end AXIS_PTS
/begin AXIS_PTS ldp_n_32__eoi_bas "" 0x61620 N_32 _REC_AXS_20_u1 816. _CNV_A_R_LINEAR_____15_CM 6 0. 8160. FORMAT "%4.0" /end AXIS_PTS
/begin MEASUREMENT TPS_AV_LIH_DIF "Difference between TPS_AV and TPS_LIH" UWORD _CNV_A_R_LINEAR_____47_CM 1 100. -119.5 119.5 ECU_ADDRESS 0x3fcdc4 FORMAT "%8.3" /end MEASUREMENT
/begin MEASUREMENT LV_INH_MTC_CTL "State Bit for Deactivation of the ETC Position Controller Output" UBYTE _CNV_S_2_RANGE______74_CM 1 100. 0. 1. ECU_ADDRESS 0x3fd506 /end MEASUREMENT
/begin MEASUREMENT IGA_MV_KNK "meanvalue of actual retard adjustment without adaptation values" UBYTE _CNV_A_R_LINEAR_____61_CM 1 100. -48. 0. ECU_ADDRESS 0x3fd909 FORMAT "%4.1" /end MEASUREMENT
/begin MEASUREMENT IGA_MV_KNK_FIL "Filtered mean knock correction" SBYTE _CNV_A_R_LINEAR_____6_CM 1 100. -48. 47.625 ECU_ADDRESS 0x3fd879 FORMAT "%5.1" /end MEASUREMENT
/begin MEASUREMENT FAC_IGA_MAX_KNK "Weighting factor for the max. spark retard against coolant" UBYTE _CNV_A_R_LINEAR_____8_CM 1 100. 0. 0.996094 ECU_ADDRESS 0x3fd91f FORMAT "%5.3" /end MEASUREMENT
/begin CHARACTERISTIC ID_MAF_FAC_SLOP__PQ_ESTIM "Slope air flow function" CURVE 0x639bc _REC_CUR_20_u2_u2 8.880330000000001 _CNV_A_R_LINEAR_____285_CM 0. 8.880330000000001 FORMAT "%6.4"
 /begin AXIS_DESCR COM_AXIS PQ_ESTIM _CNV_A_R_LINEAR_____2_CM 16 0. 0.99998474 FORMAT "%7.5" AXIS_PTS_REF ldpm_pq_estim_id_maf_fac_ofs /end AXIS_DESCR
/end CHARACTERISTIC
/begin MEASUREMENT TPS_SP "real throttle angle setpoint for MTC-position controller" UWORD _CNV_A_R_LINEAR_____34_CM 1 100. 0. 119.5 ECU_ADDRESS 0x3fd01a FORMAT "%7.3" /end MEASUREMENT
/begin CHARACTERISTIC C_TPS_SP_AS_MAN "Throttle position setpoint manual" VALUE 0x63e7c _REC_VAL_20_u2 119.5 _CNV_A_R_LINEAR_____34_CM 0. 119.5 FORMAT "%7.3" /end CHARACTERISTIC
/begin CHARACTERISTIC C_TPS_SP_MAN_ACT "variable enabled for throttle position setpoint manual" VALUE 0x63e7e _REC_VAL_20_u1 1. _CNV_A_R_LINEAR_____17_CM 0. 1. FORMAT "%2.0" /end CHARACTERISTIC
/begin CHARACTERISTIC C_TPS_AD_CTL_INI "TPS setpoint with MTC position controller off" VALUE 0x63e7f _REC_VAL_20_u1 119.5 _CNV_A_R_LINEAR_____300_CM 0. 119.5 FORMAT "%4.1" /end CHARACTERISTIC
/begin MEASUREMENT MAP_SP "Setpoint of the manifold pressure" UWORD _CNV_A_R_LINEAR_____1_CM 1 100. 0. 5434. ECU_ADDRESS 0x3fcf90 FORMAT "%7.2" /end MEASUREMENT
/begin MEASUREMENT PQ_SP "Setpoint of the pressure quotient" UWORD _CNV_A_R_LINEAR_____2_CM 1 100. 0. 0.99998474 ECU_ADDRESS 0x3fcf92 FORMAT "%7.5" /end MEASUREMENT
/begin MEASUREMENT MAF_SP_RATIO "Setpoint of the ratio MAF_SP / MAF_MAX_COR" UWORD _CNV_A_R_LINEAR_____2_CM 1 100. 0. 0.99998474 ECU_ADDRESS 0x3fcf8c FORMAT "%7.5" /end MEASUREMENT
/begin MEASUREMENT AMP_MDL_IVS "Ambient pressure used for model adjustment inverse" UWORD _CNV_A_R_LINEAR_____1_CM 1 100. 0. 5434. ECU_ADDRESS 0x3fcf96 FORMAT "%7.2" /end MEASUREMENT
/begin MEASUREMENT PRS_UP_THR_IVS "Pressure upstream the throttle inverse" UWORD _CNV_A_R_LINEAR_____1_CM 1 100. 0. 5434. ECU_ADDRESS 0x3fcf98 FORMAT "%7.2" /end MEASUREMENT
/begin MEASUREMENT AR_RED_SP_1 "Setpoint reduced throttle area" UWORD _CNV_A_R_LINEAR_____286_CM 1 100. 0. 58.592855 ECU_ADDRESS 0x3fcf9a FORMAT "%7.4" /end MEASUREMENT
/begin MEASUREMENT AR_RED_SP_MMV_1 "Moving mean value of AR_RED_SP_1" UWORD _CNV_A_R_LINEAR_____286_CM 1 100. 0. 58.592855 ECU_ADDRESS 0x3fcf9c FORMAT "%7.4" /end MEASUREMENT
/begin MEASUREMENT AR_RED_SP_MMV "Moving mean value of desired reduced area" UWORD _CNV_A_R_LINEAR_____286_CM 1 100. 0. 58.592855 ECU_ADDRESS 0x3fcf9e FORMAT "%7.4" /end MEASUREMENT
/begin MEASUREMENT TPS_SP_MDL_BAS "Setpoint of the throttle position before maximum check         " UWORD _CNV_A_R_LINEAR_____34_CM 1 100. 0. 119.5 ECU_ADDRESS 0x3fcfa0 FORMAT "%7.3" /end MEASUREMENT
/begin MEASUREMENT TPS_SP_MDL "Setpoint throttle position" UWORD _CNV_A_R_LINEAR_____34_CM 1 100. 0. 119.5 ECU_ADDRESS 0x3fcf80 FORMAT "%7.3" /end MEASUREMENT
/begin MEASUREMENT TPS_SP_MDL_MAX "Setpoint throttle position after limitation" UWORD _CNV_A_R_LINEAR_____34_CM 1 100. 0. 119.5 ECU_ADDRESS 0x3fcfa2 FORMAT "%7.3" /end MEASUREMENT
/begin MEASUREMENT TPS_SP_MDL_BAS_COR "Setpoint throttle position after linear interpolation      " UWORD _CNV_A_R_LINEAR_____34_CM 1 100. 0. 119.5 ECU_ADDRESS 0x3fcfa4 FORMAT "%7.3" /end MEASUREMENT
/begin CHARACTERISTIC IP_AMP_DEC__MAF_KGH_SP "pressure decrease in the air cleaner" CURVE 0x63e80 _REC_CUR_20_u2_u2 5434. _CNV_A_R_LINEAR_____1_CM 0. 5434. FORMAT "%7.2"
 /begin AXIS_DESCR COM_AXIS MAF_KGH_SP _CNV_A_R_LINEAR_____52_CM 4 0. 2047.96875 FORMAT "%6.2" AXIS_PTS_REF ldp_maf_kgh_sp__amp_dec /end AXIS_DESCR
/end CHARACTERISTIC
/begin AXIS_PTS ldp_n_32__tps_sp_mdl_max "" 0x61098 N_32 _REC_AXS_20_u1 816. _CNV_A_R_LINEAR_____15_CM 8 0. 8160. FORMAT "%4.0" /end AXIS_PTS
/begin CHARACTERISTIC IP_TPS_SP_MDL_MAX__N_32__MAF_SP "Maximum throttle position setpoint at ignition key on" MAP 0x63ea8 _REC_MAP_20_u2_u1_u2 119.5 _CNV_A_R_LINEAR_____34_CM 0. 119.5 FORMAT "%7.3"
 /begin AXIS_DESCR COM_AXIS N_32 _CNV_A_R_LINEAR_____15_CM 8 0. 8160. FORMAT "%4.0" AXIS_PTS_REF ldp_n_32__tps_sp_mdl_max /end AXIS_DESCR
 /begin AXIS_DESCR COM_AXIS MAF_SP _CNV_A_R_LINEAR_____56_CM 4 0. 1389. FORMAT "%7.2" AXIS_PTS_REF ldp_maf_sp__tps_sp_mdl_max /end AXIS_DESCR
/end CHARACTERISTIC
/begin CHARACTERISTIC LC_AR_RED_FIL_ENA "Logical variable enabled for reduced throttle area filter" VALUE 0x63ee8 _REC_VAL_20_u1 1. _CNV_A_R_LINEAR_____13_CM 0. 1. FORMAT "%1.0" /end CHARACTERISTIC
/begin MEASUREMENT MAF_SP_S "MAF setpoint for stratified mode" UWORD _CNV_A_R_LINEAR_____56_CM 1 100. 0. 1389. ECU_ADDRESS 0x3fcd92 FORMAT "%6.2" /end MEASUREMENT
/begin MEASUREMENT FAC_MAF_MAX_S "Ratio between MAF and MAF_MAX for stratified mode" UWORD _CNV_A_R_LINEAR_____5_CM 1 100. 0. 1.99996948 ECU_ADDRESS 0x3fcd98 FORMAT "%7.5" /end MEASUREMENT
/begin MEASUREMENT MAF_DIF_S "Air mass flow difference in stratified combustion" UWORD _CNV_A_R_LINEAR_____301_CM 1 100. -695. 694.97 ECU_ADDRESS 0x3fcd96 FORMAT "%7.2" /end MEASUREMENT
/begin AXIS_PTS ldp_n_32__pq_egr_sp "" 0x610be N_32 _REC_AXS_20_u1 816. _CNV_A_R_LINEAR_____15_CM 8 0. 8160. FORMAT "%4.0" /end AXIS_PTS
/begin AXIS_PTS ldp_n_32__fac_maf_max_s "" 0x610c7 N_32 _REC_AXS_20_u1 816. _CNV_A_R_LINEAR_____15_CM 8 0. 8160. FORMAT "%4.0" /end AXIS_PTS
/begin AXIS_PTS ldp_mff_sp_s__fac_maf_max_s "" 0x610de MFF_SP_S _REC_AXS_20_u2 1389. _CNV_A_R_LINEAR_____56_CM 6 0. 1389. FORMAT "%7.2" /end AXIS_PTS
/begin AXIS_PTS ldp_maf_dif_s__eff_maf_s "" 0x610ec MAF_DIF_S _REC_AXS_20_u2 1389.97 _CNV_A_R_LINEAR_____301_CM 16 -695. 694.97 FORMAT "%7.2" /end AXIS_PTS
/begin CHARACTERISTIC IP_PQ_EGR_SP "MAF setpoint for stratified mode" MAP 0x63ef6 _REC_MAP_20_u2_u1_u2 0.99998474 _CNV_A_R_LINEAR_____2_CM 0. 0.99998474 FORMAT "%7.5"
 /begin AXIS_DESCR COM_AXIS N_32 _CNV_A_R_LINEAR_____15_CM 8 0. 8160. FORMAT "%4.0" AXIS_PTS_REF ldp_n_32__pq_egr_sp /end AXIS_DESCR
 /begin AXIS_DESCR COM_AXIS MFF_SP_S _CNV_A_R_LINEAR_____56_CM 6 0. 1389. FORMAT "%7.2" AXIS_PTS_REF ldp_mff_sp_s__pq_egr_sp /end AXIS_DESCR
/end CHARACTERISTIC
/begin CHARACTERISTIC IP_FAC_MAF_MAX_S "Ratio between MAF and MAF_MAX for stratified mode" MAP 0x63f56 _REC_MAP_20_u2_u1_u2 1.99996948 _CNV_A_R_LINEAR_____5_CM 0. 1.99996948 FORMAT "%7.5"
 /begin AXIS_DESCR COM_AXIS N_32 _CNV_A_R_LINEAR_____15_CM 8 0. 8160. FORMAT "%4.0" AXIS_PTS_REF ldp_n_32__fac_maf_max_s /end AXIS_DESCR
 /begin AXIS_DESCR COM_AXIS MFF_SP_S _CNV_A_R_LINEAR_____56_CM 6 0. 1389. FORMAT "%7.2" AXIS_PTS_REF ldp_mff_sp_s__fac_maf_max_s /end AXIS_DESCR
/end CHARACTERISTIC
/begin CHARACTERISTIC IP_EFF_MAF_S "AIR efficiency in stratified combustion" CURVE 0x63fb6 _REC_CUR_20_u2_u2 1.99996948 _CNV_A_R_LINEAR_____5_CM 0. 1.99996948 FORMAT "%7.5"
 /begin AXIS_DESCR COM_AXIS MAF_DIF_S _CNV_A_R_LINEAR_____301_CM 16 -695. 694.97 FORMAT "%7.2" AXIS_PTS_REF ldp_maf_dif_s__eff_maf_s /end AXIS_DESCR
/end CHARACTERISTIC
/begin CHARACTERISTIC LC_TPS_FIL_ENA "Logical variable enabled for throttle position setpoint filter" VALUE 0x63ee9 _REC_VAL_20_u1 1. _CNV_A_R_LINEAR_____13_CM 0. 1. FORMAT "%1.0" /end CHARACTERISTIC
/begin AXIS_PTS ldp_mff_sp_s__pq_egr_sp "" 0x610d0 MFF_SP_S _REC_AXS_20_u2 1389. _CNV_A_R_LINEAR_____56_CM 6 0. 1389. FORMAT "%7.2" /end AXIS_PTS
/begin CHARACTERISTIC IP_TPS_SP_MDL_BAS "throttle position setpoint (!inverse of IP_AR_RED_THR__TPS_SEG!)" CURVE 0x63e88 _REC_CUR_20_u2_u2 119.5 _CNV_A_R_LINEAR_____34_CM 0. 119.5 FORMAT "%7.3"
 /begin AXIS_DESCR COM_AXIS AR_RED_SP_MMV _CNV_A_R_LINEAR_____286_CM 16 0. 58.592855 FORMAT "%7.4" AXIS_PTS_REF ldp_ar_red_sp_mmv /end AXIS_DESCR
/end CHARACTERISTIC
/begin AXIS_PTS ldp_ar_red_sp_mmv "" 0x61076 AR_RED_SP_MMV _REC_AXS_20_u2 58.592855 _CNV_A_R_LINEAR_____286_CM 16 0. 58.592855 FORMAT "%7.4" /end AXIS_PTS
/begin AXIS_PTS ldp_maf_kgh_sp__amp_dec "" 0x6106c MAF_KGH_SP _REC_AXS_20_u2 2047.96875 _CNV_A_R_LINEAR_____52_CM 4 0. 2047.96875 FORMAT "%6.2" /end AXIS_PTS
/begin MEASUREMENT LV_MTC_CUR_OFF "Logical variable to switch off  the MTC-controller" UBYTE _CNV_S_2_RANGE______74_CM 1 100. 0. 1. ECU_ADDRESS 0x3fd553 /end MEASUREMENT
/begin CHARACTERISTIC LC_MAF_SP_EGR "Logical variable switch mass flow and partial pressure" VALUE 0x63fd6 _REC_VAL_20_u1 1. _CNV_A_R_LINEAR_____13_CM 0. 1. FORMAT "%1.0" /end CHARACTERISTIC
/begin MEASUREMENT MAF_KGH_SP "Setpoint mass air flow into the manifold" UWORD _CNV_A_R_LINEAR_____52_CM 1 100. 0. 2047.96875 ECU_ADDRESS 0x3fcf8e FORMAT "%7.2" /end MEASUREMENT
/begin AXIS_PTS ldp_pq_sp_fil__crlc_ar_red_sp "" 0x610ac CRLC_AR_RED_SP _REC_AXS_20_u2 0.99998474 _CNV_A_R_LINEAR_____2_CM 8 0. 0.99998474 FORMAT "%7.5" /end AXIS_PTS
/begin CHARACTERISTIC IP_CRLC_AR_RED_SP "correlation constant for the moving mean value calculation of AR_RED_SP" CURVE 0x63eec _REC_CUR_20_u1_u2 0.9960940000000002 _CNV_A_R_LINEAR_____8_CM 0. 0.996094 FORMAT "%5.3"
 /begin AXIS_DESCR COM_AXIS PQ _CNV_A_R_LINEAR_____2_CM 8 0. 0.99998474 FORMAT "%7.5" AXIS_PTS_REF ldp_pq_sp_fil__crlc_ar_red_sp /end AXIS_DESCR
/end CHARACTERISTIC
/begin AXIS_PTS ldp_maf_sp__tps_sp_mdl_max "" 0x610a2 MAF_SP _REC_AXS_20_u2 1389. _CNV_A_R_LINEAR_____56_CM 4 0. 1389. FORMAT "%7.2" /end AXIS_PTS
/begin CHARACTERISTIC LC_INH_ISAPWM_MAN_AS "logical variable to inhibit ISAPWM setpoint by application system" VALUE 0x642f2 _REC_VAL_20_u1 1. _CNV_A_R_LINEAR_____17_CM 0. 1. FORMAT "%2.0" /end CHARACTERISTIC
/begin CHARACTERISTIC ID_MAF_FAC_OFS__PQ_ESTIM "Offset air flow function" CURVE 0x6399c _REC_CUR_20_u2_u2 8.880330000000001 _CNV_A_R_LINEAR_____285_CM 0. 8.880330000000001 FORMAT "%6.4"
 /begin AXIS_DESCR COM_AXIS PQ_ESTIM _CNV_A_R_LINEAR_____2_CM 16 0. 0.99998474 FORMAT "%7.5" AXIS_PTS_REF ldpm_pq_estim_id_maf_fac_ofs /end AXIS_DESCR
/end CHARACTERISTIC
/begin AXIS_PTS ldpm_pq_estim_id_maf_fac_ofs "" 0x60f74 PQ_ESTIM _REC_AXS_20_u2 0.99998474 _CNV_A_R_LINEAR_____2_CM 16 0. 0.99998474 FORMAT "%7.5" /end AXIS_PTS
/begin MEASUREMENT EFF_TOT_BAS_AFL "Total basis efficiency in air fuel lean mode" UWORD _CNV_A_R_LINEAR_____5_CM 1 100. 0. 1.99996948 ECU_ADDRESS 0x3fc5de FORMAT "%7.5" /end MEASUREMENT
/begin MEASUREMENT EFF_IGA_AFL "Basis ignition efficiency in air fuel lean mode" UWORD _CNV_A_R_LINEAR_____5_CM 1 100. 0. 1.99996948 ECU_ADDRESS 0x3fc5e0 FORMAT "%7.5" /end MEASUREMENT
/begin MEASUREMENT EFF_LAMB_AFL "Basis lambda efficiency in air fuel lean mode" UWORD _CNV_A_R_LINEAR_____5_CM 1 100. 0. 1.99996948 ECU_ADDRESS 0x3fc5e2 FORMAT "%7.5" /end MEASUREMENT
/begin MEASUREMENT TQI_SP_MAF_AFL "???" SWORD _CNV_A_R_LINEAR_____37_CM 1 100. -1024. 1023.96875 ECU_ADDRESS 0x3fc5e4 FORMAT "%7.1" /end MEASUREMENT
/begin MEASUREMENT MAF_SP_TQI_AFL "Air mass setpoint in air fuel lean mode" UWORD _CNV_A_R_LINEAR_____56_CM 1 100. 0. 1389. ECU_ADDRESS 0x3fc5e6 FORMAT "%7.2" /end MEASUREMENT
/begin MEASUREMENT LV_AUTH_MAF_AFL "Logical variable authorize air fuel lean mode after MAF check" UBYTE _CNV_S_2_RANGE______74_CM 1 100. 0. 1. ECU_ADDRESS 0x3fd3dc BIT_MASK 0x1 /end MEASUREMENT
/begin MEASUREMENT LV_HOM_ACT "Homogeneous ignition and injection parameters are applied to the engine" UBYTE _CNV_S_2_RANGE______74_CM 1 100. 0. 1. ECU_ADDRESS 0x3fd3e3 BIT_MASK 0x1 /end MEASUREMENT
/begin MEASUREMENT LV_S_ACT "Stratified ignition and injection parameters are applied to the engine" UBYTE _CNV_S_2_RANGE______74_CM 1 100. 0. 1. ECU_ADDRESS 0x3fd3e5 BIT_MASK 0x1 /end MEASUREMENT
/begin MEASUREMENT LV_HOM_RUN "Flag to activate homogeneous calculations" UBYTE _CNV_S_2_RANGE______74_CM 1 100. 0. 1. ECU_ADDRESS 0x3fd3e7 BIT_MASK 0x1 /end MEASUREMENT
/begin MEASUREMENT LV_S_RUN "Flag to activate stratified calculations" UBYTE _CNV_S_2_RANGE______74_CM 1 100. 0. 1. ECU_ADDRESS 0x3fd3e6 BIT_MASK 0x1 /end MEASUREMENT
/begin MEASUREMENT LV_MAF_SP_SWI "Flag for MAF setpoint switch" UBYTE _CNV_S_2_RANGE______74_CM 1 100. 0. 1. ECU_ADDRESS 0x3fd3e8 BIT_MASK 0x1 /end MEASUREMENT
/begin MEASUREMENT LV_SP_RATE_CYL_EGR_SWI "Flag for EGR setpoint rate" UBYTE _CNV_S_2_RANGE______74_CM 1 100. 0. 1. ECU_ADDRESS 0x3fd3e9 BIT_MASK 0x1 /end MEASUREMENT
/begin MEASUREMENT LV_FUP_SP_SWI "Flag for fuel pressure setpoint switch" UBYTE _CNV_S_2_RANGE______74_CM 1 100. 0. 1. ECU_ADDRESS 0x3fd3eb BIT_MASK 0x1 /end MEASUREMENT
/begin MEASUREMENT LV_PORT_DEAC_SWI "Flag for swirl port deac switch" UBYTE _CNV_S_2_RANGE______74_CM 1 100. 0. 1. ECU_ADDRESS 0x3fd3ec BIT_MASK 0x1 /end MEASUREMENT
/begin MEASUREMENT LV_TRAN_HOM_TO_PREL "Transition from Homogeneous Mode to \"HOM to S preliminary\"." UBYTE _CNV_S_2_RANGE______74_CM 1 100. 0. 1. ECU_ADDRESS 0x3fd3f6 BIT_MASK 0x1 /end MEASUREMENT
/begin MEASUREMENT LV_TRAN_SWI_HOM_TO_S "Transition from \"HOM to S_preliminary\"-mode to \"Going back to stratified \"" UBYTE _CNV_S_2_RANGE______74_CM 1 100. 0. 1. ECU_ADDRESS 0x3fd3f7 BIT_MASK 0x1 /end MEASUREMENT
/begin MEASUREMENT LV_TRAN_S_TO_PREL "Transition from Stratified Mode to \"S to HOM preliminary\"." UBYTE _CNV_S_2_RANGE______74_CM 1 100. 0. 1. ECU_ADDRESS 0x3fd3f9 BIT_MASK 0x1 /end MEASUREMENT
/begin MEASUREMENT LV_TRAN_PREL_TO_BACKHOM "Transition from \"HOM to S_preliminary\" to \"Going back to homogeneous\"" UBYTE _CNV_S_2_RANGE______74_CM 1 100. 0. 1. ECU_ADDRESS 0x3fd3f8 BIT_MASK 0x1 /end MEASUREMENT
/begin MEASUREMENT LV_TRAN_PREL_TO_BACKS "Transition from \"S to HOM preliminary\" to \"Going back to stratified\"" UBYTE _CNV_S_2_RANGE______74_CM 1 100. 0. 1. ECU_ADDRESS 0x3fd3fa BIT_MASK 0x1 /end MEASUREMENT
/begin MEASUREMENT LV_TRAN_SWI_S_TO_HOM "Transition from \"S to HOM preliminary\"-mode to \"Going back to homogeneous\"-mode." UBYTE _CNV_S_2_RANGE______74_CM 1 100. 0. 1. ECU_ADDRESS 0x3fd3fb BIT_MASK 0x1 /end MEASUREMENT
/begin MEASUREMENT LV_TRAN_BACKS_TO_S "Transition from \"Going back to stratified\" to Stratified Mode " UBYTE _CNV_S_2_RANGE______74_CM 1 100. 0. 1. ECU_ADDRESS 0x3fd3fc BIT_MASK 0x1 /end MEASUREMENT
/begin MEASUREMENT LV_TRAN_BACKHOM_TO_HOM_AFL "Transition from  \"BACKHOM\" to \"HOM_AFL\"" UBYTE _CNV_S_2_RANGE______74_CM 1 100. 0. 1. ECU_ADDRESS 0x3fd3fd BIT_MASK 0x1 /end MEASUREMENT
/begin MEASUREMENT LV_TRAN_BACKHOM_TO_HOM_AFS "Transition from  \"BACKHOM\" to \"HOM_AFS\"" UBYTE _CNV_S_2_RANGE______74_CM 1 100. 0. 1. ECU_ADDRESS 0x3fd3fe BIT_MASK 0x1 /end MEASUREMENT
/begin MEASUREMENT LV_HOM_AFL_REQ "Homogeneous air fuel lean mode requested " UBYTE _CNV_S_2_RANGE______74_CM 1 100. 0. 1. ECU_ADDRESS 0x3fd3ff BIT_MASK 0x1 /end MEASUREMENT
/begin MEASUREMENT LV_HOM_AFS_REQ "Homogeneous air fuel stoichiometric mode requested" UBYTE _CNV_S_2_RANGE______74_CM 1 100. 0. 1. ECU_ADDRESS 0x3fd3ee BIT_MASK 0x1 /end MEASUREMENT
/begin MEASUREMENT LV_TRAN_TO_HOM_AFS "Transition to air fuel stoichiometric mode" UBYTE _CNV_S_2_RANGE______74_CM 1 100. 0. 1. ECU_ADDRESS 0x3fd401 BIT_MASK 0x1 /end MEASUREMENT
/begin MEASUREMENT LV_LAMB_HOM_AFL_ACT_1 "Internal state bit in state AFS_TO_AFL" UBYTE _CNV_S_2_RANGE______74_CM 1 100. 0. 1. ECU_ADDRESS 0x3fd402 BIT_MASK 0x1 /end MEASUREMENT
/begin MEASUREMENT LV_LAMB_SP_REQ_ACT "Logical control bit for activating LAMB_SP_REQ" UBYTE _CNV_S_2_RANGE______74_CM 1 100. 0. 1. ECU_ADDRESS 0x3fd3ed BIT_MASK 0x1 /end MEASUREMENT
/begin MEASUREMENT T_DLY_EGR_S "Timer to delay the transition from homogeneous to stratified (to get right EGR-rate)" UBYTE _CNV_A_R_LINEAR_____21_CM 1 100. 0. 2.55 ECU_ADDRESS 0x3fd7e5 FORMAT "%4.2" /end MEASUREMENT
/begin MEASUREMENT CYC_DLY_THR_S_HOM_CTR "segment synch. counter to delay the transition from stratified to (to reduce exhaust gas in the intake manifold)" UWORD _CNV_A_R_LINEAR_____20_CM 1 100. 0. 65535. ECU_ADDRESS 0x3fc5d8 FORMAT "%5.0" /end MEASUREMENT
/begin MEASUREMENT EGR_RATIO_PREV_S "EGR_RATIO in stratified mode (input in IP_CYC_DLY_THR_S_HOM_CTR)" UWORD _CNV_A_R_LINEAR_____144_CM 1 100. 0. 99.99847412 ECU_ADDRESS 0x3fc5f4 /end MEASUREMENT
/begin MEASUREMENT LAMB_SP_REQ "Lambda setpoint request during combustion mode change in homogeneous" UWORD _CNV_A_R_LINEAR_____50_CM 1 100. 0. 31.99902344 ECU_ADDRESS 0x3fc5dc FORMAT "%7.4" /end MEASUREMENT
/begin MEASUREMENT EFF_LAMB_AFL_1 "Lambda efficiency for lambda intermediate step LAMB_HOM_AFL_1" UWORD _CNV_A_R_LINEAR_____5_CM 1 100. 0. 1.99996948 ECU_ADDRESS 0x3fc5f6 FORMAT "%7.5" /end MEASUREMENT
/begin MEASUREMENT EFF_IGA_AFS_TO_AFL_THD "Ignition efficiency threshold for switching to HOM_AFL" UWORD _CNV_A_R_LINEAR_____5_CM 1 100. 0. 1.99996948 ECU_ADDRESS 0x3fc5f8 FORMAT "%7.5" /end MEASUREMENT
/begin MEASUREMENT STATE_CMB_CTL_MAN "States of the combustion management manual selected" ULONG _CNV_S_4_RANGE_STAT_305_CM 1 100. 0. 3. ECU_ADDRESS 0x3fc0e0 /end MEASUREMENT
/begin MEASUREMENT STATE_TQ_CMB "Combustion selection on torque" ULONG _CNV_S_3_RANGE_STAT_306_CM 1 100. 0. 2. ECU_ADDRESS 0x3fc0d8 /end MEASUREMENT
/begin MEASUREMENT STATE_TQI_REQ_FAST "State torque request TQI_REQ_FAST " ULONG _CNV_S_5_RANGE_STAT_307_CM 1 100. 0. 4. ECU_ADDRESS 0x3fc5ec /end MEASUREMENT
/begin MEASUREMENT LV_TRAN_TO_HOM_AFL "Transition to air fuel lean mode" UBYTE _CNV_S_2_RANGE______74_CM 1 100. 0. 1. ECU_ADDRESS 0x3fd400 BIT_MASK 0x1 /end MEASUREMENT
/begin MEASUREMENT LV_TRAN_TQ_S_TO_AFS "Transition S to AFS requested" UBYTE _CNV_S_2_RANGE______74_CM 1 100. 0. 1. ECU_ADDRESS 0x3fd3f3 BIT_MASK 0x1 /end MEASUREMENT
/begin MEASUREMENT LV_TRAN_TQ_S_TO_AFL "Transition S to AFL requested" UBYTE _CNV_S_2_RANGE______74_CM 1 100. 0. 1. ECU_ADDRESS 0x3fd3f4 BIT_MASK 0x1 /end MEASUREMENT
/begin MEASUREMENT LV_TRAN_TQ_AFS_TO_S "Transition AFS to S requested" UBYTE _CNV_S_2_RANGE______74_CM 1 100. 0. 1. ECU_ADDRESS 0x3fd3f0 BIT_MASK 0x1 /end MEASUREMENT
/begin MEASUREMENT LV_TRAN_TQ_AFL_TO_S "Transition AFL to S requested" UBYTE _CNV_S_2_RANGE______74_CM 1 100. 0. 1. ECU_ADDRESS 0x3fd3f2 BIT_MASK 0x1 /end MEASUREMENT
/begin MEASUREMENT LV_TRAN_TQ_AFL_TO_AFS "Transition AFL to AFS requested" UBYTE _CNV_S_2_RANGE______74_CM 1 100. 0. 1. ECU_ADDRESS 0x3fd3f1 BIT_MASK 0x1 /end MEASUREMENT
/begin MEASUREMENT LV_TQI_S "Logical constant stratified mode requested" UBYTE _CNV_S_2_RANGE______74_CM 1 100. 0. 1. ECU_ADDRESS 0x3fd3e0 BIT_MASK 0x1 /end MEASUREMENT
/begin MEASUREMENT LV_TQI_HOM_AFL "Logical constant air fuel lean mode requested" UBYTE _CNV_S_2_RANGE______74_CM 1 100. 0. 1. ECU_ADDRESS 0x3fd3e1 BIT_MASK 0x1 /end MEASUREMENT
/begin MEASUREMENT T_TQI_SWI "Time counter for delaying the transition AFS to AFL, AFS to S or AFL to S" UBYTE _CNV_A_R_LINEAR_____21_CM 1 100. 0. 2.55 ECU_ADDRESS 0x3fd7e4 FORMAT "%4.2" /end MEASUREMENT
/begin MEASUREMENT N_HYS_AFL "Engine speed hysteresis for evaluation the torque threshold IP_TQI_THD_S_AFL" UBYTE _CNV_A_R_LINEAR_____15_CM 1 100. 0. 8160. ECU_ADDRESS 0x3fd7e2 FORMAT "%4.0" /end MEASUREMENT
/begin MEASUREMENT N_HYS_AFS "Engine speed hysteresis for evaluation the torque threshold IP_TQI_THD_AFL_AFS" UBYTE _CNV_A_R_LINEAR_____15_CM 1 100. 0. 8160. ECU_ADDRESS 0x3fd7e3 FORMAT "%4.0" /end MEASUREMENT
/begin MEASUREMENT TQI_THD_S_AFL "Torque threshold stratified / air fuel lean" SWORD _CNV_A_R_LINEAR_____37_CM 1 100. -1024. 1023.96875 ECU_ADDRESS 0x3fc5f2 FORMAT "%7.1" /end MEASUREMENT
/begin MEASUREMENT TQI_THD_AFL_AFS "Torque threshold air fuel lean / stoichiometric" SWORD _CNV_A_R_LINEAR_____37_CM 1 100. -1024. 1023.96875 ECU_ADDRESS 0x3fc5f0 FORMAT "%7.1" /end MEASUREMENT
/begin MEASUREMENT LV_TQI_HOM_AFS "Logical constant air fuel stoichometric mode requested" UBYTE _CNV_S_2_RANGE______74_CM 1 100. 0. 1. ECU_ADDRESS 0x3fd3e2 BIT_MASK 0x1 /end MEASUREMENT
/begin MEASUREMENT LV_CQ "Logical variable combustion quality" UBYTE _CNV_S_2_RANGE______74_CM 1 100. 0. 1. ECU_ADDRESS 0x3fd3de BIT_MASK 0x1 /end MEASUREMENT
/begin MEASUREMENT LV_AUTH_LAMB_S "Logical variable stratified mode possible in lambda" UBYTE _CNV_S_2_RANGE______74_CM 1 100. 0. 1. ECU_ADDRESS 0x3fd3dd BIT_MASK 0x1 /end MEASUREMENT
/begin MEASUREMENT LAMB_SP_S "Lambda setpoint for stratified mode" UWORD _CNV_A_R_LINEAR_____50_CM 1 100. 0. 31.99902344 ECU_ADDRESS 0x3fc5da FORMAT "%7.4" /end MEASUREMENT
/begin MEASUREMENT LV_TRAN_TQ_AFS_TO_AFL "Transition AFS to AFL requested" UBYTE _CNV_S_2_RANGE______74_CM 1 100. 0. 1. ECU_ADDRESS 0x3fd3ef BIT_MASK 0x1 /end MEASUREMENT
/begin AXIS_PTS ldp_n_32__fac_maf_afl "" 0x60dec N_32 _REC_AXS_20_u1 8160. _CNV_A_R_LINEAR_____15_CM 6 0. 8160. FORMAT "%4.0" /end AXIS_PTS
/begin AXIS_PTS ldp_n_32__eff_iga_afl "" 0x60df3 N_32 _REC_AXS_20_u1 8160. _CNV_A_R_LINEAR_____15_CM 8 0. 8160. FORMAT "%4.0" /end AXIS_PTS
/begin AXIS_PTS ldp_tqi_req_slow__eff_iga_afl "" 0x60dfc TQI_REQ_SLOW _REC_AXS_20_u2 2047.96875 _CNV_A_R_LINEAR_____65_CM 8 -1024. 1023.96875 FORMAT "%6.2" /end AXIS_PTS
/begin AXIS_PTS ldp_egr_ratio_prev_s "" 0x60e0e EGR_RATIO_PREV_S _REC_AXS_20_u2 99.99847412 _CNV_A_R_LINEAR_____144_CM 6 0. 99.99847412 /end AXIS_PTS
/begin AXIS_PTS ldp_tco__tqi_thd_s_afl "" 0x60e29 TCO _REC_AXS_20_u1 190.5 _CNV_A_R_LINEAR_____22_CM 4 -48. 142.5 FORMAT "%5.1" /end AXIS_PTS
/begin AXIS_PTS ldp_tco__tqi_thd_afl_afs "" 0x60e2e TCO _REC_AXS_20_u1 190.5 _CNV_A_R_LINEAR_____22_CM 4 -48. 142.5 FORMAT "%5.1" /end AXIS_PTS
/begin AXIS_PTS ldp_n_hys_afs__tqi_thd_afl_afs "" 0x60e33 N_HYS_AFS _REC_AXS_20_u1 8160. _CNV_A_R_LINEAR_____15_CM 12 0. 8160. FORMAT "%4.0" /end AXIS_PTS
/begin AXIS_PTS ldp_tqi_req_fast__lamb_min_s "" 0x60e4a TQI_REQ_FAST _REC_AXS_20_u2 2047.96875 _CNV_A_R_LINEAR_____65_CM 8 -1024. 1023.96875 FORMAT "%6.2" /end AXIS_PTS
/begin CHARACTERISTIC IP_EFF_IGA_AFL "Ignition efficiency for air fuel lean mode" MAP 0x63138 _REC_MAP_20_u2_u1_u2 1.99996948 _CNV_A_R_LINEAR_____5_CM 0. 1.99996948 FORMAT "%7.5"
 /begin AXIS_DESCR COM_AXIS N_32 _CNV_A_R_LINEAR_____15_CM 8 0. 8160. FORMAT "%4.0" AXIS_PTS_REF ldp_n_32__eff_iga_afl /end AXIS_DESCR
 /begin AXIS_DESCR COM_AXIS TQI_REQ_SLOW _CNV_A_R_LINEAR_____65_CM 8 -1024. 1023.96875 FORMAT "%6.2" AXIS_PTS_REF ldp_tqi_req_slow__eff_iga_afl /end AXIS_DESCR
/end CHARACTERISTIC
/begin CHARACTERISTIC IP_TQI_THD_AFL_AFS "Torque threshold for combustion mode switch AFL to AFS" MAP 0x63218 _REC_MAP_20_u2_u1_u1 1023.96875 _CNV_A_R_LINEAR_____37_CM 0. 1023.96875 FORMAT "%7.2"
 /begin AXIS_DESCR COM_AXIS N_HYS_AFS _CNV_A_R_LINEAR_____15_CM 12 0. 8160. FORMAT "%4.0" AXIS_PTS_REF ldp_n_hys_afs__tqi_thd_afl_afs /end AXIS_DESCR
 /begin AXIS_DESCR COM_AXIS TCO _CNV_A_R_LINEAR_____22_CM 4 -48. 142.5 FORMAT "%5.1" AXIS_PTS_REF ldp_tco__tqi_thd_afl_afs /end AXIS_DESCR
/end CHARACTERISTIC
/begin CHARACTERISTIC C_HYS_MAF_MAX_AFL "Hysteresis on MAF_MAX_COR_THD" VALUE 0x63130 _REC_VAL_20_u2 1389. _CNV_A_R_LINEAR_____56_CM 0. 1389. FORMAT "%7.2" /end CHARACTERISTIC
/begin CHARACTERISTIC C_CQ_S_MAX "Characteristic quantity above this threshold means stable S-Mode" VALUE 0x6386c _REC_VAL_20_u1 99.609375 _CNV_A_R_LINEAR_____16_CM 0. 99.609375 FORMAT "%5.1" /end CHARACTERISTIC
/begin CHARACTERISTIC C_CQ_HOM_MAX "Characteristic quantity above this threshold means stable HOM-Mode" VALUE 0x6386d _REC_VAL_20_u1 99.609375 _CNV_A_R_LINEAR_____16_CM 0. 99.609375 FORMAT "%5.1" /end CHARACTERISTIC
/begin CHARACTERISTIC C_T_DLY_EGR_S "Delay time to delay the transition from homogeneous to stratified (to get right EGR-rate)" VALUE 0x6386e _REC_VAL_20_u1 2.55 _CNV_A_R_LINEAR_____21_CM 0. 2.55 FORMAT "%4.2" /end CHARACTERISTIC
/begin CHARACTERISTIC LC_INH_SWI_BACKHOM "Logical constant inhibition switch to BACKHOM" VALUE 0x6386f _REC_VAL_20_u1 1. _CNV_A_R_LINEAR_____17_CM 0. 1. FORMAT "%2.0" /end CHARACTERISTIC
/begin CHARACTERISTIC LC_INH_SWI_BACKS "Logical constant inhibition switch to BACKS" VALUE 0x63871 _REC_VAL_20_u1 1. _CNV_A_R_LINEAR_____17_CM 0. 1. FORMAT "%2.0" /end CHARACTERISTIC
/begin CHARACTERISTIC LC_INH_SWI_PU_BACKS "Logical constant inhibition switch at PU to BACKS" VALUE 0x63872 _REC_VAL_20_u1 1. _CNV_A_R_LINEAR_____17_CM 0. 1. FORMAT "%2.0" /end CHARACTERISTIC
/begin CHARACTERISTIC C_CMB_CTL_MAN "Manual combustion mode selection (0 : automatic, 1:\"HOM_AFS\", 2:\"HOM_AFL\", 3:\"S\")" VALUE 0x63873 _REC_VAL_20_u1 3. _CNV_A_R_LINEAR_____17_CM 0. 3. FORMAT "%2.0" /end CHARACTERISTIC
/begin CHARACTERISTIC C_TCO_MIN_S "Minimum coolcant temperature threshold for stratified mode possible" VALUE 0x63874 _REC_VAL_20_u1 190.5 _CNV_A_R_LINEAR_____22_CM -48. 142.5 FORMAT "%5.1" /end CHARACTERISTIC
/begin CHARACTERISTIC C_TCO_MIN_AFL "Minimum coolcant temperature threshold for homogeneous lean mode possible" VALUE 0x63875 _REC_VAL_20_u1 190.5 _CNV_A_R_LINEAR_____22_CM -48. 142.5 FORMAT "%5.1" /end CHARACTERISTIC
/begin CHARACTERISTIC C_EFF_IGA_AFS_TO_AFL_OFS "Ignition efficiency offset for transition AFS to AFL" VALUE 0x63876 _REC_VAL_20_u2 1.99996948 _CNV_A_R_LINEAR_____5_CM 0. 1.99996948 FORMAT "%7.5" /end CHARACTERISTIC
/begin CHARACTERISTIC C_EFF_IGA_AFL_TO_AFS_OFS "Ignition efficiency offset for transition AFL to AFS" VALUE 0x63878 _REC_VAL_20_u2 1.99996948 _CNV_A_R_LINEAR_____5_CM 0. 1.99996948 FORMAT "%7.5" /end CHARACTERISTIC
/begin CHARACTERISTIC C_TQI_HYS_AFL "Torque hysteresis for combustion management AFL to S" VALUE 0x6387a _REC_VAL_20_u2 1023.96875 _CNV_A_R_LINEAR_____37_CM 0. 1023.96875 FORMAT "%7.2" /end CHARACTERISTIC
/begin CHARACTERISTIC C_TQI_HYS_AFS "Torque hysteresis for combustion management  AFS to AFL" VALUE 0x6387c _REC_VAL_20_u2 1023.96875 _CNV_A_R_LINEAR_____37_CM 0. 1023.96875 FORMAT "%7.2" /end CHARACTERISTIC
/begin CHARACTERISTIC C_N_HYS_AFS "Engine speed hysteresis in AFS mode" VALUE 0x6387e _REC_VAL_20_u1 8160. _CNV_A_R_LINEAR_____15_CM 0. 8160. FORMAT "%4.0" /end CHARACTERISTIC
/begin CHARACTERISTIC C_N_HYS_AFL "Engine speed hysteresis in AFL mode" VALUE 0x6387f _REC_VAL_20_u1 8160. _CNV_A_R_LINEAR_____15_CM 0. 8160. FORMAT "%4.0" /end CHARACTERISTIC
/begin CHARACTERISTIC C_T_DLY_TQI_SWI "Delay time for setting LV_TQI to request stratified mode" VALUE 0x63880 _REC_VAL_20_u1 2.55 _CNV_A_R_LINEAR_____21_CM 0. 2.55 FORMAT "%4.2" /end CHARACTERISTIC
/begin CHARACTERISTIC C_CQ_S_MIN "Minimum characteristic quantity value for STRAT acceptation" VALUE 0x63881 _REC_VAL_20_u1 99.609375 _CNV_A_R_LINEAR_____16_CM 0. 99.609375 FORMAT "%5.1" /end CHARACTERISTIC
/begin CHARACTERISTIC C_CQ_HOM_MIN "Minimum characteristic quantity value for HOM acceptation" VALUE 0x63882 _REC_VAL_20_u1 99.609375 _CNV_A_R_LINEAR_____16_CM 0. 99.609375 FORMAT "%5.1" /end CHARACTERISTIC
/begin CHARACTERISTIC C_FAC_LAMB_AFS "Air fuel stoichometric factor (typical value 14.71)" VALUE 0x63884 _REC_VAL_20_u2 31.99902344 _CNV_A_R_LINEAR_____50_CM 0. 31.99902344 FORMAT "%7.4" /end CHARACTERISTIC
/begin CHARACTERISTIC LC_INH_SWI_PU "Logical constant inhibition switch to PU" VALUE 0x63870 _REC_VAL_20_u1 1. _CNV_A_R_LINEAR_____17_CM 0. 1. FORMAT "%2.0" /end CHARACTERISTIC
/begin CHARACTERISTIC C_HYS_LAMB_MIN_S "Hysteresis for minimum lambda threshold for stratified mode" VALUE 0x6389e _REC_VAL_20_u2 31.99902344 _CNV_A_R_LINEAR_____50_CM 0. 31.99902344 FORMAT "%7.4" /end CHARACTERISTIC
/begin MEASUREMENT LV_CQ_S "Logical variable combustion quality for stratified mode" UBYTE _CNV_S_2_RANGE______74_CM 1 100. 0. 1. ECU_ADDRESS 0x3fd3df BIT_MASK 0x1 /end MEASUREMENT
/begin AXIS_PTS ldp_mff_sp__iga_bas_s "" 0x60f3a MFF_SP _REC_AXS_20_u2 1389. _CNV_A_R_LINEAR_____56_CM 12 0. 1389. FORMAT "%7.2" /end AXIS_PTS
/begin CHARACTERISTIC LC_IGA_MAN "Logical constant for stratified mode" VALUE 0x63960 _REC_VAL_20_u1 1. _CNV_A_R_LINEAR_____13_CM 0. 1. FORMAT "%1.0" /end CHARACTERISTIC
/begin AXIS_PTS ldp_n_hys_afl__tqi_thd_s_afl "" 0x60e1c N_HYS_AFL _REC_AXS_20_u1 8160. _CNV_A_R_LINEAR_____15_CM 12 0. 8160. FORMAT "%4.0" /end AXIS_PTS
/begin MEASUREMENT IGA_IGC_S_0 "Ignition angle for stratified mode (absolute value)" UBYTE _CNV_A_R_LINEAR_____11_CM 1 100. -23.625 72. ECU_ADDRESS 0x3fd891 FORMAT "%5.1" /end MEASUREMENT
/begin MEASUREMENT IGA_IGC_S_1 "Ignition angle for stratified mode (absolute value)" UBYTE _CNV_A_R_LINEAR_____11_CM 1 100. -23.625 72. ECU_ADDRESS 0x3fd892 FORMAT "%5.1" /end MEASUREMENT
/begin MEASUREMENT IGA_IGC_S_2 "Ignition angle for stratified mode (absolute value)" UBYTE _CNV_A_R_LINEAR_____11_CM 1 100. -23.625 72. ECU_ADDRESS 0x3fd893 FORMAT "%5.1" /end MEASUREMENT
/begin MEASUREMENT IGA_IGC_S_3 "Ignition angle for stratified mode (absolute value)" UBYTE _CNV_A_R_LINEAR_____11_CM 1 100. -23.625 72. ECU_ADDRESS 0x3fd894 FORMAT "%5.1" /end MEASUREMENT
/begin MEASUREMENT IGA_IGC_S_4 "Ignition angle for stratified mode (absolute value)" UBYTE _CNV_A_R_LINEAR_____11_CM 1 100. -23.625 72. ECU_ADDRESS 0x3fd895 FORMAT "%5.1" /end MEASUREMENT
/begin MEASUREMENT IGA_IGC_S_5 "Ignition angle for stratified mode (absolute value)" UBYTE _CNV_A_R_LINEAR_____11_CM 1 100. -23.625 72. ECU_ADDRESS 0x3fd896 FORMAT "%5.1" /end MEASUREMENT
/begin AXIS_PTS ldp_n_32__iga_bas_s "" 0x60f29 N_32 _REC_AXS_20_u1 816. _CNV_A_R_LINEAR_____15_CM 16 0. 8160. FORMAT "%4.0" /end AXIS_PTS
/begin MEASUREMENT LV_IGA_AND_INJ_SWI_TMP "Flag for ignition and injection values switch" UBYTE _CNV_S_2_RANGE______74_CM 1 100. 0. 1. ECU_ADDRESS 0x3fd3ea /end MEASUREMENT
/begin CHARACTERISTIC C_IGA_MAN "Constant for stratified mode" VALUE 0x63961 _REC_VAL_20_u1 95.625 _CNV_A_R_LINEAR_____11_CM -23.625 72. FORMAT "%5.1" /end CHARACTERISTIC
/begin CHARACTERISTIC IP_IGA_BAS_S "Basic ignition angle for stratified mode" MAP 0x638a0 _REC_MAP_20_u1_u1_u2 95.625 _CNV_A_R_LINEAR_____11_CM -23.625 72. FORMAT "%5.1"
 /begin AXIS_DESCR COM_AXIS N_32 _CNV_A_R_LINEAR_____15_CM 16 0. 8160. FORMAT "%4.0" AXIS_PTS_REF ldp_n_32__iga_bas_s /end AXIS_DESCR
 /begin AXIS_DESCR COM_AXIS MFF_SP _CNV_A_R_LINEAR_____56_CM 12 0. 1389. FORMAT "%7.2" AXIS_PTS_REF ldp_mff_sp__iga_bas_s /end AXIS_DESCR
/end CHARACTERISTIC
/begin CHARACTERISTIC IP_CYC_DLY_THR_S_HOM "Cycle counter to delay transition S->HOM (to reduce exhaust gas in the intake manifold)" CURVE 0x63860 _REC_CUR_20_u2_u2 65535. _CNV_A_R_LINEAR_____17_CM 0. 65535. FORMAT "%5.0"
 /begin AXIS_DESCR COM_AXIS EGR_RATIO_PREV_S _CNV_A_R_LINEAR_____144_CM 6 0. 99.99847412 AXIS_PTS_REF ldp_egr_ratio_prev_s /end AXIS_DESCR
/end CHARACTERISTIC
/begin MEASUREMENT IGA_BAS_S "Basic ignition angle for stratified mode" UBYTE _CNV_A_R_LINEAR_____11_CM 1 100. -23.625 72. ECU_ADDRESS 0x3fd897 FORMAT "%5.1" /end MEASUREMENT
/begin MEASUREMENT STATE_CMB_CTL "States of the combustion management" ULONG _CNV_S_9_RANGE_STAT_311_CM 1 100. 0. 8. ECU_ADDRESS 0x3fc0dc /end MEASUREMENT
/begin CHARACTERISTIC IP_FAC_MAF_AFL "Asessment factor for MAF_MAX_COR for decision AFL or AFS mode" CURVE 0x63132 _REC_CUR_20_u1_u1 1.9921875 _CNV_A_R_LINEAR_____67_CM 0. 1.9921875 FORMAT "%5.3"
 /begin AXIS_DESCR COM_AXIS N_32 _CNV_A_R_LINEAR_____15_CM 6 0. 8160. FORMAT "%4.0" AXIS_PTS_REF ldp_n_32__fac_maf_afl /end AXIS_DESCR
/end CHARACTERISTIC
/begin AXIS_PTS ldp_n_32__lamb_min_s "" 0x60e40 N_32 _REC_AXS_20_u1 8160. _CNV_A_R_LINEAR_____15_CM 8 0. 8160. FORMAT "%4.0" /end AXIS_PTS
/begin CHARACTERISTIC IP_LAMB_MIN_S "Minimum lambda for stratified mode" MAP 0x63278 _REC_MAP_20_u2_u1_u2 31.99902344 _CNV_A_R_LINEAR_____50_CM 0. 31.99902344 FORMAT "%7.4"
 /begin AXIS_DESCR COM_AXIS N_32 _CNV_A_R_LINEAR_____15_CM 8 0. 8160. FORMAT "%4.0" AXIS_PTS_REF ldp_n_32__lamb_min_s /end AXIS_DESCR
 /begin AXIS_DESCR COM_AXIS TQI_REQ_FAST _CNV_A_R_LINEAR_____65_CM 8 -1024. 1023.96875 FORMAT "%6.2" AXIS_PTS_REF ldp_tqi_req_fast__lamb_min_s /end AXIS_DESCR
/end CHARACTERISTIC
/begin MEASUREMENT EOI_LIM "latest possible EOI" UWORD _CNV_A_R_LINEAR_____6_CM 1 100. 0. 720. ECU_ADDRESS 0x3fc678 FORMAT "%6.2" /end MEASUREMENT
/begin MEASUREMENT CAM_OP_IN_VVL "actual value inlet valve opening angle" SWORD _CNV_A_R_LINEAR_____117_CM 1 100. -768. 767.9765625 ECU_ADDRESS 0x3fc69a FORMAT "%7.2" /end MEASUREMENT
/begin MEASUREMENT EOI_IVVT_VVL "Correction for inlet-CAM-position and inlet valve opening angle" UWORD _CNV_A_R_LINEAR_____6_CM 1 100. 0. 720. ECU_ADDRESS 0x3fc69c FORMAT "%6.2" /end MEASUREMENT
/begin CHARACTERISTIC IP_TQI_THD_S_AFL "Torque threshold for combustion mode switch S to AFL" MAP 0x631b8 _REC_MAP_20_u2_u1_u1 1023.96875 _CNV_A_R_LINEAR_____37_CM 0. 1023.96875 FORMAT "%7.2"
 /begin AXIS_DESCR COM_AXIS N_HYS_AFL _CNV_A_R_LINEAR_____15_CM 12 0. 8160. FORMAT "%4.0" AXIS_PTS_REF ldp_n_hys_afl__tqi_thd_s_afl /end AXIS_DESCR
 /begin AXIS_DESCR COM_AXIS TCO _CNV_A_R_LINEAR_____22_CM 4 -48. 142.5 FORMAT "%5.1" AXIS_PTS_REF ldp_tco__tqi_thd_s_afl /end AXIS_DESCR
/end CHARACTERISTIC
/begin MEASUREMENT IGA_BAS_EGR_COR "Additive basic ignition angle correction due to EGR influence" SBYTE _CNV_A_R_LINEAR_____6_CM 1 100. -48. 47.625 ECU_ADDRESS 0x3fd882 FORMAT "%5.1" /end MEASUREMENT
/begin MEASUREMENT IGA_BAS_EGR_COR_HOM "Additive basic ignition angle correction due to EGR influence to homogenous mode" SBYTE _CNV_A_R_LINEAR_____6_CM 1 100. -48. 47.625 ECU_ADDRESS 0x3fd883 FORMAT "%5.1" /end MEASUREMENT
/begin MEASUREMENT IGA_BAS_EGR_COR_S "Additive basic ignition angle correction due to EGR influence to stratified mode" SBYTE _CNV_A_R_LINEAR_____6_CM 1 100. -48. 47.625 ECU_ADDRESS 0x3fd884 FORMAT "%5.1" /end MEASUREMENT
/begin AXIS_PTS ldpm_lamb_ratio "" 0x61286 LAMB_RATIO _REC_AXS_20_u2 4. _CNV_A_R_LINEAR_____185_CM 8 -2. 2. FORMAT "%8.5" /end AXIS_PTS
/begin CHARACTERISTIC IP_FAC_RATE_EGR_AFR "Temperature corrective factor (air/fuel rich)" CURVE 0x6451c _REC_CUR_20_u1_u1 1.99220002 _CNV_A_R_LINEAR_____64_CM 0. 1.99220002 FORMAT "%5.3"
 /begin AXIS_DESCR COM_AXIS TCO _CNV_A_R_LINEAR_____22_CM 8 -48. 142.5 FORMAT "%5.1" AXIS_PTS_REF ldpm_tco__iga_egr /end AXIS_DESCR
/end CHARACTERISTIC
/begin CHARACTERISTIC IP_FAC_RATE_EGR_AFL "Temperature corrective factor (air/fuel lean)" CURVE 0x64524 _REC_CUR_20_u1_u1 1.99220002 _CNV_A_R_LINEAR_____64_CM 0. 1.99220002 FORMAT "%5.3"
 /begin AXIS_DESCR COM_AXIS TCO _CNV_A_R_LINEAR_____22_CM 8 -48. 142.5 FORMAT "%5.1" AXIS_PTS_REF ldpm_tco__iga_egr /end AXIS_DESCR
/end CHARACTERISTIC
/begin CHARACTERISTIC IP_IGA_EGR_AFR "Sparke advance added to basic value with EGR function (air/fuel rich)" MAP 0x6452c _REC_MAP_20_u1_u1_u2 95.625 _CNV_A_R_LINEAR_____61_CM -48. 47.625 FORMAT "%5.1"
 /begin AXIS_DESCR COM_AXIS N_32 _CNV_A_R_LINEAR_____15_CM 5 0. 8160. FORMAT "%4.0" AXIS_PTS_REF ldp_n_32__iga_egr_afr /end AXIS_DESCR
 /begin AXIS_DESCR COM_AXIS MAF _CNV_A_R_LINEAR_____56_CM 5 0. 1389. FORMAT "%7.2" AXIS_PTS_REF ldpm_maf__iga_egr /end AXIS_DESCR
/end CHARACTERISTIC
/begin CHARACTERISTIC IP_IGA_EGR_AFL "Sparke advance added to basic value with EGR function (air/fuel lean)" MAP 0x64545 _REC_MAP_20_u1_u1_u2 95.625 _CNV_A_R_LINEAR_____61_CM -48. 47.625 FORMAT "%5.1"
 /begin AXIS_DESCR COM_AXIS N_32 _CNV_A_R_LINEAR_____15_CM 5 0. 8160. FORMAT "%4.0" AXIS_PTS_REF ldp_n_32__iga_egr_afl /end AXIS_DESCR
 /begin AXIS_DESCR COM_AXIS MAF _CNV_A_R_LINEAR_____56_CM 5 0. 1389. FORMAT "%7.2" AXIS_PTS_REF ldpm_maf__iga_egr /end AXIS_DESCR
/end CHARACTERISTIC
/begin CHARACTERISTIC IP_IGA_EGR_LAMB_RATIO_FAC "Lambda factor for interpolation between IP_IGA_EGR_AFL and IP_IGA_EGR_AFR" MAP 0x6455e _REC_MAP_20_u2_u2_u2 4. _CNV_A_R_LINEAR_____185_CM -2. 2. FORMAT "%8.5"
 /begin AXIS_DESCR COM_AXIS LAMB_RATIO _CNV_A_R_LINEAR_____185_CM 8 -2. 2. FORMAT "%8.5" AXIS_PTS_REF ldpm_lamb_ratio /end AXIS_DESCR
 /begin AXIS_DESCR COM_AXIS MAF _CNV_A_R_LINEAR_____56_CM 5 0. 1389. FORMAT "%7.2" AXIS_PTS_REF ldpm_maf__iga_egr /end AXIS_DESCR
/end CHARACTERISTIC
/begin CHARACTERISTIC IP_FAC_RATE_EGR_S "temperature corrective factor (stratified mode)" CURVE 0x645ae _REC_CUR_20_u1_u1 1.99220002 _CNV_A_R_LINEAR_____64_CM 0. 1.99220002 FORMAT "%5.3"
 /begin AXIS_DESCR COM_AXIS TCO _CNV_A_R_LINEAR_____22_CM 8 -48. 142.5 FORMAT "%5.1" AXIS_PTS_REF ldpm_tco__iga_egr /end AXIS_DESCR
/end CHARACTERISTIC
/begin CHARACTERISTIC IP_IGA_EGR_S "Spark advance added to basic value with EGR function (stratified mode)" MAP 0x645b6 _REC_MAP_20_u1_u1_u2 95.625 _CNV_A_R_LINEAR_____61_CM -48. 47.625 FORMAT "%5.1"
 /begin AXIS_DESCR COM_AXIS N_32 _CNV_A_R_LINEAR_____15_CM 5 0. 8160. FORMAT "%4.0" AXIS_PTS_REF ldp_n_32__iga_egr_s /end AXIS_DESCR
 /begin AXIS_DESCR COM_AXIS MFF_SP_S _CNV_A_R_LINEAR_____56_CM 5 0. 1389. FORMAT "%7.2" AXIS_PTS_REF ldp_mff_sp_s__egr_iga /end AXIS_DESCR
/end CHARACTERISTIC
/begin AXIS_PTS ldpm_tco__iga_egr "" 0x61265 TCO _REC_AXS_20_u1 190.5 _CNV_A_R_LINEAR_____22_CM 8 -48. 142.5 FORMAT "%5.1" /end AXIS_PTS
/begin AXIS_PTS ldp_n_32__iga_egr_afr "" 0x6126e N_32 _REC_AXS_20_u1 8160. _CNV_A_R_LINEAR_____15_CM 5 0. 8160. FORMAT "%4.0" /end AXIS_PTS
/begin AXIS_PTS ldpm_maf__iga_egr "" 0x6127a MAF _REC_AXS_20_u2 1389. _CNV_A_R_LINEAR_____56_CM 5 0. 1389. FORMAT "%7.2" /end AXIS_PTS
/begin AXIS_PTS ldp_n_32__iga_egr_afl "" 0x61274 N_32 _REC_AXS_20_u1 8160. _CNV_A_R_LINEAR_____15_CM 5 0. 8160. FORMAT "%4.0" /end AXIS_PTS
/begin AXIS_PTS ldp_n_32__iga_egr_s "" 0x612a4 N_32 _REC_AXS_20_u1 8160. _CNV_A_R_LINEAR_____15_CM 5 0. 8160. FORMAT "%4.0" /end AXIS_PTS
/begin AXIS_PTS ldp_mff_sp_s__egr_iga "" 0x61298 MFF_SP_S _REC_AXS_20_u2 1389. _CNV_A_R_LINEAR_____56_CM 5 0. 1389. FORMAT "%7.2" /end AXIS_PTS
/begin MEASUREMENT MAF_KGH_SP_ISA "setpoint ISA mass air flow" UWORD _CNV_A_R_LINEAR_____52_CM 1 100. 0. 2047.96875 ECU_ADDRESS 0x3fcfa6 FORMAT "%7.2" /end MEASUREMENT
/begin MEASUREMENT MAF_KGH_SP_ISA_CLC "maximum setpoint ISA mass air flow at PSI_SP_ISA" UWORD _CNV_A_R_LINEAR_____52_CM 1 100. 0. 2047.96875 ECU_ADDRESS 0x3fcfac FORMAT "%7.2" /end MEASUREMENT
/begin MEASUREMENT PQ_SP_ISA "setpoint air flow function rate ISA" UWORD _CNV_A_R_LINEAR_____2_CM 1 100. 0. 0.99998474 ECU_ADDRESS 0x3fcfae FORMAT "%7.5" /end MEASUREMENT
/begin MEASUREMENT MAF_KGH_SP_THR "setpoint throttle mass air" UWORD _CNV_A_R_LINEAR_____52_CM 1 100. 0. 2047.96875 ECU_ADDRESS 0x3fcfa8 FORMAT "%7.2" /end MEASUREMENT
/begin MEASUREMENT MAF_TURB_RATIO "mass air flow ratio of MAF_SP_ISA / MAF_SP" UBYTE _CNV_A_R_LINEAR_____8_CM 1 100. 0. 0.996094 ECU_ADDRESS 0x3fcf82 FORMAT "%5.3" /end MEASUREMENT
/begin MEASUREMENT MAF_KGH_SP_ISA_RAW "setpoint mass air flow idle speed actuator" UWORD _CNV_A_R_LINEAR_____52_CM 1 100. 0. 2047.96875 ECU_ADDRESS 0x3fcfaa FORMAT "%7.2" /end MEASUREMENT
/begin MEASUREMENT PSI_SP "Setpoint air flow function rate" UWORD _CNV_A_R_LINEAR_____285_CM 1 100. 0. 8.880330000000001 ECU_ADDRESS 0x3fcf94 FORMAT "%5.4" /end MEASUREMENT
/begin MEASUREMENT PSI_SP_ISA "Setpoint air flow function rate ISA" UWORD _CNV_A_R_LINEAR_____285_CM 1 100. 0. 8.880330000000001 ECU_ADDRESS 0x3fcfb0 FORMAT "%5.4" /end MEASUREMENT
/begin CHARACTERISTIC ID_MAF_ISA_FAC_OFS__PQ_ESTIM "offset air flow function for ISA" CURVE 0x6474a _REC_CUR_20_u2_u2 8.880330000000001 _CNV_A_R_LINEAR_____285_CM 0. 8.880330000000001 FORMAT "%6.4"
 /begin AXIS_DESCR COM_AXIS PQ_ESTIM _CNV_A_R_LINEAR_____2_CM 16 0. 0.99998474 FORMAT "%7.5" AXIS_PTS_REF ldpm_pq_estim_id_maf_isa_fac_ofs /end AXIS_DESCR
/end CHARACTERISTIC
/begin CHARACTERISTIC ID_MAF_ISA_FAC_SLOP__PQ_ESTIM "slope air flow function for ISA" CURVE 0x6476a _REC_CUR_20_u2_u2 8.880330000000001 _CNV_A_R_LINEAR_____285_CM 0. 8.880330000000001 FORMAT "%6.4"
 /begin AXIS_DESCR COM_AXIS PQ_ESTIM _CNV_A_R_LINEAR_____2_CM 16 0. 0.99998474 FORMAT "%7.5" AXIS_PTS_REF ldpm_pq_estim_id_maf_isa_fac_ofs /end AXIS_DESCR
/end CHARACTERISTIC
/begin AXIS_PTS ldpm_pq_estim_id_maf_isa_fac_ofs "" 0x6132a PQ_ESTIM _REC_AXS_20_u2 0.99998474 _CNV_A_R_LINEAR_____2_CM 16 0. 0.99998474 FORMAT "%7.5" /end AXIS_PTS
/begin CHARACTERISTIC C_AR_RED_ISA_MAX "maximum reduced area at full opened idle speed actuator valve" VALUE 0x6478a _REC_VAL_20_u2 58.592855 _CNV_A_R_LINEAR_____286_CM 0. 58.592855 FORMAT "%7.4" /end CHARACTERISTIC
/begin MEASUREMENT AR_RED_ISA_SP_1 "setpoint reduced area at ISA valve previous filtering" UWORD _CNV_A_R_LINEAR_____286_CM 1 100. 0. 58.592855 ECU_ADDRESS 0x3fcfb2 FORMAT "%7.4" /end MEASUREMENT
/begin MEASUREMENT AR_RED_ISA_SP_MMV "filtered setpoint reduced area at ISA valve including AR_RED-controller share AR_RED_ISA_DIF_I_REL_MMV" UWORD _CNV_A_R_LINEAR_____286_CM 1 100. 0. 58.592855 ECU_ADDRESS 0x3fcfb6 FORMAT "%7.4" /end MEASUREMENT
/begin MEASUREMENT AR_RED_ISA_SP_MMV_1 "filtered setpoint reduced area at ISA valve" UWORD _CNV_A_R_LINEAR_____286_CM 1 100. 0. 58.592855 ECU_ADDRESS 0x3fcfb4 FORMAT "%7.4" /end MEASUREMENT
/begin MEASUREMENT ISAPWM_ISA "idle speed actuator duty cycle" UWORD _CNV_A_R_LINEAR_____144_CM 1 100. 0. 99.99847412 ECU_ADDRESS 0x3fcf84 FORMAT "%5.2" /end MEASUREMENT
/begin MEASUREMENT ISAPWM_ISA_1 "idle speed actuator duty cycle coil 1 (opening)" UWORD _CNV_A_R_LINEAR_____144_CM 1 100. 0. 99.99847412 ECU_ADDRESS 0x3fcf88 FORMAT "%5.2" /end MEASUREMENT
/begin MEASUREMENT ISAPWM_ISA_2 "idle speed actuator duty cycle coil 2 (closing)" UWORD _CNV_A_R_LINEAR_____144_CM 1 100. 0. 99.99847412 ECU_ADDRESS 0x3fcf8a FORMAT "%5.2" /end MEASUREMENT
/begin MEASUREMENT ISAPWM_MMV "moving mean value of idle speed actuator duty cycle" UWORD _CNV_A_R_LINEAR_____144_CM 1 100. 0. 99.99847412 ECU_ADDRESS 0x3fcf86 FORMAT "%5.2" /end MEASUREMENT
/begin CHARACTERISTIC IP_CRLC_AR_RED_ISA_SP "correlation constant for the moving mean value calculation of AR_RED_ISA_SP_MMV_1" CURVE 0x6478c _REC_CUR_20_u1_u2 0.9960940000000002 _CNV_A_R_LINEAR_____8_CM 0. 0.996094 FORMAT "%5.3"
 /begin AXIS_DESCR COM_AXIS PQ_SP_ISA _CNV_A_R_LINEAR_____2_CM 8 0. 0.99998474 FORMAT "%7.5" AXIS_PTS_REF ldp_pq_sp_isa /end AXIS_DESCR
/end CHARACTERISTIC
/begin AXIS_PTS ldp_pq_sp_isa "" 0x6134c PQ_SP_ISA _REC_AXS_20_u2 0.99998474 _CNV_A_R_LINEAR_____2_CM 8 0. 0.99998474 FORMAT "%7.5" /end AXIS_PTS
/begin CHARACTERISTIC LC_AR_RED_ISA_FIL_ENA "logical variable to enable reduced ISA area filter" VALUE 0x64794 _REC_VAL_20_u1 1. _CNV_A_R_LINEAR_____17_CM 0. 1. FORMAT "%2.0" /end CHARACTERISTIC
/begin CHARACTERISTIC IP_ISAPWM_ISA "ISA position setpoint" CURVE 0x64796 _REC_CUR_20_u2_u2 99.99847412 _CNV_A_R_LINEAR_____144_CM 0. 99.99847412 FORMAT "%5.2"
 /begin AXIS_DESCR COM_AXIS AR_RED_ISA_SP_MMV _CNV_A_R_LINEAR_____286_CM 16 0. 58.592855 FORMAT "%7.4" AXIS_PTS_REF ldp_ar_red_isa_sp_mmv /end AXIS_DESCR
/end CHARACTERISTIC
/begin AXIS_PTS ldp_ar_red_isa_sp_mmv "" 0x6135e AR_RED_ISA_SP_MMV _REC_AXS_20_u2 58.592855 _CNV_A_R_LINEAR_____286_CM 16 0. 58.592855 FORMAT "%7.4" /end AXIS_PTS
/begin CHARACTERISTIC IP_FAC_ISAPWM_VB "battery voltage correction for ISAPWM duty cycle" CURVE 0x647b6 _REC_CUR_20_u1_u1 1.99220002 _CNV_A_R_LINEAR_____64_CM 0. 1.99220002 FORMAT "%5.3"
 /begin AXIS_DESCR COM_AXIS VB _CNV_A_R_LINEAR_____42_CM 8 0. 25.8984 FORMAT "%3.1" AXIS_PTS_REF ldpm_vb_1 /end AXIS_DESCR
/end CHARACTERISTIC
/begin AXIS_PTS ldpm_vb_1 "" 0x61380 VB _REC_AXS_20_u1 25.8984 _CNV_A_R_LINEAR_____42_CM 8 0. 25.8984 FORMAT "%3.1" /end AXIS_PTS
/begin CHARACTERISTIC C_ISAPWM_MAN_AS "maximum reduced area at full opened idle speed actuator valve" VALUE 0x647be _REC_VAL_20_u2 99.99847412 _CNV_A_R_LINEAR_____144_CM 0. 99.99847412 FORMAT "%5.2" /end CHARACTERISTIC
/begin CHARACTERISTIC C_ISAPWM_OFS_AS "additive ISAPWM offset by application system" VALUE 0x647c0 _REC_VAL_20_u2 99.99847412 _CNV_A_R_LINEAR_____144_CM 0. 99.99847412 FORMAT "%5.2" /end CHARACTERISTIC
/begin CHARACTERISTIC C_CRLC_ISAPWM_MMV "correlation constant for moving mean value calculation of ISAPWM_ISA" VALUE 0x647c2 _REC_VAL_20_u1 0.9960940000000002 _CNV_A_R_LINEAR_____8_CM 0. 0.996094 FORMAT "%5.3" /end CHARACTERISTIC
/begin CHARACTERISTIC C_ISAPWM_ISA_DIAG "diagnosis substitute value in case of  \"STATE_ISA_DIAG = error active / substitute opening\"" VALUE 0x647c3 _REC_VAL_20_u1 0.9960940000000002 _CNV_A_R_LINEAR_____8_CM 0. 0.996094 FORMAT "%5.3" /end CHARACTERISTIC
/begin CHARACTERISTIC C_PQ_SP_MAX_ISA "Pressure quotient threshold at ISA valve" VALUE 0x647c4 _REC_VAL_20_u2 0.99998474 _CNV_A_R_LINEAR_____2_CM 0. 0.99998474 FORMAT "%7.5" /end CHARACTERISTIC
/begin CHARACTERISTIC C_PQ_SP_MAX "Pressure quotient threshold" VALUE 0x63eea _REC_VAL_20_u2 0.99998474 _CNV_A_R_LINEAR_____2_CM 0. 0.99998474 FORMAT "%7.5" /end CHARACTERISTIC
/begin MEASUREMENT MAF_SP_ISA "MAF setpoint output for inverse air path of idle speed actuator (ISA)" UWORD _CNV_A_R_LINEAR_____56_CM 1 100. 0. 1389. ECU_ADDRESS 0x3fc272 FORMAT "%6.2" /end MEASUREMENT
/begin CHARACTERISTIC LC_ISA_ENA "logical constant enabled idle speed actuator (ISA)" VALUE 0x647c6 _REC_VAL_20_u1 1. _CNV_A_R_LINEAR_____17_CM 0. 1. FORMAT "%2.0" /end CHARACTERISTIC
/begin MEASUREMENT LV_ISA_ENA "logical variable for enabled idle speed actuator (ISA)" UBYTE _CNV_S_2_RANGE______74_CM 1 100. 0. 1. ECU_ADDRESS 0x3fd352 /end MEASUREMENT
/begin CHARACTERISTIC IP_MAF_SP_ISA "Setpoint mass air flow idle speed actuator (ISA)" MAP 0x647c8 _REC_MAP_20_u2_u1_u2 1389. _CNV_A_R_LINEAR_____56_CM 0. 1389. FORMAT "%4.0"
 /begin AXIS_DESCR COM_AXIS N_32 _CNV_A_R_LINEAR_____15_CM 16 0. 8160. FORMAT "%4.0" AXIS_PTS_REF ldp_n_32__maf_sp_isa /end AXIS_DESCR
 /begin AXIS_DESCR COM_AXIS MAF_SP_TQI _CNV_A_R_LINEAR_____56_CM 12 0. 1389. FORMAT "%7.2" AXIS_PTS_REF ldp_maf_sp_tqi__maf_sp_isa /end AXIS_DESCR
/end CHARACTERISTIC
/begin AXIS_PTS ldp_n_32__maf_sp_isa "" 0x61389 N_32 _REC_AXS_20_u1 816. _CNV_A_R_LINEAR_____15_CM 16 0. 8160. FORMAT "%4.0" /end AXIS_PTS
/begin AXIS_PTS ldp_maf_sp_tqi__maf_sp_isa "" 0x6139a MAF_SP_TQI _REC_AXS_20_u2 1389. _CNV_A_R_LINEAR_____56_CM 12 0. 1389. FORMAT "%7.2" /end AXIS_PTS
/begin COMPU_METHOD _CNV_A_R_LINEAR_____0_CM "" RAT_FUNC "%6.3" "rpm" COEFFS 0 1. 0. 0 0 1 /end COMPU_METHOD
/begin COMPU_METHOD _CNV_A_R_LINEAR_____1_CM "" RAT_FUNC "%6.3" "hPa" COEFFS 0 12.06017666543982 0. 0 0 1 /end COMPU_METHOD
/begin COMPU_METHOD _CNV_A_R_LINEAR_____2_CM "" RAT_FUNC "%6.3" "-" COEFFS 0 65536.00007936121 0. 0 0 1 /end COMPU_METHOD
/begin COMPU_METHOD _CNV_A_R_LINEAR_____4_CM "" RAT_FUNC "%6.3" "°CRK" COEFFS 0 1. 0. 0 0 1 /end COMPU_METHOD
/begin COMPU_METHOD _CNV_A_R_LINEAR_____5_CM "" RAT_FUNC "%6.3" "-" COEFFS 0 32768.00003968061 0. 0 0 1 /end COMPU_METHOD
/begin COMPU_METHOD _CNV_A_R_LINEAR_____6_CM "" RAT_FUNC "%6.3" "°CRK" COEFFS 0 2.666666666666667 0. 0 0 1 /end COMPU_METHOD
/begin COMPU_METHOD _CNV_A_R_LINEAR_____8_CM "" RAT_FUNC "%6.3" "[-]" COEFFS 0 255.9999357490357 0. 0 0 1 /end COMPU_METHOD
/begin COMPU_METHOD _CNV_A_R_LINEAR_____11_CM "" RAT_FUNC "%6.3" "°CRK" COEFFS 0 2.666666666666667 63. 0 0 1 /end COMPU_METHOD
/begin COMPU_METHOD _CNV_A_R_LINEAR_____12_CM "" RAT_FUNC "%6.3" "%" COEFFS 0 327.680000003584 3.584063961170614e-007 0 0 1 /end COMPU_METHOD
/begin COMPU_METHOD _CNV_A_R_LINEAR_____13_CM "" RAT_FUNC "%6.3" "[-]" COEFFS 0 1. 0. 0 0 1 /end COMPU_METHOD
/begin COMPU_METHOD _CNV_A_R_LINEAR_____14_CM "" RAT_FUNC "%6.3" "rpm/s" COEFFS 0 3.125e-002 0. 0 0 1 /end COMPU_METHOD
/begin COMPU_METHOD _CNV_A_R_LINEAR_____15_CM "" RAT_FUNC "%6.3" "rpm" COEFFS 0 3.125e-002 0. 0 0 1 /end COMPU_METHOD
/begin COMPU_METHOD _CNV_A_R_LINEAR_____16_CM "" RAT_FUNC "%6.3" "%" COEFFS 0 2.56 0. 0 0 1 /end COMPU_METHOD
/begin COMPU_METHOD _CNV_A_R_LINEAR_____17_CM "" RAT_FUNC "%6.3" "-" COEFFS 0 1. 0. 0 0 1 /end COMPU_METHOD
/begin COMPU_METHOD _CNV_A_R_LINEAR_____18_CM "" RAT_FUNC "%6.3" "s" COEFFS 0 10. 0. 0 0 1 /end COMPU_METHOD
/begin COMPU_METHOD _CNV_A_R_LINEAR_____19_CM "" RAT_FUNC "%6.3" "s" COEFFS 0 200. 0. 0 0 1 /end COMPU_METHOD
/begin COMPU_METHOD _CNV_A_R_LINEAR_____20_CM "" RAT_FUNC "%6.3" "s" COEFFS 0 1. 0. 0 0 1 /end COMPU_METHOD
/begin COMPU_METHOD _CNV_A_R_LINEAR_____21_CM "" RAT_FUNC "%6.3" "s" COEFFS 0 100. 0. 0 0 1 /end COMPU_METHOD
/begin COMPU_METHOD _CNV_A_R_LINEAR_____22_CM "" RAT_FUNC "%6.3" "°C" COEFFS 0 1.333333333333333 64. 0 0 1 /end COMPU_METHOD
/begin COMPU_METHOD _CNV_A_R_LINEAR_____23_CM "" RAT_FUNC "%6.3" "°C" COEFFS 0 1.333333333333333 0. 0 0 1 /end COMPU_METHOD
/begin COMPU_METHOD _CNV_A_R_LINEAR_____24_CM "" RAT_FUNC "%6.3" "ms" COEFFS 0 250. 0. 0 0 1 /end COMPU_METHOD
/begin COMPU_METHOD _CNV_A_R_LINEAR_____33_CM "" RAT_FUNC "%6.3" "s" COEFFS 0 2. 0. 0 0 1 /end COMPU_METHOD
/begin COMPU_METHOD _CNV_A_R_LINEAR_____34_CM "" RAT_FUNC "%6.3" "°TPS" COEFFS 0 137.0962343096234 0. 0 0 1 /end COMPU_METHOD
/begin COMPU_METHOD _CNV_A_R_LINEAR_____37_CM "" RAT_FUNC "%6.3" "Nm" COEFFS 0 32. 0. 0 0 1 /end COMPU_METHOD
/begin COMPU_METHOD _CNV_A_R_LINEAR_____40_CM "" RAT_FUNC "%6.3" "V" COEFFS 0 51.2 0. 0 0 1 /end COMPU_METHOD
/begin COMPU_METHOD _CNV_A_R_LINEAR_____42_CM "" RAT_FUNC "%6.3" "V" COEFFS 0 9.846168103048838 0. 0 0 1 /end COMPU_METHOD
/begin COMPU_METHOD _CNV_A_R_LINEAR_____43_CM "" RAT_FUNC "%6.3" "km/h" COEFFS 0 1. 0. 0 0 1 /end COMPU_METHOD
/begin COMPU_METHOD _CNV_A_R_LINEAR_____47_CM "" RAT_FUNC "%6.3" "°TPS" COEFFS 0 137.0962343096234 16383. 0 0 1 /end COMPU_METHOD
/begin COMPU_METHOD _CNV_A_R_LINEAR_____49_CM "" RAT_FUNC "%6.3" "°CRK" COEFFS 0 -2.666666666666667 0. 0 0 1 /end COMPU_METHOD
/begin COMPU_METHOD _CNV_A_R_LINEAR_____50_CM "" RAT_FUNC "%6.3" "-" COEFFS 0 1023.999999919998 0. 0 0 1 /end COMPU_METHOD
/begin COMPU_METHOD _CNV_A_R_LINEAR_____51_CM "" RAT_FUNC "%6.3" "mg/stk" COEFFS 0 0.183585313174946 0. 0 0 1 /end COMPU_METHOD
/begin COMPU_METHOD _CNV_A_R_LINEAR_____52_CM "" RAT_FUNC "%6.3" "kg/h" COEFFS 0 32. 0. 0 0 1 /end COMPU_METHOD
/begin COMPU_METHOD _CNV_A_R_LINEAR_____56_CM "" RAT_FUNC "%6.3" "mg/stk" COEFFS 0 47.18142548596112 0. 0 0 1 /end COMPU_METHOD
/begin COMPU_METHOD _CNV_A_R_LINEAR_____61_CM "" RAT_FUNC "%6.3" "°CRK" COEFFS 0 2.666666666666667 128. 0 0 1 /end COMPU_METHOD
/begin COMPU_METHOD _CNV_A_R_LINEAR_____62_CM "" RAT_FUNC "%6.3" "%" COEFFS 0 81.91999999679995 32767.99999871998 0 0 1 /end COMPU_METHOD
/begin COMPU_METHOD _CNV_A_R_LINEAR_____63_CM "" RAT_FUNC "%6.3" "%" COEFFS 0 327.680000003584 32768.00000035841 0 0 1 /end COMPU_METHOD
/begin COMPU_METHOD _CNV_A_R_LINEAR_____64_CM "" RAT_FUNC "%6.3" "-" COEFFS 0 127.9991955827809 0. 0 0 1 /end COMPU_METHOD
/begin COMPU_METHOD _CNV_A_R_LINEAR_____65_CM "" RAT_FUNC "%6.3" "Nm" COEFFS 0 32. 32768. 0 0 1 /end COMPU_METHOD
/begin COMPU_METHOD _CNV_A_R_LINEAR_____67_CM "" RAT_FUNC "%6.3" "[-]" COEFFS 0 128. 0. 0 0 1 /end COMPU_METHOD
/begin COMPU_METHOD _CNV_A_R_LINEAR_____68_CM "" RAT_FUNC "%6.3" "-" COEFFS 0 255.9983911655618 0. 0 0 1 /end COMPU_METHOD
/begin COMPU_METHOD _CNV_S_2_RANGE______74_CM "" TAB_VERB "%6.3" "[-]" COMPU_TAB_REF _CNV_S_2_RANGE______74 /end COMPU_METHOD
/begin COMPU_VTAB _CNV_S_2_RANGE______74 "" TAB_VERB 2 0 "0" 1 "1" /end COMPU_VTAB
/begin COMPU_METHOD _CNV_S_2_RANGE______76_CM "" TAB_VERB "%6.3" "-" COMPU_TAB_REF _CNV_S_2_RANGE______76 /end COMPU_METHOD
/begin COMPU_VTAB _CNV_S_2_RANGE______76 "" TAB_VERB 2 0 "0" 1 "1" /end COMPU_VTAB
/begin COMPU_METHOD _CNV_A_R_LINEAR_____78_CM "" RAT_FUNC "%6.3" "%" COEFFS 0 327.68 0. 0 0 1 /end COMPU_METHOD
/begin COMPU_METHOD _CNV_A_R_LINEAR_____79_CM "" RAT_FUNC "%6.3" "%" COEFFS 0 81.91999999679995 -1.280022843275219e-006 0 0 1 /end COMPU_METHOD
/begin COMPU_METHOD _CNV_A_R_LINEAR_____81_CM "" RAT_FUNC "%6.3" "°TPS/s" COEFFS 0 8.535564853556485e-002 0. 0 0 1 /end COMPU_METHOD
/begin COMPU_METHOD _CNV_A_R_LINEAR_____94_CM "" RAT_FUNC "%6.3" "°C" COEFFS 0 16. 0. 0 0 1 /end COMPU_METHOD
/begin COMPU_METHOD _CNV_A_R_LINEAR_____99_CM "" RAT_FUNC "%6.3" "V" COEFFS 0 13107.19998965744 0. 0 0 1 /end COMPU_METHOD
/begin COMPU_METHOD _CNV_A_R_LINEAR_____102_CM "" RAT_FUNC "%6.3" "ms" COEFFS 0 15.625 0. 0 0 1 /end COMPU_METHOD
/begin COMPU_METHOD _CNV_A_R_LINEAR_____117_CM "" RAT_FUNC "%6.3" "°CRK" COEFFS 0 42.66666666666666 0. 0 0 1 /end COMPU_METHOD
/begin COMPU_METHOD _CNV_A_R_LINEAR_____118_CM "" RAT_FUNC "%6.3" "-" COEFFS 0 32. 0. 0 0 1 /end COMPU_METHOD
/begin COMPU_METHOD _CNV_S_9_RANGE_FIL__119_CM "" TAB_VERB "%6.3" "-" COMPU_TAB_REF _CNV_S_9_RANGE_FIL__119 /end COMPU_METHOD
/begin COMPU_VTAB _CNV_S_9_RANGE_FIL__119 "" TAB_VERB 9 0 "10" 2 "12" 3 "14" 4 "16" 6 "9" 8 "5" 10 "6" 11 "7" 12 "8" /end COMPU_VTAB
/begin COMPU_METHOD _CNV_A_R_LINEAR_____120_CM "" RAT_FUNC "%6.3" "-" COEFFS 0 2.666666666666667 0. 0 0 1 /end COMPU_METHOD
/begin COMPU_METHOD _CNV_A_R_LINEAR_____121_CM "" RAT_FUNC "%6.3" "V" COEFFS 0 50.00000098039217 -4.901961005998601e-007 0 0 1 /end COMPU_METHOD
/begin COMPU_METHOD _CNV_A_R_LINEAR_____122_CM "" RAT_FUNC "%6.3" "°CRK" COEFFS 0 0.1666666666666667 0. 0 0 1 /end COMPU_METHOD
/begin COMPU_METHOD _CNV_A_R_LINEAR_____123_CM "" RAT_FUNC "%6.3" "-" COEFFS 0 682.6666665599934 2.560156259323598e-006 0 0 1 /end COMPU_METHOD
/begin COMPU_METHOD _CNV_S_7_RANGE_GAIN_124_R_CM "" TAB_VERB "%6.3" "-" COMPU_TAB_REF _CNV_S_7_RANGE_GAIN_124_R /end COMPU_METHOD
/begin COMPU_VTAB_RANGE _CNV_S_7_RANGE_GAIN_124_R "" 7 0 0 "2" 1 1 "4" 2 2 "8" 3 4 "16" 5 5 "32" 6 6 "64" 7 7 "128" /end COMPU_VTAB_RANGE
/begin COMPU_METHOD _CNV_A_R_LINEAR_____125_CM "" RAT_FUNC "%6.3" "°CRK" COEFFS 0 0.1666666666666667 10. 0 0 1 /end COMPU_METHOD
/begin COMPU_METHOD _CNV_A_R_LINEAR_____126_CM "" RAT_FUNC "%6.3" "°CRK" COEFFS 0 0.1666666666666667 30. 0 0 1 /end COMPU_METHOD
/begin COMPU_METHOD _CNV_A_R_LINEAR_____127_CM "" RAT_FUNC "%6.3" "°CRK" COEFFS 0 0.1666666666666667 50. 0 0 1 /end COMPU_METHOD
/begin COMPU_METHOD _CNV_A_R_LINEAR_____128_CM "" RAT_FUNC "%6.3" "°CRK" COEFFS 0 0.1666666666666667 70. 0 0 1 /end COMPU_METHOD
/begin COMPU_METHOD _CNV_A_R_LINEAR_____129_CM "" RAT_FUNC "%6.3" "°CRK" COEFFS 0 0.1666666666666667 90. 0 0 1 /end COMPU_METHOD
/begin COMPU_METHOD _CNV_A_R_LINEAR_____130_CM "" RAT_FUNC "%6.3" "°CRK" COEFFS 0 0.1666666666666667 110. 0 0 1 /end COMPU_METHOD
/begin COMPU_METHOD _CNV_A_R_LINEAR_____131_CM "" RAT_FUNC "%6.3" "°CRK/wcyc" COEFFS 0 64. 0. 0 0 1 /end COMPU_METHOD
/begin COMPU_METHOD _CNV_A_R_LINEAR_____132_CM "" RAT_FUNC "%6.3" "°CRK/wcyc" COEFFS 0 10.66666666666667 0. 0 0 1 /end COMPU_METHOD
/begin COMPU_METHOD _CNV_A_R_LINEAR_____133_CM "" RAT_FUNC "%6.3" "°CRK" COEFFS 0 682.6456692913386 7.874015748029706e-003 0 0 1 /end COMPU_METHOD
/begin COMPU_METHOD _CNV_A_R_LINEAR_____144_CM "" RAT_FUNC "%6.3" "%" COEFFS 0 655.3600000071681 0. 0 0 1 /end COMPU_METHOD
/begin COMPU_METHOD _CNV_A_R_LINEAR_____182_CM "" RAT_FUNC "%6.3" "mm" COEFFS 0 1000. 0. 0 0 1 /end COMPU_METHOD
/begin COMPU_METHOD _CNV_A_R_LINEAR_____185_CM "" RAT_FUNC "%6.3" "-" COEFFS 0 16383.75 32767.5 0 0 1 /end COMPU_METHOD
/begin COMPU_METHOD _CNV_A_R_LINEAR_____187_CM "" RAT_FUNC "%6.3" "°CRK" COEFFS 0 42.66666666666666 32768. 0 0 1 /end COMPU_METHOD
/begin COMPU_METHOD _CNV_A_R_LINEAR_____198_CM "" RAT_FUNC "%6.3" "ms" COEFFS 0 0.2 0. 0 0 1 /end COMPU_METHOD
/begin COMPU_METHOD _CNV_A_R_LINEAR_____199_CM "" RAT_FUNC "%6.3" "°TPS" COEFFS 0 137.0962343096234 1.818989403545857e-012 0 0 1 /end COMPU_METHOD
/begin COMPU_METHOD _CNV_A_R_LINEAR_____200_CM "" RAT_FUNC "%6.3" "°TPS/10ms" COEFFS 0 137.0962343096234 0. 0 0 1 /end COMPU_METHOD
/begin COMPU_METHOD _CNV_A_R_LINEAR_____201_CM "" RAT_FUNC "%6.3" "%" COEFFS 0 327.67 0. 0 0 1 /end COMPU_METHOD
/begin COMPU_METHOD _CNV_A_R_LINEAR_____206_CM "" RAT_FUNC "%6.3" "*wcyc" COEFFS 0 1. 0. 0 0 1 /end COMPU_METHOD
/begin COMPU_METHOD _CNV_A_R_LINEAR_____285_CM "" RAT_FUNC "%6.3" "-" COEFFS 0 7379.793318491542 0. 0 0 1 /end COMPU_METHOD
/begin COMPU_METHOD _CNV_A_R_LINEAR_____286_CM "" RAT_FUNC "%6.3" "cm²" COEFFS 0 1118.481084425738 0. 0 0 1 /end COMPU_METHOD
/begin COMPU_METHOD _CNV_A_R_LINEAR_____300_CM "" RAT_FUNC "%6.3" "°TPS" COEFFS 0 2.133891213389121 0. 0 0 1 /end COMPU_METHOD
/begin COMPU_METHOD _CNV_A_R_LINEAR_____301_CM "" RAT_FUNC "%6.3" "mg/stk" COEFFS 0 47.14849960790521 32768.20722749412 0 0 1 /end COMPU_METHOD
/begin COMPU_METHOD _CNV_S_4_RANGE_STAT_305_CM "" TAB_VERB "%6.3" "-" COMPU_TAB_REF _CNV_S_4_RANGE_STAT_305 /end COMPU_METHOD
/begin COMPU_VTAB _CNV_S_4_RANGE_STAT_305 "" TAB_VERB 4 0 "AUT_CMB" 1 "AFS_MAN" 2 "AFL_MAN" 3 "S_MAN" /end COMPU_VTAB
/begin COMPU_METHOD _CNV_S_3_RANGE_STAT_306_CM "" TAB_VERB "%6.3" "-" COMPU_TAB_REF _CNV_S_3_RANGE_STAT_306 /end COMPU_METHOD
/begin COMPU_VTAB _CNV_S_3_RANGE_STAT_306 "" TAB_VERB 3 0 "TQ_REQ_AFS" 1 "TQ_REQ_AFL" 2 "TQ_REQ_S" /end COMPU_VTAB
/begin COMPU_METHOD _CNV_S_5_RANGE_STAT_307_CM "" TAB_VERB "%6.3" "-" COMPU_TAB_REF _CNV_S_5_RANGE_STAT_307 /end COMPU_METHOD
/begin COMPU_VTAB _CNV_S_5_RANGE_STAT_307 "" TAB_VERB 5 0 "AFS" 1 "AFL_AFS" 2 "AFL" 3 "S_AFL" 4 "S" /end COMPU_VTAB
/begin COMPU_METHOD _CNV_S_9_RANGE_STAT_311_CM "" TAB_VERB "%6.3" "-" COMPU_TAB_REF _CNV_S_9_RANGE_STAT_311 /end COMPU_METHOD
/begin COMPU_VTAB _CNV_S_9_RANGE_STAT_311 "" TAB_VERB 9 0 "HOM_AFS" 1 "AFS_TO_AFL" 2 "HOM_AFL" 3 "AFL_TO_AFS" 4 "HOM_TO_S" 5 "BACKS" 6 "S" 7 "S_TO_HOM" 8 "BACKHOM" /end COMPU_VTAB
/begin RECORD_LAYOUT _REC_VAL_20_u2 FNC_VALUES 1 UWORD COLUMN_DIR DIRECT /end RECORD_LAYOUT
/begin RECORD_LAYOUT _REC_VAL_20_s2 FNC_VALUES 1 SWORD COLUMN_DIR DIRECT /end RECORD_LAYOUT
/begin RECORD_LAYOUT _REC_VAL_20_u1 FNC_VALUES 1 UBYTE COLUMN_DIR DIRECT /end RECORD_LAYOUT
/begin RECORD_LAYOUT _REC_VAL_20_s1 FNC_VALUES 1 SBYTE COLUMN_DIR DIRECT /end RECORD_LAYOUT
/begin RECORD_LAYOUT _REC_AXS_20_u2 NO_AXIS_PTS_X 1 UWORD AXIS_PTS_X 2 UWORD INDEX_INCR DIRECT /end RECORD_LAYOUT
/begin RECORD_LAYOUT _REC_AXS_20_u1 NO_AXIS_PTS_X 1 UBYTE AXIS_PTS_X 2 UBYTE INDEX_INCR DIRECT /end RECORD_LAYOUT
/begin RECORD_LAYOUT _REC_CUR_20_u2_u2 FNC_VALUES 1 UWORD COLUMN_DIR DIRECT /end RECORD_LAYOUT
/begin RECORD_LAYOUT _REC_MAP_20_u1_u1_u1 FNC_VALUES 1 UBYTE COLUMN_DIR DIRECT /end RECORD_LAYOUT
/begin RECORD_LAYOUT _REC_CUR_20_u2_u1 FNC_VALUES 1 UWORD COLUMN_DIR DIRECT /end RECORD_LAYOUT
/begin RECORD_LAYOUT _REC_CUR_20_u1_u1 FNC_VALUES 1 UBYTE COLUMN_DIR DIRECT /end RECORD_LAYOUT
/begin RECORD_LAYOUT _REC_MAP_20_u1_u2_u1 FNC_VALUES 1 UBYTE COLUMN_DIR DIRECT /end RECORD_LAYOUT
/begin RECORD_LAYOUT _REC_CUR_20_u1_u2 FNC_VALUES 1 UBYTE COLUMN_DIR DIRECT /end RECORD_LAYOUT
/begin RECORD_LAYOUT _REC_MAP_20_u1_u1_u2 FNC_VALUES 1 UBYTE COLUMN_DIR DIRECT /end RECORD_LAYOUT
/begin RECORD_LAYOUT _REC_MAP_20_u2_u1_u1 FNC_VALUES 1 UWORD COLUMN_DIR DIRECT /end RECORD_LAYOUT
/begin RECORD_LAYOUT _REC_MAP_20_u2_u1_u2 FNC_VALUES 1 UWORD COLUMN_DIR DIRECT /end RECORD_LAYOUT
/begin RECORD_LAYOUT _REC_CUR_20_s1_u1 FNC_VALUES 1 SBYTE COLUMN_DIR DIRECT /end RECORD_LAYOUT
/begin RECORD_LAYOUT _REC_MAP_20_u2_u2_u2 FNC_VALUES 1 UWORD COLUMN_DIR DIRECT /end RECORD_LAYOUT
/begin RECORD_LAYOUT _REC_MAP_20_u1_u2_u2 FNC_VALUES 1 UBYTE COLUMN_DIR DIRECT /end RECORD_LAYOUT
/begin FUNCTION EOS_Basic_operating_states__LV_S "_Basic operating states: LV_ST, LV_IS, LV_REQ_ISC, LV_PL, LV_PU & LV_PUC"
 /begin DEF_CHARACTERISTIC C_CYCNR_HYS_PUC C_CYCNR_HYS_PUC_ST C_N_DIF_MAX_IS C_N_MAX_BOL_ST C_T_MIN_PU C_TCO_MIN_PUC_ST ID_N_ACCOUT_MIN_PUC__TCO__GR_AT ID_N_ACCOUT_MIN_PUC__TCO__GR_MT ID_N_HYS_MAX_PUC__GR_AT ID_N_HYS_MAX_PUC__GR_MT ID_N_HYS_MIN_PUC__GR_AT ID_N_HYS_MIN_PUC__GR_MT ID_N_HYS_PUC_ST__GR_AT ID_N_HYS_PUC_ST__GR_MT ID_N_MIN_PUC__TCO__GR_AT ID_N_MIN_PUC__TCO__GR_MT IP_CYC_CAST__TCO C_T_MAX_PU LC_INH_DT_PU /end DEF_CHARACTERISTIC
 /begin OUT_MEASUREMENT LV_ST LV_IS LV_ST_END LV_PU LV_PL LV_PUC LV_PUC_REQ T_PU /end OUT_MEASUREMENT
/end FUNCTION
/begin FUNCTION EOS_Basic_functions__FL__INF___R "_Basic functions: FL, INF & REACX"
 /begin DEF_CHARACTERISTIC C_N_GRD_MIN C_N_MAX_FL_DLY C_N_MAX_INF C_N_MIN_FL_DLY C_T_MAX_FL_DLY C_T_TI_DLY_FL_1 C_T_TI_DLY_FL_2 C_T_TI_DLY_FL_AT_1 C_T_TI_DLY_FL_AT_2 C_TCO_MIN_FL C_VS_MIN_FL C_N_MIN_FL C_T_MIN_FL_DLY ID_TPS_GRD_BOL_AE__N__TPS_AV ID_PV_MAX_FL__N /end DEF_CHARACTERISTIC
 /begin OUT_MEASUREMENT LV_FL_RAW LV_TI_RIS LV_TI_RPU LV_TI_RPL LV_TI_RAE LV_FL LV_INF LV_TI_REAC /end OUT_MEASUREMENT
/end FUNCTION
/begin FUNCTION EOS_Auxiliary_start_functions "_Auxiliary start functions" /begin DEF_CHARACTERISTIC C_T_MAX_REST C_TCO_DIF_MAX_REST /end DEF_CHARACTERISTIC /begin OUT_MEASUREMENT TCO_REST LV_REST T_AST LV_AST /end OUT_MEASUREMENT /end FUNCTION
/begin FUNCTION EOS_Combustion_Management "_Combustion_Management"
 /begin DEF_CHARACTERISTIC IP_EFF_IGA_AFL IP_TQI_THD_AFL_AFS C_HYS_MAF_MAX_AFL C_CQ_S_MAX C_CQ_HOM_MAX C_T_DLY_EGR_S LC_INH_SWI_BACKHOM LC_INH_SWI_BACKS LC_INH_SWI_PU_BACKS C_CMB_CTL_MAN C_TCO_MIN_S C_TCO_MIN_AFL C_EFF_IGA_AFS_TO_AFL_OFS C_EFF_IGA_AFL_TO_AFS_OFS C_TQI_HYS_AFL C_TQI_HYS_AFS C_N_HYS_AFS C_N_HYS_AFL C_T_DLY_TQI_SWI C_CQ_S_MIN C_CQ_HOM_MIN C_FAC_LAMB_AFS LC_INH_SWI_PU C_HYS_LAMB_MIN_S IP_CYC_DLY_THR_S_HOM IP_FAC_MAF_AFL IP_LAMB_MIN_S IP_TQI_THD_S_AFL /end DEF_CHARACTERISTIC
 /begin OUT_MEASUREMENT EFF_TOT_BAS_AFL EFF_IGA_AFL EFF_LAMB_AFL TQI_SP_MAF_AFL MAF_SP_TQI_AFL LV_AUTH_MAF_AFL LV_HOM_ACT LV_S_ACT LV_HOM_RUN LV_S_RUN LV_MAF_SP_SWI LV_SP_RATE_CYL_EGR_SWI LV_FUP_SP_SWI LV_PORT_DEAC_SWI LV_TRAN_HOM_TO_PREL LV_TRAN_SWI_HOM_TO_S LV_TRAN_S_TO_PREL LV_TRAN_PREL_TO_BACKHOM LV_TRAN_PREL_TO_BACKS LV_TRAN_SWI_S_TO_HOM LV_TRAN_BACKS_TO_S LV_TRAN_BACKHOM_TO_HOM_AFL LV_TRAN_BACKHOM_TO_HOM_AFS LV_HOM_AFL_REQ LV_HOM_AFS_REQ LV_TRAN_TO_HOM_AFS LV_LAMB_HOM_AFL_ACT_1 LV_LAMB_SP_REQ_ACT T_DLY_EGR_S CYC_DLY_THR_S_HOM_CTR EGR_RATIO_PREV_S LAMB_SP_REQ EFF_LAMB_AFL_1 EFF_IGA_AFS_TO_AFL_THD STATE_CMB_CTL_MAN STATE_TQ_CMB STATE_TQI_REQ_FAST LV_TRAN_TO_HOM_AFL LV_TRAN_TQ_S_TO_AFS LV_TRAN_TQ_S_TO_AFL LV_TRAN_TQ_AFS_TO_S LV_TRAN_TQ_AFL_TO_S LV_TRAN_TQ_AFL_TO_AFS LV_TQI_S LV_TQI_HOM_AFL T_TQI_SWI N_HYS_AFL N_HYS_AFS TQI_THD_S_AFL TQI_THD_AFL_AFS LV_TQI_HOM_AFS LV_CQ LV_AUTH_LAMB_S LAMB_SP_S LV_TRAN_TQ_AFS_TO_AFL LV_CQ_S LV_IGA_AND_INJ_SWI_TMP STATE_CMB_CTL /end OUT_MEASUREMENT
/end FUNCTION
/begin FUNCTION EOS_Catalyst_heating_functions "_Catalyst heating functions" /begin DEF_CHARACTERISTIC ID_IGA_T_CH__TCO_ST ID_T_CH_TI__TCO_ST /end DEF_CHARACTERISTIC /begin OUT_MEASUREMENT LV_WUP LV_TI_CH LV_CH LV_AFL_CH /end OUT_MEASUREMENT /end FUNCTION
/begin FUNCTION EOS_Combustion_Mode_Switch "_Combustion Mode Switch" /begin OUT_MEASUREMENT LV_IGA_AND_INJ_SWI /end OUT_MEASUREMENT /end FUNCTION
/begin FUNCTION ETC_Electronic_Throttle_Control "ETC"
 /begin SUB_FUNCTION ETC_Calculation_of_the_driver_de ETC_Throttle_position_setpoint_c ETC_Position_controller ETC_MAF_setpoint_for_stratified_ ETC_Actuator_adaptation_diagnosi ETC_MAF_coordinaton_homogeneous_ ETC_Throttle_position_setpoint_s ETC_Detection_of_mass_air_flow_m /end SUB_FUNCTION
/end FUNCTION
/begin FUNCTION ETC_Calculation_of_the_driver_de "_Calculation of the driver demand" /begin DEF_CHARACTERISTIC C_PV_COR_IS C_PV_COR_IS_HYS /end DEF_CHARACTERISTIC /end FUNCTION
/begin FUNCTION ETC_Throttle_position_setpoint_c "_Throttle position setpoint calculation"
 /begin DEF_CHARACTERISTIC ID_MAF_FAC_SLOP__PQ_ESTIM IP_AMP_DEC__MAF_KGH_SP IP_TPS_SP_MDL_MAX__N_32__MAF_SP LC_AR_RED_FIL_ENA LC_TPS_FIL_ENA IP_TPS_SP_MDL_BAS IP_CRLC_AR_RED_SP LC_INH_ISAPWM_MAN_AS ID_MAF_FAC_OFS__PQ_ESTIM ID_MAF_ISA_FAC_OFS__PQ_ESTIM ID_MAF_ISA_FAC_SLOP__PQ_ESTIM C_AR_RED_ISA_MAX IP_CRLC_AR_RED_ISA_SP LC_AR_RED_ISA_FIL_ENA IP_ISAPWM_ISA IP_FAC_ISAPWM_VB C_ISAPWM_MAN_AS C_ISAPWM_OFS_AS C_CRLC_ISAPWM_MMV C_ISAPWM_ISA_DIAG C_PQ_SP_MAX_ISA C_PQ_SP_MAX /end DEF_CHARACTERISTIC
 /begin OUT_MEASUREMENT MAP_SP PQ_SP MAF_SP_RATIO AMP_MDL_IVS PRS_UP_THR_IVS AR_RED_SP_1 AR_RED_SP_MMV_1 AR_RED_SP_MMV TPS_SP_MDL_BAS TPS_SP_MDL TPS_SP_MDL_MAX TPS_SP_MDL_BAS_COR MAF_KGH_SP MAF_KGH_SP_ISA MAF_KGH_SP_ISA_CLC PQ_SP_ISA MAF_KGH_SP_THR MAF_TURB_RATIO MAF_KGH_SP_ISA_RAW PSI_SP PSI_SP_ISA AR_RED_ISA_SP_1 AR_RED_ISA_SP_MMV AR_RED_ISA_SP_MMV_1 ISAPWM_ISA ISAPWM_ISA_1 ISAPWM_ISA_2 ISAPWM_MMV /end OUT_MEASUREMENT
/end FUNCTION
/begin FUNCTION ETC_Position_controller "_Position controller"
 /begin DEF_CHARACTERISTIC C_MTCPWM_I_MAX_POS IP_MTCPWM_D__TPS_DIF_GRD IP_MTCPWM_I__TPS_DIF IP_MTCPWM_P__TPS_DIF IP_MTCPWM_VB_FAC__VB C_TPS_SP_LIH_DIF_HYS C_MTCPWM_I_MAX_NEG C_MTCPWM_I_ADD C_MTCPWM_ADD_FIL IP_MTCPWM_I_FAC__TPS_AV_LIH_DIF IP_MTCPWM_ADD__TPS_SP_LIH_DIF C_T_MTCPWM_CLOSE_ACT_MAX C_MTCPWM_CLOSE_MAX C_TPS_SP_STOP_HYS C_TPS_SP_STOP_MAX C_MTCPWM_I_INI C_TPS_SP_LGRD_STOP C_TPS_SP_CTL_MAX C_MTCPWM_CLOSE C_MTCPWM_HYS /end DEF_CHARACTERISTIC
 /begin OUT_MEASUREMENT TPS_DIF MTCPWM_ADD MTCPWM_CTL MTCPWM_D MTCPWM_P MTCPWM_I MTCPWM_I_ADD TPS_SP_LIH_DIF MTCPWM_VB_FAC TPS_DIF_GRD T_MTCPWM_CLOSE_ACT TPS_SP_CTL LV_TPS_SP_POS LV_TPS_CHG_POS MTCPWM LV_MTCPWM_CLOSE_ACT TPS_AV_LIH_DIF LV_INH_MTC_CTL /end OUT_MEASUREMENT
/end FUNCTION
/begin FUNCTION ETC_MAF_setpoint_for_stratified_ "_MAF setpoint for stratified mode" /begin DEF_CHARACTERISTIC IP_PQ_EGR_SP IP_FAC_MAF_MAX_S IP_EFF_MAF_S LC_MAF_SP_EGR /end DEF_CHARACTERISTIC /begin OUT_MEASUREMENT MAF_SP_S FAC_MAF_MAX_S MAF_DIF_S /end OUT_MEASUREMENT /end FUNCTION
/begin FUNCTION ETC_Actuator_adaptation_diagnosi "_Actuator adaptation diagnosis"
 /begin DEF_CHARACTERISTIC C_N_MAX_TPS_AD C_TCO_MAX_TPS_AD C_TCO_MIN_TPS_AD C_TIA_MIN_TPS_AD C_TPS_AD_DIAG_ENA C_V_TPS_SP_BOL_1 C_V_TPS_SP_BOL_2 C_VB_MIN_TPS_AD C_TPS_SP_SPR_CHK_UP /end DEF_CHARACTERISTIC
/end FUNCTION
/begin FUNCTION ETC_MAF_coordinaton_homogeneous_ "_MAF coordinaton homogeneous - stratified" /begin DEF_CHARACTERISTIC LC_ISA_ENA IP_MAF_SP_ISA /end DEF_CHARACTERISTIC /begin OUT_MEASUREMENT MAF_SP MAF_SP_ISA LV_ISA_ENA /end OUT_MEASUREMENT /end FUNCTION
/begin FUNCTION ETC_Throttle_position_setpoint_s "_Throttle position setpoint selection" /begin DEF_CHARACTERISTIC C_TPS_SP_AS_MAN C_TPS_SP_MAN_ACT C_TPS_AD_CTL_INI /end DEF_CHARACTERISTIC /begin OUT_MEASUREMENT TPS_SP LV_MTC_CUR_OFF /end OUT_MEASUREMENT /end FUNCTION
/begin FUNCTION ETC_Detection_of_mass_air_flow_m "_Detection of mass air flow meter pulsation" /end FUNCTION
/begin FUNCTION IGA_Ignition_Angle "IGA"
 /begin SUB_FUNCTION IGA_Ignition_angle_general IGA_Dwell_time_control_open_loop IGA_Ignition_with_multiple_spark IGA_Corrected_basic_ignition_ang IGA_Setpoint_ignition_angle IGA_Minimum_ignition_angle IGA_Basic_ignition_angle_at_star IGA_KnockControl IGA_Ignition_angle_for_stratifie IGA_Corrected_Reference_Ignition IGA_Ignition_angle_correction_du IGA_Temperature_Correction IGA_RON_adaption IGA_Minimum_IGA_limitation_for_e /end SUB_FUNCTION
/end FUNCTION
/begin FUNCTION IGA_Ignition_angle_general "_Ignition angle general"
 /begin DEF_CHARACTERISTIC C_IGA_INI C_IGA_AS_CYL_0 C_IGA_AS_CYL_1 C_IGA_AS_CYL_2 C_IGA_AS_CYL_3 C_IGA_AS_CYL_4 C_IGA_AS_CYL_5 C_IGA_AS C_CRLC_IGA_KNK IPM_EFF_IGA__IGA_DIF LC_IGA_ST_ENA /end DEF_CHARACTERISTIC
 /begin OUT_MEASUREMENT EFF_IGA_AV EFF_IGA_BAS_COR EFF_IGA_MIN IGA_DIF_BAS IGA_IGC_0 IGA_IGC_1 IGA_IGC_2 IGA_IGC_3 IGA_IGC_4 IGA_IGC_5 IGA_SP_MAX_1 IGA_BAS_COR_KNK_ADD IGA_AV_MV IGA_0 IGA_1 IGA_2 IGA_3 IGA_4 IGA_5 IGA_DIF_AV IGA_DIF_BAS_KNK_FIL IGA_BAS_COR_KNK_FIL EFF_IGA_BAS_COR_KNK_FIL IGA_MV_KNK_FIL /end OUT_MEASUREMENT
/end FUNCTION
/begin FUNCTION IGA_Dwell_time_control_open_loop "_Dwell time control open loop" /begin DEF_CHARACTERISTIC C_TD_INI IP_TD__VB C_TD_AS /end DEF_CHARACTERISTIC /begin OUT_MEASUREMENT TD TD_MAX_WDT /end OUT_MEASUREMENT /end FUNCTION
/begin FUNCTION IGA_Ignition_with_multiple_spark "_Ignition with multiple spark" /begin DEF_CHARACTERISTIC C_TD_T_MPL IP_TD_MPL__VB C_TCO_MAX_MPL C_VB_MAX_MPL /end DEF_CHARACTERISTIC /begin OUT_MEASUREMENT LV_MPL_IGA_ACT TD_MPL TD_MPL_DLY /end OUT_MEASUREMENT /end FUNCTION
/begin FUNCTION IGA_Corrected_basic_ignition_ang "_Corrected basic ignition angle"
 /begin DEF_CHARACTERISTIC IP_IGA_BAS_LAMB_LAMB_SP IP_IGA_BAS_ADD_MIN__IVVT__N__MAF IP_IGA_BAS_ADD_MAX__IVVT__N__MAF IP_IGA_BAS_RON_98__N__MAF IP_IGA_BAS_RON_91__N__MAF IP_IGA_BAS__N__MAF C_IGA_BAS_ADD_MIN C_IGA_BAS_ADD_MAX /end DEF_CHARACTERISTIC
 /begin OUT_MEASUREMENT IGA_BAS_LAMB_COR IGA_BAS_COR IGA_BAS_IVVT_OFS IGA_BAS_IVVT IGA_BAS_RON /end OUT_MEASUREMENT
/end FUNCTION
/begin FUNCTION IGA_Setpoint_ignition_angle "_Setpoint ignition angle" /begin DEF_CHARACTERISTIC C_EFF_IGA_THD_1 IP_IGA_DIF_SP__EFF_IGA_SP LC_TQ_IGA_INH /end DEF_CHARACTERISTIC
 /begin OUT_MEASUREMENT EFF_IGA_SP EFF_IGA_SP_1 IGA_DIF_SP IGA_SP LV_TQ_IGA_ACT LV_TQ_IGA_REQ /end OUT_MEASUREMENT
/end FUNCTION
/begin FUNCTION IGA_Minimum_ignition_angle "_Minimum ignition angle" /begin DEF_CHARACTERISTIC IP_IGA_DIF_MIN_BAS__N__MAF IP_IGA_DIF_MIN_TCO__TCO /end DEF_CHARACTERISTIC /begin OUT_MEASUREMENT IGA_DIF_MIN IGA_MIN /end OUT_MEASUREMENT /end FUNCTION
/begin FUNCTION IGA_Basic_ignition_angle_at_star "_Basic ignition angle at start" /begin DEF_CHARACTERISTIC IP_IGA_ST IP_IGA_ST_H_PRS /end DEF_CHARACTERISTIC /begin OUT_MEASUREMENT IGA_ST /end OUT_MEASUREMENT /end FUNCTION
/begin FUNCTION IGA_KnockControl "_KnockControl"
 /begin DEF_CHARACTERISTIC C_CYCNR_AD2_DEC_KNK IP_MAF_MIN_KNK IP_IGA_MAX_KNK ldp_tco__maf_min_knk ldpm_maf_iga_ad ldpm_maf_knkwb ldpm_n_fil_frq_knk ldpm_n_iga_ad ldpm_n_knkwb ID_CYCNR_FAC_TRA_KNK ID_FAC_THD_KNK_1 ID_FAC_THD_KNK_2 ID_FAC_THD_KNK_3 ID_FIL_FRQ_KNK_1 ID_FIL_FRQ_KNK_2 ID_FIL_FRQ_KNK_3 ID_IGA_AD1_KNK_SIZE ID_IGA_DEC_KNK_1 ID_IGA_DEC_KNK_2 ID_IGA_TPS_GRD_TRA_KNK ID_KNK_THD_ADD ID_KNKWB_1 ID_KNKWB_2 ID_KNKWB_3 ID_KNKWE_0 ID_KNKWE_1 ID_KNKWE_2 ID_MAF_MIN_AD_KNK ID_N_GRD_MAX_KNK__N IP_FAC_IGA_MAX_KNK IP_IGA_INC_KNK C_CYCNR_AD2_INC_KNK C_FAC_TRA_KNK C_IGA_AD1_FAC_DEC_KNK C_IGA_AD1_FAC_FAST_KNK C_IGA_AD1_FAC_INC_KNK C_IGA_AD1_INC_KNK C_IGA_AD1_LGRD_NEG_KNK C_IGA_AD1_LGRD_POS_KNK C_IGA_AD1_THD_DEC_KNK C_IGA_AD1_THD_FAST_KNK C_IGA_AD1_THD_INC_KNK C_IGA_AD2_MAX_KNK C_IGA_AD2_THD_DEC_KNK C_IGA_AD2_THD_INC_KNK C_IGA_DIF_MIN_MAX_KNK C_IGA_LGRD_3 C_KNK_THD_MAX C_MAF_IGA_HYS_KNK C_N_IGA_HYS_KNK C_NL_CRLC C_NL_CRLC_TRA C_NL_MIN C_SWI_AD_KNK C_TCO_MAX_AD2_KNK C_TCO_MIN_AD2_KNK ldp_tco__fac_iga_tco_knk ID_KNKWE_3 ID_KNKWE_5 ID_KNKWB_0 ID_KNKWB_5 ID_FIL_FRQ_KNK_0 ID_FAC_THD_KNK_0 ID_KNKWB_4 ID_KNKWE_4 ID_FIL_FRQ_KNK_4 ID_FIL_FRQ_KNK_5 ldpm_n_3_9 ID_FAC_THD_KNK_4 ldpm_n_6_4 ID_FAC_THD_KNK_5 C_MAF_MIN_KNK_AD2 C_TCO_AD_MAX_KNK ID_GAIN_KNK_5 ID_GAIN_KNK_0 ID_GAIN_KNK_1 ID_GAIN_KNK_2 ID_GAIN_KNK_3 ID_GAIN_KNK_4 IGA_AD1_KNK_5__N__MAF IGA_AD1_KNK_4__N__MAF IGA_AD1_KNK_3__N__MAF IGA_AD1_KNK_2__N__MAF IGA_AD1_KNK_1__N__MAF IGA_AD1_KNK_0__N__MAF ID_TPS_GRD_TRA_KNK C_TCO_AD_MIN_KNK /end DEF_CHARACTERISTIC
 /begin OUT_MEASUREMENT IGA_AD1_KNK_0 IGA_AD1_KNK_1 IGA_AD1_KNK_2 IGA_AD1_KNK_3 IGA_AD1_KNK_4 IGA_AD1_KNK_5 IGA_AD2_KNK IGA_KNK_0 IGA_KNK_1 IGA_KNK_2 IGA_KNK_3 IGA_KNK_4 IGA_KNK_5 KNK_THD_0 KNK_THD_1 KNK_THD_2 KNK_THD_3 KNK_THD_4 KNK_THD_5 KNKS_0 KNKS_1 KNKS_2 KNKS_3 KNKS_4 KNKS_5 KNKS_CMD_FIL_0 KNKS_CMD_FIL_1 KNKS_CMD_FIL_2 KNKS_CMD_FIL_3 KNKS_CMD_FIL_4 KNKS_CMD_FIL_5 KNKS_CMD_GAIN_0 KNKS_CMD_GAIN_1 KNKS_CMD_GAIN_2 KNKS_CMD_GAIN_3 KNKS_CMD_GAIN_4 KNKS_CMD_GAIN_5 KNKWB_0 KNKWB_1 KNKWB_2 KNKWB_3 KNKWB_4 KNKWB_5 KNKWE_0 KNKWE_1 KNKWE_2 KNKWE_3 KNKWE_4 KNKWE_5 LV_KNK_AD1_ENA LV_KNK_AD2_ENA LV_KNK_CTL_ENA LV_KNK_TRA_MAF MAF_KNK N_KNK NL_0 NL_1 NL_2 NL_3 NL_4 NL_5 KNK_CTL_DIS LV_KNK_AD_RD_ENA KNK_AD1_DIS KNK_AD2_DIS LV_KNK_TRA_N IGA_ADJ_KNK_0_ IGA_ADJ_KNK_1_ IGA_ADJ_KNK_2_ IGA_ADJ_KNK_3_ IGA_ADJ_KNK_4_ IGA_ADJ_KNK_5_ IGA_ADJ_MAX_KNK IGA_ADJ_MAX_KNK_DIAG DLY_IGA_ADJ_KNK_DIAG IGA_MV_ADJ_KNK CYL_ID_KNK LV_KNK IGA_MV_KNK FAC_IGA_MAX_KNK /end OUT_MEASUREMENT
/end FUNCTION
/begin FUNCTION IGA_Ignition_angle_for_stratifie "_Ignition angle for stratified mode" /begin DEF_CHARACTERISTIC LC_IGA_MAN C_IGA_MAN IP_IGA_BAS_S /end DEF_CHARACTERISTIC
 /begin OUT_MEASUREMENT IGA_IGC_S_0 IGA_IGC_S_1 IGA_IGC_S_2 IGA_IGC_S_3 IGA_IGC_S_4 IGA_IGC_S_5 IGA_BAS_S /end OUT_MEASUREMENT
/end FUNCTION
/begin FUNCTION IGA_Corrected_Reference_Ignition "_Corrected Reference Ignition Angle"
 /begin DEF_CHARACTERISTIC IP_IGA_REF IP_IGA_REF_LAMB__LAMB_SP IP_IGA_REF_TEMP__N__MAF IP_IGA_REF_VVT__N__MAF IP_IGA_REF_TEMP_FAC IP_IGA_REF_EGR_FAC IP_IGA_REF_EGR /end DEF_CHARACTERISTIC
 /begin OUT_MEASUREMENT IGA_REF_COR IGA_REF_LAMB_COR IGA_REF_TEMP_COR IGA_REF_VVT_COR IGA_REF_EGR_COR /end OUT_MEASUREMENT
/end FUNCTION
/begin FUNCTION IGA_Ignition_angle_correction_du "_Ignition angle correction due to EGR"
 /begin DEF_CHARACTERISTIC IP_FAC_RATE_EGR_AFR IP_FAC_RATE_EGR_AFL IP_IGA_EGR_AFR IP_IGA_EGR_AFL IP_IGA_EGR_LAMB_RATIO_FAC IP_FAC_RATE_EGR_S IP_IGA_EGR_S /end DEF_CHARACTERISTIC
 /begin OUT_MEASUREMENT IGA_BAS_EGR_COR IGA_BAS_EGR_COR_HOM IGA_BAS_EGR_COR_S /end OUT_MEASUREMENT
/end FUNCTION
/begin FUNCTION IGA_Temperature_Correction "_Temperature Correction"
 /begin DEF_CHARACTERISTIC IP_IGA_BAS_TEMP_COR__TCO__TIA IP_FAC_IGA_POS__N_32__MAF IP_FAC_IGA_NEG__N_32__MAF /end DEF_CHARACTERISTIC
 /begin OUT_MEASUREMENT IGA_BAS_TEMP_COR /end OUT_MEASUREMENT
/end FUNCTION
/begin FUNCTION IGA_RON_adaption "_RON adaption"
 /begin DEF_CHARACTERISTIC C_TCO_AD_MIN_RON C_CYCNR_AD_RTD_KNK C_IGA_MIN_AD C_IGA_MAX_AD C_CYCNR_FAC_RON C_TCO_FAC_RON_MIN C_TCO_FAC_RON_MAX C_FAC_RON_AD_COLD C_FAC_RON_AD_HOT ID_MAF_MIN_KNK_AD_2__N_32 IP_FAC_RON_INC__N IP_FAC_RON_DEC__N IP_FAC_RON_AD_MAX__TIA__TCO /end DEF_CHARACTERISTIC
 /begin OUT_MEASUREMENT FAC_RON_AD /end OUT_MEASUREMENT
/end FUNCTION
/begin FUNCTION IGA_Minimum_IGA_limitation_for_e "_Minimum IGA limitation for exhaust gas temperature protection" /begin DEF_CHARACTERISTIC C_TEG_MAX_IGA_HYS C_TEG_MAX_IGA IP_IGA_DIF_MIN_TEG__TEG /end DEF_CHARACTERISTIC /begin OUT_MEASUREMENT IGA_MIN_TEG IGA_DIF_MIN_TEG EFF_IGA_MIN_TEG TEG_DYN_HYS /end OUT_MEASUREMENT /end FUNCTION
/begin FUNCTION INJ_Injection "INJ"
 /begin SUB_FUNCTION INJ_General_Calculation_of_Fuel_ INJ_Injection_phase INJ_Start_injection_time_for_sta INJ_Injector_dead_time_correctio INJ_Cold_post_start_correction INJ_Warm_up_correction INJ_Catalyst_heating_correction INJ_High_torque_request_enrichme INJ_Idle_speed_correction_TI_IS INJ_Wall_film_correction_TI_ADD_ INJ_Injection_time_correction_at INJ_Cylinder_shut_off INJ_Injection_time_at_reactivati INJ_Upstream_oxygen_sensor_signa INJ_Upstream_oxygen_sensor_heate INJ_Exhaust_gas_temperature_mode INJ_Lambda_control_A_F_Feedback_ INJ_Lambda_control_correction_TI INJ_Lambda_adaption_TI_AD_ADD_MM INJ_Application_incidence_for_th INJ_Downstream_fuel_trim_regulat INJ_Detection_of_limited_dynamic INJ_Downstream_oxygen_sensor_sig INJ_Downstream_oxygen_sensor_hea INJ_Injection_fuel_setpoint_for_ INJ_Injection_pressure_correctio INJ_Lambda_coordination INJ_Lambda_Catalyst_overheating_ INJ_Conversion_MFF_to_TI INJ_Basic_lambda_setpoint INJ_Ambient_pressure_correction INJ_Injection_phase_for_stratifi INJ_Lambda_setpoint_for_catalyst INJ_Injection_press_correction_s INJ_Injection_setpoint_for_strat INJ_Mass_Fuel_Flow_Setpoint_for_ INJ_NOx_catalyst_management_cata INJ_NOx_catalyst_management_requ INJ_NOx_engine_out_emission_homo INJ_LAMB_RATIO_calculation INJ_NOx_engine_out_emission_stra INJ_Catalyst_heating_with_second INJ_Injection_Time_Correction_by INJ_Transformation_layer_for_bas INJ_Upstream_oxygen_sensor_inter INJ_Downstream_oxygen_sensor_int INJ_Cat_enrichment_fct_after_puc INJ_Cat_enrichment_fct_after_ch_ INJ_Cat_enrichment_fct_after_hst /end SUB_FUNCTION
/end FUNCTION
/begin FUNCTION INJ_General_Calculation_of_Fuel_ "_General Calculation of Fuel Inj Time" /begin OUT_MEASUREMENT MFF_SP /end OUT_MEASUREMENT /end FUNCTION
/begin FUNCTION INJ_Injection_phase "_Injection phase"
 /begin DEF_CHARACTERISTIC C_EOI_LIM LC_EOI_HOM_MAN C_EOI_HOM_MAN C_SOI_MIN_CST_L_PRS C_SOI_MIN_CST_H_PRS IP_EOI_H_PRS_CST IP_EOI_L_PRS_CST IP_EOI_BAS IP_EOI_TCO C_EOI_AS LC_EOI_COR_IVVT_VVL IP_CAM_OP_IN_VVL__VLFT_AV /end DEF_CHARACTERISTIC
 /begin OUT_MEASUREMENT SOI_HOM EOI_HOM EOI_HOM_CLC EOI_TCO TI_HOM_MAX_CST EOI_BAS EOI_LIM CAM_OP_IN_VVL EOI_IVVT_VVL /end OUT_MEASUREMENT
/end FUNCTION
/end MODULE
/end PROJECT
