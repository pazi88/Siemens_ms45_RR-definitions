ASAP2_VERSION 1 31
/begin PROJECT MS45 "Rover Motorsteuerung V6"
/begin HEADER "_default_HeaderComment" PROJECT_NO _50 /end HEADER
/begin MODULE _default_ModuleName "_default_ModuleLongIdentifier"
/begin MOD_COMMON "_default_ModCommonComment" DEPOSIT ABSOLUTE BYTE_ORDER MSB_FIRST ALIGNMENT_BYTE 1 ALIGNMENT_WORD 2 ALIGNMENT_LONG 4 ALIGNMENT_FLOAT32_IEEE 4 ALIGNMENT_FLOAT64_IEEE 8 /end MOD_COMMON
/begin CHARACTERISTIC C_FAC_WF_PUC "transposition factor for PUC" VALUE 0x67b97 _REC_VAL_20_u1 0.9960940000000002 _CNV_A_R_LINEAR_____8_CM 0. 0.996094 FORMAT "%5.3" /end CHARACTERISTIC
/begin CHARACTERISTIC C_SEG_CTR_WF_INI "initial value for number of segments after start with increased pos. wall film compensation" VALUE 0x67c36 _REC_VAL_20_u2 65535. _CNV_A_R_LINEAR_____17_CM 0. 65535. FORMAT "%5.0" /end CHARACTERISTIC
/begin CHARACTERISTIC C_T_VLS_FL "" VALUE 0x67c90 _REC_VAL_20_u1 255. _CNV_A_R_LINEAR_____20_CM 0. 255. FORMAT "%3.0" /end CHARACTERISTIC
/begin CHARACTERISTIC C_TI_CRLC_FAST_WF_IS "fast correlation constant for idle speed" VALUE 0x67cce _REC_VAL_20_u1 0.4980468800000001 _CNV_A_R_LINEAR_____27_CM 0. 0.49804688 FORMAT "%5.3" /end CHARACTERISTIC
/begin CHARACTERISTIC C_TI_CYCNR_PUC "Duration of the wall film build-up" VALUE 0x67cd0 _REC_VAL_20_u2 3276.75 _CNV_A_R_LINEAR_____28_CM 0. 65535. FORMAT "%5.0" /end CHARACTERISTIC
/begin CHARACTERISTIC C_TI_DEC_REAC "Controlled reset for TI_WF_COR (PL, AE)" VALUE 0x67cd2 _REC_VAL_20_u1 0.102 _CNV_A_R_LINEAR_____24_CM 0. 1.02 FORMAT "%5.3" /end CHARACTERISTIC
/begin CHARACTERISTIC C_TI_DEC_RIS "Controlled reset for TI_WF_COR (IS, PU)" VALUE 0x67cd3 _REC_VAL_20_u1 0.102 _CNV_A_R_LINEAR_____24_CM 0. 1.02 FORMAT "%5.3" /end CHARACTERISTIC
/begin CHARACTERISTIC C_TI_INC_REAC "Increment for the calculation of TI_WF_COR " VALUE 0x67cd6 _REC_VAL_20_u1 0.102 _CNV_A_R_LINEAR_____24_CM 0. 1.02 FORMAT "%5.3" /end CHARACTERISTIC
/begin MEASUREMENT SEG_CTR_WF "wall film segment counter running down after engine start" UWORD _CNV_A_R_LINEAR_____46_CM 1 100. 0. 65535. ECU_ADDRESS 0x3fd174 FORMAT "%5.0" /end MEASUREMENT
/begin MEASUREMENT TI_ADD_DLY "Injector dead time correction" SWORD _CNV_A_R_LINEAR_____24_CM 1 100. -131.072 131.068 ECU_ADDRESS 0x3fcfc6 FORMAT "%8.3" /end MEASUREMENT
/begin MEASUREMENT TIB "Basic injection time - equivalent to MFF_BAS (interface to wall film compensation function)" UWORD _CNV_A_R_LINEAR_____24_CM 1 100. 0. 262.14 ECU_ADDRESS 0x3fc6ba FORMAT "%7.3" /end MEASUREMENT
/begin AXIS_PTS ldp_nr_pat__pat_ind "" 0x617e4 NUMMER_DES_ABSCHALTPATTERNS _REC_AXS_20_u1 255. _CNV_A_R_LINEAR_____17_CM 7 0. 255. FORMAT "%3.0" /end AXIS_PTS
/begin AXIS_PTS ldp_seg_ctr_fac_wf "" 0x617f6 SEG_CTR_FAC_WF _REC_AXS_20_u2 65535. _CNV_A_R_LINEAR_____46_CM 4 0. 65535. FORMAT "%5.0" /end AXIS_PTS
/begin AXIS_PTS ldp_tco_st_ti_fac_wf "" 0x6190b TCO_ST _REC_AXS_20_u1 190.5 _CNV_A_R_LINEAR_____22_CM 4 -48. 142.5 FORMAT "%5.1" /end AXIS_PTS
/begin AXIS_PTS ldp_tco_ti_wf_thd "" 0x61915 TCO _REC_AXS_20_u1 28.575 _CNV_A_R_LINEAR_____22_CM 4 -48. 142.5 FORMAT "%5.1" /end AXIS_PTS
/begin AXIS_PTS ldpm_maf_6 "" 0x61b95 MAF _REC_AXS_20_u1 1389. _CNV_A_R_LINEAR_____51_CM 8 0. 1389. FORMAT "%4.0" /end AXIS_PTS
/begin AXIS_PTS ldpm_n_29 "" 0x61c04 N_32 _REC_AXS_20_u1 8160. _CNV_A_R_LINEAR_____15_CM 8 0. 8160. FORMAT "%4.0" /end AXIS_PTS
/begin AXIS_PTS ldpm_n_35 "" 0x61c7e N_32 _REC_AXS_20_u1 8160. _CNV_A_R_LINEAR_____15_CM 6 0. 8160. FORMAT "%4.0" /end AXIS_PTS
/begin AXIS_PTS ldpm_tco_15 "" 0x61ce4 TCO _REC_AXS_20_u1 190.5 _CNV_A_R_LINEAR_____22_CM 8 -48. 142.5 FORMAT "%5.1" /end AXIS_PTS
/begin AXIS_PTS ldpm_tco_3 "" 0x61cfb TCO _REC_AXS_20_u1 190.5 _CNV_A_R_LINEAR_____22_CM 8 -48. 142.5 FORMAT "%5.1" /end AXIS_PTS
/begin AXIS_PTS ldpm_tco_3_4 "" 0x61d04 TCO _REC_AXS_20_u1 190.5 _CNV_A_R_LINEAR_____22_CM 8 -48. 142.5 FORMAT "%5.1" /end AXIS_PTS
/begin AXIS_PTS ldpm_tib_ti_wf_thd "" 0x61d5c TIB _REC_AXS_20_u2 262.14 _CNV_A_R_LINEAR_____24_CM 4 0. 262.14 FORMAT "%7.3" /end AXIS_PTS
/begin CHARACTERISTIC ID_PAT_IND__NR_PAT "Cylinder shut-off patterns" CURVE 0x658c8 _REC_CUR_20_u2_u1 65535. _CNV_A_R_LINEAR_____17_CM 0. 65535. FORMAT "%5.0"
 /begin AXIS_DESCR COM_AXIS ONLINE_DUMMY _CNV_A_R_LINEAR_____17_CM 7 0. 255. FORMAT "%3.0" AXIS_PTS_REF ldp_nr_pat__pat_ind /end AXIS_DESCR
/end CHARACTERISTIC
/begin CHARACTERISTIC ID_TI_ADD_INF__TCO "Injection time correction INF" CURVE 0x6598c _REC_CUR_20_s2_u1 10.4856 _CNV_A_R_LINEAR_____24_CM -131.072 131.068
 /begin AXIS_DESCR COM_AXIS TCO _CNV_A_R_LINEAR_____22_CM 8 -48. 142.5 FORMAT "%5.1" AXIS_PTS_REF ldpm_tco_3_4 /end AXIS_DESCR
/end CHARACTERISTIC
/begin CHARACTERISTIC ID_TI_ADD_RAE__TCO "Injection correction reset fuel-feed AE" CURVE 0x6599c _REC_CUR_20_s2_u1 10.4856 _CNV_A_R_LINEAR_____24_CM -131.072 131.068
 /begin AXIS_DESCR COM_AXIS TCO _CNV_A_R_LINEAR_____22_CM 8 -48. 142.5 FORMAT "%5.1" AXIS_PTS_REF ldpm_tco_3_4 /end AXIS_DESCR
/end CHARACTERISTIC
/begin CHARACTERISTIC ID_TI_ADD_RIS__TCO "Injection correction reset fuel-feed IS, PU" CURVE 0x659ac _REC_CUR_20_s2_u1 5.2428 _CNV_A_R_LINEAR_____24_CM -131.072 131.068
 /begin AXIS_DESCR COM_AXIS TCO _CNV_A_R_LINEAR_____22_CM 8 -48. 142.5 FORMAT "%5.1" AXIS_PTS_REF ldpm_tco_3_4 /end AXIS_DESCR
/end CHARACTERISTIC
/begin CHARACTERISTIC ID_TI_ADD_RPL__TCO "Injection correction reset fuel-feed PL" CURVE 0x659bc _REC_CUR_20_s2_u1 10.4856 _CNV_A_R_LINEAR_____24_CM -131.072 131.068
 /begin AXIS_DESCR COM_AXIS TCO _CNV_A_R_LINEAR_____22_CM 8 -48. 142.5 FORMAT "%5.1" AXIS_PTS_REF ldpm_tco_3_4 /end AXIS_DESCR
/end CHARACTERISTIC
/begin CHARACTERISTIC IP_SEG_CTR_FAC_WF__SEG_CTR_WF "number of segments depending factor for first tip in" CURVE 0x66be6 _REC_CUR_20_u1_u2 0.9960940000000002 _CNV_A_R_LINEAR_____8_CM 0. 0.996094 FORMAT "%5.3"
 /begin AXIS_DESCR COM_AXIS SEG_CTR_WF _CNV_A_R_LINEAR_____46_CM 4 0. 65535. FORMAT "%5.0" AXIS_PTS_REF ldp_seg_ctr_fac_wf /end AXIS_DESCR
/end CHARACTERISTIC
/begin CHARACTERISTIC IP_TI_CRLC_NEG_FAST_WF__N "fast negative correlation constant" CURVE 0x6735c _REC_CUR_20_u1_u1 0.4980468800000001 _CNV_A_R_LINEAR_____27_CM 0. 0.49804688 FORMAT "%5.3"
 /begin AXIS_DESCR COM_AXIS N_32 _CNV_A_R_LINEAR_____15_CM 8 0. 8160. FORMAT "%4.0" AXIS_PTS_REF ldpm_n_29 /end AXIS_DESCR
/end CHARACTERISTIC
/begin CHARACTERISTIC IP_TI_CRLC_NEG_SLOW_WF__N "slow negative correlation constant" CURVE 0x67364 _REC_CUR_20_u1_u1 0.4980468800000001 _CNV_A_R_LINEAR_____27_CM 0. 0.49804688 FORMAT "%5.3"
 /begin AXIS_DESCR COM_AXIS N_32 _CNV_A_R_LINEAR_____15_CM 8 0. 8160. FORMAT "%4.0" AXIS_PTS_REF ldpm_n_29 /end AXIS_DESCR
/end CHARACTERISTIC
/begin CHARACTERISTIC IP_TI_CRLC_POS_FAST_WF__N "fast positive correlation constant" CURVE 0x6736c _REC_CUR_20_u1_u1 0.4980468800000001 _CNV_A_R_LINEAR_____27_CM 0. 0.49804688 FORMAT "%5.3"
 /begin AXIS_DESCR COM_AXIS N_32 _CNV_A_R_LINEAR_____15_CM 8 0. 8160. FORMAT "%4.0" AXIS_PTS_REF ldpm_n_29 /end AXIS_DESCR
/end CHARACTERISTIC
/begin CHARACTERISTIC IP_TI_CRLC_POS_SLOW_WF__N "slow positive correlation constant" CURVE 0x67374 _REC_CUR_20_u1_u1 0.4980468800000001 _CNV_A_R_LINEAR_____27_CM 0. 0.49804688 FORMAT "%5.3"
 /begin AXIS_DESCR COM_AXIS N_32 _CNV_A_R_LINEAR_____15_CM 8 0. 8160. FORMAT "%4.0" AXIS_PTS_REF ldpm_n_29 /end AXIS_DESCR
/end CHARACTERISTIC
/begin CHARACTERISTIC IP_TI_DIF_WF_THD__TCO "threshold for suppressing small variations of tib" CURVE 0x673ac _REC_CUR_20_u2_u1 262.14 _CNV_A_R_LINEAR_____24_CM 0. 262.14 FORMAT "%7.3"
 /begin AXIS_DESCR COM_AXIS TCO _CNV_A_R_LINEAR_____22_CM 4 -48. 142.5 FORMAT "%5.1" AXIS_PTS_REF ldp_tco_ti_wf_thd /end AXIS_DESCR
/end CHARACTERISTIC
/begin CHARACTERISTIC IP_TI_FAC_NEG_FAST_WF__N__MAF "load correction fast wall film negative" MAP 0x673b4 _REC_MAP_20_u1_u1_u1 1.9921875 _CNV_A_R_LINEAR_____67_CM 0. 1.9921875 FORMAT "%5.3"
 /begin AXIS_DESCR COM_AXIS N_32 _CNV_A_R_LINEAR_____15_CM 8 0. 8160. FORMAT "%4.0" AXIS_PTS_REF ldpm_n_29 /end AXIS_DESCR
 /begin AXIS_DESCR COM_AXIS MAF _CNV_A_R_LINEAR_____51_CM 8 0. 1389. FORMAT "%4.0" AXIS_PTS_REF ldpm_maf_6 /end AXIS_DESCR
/end CHARACTERISTIC
/begin CHARACTERISTIC IP_TI_FAC_NEG_SLOW_WF__N__MAF "load correction slow wall film negative" MAP 0x673f4 _REC_MAP_20_u1_u1_u1 1.9921875 _CNV_A_R_LINEAR_____67_CM 0. 1.9921875 FORMAT "%5.3"
 /begin AXIS_DESCR COM_AXIS N_32 _CNV_A_R_LINEAR_____15_CM 8 0. 8160. FORMAT "%4.0" AXIS_PTS_REF ldpm_n_29 /end AXIS_DESCR
 /begin AXIS_DESCR COM_AXIS MAF _CNV_A_R_LINEAR_____51_CM 8 0. 1389. FORMAT "%4.0" AXIS_PTS_REF ldpm_maf_6 /end AXIS_DESCR
/end CHARACTERISTIC
/begin CHARACTERISTIC IP_TI_FAC_POS_SLOW_WF__N__MAF "load correction slow wall film positive" MAP 0x67474 _REC_MAP_20_u1_u1_u1 1.9921875 _CNV_A_R_LINEAR_____67_CM 0. 1.9921875 FORMAT "%5.3"
 /begin AXIS_DESCR COM_AXIS N_32 _CNV_A_R_LINEAR_____15_CM 8 0. 8160. FORMAT "%4.0" AXIS_PTS_REF ldpm_n_29 /end AXIS_DESCR
 /begin AXIS_DESCR COM_AXIS MAF _CNV_A_R_LINEAR_____51_CM 8 0. 1389. FORMAT "%4.0" AXIS_PTS_REF ldpm_maf_6 /end AXIS_DESCR
/end CHARACTERISTIC
/begin CHARACTERISTIC IP_TI_FAST_WF_THD__TIB "threshold for fast wall film correction" CURVE 0x674b4 _REC_CUR_20_u2_u2 262.14 _CNV_A_R_LINEAR_____24_CM 0. 262.14 FORMAT "%7.3"
 /begin AXIS_DESCR COM_AXIS TIB _CNV_A_R_LINEAR_____24_CM 4 0. 262.14 FORMAT "%7.3" AXIS_PTS_REF ldpm_tib_ti_wf_thd /end AXIS_DESCR
/end CHARACTERISTIC
/begin CHARACTERISTIC IP_TI_SLOW_WF_THD__TIB "threshold for slow wall film correction" CURVE 0x674bc _REC_CUR_20_u2_u2 262.14 _CNV_A_R_LINEAR_____24_CM 0. 262.14 FORMAT "%7.3"
 /begin AXIS_DESCR COM_AXIS TIB _CNV_A_R_LINEAR_____24_CM 4 0. 262.14 FORMAT "%7.3" AXIS_PTS_REF ldpm_tib_ti_wf_thd /end AXIS_DESCR
/end CHARACTERISTIC
/begin CHARACTERISTIC IP_TI_ST_REST__TCO "restart correction function during engine stopped,start" CURVE 0x674ca _REC_CUR_20_u1_u1 0.199220002 _CNV_A_R_LINEAR_____68_CM 0. 0.99610001 FORMAT "%4.3"
 /begin AXIS_DESCR COM_AXIS TCO _CNV_A_R_LINEAR_____22_CM 8 -48. 142.5 FORMAT "%5.1" AXIS_PTS_REF ldpm_tco_3 /end AXIS_DESCR
/end CHARACTERISTIC
/begin CHARACTERISTIC IP_TI_TCO_NEG_FAST_WF__N__TCO "fast negative wall film factor" MAP 0x674d2 _REC_MAP_20_u1_u1_u1 127.5 _CNV_A_R_LINEAR_____69_CM 0. 127.5 FORMAT "%5.1"
 /begin AXIS_DESCR COM_AXIS N_32 _CNV_A_R_LINEAR_____15_CM 8 0. 8160. FORMAT "%4.0" AXIS_PTS_REF ldpm_n_29 /end AXIS_DESCR
 /begin AXIS_DESCR COM_AXIS TCO _CNV_A_R_LINEAR_____22_CM 8 -48. 142.5 FORMAT "%5.1" AXIS_PTS_REF ldpm_tco_15 /end AXIS_DESCR
/end CHARACTERISTIC
/begin CHARACTERISTIC IP_TI_TCO_NEG_SLOW_WF__N__TCO "total negativewall film factor" MAP 0x67512 _REC_MAP_20_u1_u1_u1 127.5 _CNV_A_R_LINEAR_____69_CM 0. 127.5 FORMAT "%5.1"
 /begin AXIS_DESCR COM_AXIS N_32 _CNV_A_R_LINEAR_____15_CM 8 0. 8160. FORMAT "%4.0" AXIS_PTS_REF ldpm_n_29 /end AXIS_DESCR
 /begin AXIS_DESCR COM_AXIS TCO _CNV_A_R_LINEAR_____22_CM 8 -48. 142.5 FORMAT "%5.1" AXIS_PTS_REF ldpm_tco_15 /end AXIS_DESCR
/end CHARACTERISTIC
/begin CHARACTERISTIC IP_TI_TCO_POS_FAST_WF__N__TCO "fast positive wall film factor" MAP 0x67552 _REC_MAP_20_u1_u1_u1 127.5 _CNV_A_R_LINEAR_____69_CM 0. 127.5 FORMAT "%5.1"
 /begin AXIS_DESCR COM_AXIS N_32 _CNV_A_R_LINEAR_____15_CM 8 0. 8160. FORMAT "%4.0" AXIS_PTS_REF ldpm_n_29 /end AXIS_DESCR
 /begin AXIS_DESCR COM_AXIS TCO _CNV_A_R_LINEAR_____22_CM 8 -48. 142.5 FORMAT "%5.1" AXIS_PTS_REF ldpm_tco_15 /end AXIS_DESCR
/end CHARACTERISTIC
/begin CHARACTERISTIC IP_TI_TCO_POS_SLOW_WF__N__TCO "total positive wall film factor" MAP 0x67592 _REC_MAP_20_u1_u1_u1 127.5 _CNV_A_R_LINEAR_____69_CM 0. 127.5 FORMAT "%5.1"
 /begin AXIS_DESCR COM_AXIS N_32 _CNV_A_R_LINEAR_____15_CM 8 0. 8160. FORMAT "%4.0" AXIS_PTS_REF ldpm_n_29 /end AXIS_DESCR
 /begin AXIS_DESCR COM_AXIS TCO _CNV_A_R_LINEAR_____22_CM 8 -48. 142.5 FORMAT "%5.1" AXIS_PTS_REF ldpm_tco_15 /end AXIS_DESCR
/end CHARACTERISTIC
/begin CHARACTERISTIC IP_TI_TCO_ST_FAC_WF__TCO_ST "TCO_ST depending factor for first tip in" CURVE 0x675d2 _REC_CUR_20_u1_u1 0.9960940000000002 _CNV_A_R_LINEAR_____8_CM 0. 0.996094 FORMAT "%5.3"
 /begin AXIS_DESCR COM_AXIS TCO_ST _CNV_A_R_LINEAR_____22_CM 4 -48. 142.5 FORMAT "%5.1" AXIS_PTS_REF ldp_tco_st_ti_fac_wf /end AXIS_DESCR
/end CHARACTERISTIC
/begin CHARACTERISTIC IP_TI_TCO_WUP__TCO__TCO_ST "Warm-up enrichment deactivation factor" MAP 0x675d6 _REC_MAP_20_u1_u1_u1 0.19968 _CNV_A_R_LINEAR_____70_CM 0. 1.9968 FORMAT "%4.2"
 /begin AXIS_DESCR COM_AXIS TCO _CNV_A_R_LINEAR_____22_CM 8 -48. 142.5 FORMAT "%5.1" AXIS_PTS_REF ldpm_tco_7 /end AXIS_DESCR
 /begin AXIS_DESCR COM_AXIS TCO _CNV_A_R_LINEAR_____22_CM 3 -48. 142.5 FORMAT "%5.1" AXIS_PTS_REF ldp_tco_st_ip_ti_tco_wup /end AXIS_DESCR
/end CHARACTERISTIC
/begin CHARACTERISTIC IP_TI_VO_FAST_WF__VO "VO-dependent wall film amount correction factor for fast compensation" CURVE 0x675ee _REC_CUR_20_u1_u1 1.99220002 _CNV_A_R_LINEAR_____64_CM 0. 1.99220002 FORMAT "%5.3"
 /begin AXIS_DESCR COM_AXIS VO _CNV_A_R_LINEAR_____6_CM 8 0. 95.625 FORMAT "%4.1" AXIS_PTS_REF ldpm_vo_1 /end AXIS_DESCR
/end CHARACTERISTIC
/begin CHARACTERISTIC IP_TI_VO_SLOW_WF__VO "VO-dependent wall film amount correction factor for slow compensation" CURVE 0x675f6 _REC_CUR_20_u1_u1 1.99220002 _CNV_A_R_LINEAR_____64_CM 0. 1.99220002 FORMAT "%5.3"
 /begin AXIS_DESCR COM_AXIS VO _CNV_A_R_LINEAR_____6_CM 8 0. 95.625 FORMAT "%4.1" AXIS_PTS_REF ldpm_vo_1 /end AXIS_DESCR
/end CHARACTERISTIC
/begin MEASUREMENT TI_WUP "Warm-up injection time correction" UWORD _CNV_A_R_LINEAR_____72_CM 1 100. 0. 4. ECU_ADDRESS 0x3fc6ae FORMAT "%6.4" /end MEASUREMENT
/begin MEASUREMENT TI_CAST "Cold post start injection time correction" UWORD _CNV_A_R_LINEAR_____72_CM 1 100. 0. 4. ECU_ADDRESS 0x3fcfb8 FORMAT "%6.4" /end MEASUREMENT
/begin MEASUREMENT LV_SCC "Logical value for single cylinder cut off" UBYTE _CNV_S_2_RANGE______74_CM 1 100. 0. 1. ECU_ADDRESS 0x3fd4ce /end MEASUREMENT
/begin MEASUREMENT TI_ADD_WF "Total amount of wall film compensation" SWORD _CNV_A_R_LINEAR_____24_CM 1 100. -131.072 131.068 ECU_ADDRESS 0x3fd15e /end MEASUREMENT
/begin MEASUREMENT TI_WF_COR "Reactivation fuel feed injection time correction for wall-wetting" UWORD _CNV_A_R_LINEAR_____24_CM 1 100. 0. 262.14 ECU_ADDRESS 0x3fc6ca FORMAT "%7.3" /end MEASUREMENT
/begin MEASUREMENT TI_FAST_WF_POST_THD "Fast term of wall film compensation" SWORD _CNV_A_R_LINEAR_____24_CM 1 100. -131.072 131.068 ECU_ADDRESS 0x3fd16e FORMAT "%8.3" /end MEASUREMENT
/begin MEASUREMENT TI_SLOW_WF_POST_THD "Slow term of wall film compensation" SWORD _CNV_A_R_LINEAR_____24_CM 1 100. -131.072 131.068 ECU_ADDRESS 0x3fd170 FORMAT "%8.3" /end MEASUREMENT
/begin MEASUREMENT INH_CYC_IV "Shut off request for cylinder x (individual)" UWORD _CNV_A_R_LINEAR_____17_CM 1 100. 0. 65535. ECU_ADDRESS 0x3fc93a FORMAT "%5.0" /end MEASUREMENT
/begin MEASUREMENT INH_IV_FCUT "Shut off sequence of pull fuel cut off " UBYTE _CNV_A_R_LINEAR_____17_CM 1 100. 0. 255. ECU_ADDRESS 0x3fd9af FORMAT "%3.0" /end MEASUREMENT
/begin MEASUREMENT INH_IV_IGK "Shut off sequence of IGK (off) " UBYTE _CNV_A_R_LINEAR_____17_CM 1 100. 0. 255. ECU_ADDRESS 0x3fd9b5 FORMAT "%3.0" /end MEASUREMENT
/begin MEASUREMENT INH_SWI_IV "Shut off sequence of coordinated pattern " UWORD _CNV_A_R_LINEAR_____17_CM 1 100. 0. 65535. ECU_ADDRESS 0x3fc93c FORMAT "%5.0" /end MEASUREMENT
/begin MEASUREMENT LV_INJ_CUT "All cylinders are shut off" UBYTE _CNV_S_2_RANGE______74_CM 1 100. 0. 1. ECU_ADDRESS 0x3fd4cd BIT_MASK 0x1 /end MEASUREMENT
/begin MEASUREMENT LV_IND_FCUT "At least 1 Cyl. is shut off" UBYTE _CNV_S_2_RANGE______76_CM 1 100. 0. 1. ECU_ADDRESS 0x3fd4cc BIT_MASK 0x1 /end MEASUREMENT
/begin MEASUREMENT LV_ST_H_PRS "Logical variable indicating high pressure start active" UBYTE _CNV_S_2_RANGE______76_CM 1 100. 0. 1. ECU_ADDRESS 0x3fd544 BIT_MASK 0x1 /end MEASUREMENT
/begin MEASUREMENT TI_ST_REST "???" UBYTE _CNV_A_R_LINEAR_____8_CM 1 100. 0. 0.996094 ECU_ADDRESS 0x3fd7f1 FORMAT "%5.3" /end MEASUREMENT
/begin MEASUREMENT TI_ST_AMP "Injection correction at start upon AMP " UBYTE _CNV_A_R_LINEAR_____8_CM 1 100. 0. 0.996094 ECU_ADDRESS 0x3fd7ec FORMAT "%5.3" /end MEASUREMENT
/begin MEASUREMENT MFF_CST "Basic injection at start (LV_ST)" UWORD _CNV_A_R_LINEAR_____56_CM 1 100. 0. 1389. ECU_ADDRESS 0x3fcfba FORMAT "%7.2" /end MEASUREMENT
/begin MEASUREMENT MFF_SP_HOM_2 "Mass fuel flow setpoint for homogeneous charge (output)" UWORD _CNV_A_R_LINEAR_____56_CM 1 100. 0. 1389. ECU_ADDRESS 0x3fc6a4 FORMAT "%7.2" /end MEASUREMENT
/begin MEASUREMENT LAMB_CH "Lambda catalyst heating" UWORD _CNV_A_R_LINEAR_____50_CM 1 100. 0. 31.99902344 ECU_ADDRESS 0x3fc6f4 /end MEASUREMENT
/begin MEASUREMENT LAMB_AFL_CH "Lambda catalyst heating with lean strategy" UWORD _CNV_A_R_LINEAR_____50_CM 1 100. 0. 31.99902344 ECU_ADDRESS 0x3fc6f6 /end MEASUREMENT
/begin MEASUREMENT LAMB_FL "Lambda Requirement for Full Load Enrichment" UWORD _CNV_A_R_LINEAR_____50_CM 1 100. 0. 31.99902344 ECU_ADDRESS 0x3fc6f2 /end MEASUREMENT
/begin MEASUREMENT TI_HOM_2 "fuel injection time for homogeneous mode" UWORD _CNV_A_R_LINEAR_____24_CM 1 100. 0. 262.14 ECU_ADDRESS 0x3fc65a FORMAT "%7.3" /end MEASUREMENT
/begin MEASUREMENT LAMB_HOM_AFS "stociometric lambda setpoint  " UWORD _CNV_A_R_LINEAR_____50_CM 1 100. 0. 31.99902344 ECU_ADDRESS 0x3fc6f0 /end MEASUREMENT
/begin MEASUREMENT LAMB_HOM_AFL "lambda setpoint for homogeneous lean combustion" UWORD _CNV_A_R_LINEAR_____50_CM 1 100. 0. 31.99902344 ECU_ADDRESS 0x3fc6ec /end MEASUREMENT
/begin MEASUREMENT LAMB_COP "lambda for catalyst overheating prevention" UWORD _CNV_A_R_LINEAR_____50_CM 1 100. 0. 31.99902344 ECU_ADDRESS 0x3fc6e6 FORMAT "%7.4" /end MEASUREMENT
/begin MEASUREMENT TEG_COP_DIF "boolean for active catalyst overheating control" SWORD _CNV_A_R_LINEAR_____94_CM 1 100. -2048. 2047. ECU_ADDRESS 0x3fc6e8 FORMAT "%8.2" /end MEASUREMENT
/begin MEASUREMENT MFF_BAS "Basic injection fuel mass flow (homogenious charge)" UWORD _CNV_A_R_LINEAR_____56_CM 1 100. 0. 1389. ECU_ADDRESS 0x3fc6b6 FORMAT "%7.2" /end MEASUREMENT
/begin MEASUREMENT MFF_ADD_WF "Fuel mass flow for wall film compensation - equivalent to TI_ADD_WF (interface to total injection formula)" SWORD _CNV_A_R_LINEAR_____108_CM 1 100. -694.5 694.478806 ECU_ADDRESS 0x3fc6b8 FORMAT "%7.2" /end MEASUREMENT
/begin CHARACTERISTIC C_MFF_SP_MAN "manual setpoint for fuel mass in homogeneous mode" VALUE 0x67bec _REC_VAL_20_u2 1389. _CNV_A_R_LINEAR_____56_CM 0. 1389. FORMAT "%7.2" /end CHARACTERISTIC
/begin CHARACTERISTIC C_MFF_SP_HOM_OFS_AS "additive mass fuel offset value for application" VALUE 0x67bea _REC_VAL_20_u2 1389. _CNV_A_R_LINEAR_____56_CM 0. 1389. FORMAT "%7.2" /end CHARACTERISTIC
/begin CHARACTERISTIC C_CYC_CAST_H_PRS "Cycle counter break off threshold to switch over to \"low pressure start\"" VALUE 0x67b6a _REC_VAL_20_u2 65535. _CNV_A_R_LINEAR_____17_CM 0. 65535. FORMAT "%5.0" /end CHARACTERISTIC
/begin CHARACTERISTIC C_MFF_FAC "Constannt for stoichiometric air/fuel ratio (=1/14.7)" VALUE 0x67be8 _REC_VAL_20_u2 0.125 _CNV_A_R_LINEAR_____109_CM 0. 0.125 FORMAT "%7.5" /end CHARACTERISTIC
/begin CHARACTERISTIC C_TI_HOM_MAN "manual setpoint for injection time in homogeneous mode" VALUE 0x67cd4 _REC_VAL_20_u2 262.14 _CNV_A_R_LINEAR_____24_CM 0. 262.14 FORMAT "%7.3" /end CHARACTERISTIC
/begin CHARACTERISTIC LC_TI_HOM_MAN_ACT "switch for manual setpoint for injection time in homogeneous mode" VALUE 0x67d89 _REC_VAL_20_u1 1. _CNV_S_2_RANGE______76_CM 0. 1. /end CHARACTERISTIC
/begin CHARACTERISTIC C_TI_AS "global injection time correction" VALUE 0x67cc7 _REC_VAL_20_u1 1.99220002 _CNV_A_R_LINEAR_____64_CM 0. 1.99220002 FORMAT "%5.3" /end CHARACTERISTIC
/begin CHARACTERISTIC C_LAMB_FL_PAS "Passive value for full load enrichment" VALUE 0x67bd2 _REC_VAL_20_u2 31.99902344 _CNV_A_R_LINEAR_____50_CM 0. 31.99902344 FORMAT "%7.4" /end CHARACTERISTIC
/begin CHARACTERISTIC C_LAMB_BAS_COR_MIN "Minimum value for lambda setpoint" VALUE 0x67bca _REC_VAL_20_u2 31.99902344 _CNV_A_R_LINEAR_____50_CM 0. 31.99902344 FORMAT "%7.4" /end CHARACTERISTIC
/begin CHARACTERISTIC C_LAMB_SP_1_HYS "Hysteresis for lambda = 1 detection" VALUE 0x67bd6 _REC_VAL_20_u2 31.99902344 _CNV_A_R_LINEAR_____50_CM 0. 31.99902344 FORMAT "%7.4" /end CHARACTERISTIC
/begin CHARACTERISTIC C_LAMB_SA_CH_HYS "Hysteresis for secondary air catalyst heating active" VALUE 0x67bd4 _REC_VAL_20_u2 31.99902344 _CNV_A_R_LINEAR_____50_CM 0. 31.99902344 FORMAT "%7.4" /end CHARACTERISTIC
/begin CHARACTERISTIC C_LAMB_COP_MIN "Minimum value for catalyst overheating protection" VALUE 0x67bce _REC_VAL_20_u2 31.99902344 _CNV_A_R_LINEAR_____50_CM 0. 31.99902344 FORMAT "%7.4" /end CHARACTERISTIC
/begin CHARACTERISTIC C_TEG_COP_BOL "bottom level of the exhaust gas temperature" VALUE 0x67cbc _REC_VAL_20_u2 2047.96875 _CNV_A_R_LINEAR_____110_CM 0. 2047.96875 FORMAT "%7.2" /end CHARACTERISTIC
/begin CHARACTERISTIC C_LAMB_COP_PAS "passive value for the lambda catalyst overheating prevention" VALUE 0x67bd0 _REC_VAL_20_u2 31.99902344 _CNV_A_R_LINEAR_____50_CM 0. 31.99902344 FORMAT "%7.4" /end CHARACTERISTIC
/begin CHARACTERISTIC C_LAMB_COP_I "I-part of controler" VALUE 0x67bcc _REC_VAL_20_u2 3.9219e-003 _CNV_A_R_LINEAR_____111_CM 0. 3.9219e-003 FORMAT "%9.8" /end CHARACTERISTIC
/begin CHARACTERISTIC C_FAC_MFF_TI_STND_2 "Injectionvalve characteristic for fuel mass flow to injection time at standard conditions" VALUE 0x67b86 _REC_VAL_20_u2 0.7549 _CNV_A_R_LINEAR_____112_CM 0. 0.7549 FORMAT "%6.4" /end CHARACTERISTIC
/begin AXIS_PTS ldp_tco__mff_lgrd_ast "" 0x618a4 TCO _REC_AXS_20_u1 190.5 _CNV_A_R_LINEAR_____22_CM 8 -48. 142.5 FORMAT "%5.1" /end AXIS_PTS
/begin AXIS_PTS ldpm_tco__mff_cst "" 0x61d30 TCO _REC_AXS_20_u1 19.05 _CNV_A_R_LINEAR_____22_CM 8 -48. 142.5 FORMAT "%5.1" /end AXIS_PTS
/begin CHARACTERISTIC IP_MFF_CST "Basic value for cranking injection" MAP 0x66952 _REC_MAP_20_u2_u2_u1 1389. _CNV_A_R_LINEAR_____56_CM 0. 1389. FORMAT "%7.2"
 /begin AXIS_DESCR COM_AXIS N _CNV_A_R_LINEAR_____0_CM 3 0. 8160. FORMAT "%4.0" AXIS_PTS_REF ldp_n__mff_cst /end AXIS_DESCR
 /begin AXIS_DESCR COM_AXIS TCO _CNV_A_R_LINEAR_____22_CM 8 -48. 142.5 FORMAT "%5.1" AXIS_PTS_REF ldpm_tco__mff_cst /end AXIS_DESCR
/end CHARACTERISTIC
/begin AXIS_PTS ldp_cyc__mff_cst "" 0x614a4 CYC _REC_AXS_20_u1 255. _CNV_A_R_LINEAR_____13_CM 4 0. 255. FORMAT "%3.0" /end AXIS_PTS
/begin AXIS_PTS ldp_vb__ti_add_dly "" 0x61ab3 VB _REC_AXS_20_u1 3.107808 _CNV_A_R_LINEAR_____42_CM 8 0. 25.8984 FORMAT "%3.1" /end AXIS_PTS
/begin AXIS_PTS ldp_tco_st_ip_ti_tco_wup "" 0x61900 TCO _REC_AXS_20_u1 190.5 _CNV_A_R_LINEAR_____22_CM 3 -48. 142.5 FORMAT "%5.1" /end AXIS_PTS
/begin AXIS_PTS ldpm_tco_7 "" 0x61d14 TCO _REC_AXS_20_u1 190.5 _CNV_A_R_LINEAR_____22_CM 8 -48. 142.5 FORMAT "%5.1" /end AXIS_PTS
/begin AXIS_PTS ldp_n__lamb_fl "" 0x61694 N_32 _REC_AXS_20_u1 8160. _CNV_A_R_LINEAR_____15_CM 12 0. 8160. FORMAT "%4.0" /end AXIS_PTS
/begin CHARACTERISTIC IP_MFF_LGRD_AST "Injection time change limitation after Start" CURVE 0x669a2 _REC_CUR_20_u2_u1 1389. _CNV_A_R_LINEAR_____56_CM 0. 1389. FORMAT "%7.2"
 /begin AXIS_DESCR COM_AXIS TCO _CNV_A_R_LINEAR_____22_CM 8 -48. 142.5 FORMAT "%5.1" AXIS_PTS_REF ldp_tco__mff_lgrd_ast /end AXIS_DESCR
/end CHARACTERISTIC
/begin CHARACTERISTIC IP_LAMB_FL__N "Lambda full load enrichment" CURVE 0x664c6 _REC_CUR_20_u2_u1 31.99902344 _CNV_A_R_LINEAR_____50_CM 0. 31.99902344
 /begin AXIS_DESCR COM_AXIS N_32 _CNV_A_R_LINEAR_____15_CM 12 0. 8160. FORMAT "%4.0" AXIS_PTS_REF ldp_n__lamb_fl /end AXIS_DESCR
/end CHARACTERISTIC
/begin AXIS_PTS ldp_n_32__lamb_bas "" 0x61637 N_32 _REC_AXS_20_u1 8160. _CNV_A_R_LINEAR_____15_CM 8 0. 8160. FORMAT "%4.0" /end AXIS_PTS
/begin AXIS_PTS ldp_tco__lamb_add_afl_ch "" 0x61886 TCO _REC_AXS_20_u1 190.5 _CNV_A_R_LINEAR_____22_CM 8 -48. 142.5 FORMAT "%5.1" /end AXIS_PTS
/begin AXIS_PTS ldp_n_32__lamb_hom_afl "" 0x61652 N_32 _REC_AXS_20_u1 8160. _CNV_A_R_LINEAR_____15_CM 8 0. 8160. FORMAT "%4.0" /end AXIS_PTS
/begin AXIS_PTS ldpm_n_19 "" 0x61bfb N_32 _REC_AXS_20_u1 8160. _CNV_A_R_LINEAR_____15_CM 8 0. 8160. FORMAT "%4.0" /end AXIS_PTS
/begin AXIS_PTS ldp_n_32__fac_lamb_wup "" 0x61627 N_32 _REC_AXS_20_u1 8160. _CNV_A_R_LINEAR_____15_CM 6 0. 8160. FORMAT "%4.0" /end AXIS_PTS
/begin AXIS_PTS ldp_tqi_req_slow__lamb_hom_afl "" 0x619f4 TQI_REQ_SLOW _REC_AXS_20_u2 2047.96875 _CNV_A_R_LINEAR_____65_CM 8 -1024. 1023.96875 FORMAT "%6.2" /end AXIS_PTS
/begin AXIS_PTS ldp_tqi_req_slow__fac_lamb_wup "" 0x619b0 TQI_REQ_SLOW _REC_AXS_20_u2 2047.96875 _CNV_A_R_LINEAR_____65_CM 6 -1024. 1023.96875 FORMAT "%6.2" /end AXIS_PTS
/begin CHARACTERISTIC IP_LAMB_LAMB_WUP "correction factor for basic lambda warm-up" MAP 0x65bdc _REC_MAP_20_u1_u1_u2 1.9921875 _CNV_A_R_LINEAR_____67_CM 0. 1.9921875 FORMAT "%5.3"
 /begin AXIS_DESCR COM_AXIS N_32 _CNV_A_R_LINEAR_____15_CM 6 0. 8160. FORMAT "%4.0" AXIS_PTS_REF ldp_n_32__fac_lamb_wup /end AXIS_DESCR
 /begin AXIS_DESCR COM_AXIS TQI_REQ_SLOW _CNV_A_R_LINEAR_____65_CM 6 -1024. 1023.96875 FORMAT "%6.2" AXIS_PTS_REF ldp_tqi_req_slow__fac_lamb_wup /end AXIS_DESCR
/end CHARACTERISTIC
/begin CHARACTERISTIC IP_TI_CAST__TIA__TCO "Initialization value of post start enrichment factor" MAP 0x6734c _REC_MAP_20_u1_u1_u1 0.3984375 _CNV_A_R_LINEAR_____113_CM 0. 3.984375 FORMAT "%4.2"
 /begin AXIS_DESCR COM_AXIS TIA _CNV_A_R_LINEAR_____22_CM 2 -48. 142.5 FORMAT "%5.1" AXIS_PTS_REF ldp_tia_ip_ti_cast /end AXIS_DESCR
 /begin AXIS_DESCR COM_AXIS TCO _CNV_A_R_LINEAR_____22_CM 8 -48. 142.5 FORMAT "%5.1" AXIS_PTS_REF ldpm_tco_3 /end AXIS_DESCR
/end CHARACTERISTIC
/begin CHARACTERISTIC IP_TI_DEAC_CAST__CYC_CAST__TCO "Deactivation factor of post start enrichment" MAP 0x6737c _REC_MAP_20_u1_u2_u1 9.960940000000002e-002 _CNV_A_R_LINEAR_____8_CM 0. 0.996094 FORMAT "%5.3"
 /begin AXIS_DESCR COM_AXIS CYC_CAST _CNV_A_R_LINEAR_____17_CM 6 0. 65535. FORMAT "%5.0" AXIS_PTS_REF ldp_cyc_cast_ip_ti_deac_cast /end AXIS_DESCR
 /begin AXIS_DESCR COM_AXIS TCO _CNV_A_R_LINEAR_____22_CM 8 -48. 142.5 FORMAT "%5.1" AXIS_PTS_REF ldpm_tco_3 /end AXIS_DESCR
/end CHARACTERISTIC
/begin AXIS_PTS ldp_amp_mes_ti_st_amp_fac "" 0x61488 AMP _REC_AXS_20_u2 5434. _CNV_A_R_LINEAR_____1_CM 6 0. 5434. FORMAT "%7.2" /end AXIS_PTS
/begin CHARACTERISTIC IP_TI_ST_AMP_FAC__AMP "Cranking injection time correction upon ambient pressure" CURVE 0x674c4 _REC_CUR_20_u1_u2 4.980470000000001e-002 _CNV_A_R_LINEAR_____8_CM 0. 0.996094 FORMAT "%5.3"
 /begin AXIS_DESCR COM_AXIS AMP_MES _CNV_A_R_LINEAR_____1_CM 6 0. 5434. FORMAT "%7.2" AXIS_PTS_REF ldp_amp_mes_ti_st_amp_fac /end AXIS_DESCR
/end CHARACTERISTIC
/begin CHARACTERISTIC IP_TI_WUP__N__MAF "Warm-up injection factor versus working point" MAP 0x675fe _REC_MAP_20_u1_u1_u1 0.1494141 _CNV_A_R_LINEAR_____8_CM 0. 0.996094 FORMAT "%5.3"
 /begin AXIS_DESCR COM_AXIS N_32 _CNV_A_R_LINEAR_____15_CM 8 0. 8160. FORMAT "%4.0" AXIS_PTS_REF ldpm_n_19 /end AXIS_DESCR
 /begin AXIS_DESCR COM_AXIS MAF _CNV_A_R_LINEAR_____51_CM 8 0. 1389. FORMAT "%4.0" AXIS_PTS_REF ldpm_maf_4 /end AXIS_DESCR
/end CHARACTERISTIC
/begin CHARACTERISTIC IP_MFF_DEAC_CST "Cranking injection time deactivation factor" MAP 0x66982 _REC_MAP_20_u1_u1_u1 0.1494141 _CNV_A_R_LINEAR_____8_CM 0. 0.996094 FORMAT "%5.3"
 /begin AXIS_DESCR COM_AXIS CYCNR_ST _CNV_A_R_LINEAR_____13_CM 4 0. 255. FORMAT "%3.0" AXIS_PTS_REF ldp_cyc__mff_cst /end AXIS_DESCR
 /begin AXIS_DESCR COM_AXIS TCO _CNV_A_R_LINEAR_____22_CM 8 -48. 142.5 FORMAT "%5.1" AXIS_PTS_REF ldpm_tco__mff_cst /end AXIS_DESCR
/end CHARACTERISTIC
/begin CHARACTERISTIC IP_TI_ADD_DLY "Injector dead time correction" MAP 0x672ec _REC_MAP_20_u2_u1_u2 26.214 _CNV_A_R_LINEAR_____115_CM -131.072 131.068 FORMAT "%6.2"
 /begin AXIS_DESCR COM_AXIS VB _CNV_A_R_LINEAR_____42_CM 8 0. 25.8984 FORMAT "%3.1" AXIS_PTS_REF ldp_vb__ti_add_dly /end AXIS_DESCR
 /begin AXIS_DESCR COM_AXIS FUP _CNV_A_R_LINEAR_____114_CM 6 0. 173888. FORMAT "%6.0" AXIS_PTS_REF ldp_fup_map_dif__ti_add_dly /end AXIS_DESCR
/end CHARACTERISTIC
/begin AXIS_PTS ldpm_maf_4 "" 0x61b8c MAF _REC_AXS_20_u1 1389. _CNV_A_R_LINEAR_____51_CM 8 0. 1389. FORMAT "%4.0" /end AXIS_PTS
/begin AXIS_PTS ldp_t_ast__lamb_add_afl_ch "" 0x61836 T_AST _REC_AXS_20_u2 983.025 _CNV_A_R_LINEAR_____18_CM 8 0. 6553.5 FORMAT "%5.1" /end AXIS_PTS
/begin CHARACTERISTIC IP_LAMB_BAS_WUP_COR "Warm-up correction of basic lambda" MAP 0x66346 _REC_MAP_20_u2_u1_u1 63.99902344 _CNV_A_R_LINEAR_____105_CM -32. 31.99902344 FORMAT "%8.4"
 /begin AXIS_DESCR COM_AXIS TCO _CNV_A_R_LINEAR_____22_CM 8 -48. 142.5 FORMAT "%5.1" AXIS_PTS_REF ldp_tco__lamb_bas_wup_cor /end AXIS_DESCR
 /begin AXIS_DESCR COM_AXIS TCO _CNV_A_R_LINEAR_____22_CM 8 -48. 142.5 FORMAT "%5.1" AXIS_PTS_REF ldp_tco_st__lamb_bas_wup_cor /end AXIS_DESCR
/end CHARACTERISTIC
/begin AXIS_PTS ldp_tco__lamb_bas_wup_cor "" 0x6188f TCO _REC_AXS_20_u1 190.5 _CNV_A_R_LINEAR_____22_CM 8 -48. 142.5 FORMAT "%5.1" /end AXIS_PTS
/begin CHARACTERISTIC C_FAC_WF_PU "transposition factor for PU" VALUE 0x67b96 _REC_VAL_20_u1 0.9960940000000002 _CNV_A_R_LINEAR_____8_CM 0. 0.996094 FORMAT "%5.3" /end CHARACTERISTIC
/begin AXIS_PTS ldp_tco_st__lamb_bas_wup_cor "" 0x618ee TCO _REC_AXS_20_u1 190.5 _CNV_A_R_LINEAR_____22_CM 8 -48. 142.5 FORMAT "%5.1" /end AXIS_PTS
/begin CHARACTERISTIC IP_FUP_MIN_INJ_ST "Fuel pressure threshold to reach before injection is started" CURVE 0x65d98 _REC_CUR_20_u1_u1 173888. _CNV_A_R_LINEAR_____116_CM 0. 173888. FORMAT "%6.0"
 /begin AXIS_DESCR COM_AXIS TCO _CNV_A_R_LINEAR_____22_CM 8 -48. 142.5 FORMAT "%5.1" AXIS_PTS_REF ldpm_tco__mff_cst /end AXIS_DESCR
/end CHARACTERISTIC
/begin CHARACTERISTIC IP_LAMB_HOM_AFL "lambda setpoint for homogeneous lean combustion" MAP 0x664de _REC_MAP_20_u2_u1_u2 31.99902344 _CNV_A_R_LINEAR_____50_CM 0. 31.99902344
 /begin AXIS_DESCR COM_AXIS N_32 _CNV_A_R_LINEAR_____15_CM 8 0. 8160. FORMAT "%4.0" AXIS_PTS_REF ldp_n_32__lamb_hom_afl /end AXIS_DESCR
 /begin AXIS_DESCR COM_AXIS TQI_REQ_SLOW _CNV_A_R_LINEAR_____65_CM 8 -1024. 1023.96875 FORMAT "%6.2" AXIS_PTS_REF ldp_tqi_req_slow__lamb_hom_afl /end AXIS_DESCR
/end CHARACTERISTIC
/begin CHARACTERISTIC IP_LAMB_ADD_AFL_CH "additive correction of the basic lambda heating correction" MAP 0x66246 _REC_MAP_20_u2_u2_u1 63.99902344 _CNV_A_R_LINEAR_____105_CM -32. 31.99902344 FORMAT "%8.4"
 /begin AXIS_DESCR COM_AXIS T_AST _CNV_A_R_LINEAR_____18_CM 8 0. 6553.5 FORMAT "%5.1" AXIS_PTS_REF ldp_t_ast__lamb_add_afl_ch /end AXIS_DESCR
 /begin AXIS_DESCR COM_AXIS TCO _CNV_A_R_LINEAR_____22_CM 8 -48. 142.5 FORMAT "%5.1" AXIS_PTS_REF ldp_tco__lamb_add_afl_ch /end AXIS_DESCR
/end CHARACTERISTIC
/begin MEASUREMENT BIOS_TI_0 "injection time cylinder logical " UWORD _CNV_A_R_LINEAR_____24_CM 1 100. 0. 262.14 ECU_ADDRESS 0x3fc634 FORMAT "%7.3" /end MEASUREMENT
/begin MEASUREMENT BIOS_TI_1 "injection time cylinder logical " UWORD _CNV_A_R_LINEAR_____24_CM 1 100. 0. 262.14 ECU_ADDRESS 0x3fc636 FORMAT "%7.3" /end MEASUREMENT
/begin MEASUREMENT BIOS_TI_2 "injection time cylinder logical " UWORD _CNV_A_R_LINEAR_____24_CM 1 100. 0. 262.14 ECU_ADDRESS 0x3fc638 FORMAT "%7.3" /end MEASUREMENT
/begin MEASUREMENT BIOS_TI_3 "injection time cylinder logical " UWORD _CNV_A_R_LINEAR_____24_CM 1 100. 0. 262.14 ECU_ADDRESS 0x3fc63a FORMAT "%7.3" /end MEASUREMENT
/begin MEASUREMENT BIOS_TI_4 "injection time cylinder logical " UWORD _CNV_A_R_LINEAR_____24_CM 1 100. 0. 262.14 ECU_ADDRESS 0x3fc63c FORMAT "%7.3" /end MEASUREMENT
/begin MEASUREMENT BIOS_TI_5 "injection time cylinder logical " UWORD _CNV_A_R_LINEAR_____24_CM 1 100. 0. 262.14 ECU_ADDRESS 0x3fc63e FORMAT "%7.3" /end MEASUREMENT
/begin MEASUREMENT MFF_SP_CLC_1 "Calculated mass fuel flow setpoint for homogenious charge" UWORD _CNV_A_R_LINEAR_____56_CM 1 100. 0. 1389. ECU_ADDRESS 0x3fc6a8 FORMAT "%7.2" /end MEASUREMENT
/begin MEASUREMENT MFF_SP_CLC_2 "Calculated mass fuel flow setpoint for homogenious charge" UWORD _CNV_A_R_LINEAR_____56_CM 1 100. 0. 1389. ECU_ADDRESS 0x3fc6aa FORMAT "%7.2" /end MEASUREMENT
/begin MEASUREMENT LV_MFF_CST_FUP_ACT "Logical variable indicating fuel pressure has reached threshold once" UBYTE _CNV_S_2_RANGE______76_CM 1 100. 0. 1. ECU_ADDRESS 0x3fd545 BIT_MASK 0x1 /end MEASUREMENT
/begin MEASUREMENT MFF_ADD_REAC "Fuel mass flow for reactivation fuel feed - equivalent to TI_ADD_REAC" SWORD _CNV_A_R_LINEAR_____108_CM 1 100. -694.5 694.478806 ECU_ADDRESS 0x3fc6c4 FORMAT "%7.2" /end MEASUREMENT
/begin CHARACTERISTIC C_LAMB_SP_OFS_AS "manual lambda setpoint for application" VALUE 0x67bd8 _REC_VAL_20_u2 31.999023 _CNV_A_R_LINEAR_____146_CM -16. 15.999023 FORMAT "%8.4" /end CHARACTERISTIC
/begin CHARACTERISTIC IP_TI_FAC_POS_FAST_WF__N__MAF "load correction fast wall film positive" MAP 0x67434 _REC_MAP_20_u1_u1_u1 1.9921875 _CNV_A_R_LINEAR_____67_CM 0. 1.9921875 FORMAT "%5.3"
 /begin AXIS_DESCR COM_AXIS N_32 _CNV_A_R_LINEAR_____15_CM 8 0. 8160. FORMAT "%4.0" AXIS_PTS_REF ldpm_n_29 /end AXIS_DESCR
 /begin AXIS_DESCR COM_AXIS MAF _CNV_A_R_LINEAR_____51_CM 8 0. 1389. FORMAT "%4.0" AXIS_PTS_REF ldpm_maf_6 /end AXIS_DESCR
/end CHARACTERISTIC
/begin AXIS_PTS ldp_tqi_req_slow__lamb_ch_rgl "" 0x619e2 TQI_REQ_SLOW _REC_AXS_20_u2 2047.96875 _CNV_A_R_LINEAR_____65_CM 8 -1024. 1023.96875 FORMAT "%6.2" /end AXIS_PTS
/begin AXIS_PTS ldp_n_32__lamb_ch_rgl "" 0x61649 N_32 _REC_AXS_20_u1 8160. _CNV_A_R_LINEAR_____15_CM 8 0. 8160. FORMAT "%4.0" /end AXIS_PTS
/begin CHARACTERISTIC IP_LAMB_CH_RGL "basic lambda correction for lean catalyst heating" MAP 0x66446 _REC_MAP_20_u2_u2_u1 31.99902344 _CNV_A_R_LINEAR_____50_CM 0. 31.99902344
 /begin AXIS_DESCR COM_AXIS TQI_REQ_SLOW _CNV_A_R_LINEAR_____65_CM 8 -1024. 1023.96875 FORMAT "%6.2" AXIS_PTS_REF ldp_tqi_req_slow__lamb_ch_rgl /end AXIS_DESCR
 /begin AXIS_DESCR COM_AXIS N_32 _CNV_A_R_LINEAR_____15_CM 8 0. 8160. FORMAT "%4.0" AXIS_PTS_REF ldp_n_32__lamb_ch_rgl /end AXIS_DESCR
/end CHARACTERISTIC
/begin AXIS_PTS ldp_tqi_req_slow__lamb_ch_is "" 0x619d0 TQI_REQ_SLOW _REC_AXS_20_u2 2047.96875 _CNV_A_R_LINEAR_____65_CM 8 -1024. 1023.96875 FORMAT "%6.2" /end AXIS_PTS
/begin AXIS_PTS ldp_n_32__lamb_ch_is "" 0x61640 N_32 _REC_AXS_20_u1 8160. _CNV_A_R_LINEAR_____15_CM 8 0. 8160. FORMAT "%4.0" /end AXIS_PTS
/begin CHARACTERISTIC IP_LAMB_CH_IS "basic lambda correction for lean catalyst heating during idle" MAP 0x663c6 _REC_MAP_20_u2_u2_u1 31.99902344 _CNV_A_R_LINEAR_____50_CM 0. 31.99902344
 /begin AXIS_DESCR COM_AXIS TQI_REQ_SLOW _CNV_A_R_LINEAR_____65_CM 8 -1024. 1023.96875 FORMAT "%6.2" AXIS_PTS_REF ldp_tqi_req_slow__lamb_ch_is /end AXIS_DESCR
 /begin AXIS_DESCR COM_AXIS N_32 _CNV_A_R_LINEAR_____15_CM 8 0. 8160. FORMAT "%4.0" AXIS_PTS_REF ldp_n_32__lamb_ch_is /end AXIS_DESCR
/end CHARACTERISTIC
/begin AXIS_PTS ldpm_vo_1 "" 0x61d81 VO _REC_AXS_20_u1 95.625 _CNV_A_R_LINEAR_____6_CM 8 0. 95.625 FORMAT "%4.1" /end AXIS_PTS
/begin MEASUREMENT MFF_SP_HOM_1 "Mass fuel flow setpoint for homogeneous charge (output)" UWORD _CNV_A_R_LINEAR_____56_CM 1 100. 0. 1389. ECU_ADDRESS 0x3fc6a0 FORMAT "%7.2" /end MEASUREMENT
/begin MEASUREMENT MFF_SP_HOM_ENG_1 "Calculated mass fuel flow output for canister purge" UWORD _CNV_A_R_LINEAR_____56_CM 1 100. 0. 1389. ECU_ADDRESS 0x3fc6a2 FORMAT "%7.2" /end MEASUREMENT
/begin MEASUREMENT MFF_SP_HOM_ENG_2 "Calculated mass fuel flow output for canister purge" UWORD _CNV_A_R_LINEAR_____56_CM 1 100. 0. 1389. ECU_ADDRESS 0x3fc6a6 FORMAT "%7.2" /end MEASUREMENT
/begin MEASUREMENT MFF_AD_ADD_MMV_REL_2 "Fuel mass flow for additive lambda adaptation - equivalent to TI_AD_ADD_MMV_REL_2" SWORD _CNV_A_R_LINEAR_____108_CM 1 100. -694.5 694.478806 ECU_ADDRESS 0x3fc6c2 FORMAT "%7.2" /end MEASUREMENT
/begin MEASUREMENT MFF_AD_ADD_MMV_REL_1 "Fuel mass flow for additive lambda adaptation - equivalent to TI_AD_ADD_MMV_REL_1" SWORD _CNV_A_R_LINEAR_____108_CM 1 100. -694.5 694.478806 ECU_ADDRESS 0x3fc6be FORMAT "%7.2" /end MEASUREMENT
/begin MEASUREMENT MFF_AD_FAC_MMV_REL_1 "Fuel factor for multiplicative lambda adaptation - equal to TI_AD_FAC_MMV_REL_" SWORD _CNV_A_R_LINEAR_____149_CM 1 100. -50. 49.99847412 ECU_ADDRESS 0x3fc6bc FORMAT "%7.3" /end MEASUREMENT
/begin MEASUREMENT MFF_AD_FAC_MMV_REL_2 "Fuel factor for multiplicative lambda adaptation - equal to TI_AD_FAC_MMV_REL_2" SWORD _CNV_A_R_LINEAR_____149_CM 1 100. -50. 49.99847412 ECU_ADDRESS 0x3fc6c0 FORMAT "%7.3" /end MEASUREMENT
/begin MEASUREMENT CYC_CAST_FUP_THD "cycle counter value when high pressure injection starts" UWORD _CNV_A_R_LINEAR_____17_CM 1 100. 0. 65535. ECU_ADDRESS 0x3fcfc0 FORMAT "%5.0" /end MEASUREMENT
/begin MEASUREMENT CYC_CAST "" UWORD _CNV_A_R_LINEAR_____17_CM 1 100. 0. 65535. ECU_ADDRESS 0x3fcfbe FORMAT "%5.0" /end MEASUREMENT
/begin CHARACTERISTIC LC_LAMB_SP_MAN_ACT "Logical variable switch to manual lambda setpoint" VALUE 0x67d86 _REC_VAL_20_u1 1. _CNV_S_2_RANGE______76_CM 0. 1. /end CHARACTERISTIC
/begin AXIS_PTS ldp_tia_ip_ti_cast "" 0x61936 TIA _REC_AXS_20_u1 28.575 _CNV_A_R_LINEAR_____22_CM 2 -48. 142.5 FORMAT "%5.1" /end AXIS_PTS
/begin AXIS_PTS ldp_cyc_cast_ip_ti_deac_cast "" 0x614aa CYC_CAST _REC_AXS_20_u2 65535. _CNV_A_R_LINEAR_____17_CM 6 0. 65535. FORMAT "%5.0" /end AXIS_PTS
/begin MEASUREMENT TI_ADD_REAC "Reactivation fuel feed injection time correction" UWORD _CNV_A_R_LINEAR_____24_CM 1 100. 0. 262.14 ECU_ADDRESS 0x3fc6c6 FORMAT "%7.3" /end MEASUREMENT
/begin MEASUREMENT TI_ADD_REAC_INF "Reactivation fuel feed injection time correction with intercept function" UWORD _CNV_A_R_LINEAR_____24_CM 1 100. 0. 262.14 ECU_ADDRESS 0x3fc6ce FORMAT "%7.3" /end MEASUREMENT
/begin CHARACTERISTIC C_TI_AS_CYL_0 "injection time factor to correct cylinder injection value cyl. 0" VALUE 0x67cc8 _REC_VAL_20_u1 1.99220002 _CNV_A_R_LINEAR_____64_CM 0. 1.99220002 FORMAT "%5.3" /end CHARACTERISTIC
/begin CHARACTERISTIC C_TI_AS_CYL_1 "injection time factor to correct cylinder injection value cyl. 1" VALUE 0x67cc9 _REC_VAL_20_u1 1.99220002 _CNV_A_R_LINEAR_____64_CM 0. 1.99220002 FORMAT "%5.3" /end CHARACTERISTIC
/begin CHARACTERISTIC C_TI_AS_CYL_2 "injection time factor to correct cylinder injection value cyl. 2" VALUE 0x67cca _REC_VAL_20_u1 1.99220002 _CNV_A_R_LINEAR_____64_CM 0. 1.99220002 FORMAT "%5.3" /end CHARACTERISTIC
/begin CHARACTERISTIC C_TI_AS_CYL_3 "injection time factor to correct cylinder injection value cyl. 3" VALUE 0x67ccb _REC_VAL_20_u1 1.99220002 _CNV_A_R_LINEAR_____64_CM 0. 1.99220002 FORMAT "%5.3" /end CHARACTERISTIC
/begin CHARACTERISTIC C_TI_AS_CYL_4 "injection time factor to correct cylinder injection value cyl. 4" VALUE 0x67ccc _REC_VAL_20_u1 1.99220002 _CNV_A_R_LINEAR_____64_CM 0. 1.99220002 FORMAT "%5.3" /end CHARACTERISTIC
/begin CHARACTERISTIC C_TI_AS_CYL_5 "injection time factor to correct cylinder injection value cyl. 5" VALUE 0x67ccd _REC_VAL_20_u1 1.99220002 _CNV_A_R_LINEAR_____64_CM 0. 1.99220002 FORMAT "%5.3" /end CHARACTERISTIC
/begin CHARACTERISTIC C_FAC_MFF_TI_STND "injector characteristic for mass fuel flow to injection time at standard pressure and temperature" VALUE 0x67d96 _REC_VAL_20_u2 0.37745 _CNV_A_R_LINEAR_____156_CM 0. 0.37745 FORMAT "%7.5" /end CHARACTERISTIC
/begin MEASUREMENT LAMB_AFL_1 "lambda setpoint for homogeneous lean step value" UWORD _CNV_A_R_LINEAR_____50_CM 1 100. 0. 31.99902344 ECU_ADDRESS 0x3fc6ee /end MEASUREMENT
/begin CHARACTERISTIC IP_LAMB_AFL_1 "lambda setpoint for homogeneous lean step value" MAP 0x6655e _REC_MAP_20_u2_u1_u2 31.99902344 _CNV_A_R_LINEAR_____50_CM 0. 31.99902344
 /begin AXIS_DESCR COM_AXIS N_32 _CNV_A_R_LINEAR_____15_CM 8 0. 8160. FORMAT "%4.0" AXIS_PTS_REF ldp_n_32__lamb_afl_1 /end AXIS_DESCR
 /begin AXIS_DESCR COM_AXIS TQI_REQ_SLOW _CNV_A_R_LINEAR_____65_CM 8 -1024. 1023.96875 FORMAT "%6.2" AXIS_PTS_REF ldp_tqi_req_slow__lamb_afl_1 /end AXIS_DESCR
/end CHARACTERISTIC
/begin AXIS_PTS ldp_tqi_req_slow__lamb_afl_1 "" 0x61a06 TQI_REQ_SLOW _REC_AXS_20_u2 2047.96875 _CNV_A_R_LINEAR_____65_CM 8 -1024. 1023.96875 FORMAT "%6.2" /end AXIS_PTS
/begin MEASUREMENT INJ_HOM_REQ "homogeneous injection requested, binary coded" UBYTE _CNV_A_R_LINEAR_____13_CM 1 100. 0. 255. ECU_ADDRESS 0x3fd7e7 FORMAT "%3.0" /end MEASUREMENT
/begin MEASUREMENT LV_LAMB_COP "boolean for active catalyst overheating control" UBYTE _CNV_S_2_RANGE______76_CM 1 100. 0. 1. ECU_ADDRESS 0x3fd41c BIT_MASK 0x1 /end MEASUREMENT
/begin MEASUREMENT LAMB_RATIO "Current Lambda ratio for interpolation factor" UWORD _CNV_A_R_LINEAR_____185_CM 1 100. -2. 2. ECU_ADDRESS 0x3fc6f8 FORMAT "%8.5" /end MEASUREMENT
/begin AXIS_PTS ldp_n_32__lamb_afl_1 "" 0x6165b N_32 _REC_AXS_20_u1 8160. _CNV_A_R_LINEAR_____15_CM 8 0. 8160. FORMAT "%4.0" /end AXIS_PTS
/begin AXIS_PTS ldp_n_32__lamb_iga_afl "" 0x61f80 N_32 _REC_AXS_20_u1 8160. _CNV_A_R_LINEAR_____15_CM 16 0. 8160. FORMAT "%4.0" /end AXIS_PTS
/begin AXIS_PTS ldp_maf_hb__lamb_iga_afl "" 0x61f91 MAF_HB _REC_AXS_20_u1 1389. _CNV_A_R_LINEAR_____51_CM 12 0. 1389. FORMAT "%4.0" /end AXIS_PTS
/begin CHARACTERISTIC IP_LAMB_BAS "basic lambda setpoint" MAP 0x662c6 _REC_MAP_20_u2_u1_u2 31.99902344 _CNV_A_R_LINEAR_____50_CM 0. 31.99902344
 /begin AXIS_DESCR COM_AXIS N_32 _CNV_A_R_LINEAR_____15_CM 8 0. 8160. FORMAT "%4.0" AXIS_PTS_REF ldp_n_32__lamb_bas /end AXIS_DESCR
 /begin AXIS_DESCR COM_AXIS TQI_REQ_SLOW _CNV_A_R_LINEAR_____65_CM 8 -1024. 1023.96875 FORMAT "%6.2" AXIS_PTS_REF ldp_tqi_req_slow__lamb_bas /end AXIS_DESCR
/end CHARACTERISTIC
/begin CHARACTERISTIC IP_LAMB_IGA_AFL__N_32__MAF_HB "Lambda map for interpolation on ignition angle corrected with maps IGA_xxx_AFL" MAP 0x68c4a _REC_MAP_20_u2_u1_u1 31.99902344 _CNV_A_R_LINEAR_____50_CM 0. 31.99902344
 /begin AXIS_DESCR COM_AXIS N_32 _CNV_A_R_LINEAR_____15_CM 16 0. 8160. FORMAT "%4.0" AXIS_PTS_REF ldp_n_32__lamb_iga_afl /end AXIS_DESCR
 /begin AXIS_DESCR COM_AXIS MAF _CNV_A_R_LINEAR_____51_CM 12 0. 1389. FORMAT "%4.0" AXIS_PTS_REF ldp_maf_hb__lamb_iga_afl /end AXIS_DESCR
/end CHARACTERISTIC
/begin CHARACTERISTIC C_LAMB_IGA_AFR "Lambdavalue for ignition angle interpolation correlated with maps IP_IGA_xxx_AFR" VALUE 0x68dca _REC_VAL_20_u2 31.99902344 _CNV_A_R_LINEAR_____50_CM 0. 31.99902344 FORMAT "%7.4" /end CHARACTERISTIC
/begin MEASUREMENT LAMB_SAWUP "Basis lambda (pre-control)" UWORD _CNV_A_R_LINEAR_____50_CM 1 100. 0. 31.99902344 ECU_ADDRESS 0x3fcca4 FORMAT "%7.4" /end MEASUREMENT
/begin MEASUREMENT FAC_LAMB_DE_SA "Lambda deviation through secondary air" UWORD _CNV_A_R_LINEAR_____186_CM 1 100. 0. 3.999939 ECU_ADDRESS 0x3fcca6 FORMAT "%7.5" /end MEASUREMENT
/begin MEASUREMENT LAMB_SA_CH "Lambda for secondary air catalyst heating" UWORD _CNV_A_R_LINEAR_____50_CM 1 100. 0. 31.99902344 ECU_ADDRESS 0x3fcca8 FORMAT "%7.4" /end MEASUREMENT
/begin AXIS_PTS ldp_tqi_req_slow__lamb_bas "" 0x619be TQI_REQ_SLOW _REC_AXS_20_u2 2047.96875 _CNV_A_R_LINEAR_____65_CM 8 -1024. 1023.96875 FORMAT "%6.2" /end AXIS_PTS
/begin AXIS_PTS ldp_tqi_req_slow__lamb_sawup "" 0x61f9e TQI_REQ_SLOW _REC_AXS_20_u2 2047.96875 _CNV_A_R_LINEAR_____65_CM 8 -1024. 1023.96875 FORMAT "%6.2" /end AXIS_PTS
/begin AXIS_PTS ldp_tqi_req_slow__lamb_sawup_is "" 0x61fba TQI_REQ_SLOW _REC_AXS_20_u2 2047.96875 _CNV_A_R_LINEAR_____65_CM 8 -1024. 1023.96875 FORMAT "%6.2" /end AXIS_PTS
/begin AXIS_PTS ldp_n_32__lamb_sawup "" 0x61fb0 N_32 _REC_AXS_20_u1 8160. _CNV_A_R_LINEAR_____15_CM 8 0. 8160. FORMAT "%4.0" /end AXIS_PTS
/begin AXIS_PTS ldp_n_32__lamb_sawup_is "" 0x61fcc N_32 _REC_AXS_20_u1 8160. _CNV_A_R_LINEAR_____15_CM 8 0. 8160. FORMAT "%4.0" /end AXIS_PTS
/begin AXIS_PTS ldp_t_ast__lamb_add_sawup "" 0x61fd6 T_AST _REC_AXS_20_u2 6553.5 _CNV_A_R_LINEAR_____18_CM 8 0. 6553.5 FORMAT "%6.1" /end AXIS_PTS
/begin AXIS_PTS ldp_tco__lamb_add_sawup "" 0x61fe8 TCO _REC_AXS_20_u1 190.5 _CNV_A_R_LINEAR_____22_CM 8 -48. 142.5 FORMAT "%5.1" /end AXIS_PTS
/begin CHARACTERISTIC IP_LAMB_SAWUP "basic lambda correction for rich catalyst heating" MAP 0x68dd0 _REC_MAP_20_u2_u2_u1 31.99902344 _CNV_A_R_LINEAR_____50_CM 0. 31.99902344 FORMAT "%7.4"
 /begin AXIS_DESCR COM_AXIS TQI_REQ_SLOW _CNV_A_R_LINEAR_____65_CM 8 -1024. 1023.96875 FORMAT "%6.2" AXIS_PTS_REF ldp_tqi_req_slow__lamb_sawup /end AXIS_DESCR
 /begin AXIS_DESCR COM_AXIS N_32 _CNV_A_R_LINEAR_____15_CM 8 0. 8160. FORMAT "%4.0" AXIS_PTS_REF ldp_n_32__lamb_sawup /end AXIS_DESCR
/end CHARACTERISTIC
/begin CHARACTERISTIC IP_LAMB_SAWUP_IS "basic lambda correction for rich catalyst heating during idle speed" MAP 0x68e50 _REC_MAP_20_u2_u2_u1 31.99902344 _CNV_A_R_LINEAR_____50_CM 0. 31.99902344 FORMAT "%7.4"
 /begin AXIS_DESCR COM_AXIS TQI_REQ_SLOW _CNV_A_R_LINEAR_____65_CM 8 -1024. 1023.96875 FORMAT "%6.2" AXIS_PTS_REF ldp_tqi_req_slow__lamb_sawup_is /end AXIS_DESCR
 /begin AXIS_DESCR COM_AXIS N_32 _CNV_A_R_LINEAR_____15_CM 8 0. 8160. FORMAT "%4.0" AXIS_PTS_REF ldp_n_32__lamb_sawup_is /end AXIS_DESCR
/end CHARACTERISTIC
/begin AXIS_PTS ldp_fup_map_dif__ti_add_dly "Injector dead time correction" 0x614fa FUP_MAP_DIF _REC_AXS_20_u2 17388.8 _CNV_A_R_LINEAR_____114_CM 6 0. 173888. FORMAT "%6.0" /end AXIS_PTS
/begin CHARACTERISTIC IP_LAMB_ADD_SAWUP "additive correction of the basic lambda heating correction" MAP 0x68ed0 _REC_MAP_20_u2_u2_u1 63.99902344 _CNV_A_R_LINEAR_____105_CM -32. 31.99902344 FORMAT "%8.4"
 /begin AXIS_DESCR COM_AXIS T_AST _CNV_A_R_LINEAR_____18_CM 8 0. 6553.5 FORMAT "%6.1" AXIS_PTS_REF ldp_t_ast__lamb_add_sawup /end AXIS_DESCR
 /begin AXIS_DESCR COM_AXIS TCO _CNV_A_R_LINEAR_____22_CM 8 -48. 142.5 FORMAT "%5.1" AXIS_PTS_REF ldp_tco__lamb_add_sawup /end AXIS_DESCR
/end CHARACTERISTIC
/begin AXIS_PTS ldp_maf__mff_cor_1 "" 0x62000 MAF _REC_AXS_20_u2 138.9 _CNV_A_R_LINEAR_____56_CM 12 0. 1389. FORMAT "%7.2" /end AXIS_PTS
/begin AXIS_PTS ldp_maf__mff_cor_2 "" 0x615d0 MAF _REC_AXS_20_u2 138.9 _CNV_A_R_LINEAR_____56_CM 12 0. 1389. FORMAT "%7.2" /end AXIS_PTS
/begin AXIS_PTS ldp_n__mff_cor_1 "" 0x6201a N _REC_AXS_20_u2 816. _CNV_A_R_LINEAR_____0_CM 16 0. 8160. FORMAT "%4.0" /end AXIS_PTS
/begin AXIS_PTS ldp_n__mff_cor_2 "" 0x616a8 N _REC_AXS_20_u2 816. _CNV_A_R_LINEAR_____0_CM 16 0. 8160. FORMAT "%4.0" /end AXIS_PTS
/begin CHARACTERISTIC IP_MFF_COR_2 "Operating point correction of the basic injection fuel nass" MAP 0x667d2 _REC_MAP_20_u2_u2_u2 1.99996948 _CNV_A_R_LINEAR_____5_CM 0. 1.99996948 FORMAT "%7.5"
 /begin AXIS_DESCR COM_AXIS MAF _CNV_A_R_LINEAR_____56_CM 12 0. 1389. FORMAT "%7.2" AXIS_PTS_REF ldp_maf__mff_cor_2 /end AXIS_DESCR
 /begin AXIS_DESCR COM_AXIS N _CNV_A_R_LINEAR_____0_CM 16 0. 8160. FORMAT "%4.0" AXIS_PTS_REF ldp_n__mff_cor_2 /end AXIS_DESCR
/end CHARACTERISTIC
/begin CHARACTERISTIC IP_MFF_COR_1 "Operating point correction of the basic injection fuel nass" MAP 0x68f5e _REC_MAP_20_u2_u2_u2 1.99996948 _CNV_A_R_LINEAR_____5_CM 0. 1.99996948 FORMAT "%7.5"
 /begin AXIS_DESCR COM_AXIS MAF _CNV_A_R_LINEAR_____56_CM 12 0. 1389. FORMAT "%7.2" AXIS_PTS_REF ldp_maf__mff_cor_1 /end AXIS_DESCR
 /begin AXIS_DESCR COM_AXIS N _CNV_A_R_LINEAR_____0_CM 16 0. 8160. FORMAT "%4.0" AXIS_PTS_REF ldp_n__mff_cor_1 /end AXIS_DESCR
/end CHARACTERISTIC
/begin MEASUREMENT LAMB_SP_2 "lambda setpoint" UWORD _CNV_A_R_LINEAR_____50_CM 1 100. 0. 31.99902344 ECU_ADDRESS 0x3fc6da /end MEASUREMENT
/begin MEASUREMENT LAMB_BAS_COR_2 "lambda output for TQI_SP_MAF calculation" UWORD _CNV_A_R_LINEAR_____50_CM 1 100. 0. 31.99902344 ECU_ADDRESS 0x3fc6d8 /end MEASUREMENT
/begin MEASUREMENT LAMB_BAS_COR_1 "lambda output for TQI_SP_MAF calculation" UWORD _CNV_A_R_LINEAR_____50_CM 1 100. 0. 31.99902344 ECU_ADDRESS 0x3fc6d2 /end MEASUREMENT
/begin MEASUREMENT LAMB_BAS_COR_1_1 "transitionvalue for lambda setpoint diagnosis" UWORD _CNV_A_R_LINEAR_____50_CM 1 100. 0. 31.99902344 ECU_ADDRESS 0x3fc6e2 /end MEASUREMENT
/begin MEASUREMENT LAMB_BAS_COR_1_2 "transitionvalue for lambda setpoint diagnosis" UWORD _CNV_A_R_LINEAR_____50_CM 1 100. 0. 31.99902344 ECU_ADDRESS 0x3fc6e4 /end MEASUREMENT
/begin MEASUREMENT LAMB_SP_1 "lambda setpoint" UWORD _CNV_A_R_LINEAR_____50_CM 1 100. 0. 31.99902344 ECU_ADDRESS 0x3fc6d4 /end MEASUREMENT
/begin MEASUREMENT LAMB_SP_BAS_1 "lambda feedback for basic torque calculation" UWORD _CNV_A_R_LINEAR_____50_CM 1 100. 0. 31.99902344 ECU_ADDRESS 0x3fc6d6 /end MEASUREMENT
/begin MEASUREMENT LAMB_SP_BAS_2 "lambda feedback for basic torque calculation" UWORD _CNV_A_R_LINEAR_____50_CM 1 100. 0. 31.99902344 ECU_ADDRESS 0x3fc6dc /end MEASUREMENT
/begin MEASUREMENT LV_LAMB_SP_1_1 "logical value for lambda setpoint identical to 1 " UBYTE _CNV_S_2_RANGE______76_CM 1 100. 0. 1. ECU_ADDRESS 0x3fd418 BIT_MASK 0x1 /end MEASUREMENT
/begin MEASUREMENT LV_LAMB_SP_1_2 "logical value for lambda setpoint identical to 1 " UBYTE _CNV_S_2_RANGE______76_CM 1 100. 0. 1. ECU_ADDRESS 0x3fd41a BIT_MASK 0x1 /end MEASUREMENT
/begin MEASUREMENT LV_LAMB_SP_CH_1 "logical value for secondary air catalyst heating active" UBYTE _CNV_S_2_RANGE______76_CM 1 100. 0. 1. ECU_ADDRESS 0x3fd419 BIT_MASK 0x1 /end MEASUREMENT
/begin MEASUREMENT LV_LAMB_SP_CH_2 "logical value for secondary air catalyst heating active" UBYTE _CNV_S_2_RANGE______76_CM 1 100. 0. 1. ECU_ADDRESS 0x3fd41b BIT_MASK 0x1 /end MEASUREMENT
/begin MEASUREMENT LAMB_BAS "basic lambda setpoint" UWORD _CNV_A_R_LINEAR_____50_CM 1 100. 0. 31.99902344 ECU_ADDRESS 0x3fc6ea /end MEASUREMENT
/begin MEASUREMENT LAMB_BAS_COR "Corrected basic lambda mean value" UWORD _CNV_A_R_LINEAR_____50_CM 1 100. 0. 31.99902344 ECU_ADDRESS 0x3fc6e0 /end MEASUREMENT
/begin MEASUREMENT INH_IV "" UWORD _CNV_A_R_LINEAR_____17_CM 1 100. 0. 65535. ECU_ADDRESS 0x3fc93e FORMAT "%5.0" /end MEASUREMENT
/begin CHARACTERISTIC LC_MFF_SP_HOM_MAN_ACT "switch for manual setpoint for fuel mass in homogeneous mode" VALUE 0x67d87 _REC_VAL_20_u1 1. _CNV_S_2_RANGE______76_CM 0. 1. /end CHARACTERISTIC
/begin MEASUREMENT TI_HOM_1 "fuel injection time for homogeneous mode" UWORD _CNV_A_R_LINEAR_____24_CM 1 100. 0. 262.14 ECU_ADDRESS 0x3fc658 FORMAT "%7.3" /end MEASUREMENT
/begin MEASUREMENT LV_TI_LIM_MIN "boolean variable for injection time limitation" UBYTE _CNV_S_2_RANGE______74_CM 1 100. 0. 1. ECU_ADDRESS 0x3fd409 /end MEASUREMENT
/begin MEASUREMENT FAC_TI_PRS_1 "factor  for correction of fuel injection time due to a change of pressure decrease at the injector" UWORD _CNV_A_R_LINEAR_____191_CM 1 100. 0. 15.99975586 ECU_ADDRESS 0x3fc65c /end MEASUREMENT
/begin MEASUREMENT FAC_TI_PRS_2 "factor  for correction of fuel injection time due to a change of pressure decrease at the injector" UWORD _CNV_A_R_LINEAR_____191_CM 1 100. 0. 15.99975586 ECU_ADDRESS 0x3fc65e /end MEASUREMENT
/begin MEASUREMENT PRS_INJ_MV_1 "mean cylinder pressure during injection " UWORD _CNV_A_R_LINEAR_____114_CM 1 100. 0. 173888. ECU_ADDRESS 0x3fc660 FORMAT "%6.0" /end MEASUREMENT
/begin MEASUREMENT PRS_INJ_MV_2 "mean cylinder pressure during injection " UWORD _CNV_A_R_LINEAR_____114_CM 1 100. 0. 173888. ECU_ADDRESS 0x3fc662 FORMAT "%6.0" /end MEASUREMENT
/begin MEASUREMENT PRS_DEC_INJ_1 "pressure decrease at the injector " UWORD _CNV_A_R_LINEAR_____114_CM 1 100. 0. 173888. ECU_ADDRESS 0x3fc668 FORMAT "%6.0" /end MEASUREMENT
/begin MEASUREMENT PRS_DEC_INJ_2 "pressure decrease at the injector " UWORD _CNV_A_R_LINEAR_____114_CM 1 100. 0. 173888. ECU_ADDRESS 0x3fc66a FORMAT "%6.0" /end MEASUREMENT
/begin MEASUREMENT TI_STND_HOM_1 "fuel injection time without fuel pressure correction for homogeneous mode" UWORD _CNV_A_R_LINEAR_____24_CM 1 100. 0. 262.14 ECU_ADDRESS 0x3fc66c FORMAT "%7.3" /end MEASUREMENT
/begin MEASUREMENT TI_STND_HOM_2 "fuel injection time without fuel pressure correction for homogeneous mode" UWORD _CNV_A_R_LINEAR_____24_CM 1 100. 0. 262.14 ECU_ADDRESS 0x3fc66e FORMAT "%7.3" /end MEASUREMENT
/begin MEASUREMENT TI_HOM_CLC_1 "calculated fuel injection time for homogeneous mode" UWORD _CNV_A_R_LINEAR_____24_CM 1 100. 0. 262.14 ECU_ADDRESS 0x3fc670 FORMAT "%7.3" /end MEASUREMENT
/begin MEASUREMENT TI_HOM_CLC_2 "calculated fuel injection time for homogeneous mode" UWORD _CNV_A_R_LINEAR_____24_CM 1 100. 0. 262.14 ECU_ADDRESS 0x3fc672 FORMAT "%7.3" /end MEASUREMENT
/begin MEASUREMENT CRK_INJ_1 "rough value for injection angle (EOI-SOI) " UWORD _CNV_A_R_LINEAR_____6_CM 1 100. 0. 600. ECU_ADDRESS 0x3fc664 FORMAT "%5.1" /end MEASUREMENT
/begin MEASUREMENT CRK_INJ_2 "rough value for injection angle (EOI-SOI) " UWORD _CNV_A_R_LINEAR_____6_CM 1 100. 0. 600. ECU_ADDRESS 0x3fc666 FORMAT "%5.1" /end MEASUREMENT
/begin CHARACTERISTIC C_TCO_ST_H_PRS "Coolant temp. threshold to select high or low pressure start " VALUE 0x67cb1 _REC_VAL_20_u1 190.5 _CNV_A_R_LINEAR_____22_CM -48. 142.5 FORMAT "%5.1" /end CHARACTERISTIC
/begin AXIS_PTS ldpm_n_32_30 "" 0x6208c N_32 _REC_AXS_20_u1 8160. _CNV_A_R_LINEAR_____15_CM 6 0. 8160. FORMAT "%4.0" /end AXIS_PTS
/begin MEASUREMENT LV_AST_END "logical bit for \"After-start end\"" UBYTE _CNV_S_2_RANGE______74_CM 1 100. 0. 1. ECU_ADDRESS 0x3fd543 BIT_MASK 0x1 /end MEASUREMENT
/begin CHARACTERISTIC C_TEG_COP_SP "setpoint of the exhaust gas temperature" VALUE 0x67cbe _REC_VAL_20_u2 2047.96875 _CNV_A_R_LINEAR_____110_CM 0. 2047.96875 FORMAT "%7.2" /end CHARACTERISTIC
/begin AXIS_PTS ldp_n__mff_cst "" 0x616ca N _REC_AXS_20_u2 816. _CNV_A_R_LINEAR_____0_CM 3 0. 8160. FORMAT "%4.0" /end AXIS_PTS
/begin MEASUREMENT LV_LAM_TCO_LSCL "Temperature conditions for close loop fulfilled" UBYTE _CNV_S_2_RANGE______76_CM 1 100. 0. 1. ECU_ADDRESS 0x3fd4dc BIT_MASK 0x1 /end MEASUREMENT
/begin MEASUREMENT LV_DLY_LS_READY "Logical variable set if delay time of operability detection has elapsed" UBYTE _CNV_S_2_RANGE______76_CM 1 100. 0. 1. ECU_ADDRESS 0x3fd4f1 BIT_MASK 0x1 /end MEASUREMENT
/begin MEASUREMENT LV_T_MIN_LS "Logical variable set if delay time C_T_MIN_LS has elapsed" UBYTE _CNV_S_2_RANGE______74_CM 1 100. 0. 1. ECU_ADDRESS 0x3fd4f2 BIT_MASK 0x1 /end MEASUREMENT
/begin MEASUREMENT TEG_STAT "steady state exhaust gas temperature" UWORD _CNV_A_R_LINEAR_____94_CM 1 100. 0. 2047. ECU_ADDRESS 0x3fceae FORMAT "%7.2" /end MEASUREMENT
/begin MEASUREMENT INT_TEG_MAF "sum of the weighted air mass flow values used for the dew point recognition" UWORD _CNV_A_R_LINEAR_____236_CM 1 100. 0. 2275.52 ECU_ADDRESS 0x3fceb4 FORMAT "%6.2" /end MEASUREMENT
/begin MEASUREMENT LV_TEG_MIN_THD "dew-point recognition" UBYTE _CNV_S_2_RANGE______74_CM 1 100. 0. 1. ECU_ADDRESS 0x3fd540 BIT_MASK 0x1 /end MEASUREMENT
/begin MEASUREMENT CTR_COLD_ST "number of cold starts  " UBYTE _CNV_A_R_LINEAR_____17_CM 1 100. 0. 255. ECU_ADDRESS 0x3fd97d FORMAT "%3.0" /end MEASUREMENT
/begin MEASUREMENT N_MMV_DLY "floating mean value for limited engine speed" UWORD _CNV_A_R_LINEAR_____0_CM 1 100. 0. 8160. ECU_ADDRESS 0x3fc9a4 FORMAT "%4.0" /end MEASUREMENT
/begin MEASUREMENT MAF_MMV_DLY "floating mean value for limited MAF" UWORD _CNV_A_R_LINEAR_____56_CM 1 100. 0. 1389. ECU_ADDRESS 0x3fc9a6 FORMAT "%6.2" /end MEASUREMENT
/begin CHARACTERISTIC C_LAM_N_MIN "Minimum engine speed to close the A/F-loop" VALUE 0x62f6f _REC_VAL_20_u1 8160. _CNV_A_R_LINEAR_____15_CM 0. 8160. FORMAT "%4.0" /end CHARACTERISTIC
/begin CHARACTERISTIC ID_TCO_LAM_MIN_IS__TCO_ST "Minimum coolant temperature to close the A/F-loop in idle" CURVE 0x62aeb _REC_CUR_20_u1_u1 190.5 _CNV_A_R_LINEAR_____22_CM -48. 142.5 FORMAT "%5.1"
 /begin AXIS_DESCR COM_AXIS TCO_ST _CNV_A_R_LINEAR_____22_CM 6 -48. 142.5 FORMAT "%5.1" AXIS_PTS_REF ldpm_tco_st_tco_lam_min /end AXIS_DESCR
/end CHARACTERISTIC
/begin AXIS_PTS ldpm_tco_st_tco_lam_min "" 0x60d4e TCO_ST _REC_AXS_20_u1 190.5 _CNV_A_R_LINEAR_____22_CM 6 -48. 142.5 FORMAT "%5.1" /end AXIS_PTS
/begin CHARACTERISTIC ID_TCO_LAM_MIN__TCO_ST "Minimum coolant temperature to close the A/F-loop out of idle" CURVE 0x62ae5 _REC_CUR_20_u1_u1 190.5 _CNV_A_R_LINEAR_____22_CM -48. 142.5 FORMAT "%5.1"
 /begin AXIS_DESCR COM_AXIS TCO_ST _CNV_A_R_LINEAR_____22_CM 6 -48. 142.5 FORMAT "%5.1" AXIS_PTS_REF ldpm_tco_st_tco_lam_min /end AXIS_DESCR
/end CHARACTERISTIC
/begin CHARACTERISTIC C_VLS_CUR_ON_MIN "Threshold for the oxygen sensor output signal for the activation of pumping" VALUE 0x62ff0 _REC_VAL_20_u2 4.99511719 _CNV_A_R_LINEAR_____38_CM 0. 4.99511719 FORMAT "%5.3" /end CHARACTERISTIC
/begin AXIS_PTS ldp_tco_st_t_dly_ls_ready "" 0x60cc5 TCO_ST _REC_AXS_20_u1 190.5 _CNV_A_R_LINEAR_____22_CM 8 -48. 142.5 FORMAT "%5.1" /end AXIS_PTS
/begin CHARACTERISTIC C_TEMP_MIN_LS_UP "Exhaust gas temperature minimum for the detection of the limited sensor operability" VALUE 0x62fbc _REC_VAL_20_u2 2047. _CNV_A_R_LINEAR_____94_CM 0. 2047. FORMAT "%7.2" /end CHARACTERISTIC
/begin CHARACTERISTIC C_R_MIN_LS_READY "Internal resistance threshold for detection of operability" VALUE 0x62f9a _REC_VAL_20_u2 65535. _CNV_A_R_LINEAR_____163_CM 0. 65535. FORMAT "%5.0" /end CHARACTERISTIC
/begin CHARACTERISTIC C_VLS_AFL_MAX_DIAG "rich VLS_UP_i threshold for detection of operability" VALUE 0x62fe4 _REC_VAL_20_u2 4.99511719 _CNV_A_R_LINEAR_____38_CM 0. 4.99511719 FORMAT "%5.3" /end CHARACTERISTIC
/begin CHARACTERISTIC C_VLS_AFR_MIN_DIAG "" VALUE 0x62fea _REC_VAL_20_u2 4.99511719 _CNV_A_R_LINEAR_____38_CM 0. 4.99511719 FORMAT "%5.3" /end CHARACTERISTIC
/begin CHARACTERISTIC C_VLS_AFR_READY "Rich VLS_xxxx_i threshold for operative readiness detection" VALUE 0x62fec _REC_VAL_20_u2 4.99511719 _CNV_A_R_LINEAR_____38_CM 0. 4.99511719 FORMAT "%5.3" /end CHARACTERISTIC
/begin CHARACTERISTIC C_VLS_AFL_READY "Lean VLS_xxxx_i threshold for operative readiness detection" VALUE 0x62fe6 _REC_VAL_20_u2 4.99511719 _CNV_A_R_LINEAR_____38_CM 0. 4.99511719 FORMAT "%5.3" /end CHARACTERISTIC
/begin CHARACTERISTIC C_VLS_AFL "Threshold for detection of lean mixture" VALUE 0x62fe2 _REC_VAL_20_u2 4.99511719 _CNV_A_R_LINEAR_____38_CM 0. 4.99511719 FORMAT "%5.3" /end CHARACTERISTIC
/begin CHARACTERISTIC C_VLS_AFR "Minimum duration for Full load after which VLS_TOL_i is effected" VALUE 0x62fe8 _REC_VAL_20_u2 4.99511719 _CNV_A_R_LINEAR_____38_CM 0. 4.99511719 FORMAT "%5.3" /end CHARACTERISTIC
/begin CHARACTERISTIC C_VLS_CRLC "Averaging constant for finding the values VLS_MMV_MIN_i resp. VLS_MMV_MAX_i" VALUE 0x62fee _REC_VAL_20_u2 0.99998474 _CNV_A_R_LINEAR_____2_CM 0. 0.99998474 FORMAT "%7.5" /end CHARACTERISTIC
/begin CHARACTERISTIC C_VLS_INI_MAX "Upper initialization value for VLS_TOL_i, VLS_MMV_MAX_i" VALUE 0x62ff4 _REC_VAL_20_u2 4.99511719 _CNV_A_R_LINEAR_____38_CM 0. 4.99511719 FORMAT "%5.3" /end CHARACTERISTIC
/begin CHARACTERISTIC C_VLS_MMV_HYS "Hysteresis for the calculation of the thresholds VLS_TOL_i and VLS_BOL_i" VALUE 0x62ff8 _REC_VAL_20_u2 1. _CNV_A_R_LINEAR_____237_CM 0. 1. FORMAT "%7.5" /end CHARACTERISTIC
/begin AXIS_PTS ldp_tco_temp_ls_ini "" 0x60cce TCO _REC_AXS_20_u1 190.5 _CNV_A_R_LINEAR_____22_CM 6 -48. 142.5 FORMAT "%5.1" /end AXIS_PTS
/begin AXIS_PTS ldp_tia_temp_ls_ini "" 0x60d0b TIA _REC_AXS_20_u1 190.5 _CNV_A_R_LINEAR_____22_CM 6 -48. 142.5 FORMAT "%5.1" /end AXIS_PTS
/begin AXIS_PTS ldp_vs_fac_v_efc_teg "" 0x60d12 VS _REC_AXS_20_u1 255. _CNV_A_R_LINEAR_____43_CM 6 0. 255. FORMAT "%3.0" /end AXIS_PTS
/begin CHARACTERISTIC C_LSHPWM_AS "correction signal of LSHPWM_UP" VALUE 0x62f77 _REC_VAL_20_s1 99.609375 _CNV_A_R_LINEAR_____16_CM -50. 49.609375 FORMAT "%6.2" /end CHARACTERISTIC
/begin CHARACTERISTIC C_V_EFC_LSH_UP_MAX "maximum allowed heater voltage " VALUE 0x62fdb _REC_VAL_20_u1 25.8984 _CNV_A_R_LINEAR_____42_CM 0. 25.8984 FORMAT "%3.1" /end CHARACTERISTIC
/begin CHARACTERISTIC C_V_EFC_LSH_UP_PROT "heater voltage in the case of overvoltage conditions" VALUE 0x62fdc _REC_VAL_20_u1 25.8984 _CNV_A_R_LINEAR_____42_CM 0. 25.8984 FORMAT "%3.1" /end CHARACTERISTIC
/begin CHARACTERISTIC C_T_LSH_UP_TOL "maximum of the tolerable heating time with in a higher voltage range " VALUE 0x62faf _REC_VAL_20_u1 255. _CNV_A_R_LINEAR_____20_CM 0. 255. FORMAT "%3.0" /end CHARACTERISTIC
/begin CHARACTERISTIC C_T_LSH_UP_LIM "time after a heating phase with a higher voltage range" VALUE 0x62fae _REC_VAL_20_u1 255. _CNV_A_R_LINEAR_____20_CM 0. 255. FORMAT "%3.0" /end CHARACTERISTIC
/begin CHARACTERISTIC C_V_EFC_LSH_UP_LIM "limited voltage range of the heater" VALUE 0x62fda _REC_VAL_20_u1 25.8984 _CNV_A_R_LINEAR_____42_CM 0. 25.8984 FORMAT "%3.1" /end CHARACTERISTIC
/begin CHARACTERISTIC C_VB_PROT_MAX "maximum battery voltage threshold for the detection of overvoltage" VALUE 0x62fe0 _REC_VAL_20_u1 25.8984 _CNV_A_R_LINEAR_____42_CM 0. 25.8984 FORMAT "%3.1" /end CHARACTERISTIC
/begin CHARACTERISTIC C_T_LSH_RISE "Total heating time with increasing heater power" VALUE 0x62fac _REC_VAL_20_u1 255. _CNV_A_R_LINEAR_____20_CM 0. 255. FORMAT "%3.0" /end CHARACTERISTIC
/begin CHARACTERISTIC C_INC_V_EFC "Heater voltage increment to raise temperature" VALUE 0x62f58 _REC_VAL_20_u1 25.8984 _CNV_A_R_LINEAR_____42_CM 0. 25.8984 FORMAT "%3.1" /end CHARACTERISTIC
/begin CHARACTERISTIC C_T_LSH_TEMP_THD "Time limit until critical sensor temperature for water splash reached" VALUE 0x62fad _REC_VAL_20_u1 255. _CNV_A_R_LINEAR_____20_CM 0. 255. FORMAT "%3.0" /end CHARACTERISTIC
/begin CHARACTERISTIC IP_INT_TEG_MAF_THD__TCO_ST__TIA "Threshold for the air mass flow integral for the detection of the dew point" MAP 0x62b80 _REC_MAP_20_u2_u1_u1 2275.52 _CNV_A_R_LINEAR_____236_CM 0. 2275.52 FORMAT "%6.2"
 /begin AXIS_DESCR COM_AXIS TCO_ST _CNV_A_R_LINEAR_____22_CM 6 -48. 142.5 FORMAT "%5.1" AXIS_PTS_REF ldp_tco_st_int_teg_maf_thd /end AXIS_DESCR
 /begin AXIS_DESCR COM_AXIS TIA _CNV_A_R_LINEAR_____22_CM 6 -48. 142.5 FORMAT "%5.1" AXIS_PTS_REF ldp_tia_int_teg_maf_thd /end AXIS_DESCR
/end CHARACTERISTIC
/begin AXIS_PTS ldp_tco_st_int_teg_maf_thd "" 0x60cbe TCO_ST _REC_AXS_20_u1 190.5 _CNV_A_R_LINEAR_____22_CM 6 -48. 142.5 FORMAT "%5.1" /end AXIS_PTS
/begin AXIS_PTS ldp_tia_int_teg_maf_thd "" 0x60d04 TIA _REC_AXS_20_u1 190.5 _CNV_A_R_LINEAR_____22_CM 6 -48. 142.5 FORMAT "%5.1" /end AXIS_PTS
/begin CHARACTERISTIC IP_FAC_IGA__EFF_IGA_AV "weighting factor for the consideration of the ignition angle influence of the warming up behaviour " CURVE 0x62b28 _REC_CUR_20_u1_u2 15.9375 _CNV_A_R_LINEAR_____87_CM 0. 15.9375
 /begin AXIS_DESCR COM_AXIS EFF_IGA_AV _CNV_A_R_LINEAR_____5_CM 6 0. 1.99996948 FORMAT "%7.5" AXIS_PTS_REF ldp_eff_iga_av__fac_iga /end AXIS_DESCR
/end CHARACTERISTIC
/begin CHARACTERISTIC ID_FAC_CTR_COLD_ST__CTR_COLD_ST "weighting factor for the consideration of the number of cold-start tests" CURVE 0x62aca _REC_CUR_20_u1_u1 3.984375 _CNV_A_R_LINEAR_____113_CM 0. 3.984375 FORMAT "%4.2"
 /begin AXIS_DESCR COM_AXIS CTR_COLD_ST _CNV_A_R_LINEAR_____13_CM 6 0. 255. FORMAT "%3.0" AXIS_PTS_REF ldp_ctr_cold_st_fac_ctr_cold_st /end AXIS_DESCR
/end CHARACTERISTIC
/begin AXIS_PTS ldp_ctr_cold_st_fac_ctr_cold_st "" 0x60bff CTR_COLD_ST _REC_AXS_20_u1 255. _CNV_A_R_LINEAR_____13_CM 6 0. 255. FORMAT "%3.0" /end AXIS_PTS
/begin CHARACTERISTIC IP_ADD_TEG_IGA__POW_DIF "temperature influence by ignition angle adjustments" CURVE 0x62afe _REC_CUR_20_u2_u2 2047. _CNV_A_R_LINEAR_____94_CM 0. 2047. FORMAT "%7.2"
 /begin AXIS_DESCR COM_AXIS ONLINE_DUMMY _CNV_A_R_LINEAR_____238_CM 6 0. 69.0826 FORMAT "%5.3" AXIS_PTS_REF ldp_pow_dif_add_teg_iga /end AXIS_DESCR
/end CHARACTERISTIC
/begin AXIS_PTS ldp_pow_dif_add_teg_iga "" 0x60c9e POW_DIF _REC_AXS_20_u2 69.0826 _CNV_A_R_LINEAR_____238_CM 6 0. 69.0826 FORMAT "%5.3" /end AXIS_PTS
/begin CHARACTERISTIC ID_FAC_SCC_TEG__NR_PAT "temperature influence by fuel cut-off" CURVE 0x62ad0 _REC_CUR_20_u1_u1 1. _CNV_A_R_LINEAR_____239_CM 0. 1. FORMAT "%4.3"
 /begin AXIS_DESCR COM_AXIS ONLINE_DUMMY _CNV_A_R_LINEAR_____17_CM 13 0. 13. FORMAT "%2.0" AXIS_PTS_REF ldp_nr_pat__fac_scc_teg /end AXIS_DESCR
/end CHARACTERISTIC
/begin AXIS_PTS ldp_nr_pat__fac_scc_teg "" 0x60c8f NR_PAT _REC_AXS_20_u1 13. _CNV_A_R_LINEAR_____17_CM 13 0. 13. FORMAT "%2.0" /end AXIS_PTS
/begin CHARACTERISTIC IP_ADD_TEG_STAT_SCC__MAF_KGH "temperature influence by cylinder cut-off" CURVE 0x62b0a _REC_CUR_20_u2_u2 2047. _CNV_A_R_LINEAR_____240_CM 0. 2047. FORMAT "%5.1"
 /begin AXIS_DESCR COM_AXIS MAF_KGH _CNV_A_R_LINEAR_____52_CM 6 0. 2047.96875 FORMAT "%6.2" AXIS_PTS_REF ldp_maf_kgh_add_teg_stat_scc /end AXIS_DESCR
/end CHARACTERISTIC
/begin AXIS_PTS ldp_maf_kgh_add_teg_stat_scc "" 0x60c30 MAF_KGH _REC_AXS_20_u2 2047.96875 _CNV_A_R_LINEAR_____52_CM 6 0. 2047.96875 FORMAT "%6.2" /end AXIS_PTS
/begin CHARACTERISTIC IP_FAC_VS_TEG__VS "temperature influence by the vehicle speed" CURVE 0x62b7a _REC_CUR_20_u1_u1 3.984375 _CNV_A_R_LINEAR_____113_CM 0. 3.984375 FORMAT "%3.2"
 /begin AXIS_DESCR COM_AXIS VS _CNV_A_R_LINEAR_____43_CM 6 0. 255. FORMAT "%3.0" AXIS_PTS_REF ldp_vs_fac_vs_teg /end AXIS_DESCR
/end CHARACTERISTIC
/begin AXIS_PTS ldp_vs_fac_vs_teg "" 0x60d19 VS _REC_AXS_20_u1 255. _CNV_A_R_LINEAR_____43_CM 6 0. 255. FORMAT "%3.0" /end AXIS_PTS
/begin CHARACTERISTIC ID_CRLC_TEG_INC__MAF_KGH "Correlation constant for the exhaust gas temperature increase" CURVE 0x62abe _REC_CUR_20_u2_u2 0.99998474 _CNV_A_R_LINEAR_____2_CM 0. 0.99998474 FORMAT "%7.5"
 /begin AXIS_DESCR COM_AXIS MAF_KGH _CNV_A_R_LINEAR_____52_CM 6 0. 2047.96875 FORMAT "%6.2" AXIS_PTS_REF ldpm_maf_kgh_crlc_teg /end AXIS_DESCR
/end CHARACTERISTIC
/begin AXIS_PTS ldpm_maf_kgh_crlc_teg "" 0x60d2a MAF_KGH _REC_AXS_20_u2 2047.96875 _CNV_A_R_LINEAR_____52_CM 6 0. 2047.96875 FORMAT "%6.2" /end AXIS_PTS
/begin CHARACTERISTIC ID_CRLC_TEG_DEC__MAF_KGH "Correlation constant for exhaust gas temperature decrease" CURVE 0x62ab2 _REC_CUR_20_u2_u2 0.99998474 _CNV_A_R_LINEAR_____2_CM 0. 0.99998474 FORMAT "%7.5"
 /begin AXIS_DESCR COM_AXIS MAF_KGH _CNV_A_R_LINEAR_____52_CM 6 0. 2047.96875 FORMAT "%6.2" AXIS_PTS_REF ldpm_maf_kgh_crlc_teg /end AXIS_DESCR
/end CHARACTERISTIC
/begin CHARACTERISTIC C_TEG_STAT_MIN "minimum value of the estimated exhaust gas temperature (dew-point)" VALUE 0x62fb4 _REC_VAL_20_u2 2047. _CNV_A_R_LINEAR_____94_CM 0. 2047. FORMAT "%7.2" /end CHARACTERISTIC
/begin CHARACTERISTIC C_CRLC_TEG_DEC_PU "Correlation constant for the exhaust gas temperature in the engine states PU or PUC" VALUE 0x62f50 _REC_VAL_20_u2 0.99998474 _CNV_A_R_LINEAR_____2_CM 0. 0.99998474 FORMAT "%7.5" /end CHARACTERISTIC
/begin CHARACTERISTIC C_LAM_FAC_I "Scale factor for TI_LAM integral component" VALUE 0x62f5e _REC_VAL_20_u1 0.9960940000000002 _CNV_A_R_LINEAR_____8_CM 0. 0.996094 FORMAT "%5.3" /end CHARACTERISTIC
/begin CHARACTERISTIC C_LAM_FAC_P "Scale factor for TI_LAM proportional component" VALUE 0x62f5f _REC_VAL_20_u1 0.9960940000000002 _CNV_A_R_LINEAR_____8_CM 0. 0.996094 FORMAT "%4.3" /end CHARACTERISTIC
/begin CHARACTERISTIC C_LAM_NEG_I_IS "Basic value of TI_LAM integral component in idle when lambda < 1" VALUE 0x62f70 _REC_VAL_20_u1 0.49609375 _CNV_A_R_LINEAR_____241_CM 0. 0.49609375 FORMAT "%4.3" /end CHARACTERISTIC
/begin CHARACTERISTIC C_LAM_POS_I_IS "Basic value of TI_LAM proportional component in idle during transition from lambda > 1 to lambda < 1" VALUE 0x62f72 _REC_VAL_20_u1 0.49609375 _CNV_A_R_LINEAR_____241_CM 0. 0.49609375 FORMAT "%4.3" /end CHARACTERISTIC
/begin CHARACTERISTIC C_LAM_NEG_P_IS "Basic value of TI_LAM proportional component in idle during transition from lambda > 1 to lambda < 1" VALUE 0x62f71 _REC_VAL_20_u1 0.49609375 _CNV_A_R_LINEAR_____241_CM 0. 0.49609375 FORMAT "%4.3" /end CHARACTERISTIC
/begin CHARACTERISTIC C_LAM_POS_P_IS "Basic value of TI_LAM proportional component in idle during transition from lambda < 1 to lambda > 1" VALUE 0x62f73 _REC_VAL_20_u1 0.49609375 _CNV_A_R_LINEAR_____241_CM 0. 0.49609375 FORMAT "%4.3" /end CHARACTERISTIC
/begin CHARACTERISTIC C_LAM_SUM_P_IS "Lambda controller P jump delay to have idle P/I values " VALUE 0x62f74 _REC_VAL_20_u1 255. _CNV_A_R_LINEAR_____13_CM 0. 255. FORMAT "%3.0" /end CHARACTERISTIC
/begin CHARACTERISTIC C_T_LAM_DLY_NEG_IS "Basic LAM -P-jump delay time from rich to lean transition  in idle" VALUE 0x62fa4 _REC_VAL_20_u2 1279.9 _CNV_A_R_LINEAR_____242_CM 0. 1279.9 FORMAT "%6.2" /end CHARACTERISTIC
/begin CHARACTERISTIC C_T_LAM_DLY_POS_IS "Basic LAM -P-jump delay time from lean to rich transition  in idle " VALUE 0x62fa6 _REC_VAL_20_u2 1279.9 _CNV_A_R_LINEAR_____242_CM 0. 1279.9 FORMAT "%6.2" /end CHARACTERISTIC
/begin CHARACTERISTIC C_LAM_CYCNR "delay after PUC before reenabling Lambda control" VALUE 0x62f5c _REC_VAL_20_u2 6.553500000000001 _CNV_A_R_LINEAR_____243_CM 0. 655.35 FORMAT "%6.2" /end CHARACTERISTIC
/begin CHARACTERISTIC IP_LAM_NEG_I__N__MAF "Basic value of TI_LAM integral component out idle when lambda < 1" MAP 0x62bc8 _REC_MAP_20_u1_u1_u1 0.49609375 _CNV_A_R_LINEAR_____241_CM 0. 0.49609375 FORMAT "%4.3"
 /begin AXIS_DESCR COM_AXIS N_32 _CNV_A_R_LINEAR_____15_CM 8 0. 8160. FORMAT "%4.0" AXIS_PTS_REF ldpm_n_9 /end AXIS_DESCR
 /begin AXIS_DESCR COM_AXIS MAF _CNV_A_R_LINEAR_____51_CM 8 0. 1389. FORMAT "%4.0" AXIS_PTS_REF ldpm_maf_3 /end AXIS_DESCR
/end CHARACTERISTIC
/begin CHARACTERISTIC IP_LAM_POS_P__N__MAF "Basic value of TI_LAM proportional component out of idle during transition from lambda < 1 to lambda > 1" MAP 0x62c88 _REC_MAP_20_u1_u1_u1 0.49609375 _CNV_A_R_LINEAR_____241_CM 0. 0.49609375 FORMAT "%4.3"
 /begin AXIS_DESCR COM_AXIS N_32 _CNV_A_R_LINEAR_____15_CM 8 0. 8160. FORMAT "%4.0" AXIS_PTS_REF ldpm_n_9 /end AXIS_DESCR
 /begin AXIS_DESCR COM_AXIS MAF _CNV_A_R_LINEAR_____51_CM 8 0. 1389. FORMAT "%4.0" AXIS_PTS_REF ldpm_maf_3 /end AXIS_DESCR
/end CHARACTERISTIC
/begin CHARACTERISTIC IP_LAM_POS_I__N__MAF "Basic value of TI_LAM integral component out of idle when lambda > 1" MAP 0x62c48 _REC_MAP_20_u1_u1_u1 0.49609375 _CNV_A_R_LINEAR_____241_CM 0. 0.49609375 FORMAT "%4.3"
 /begin AXIS_DESCR COM_AXIS N_32 _CNV_A_R_LINEAR_____15_CM 8 0. 8160. FORMAT "%4.0" AXIS_PTS_REF ldpm_n_9 /end AXIS_DESCR
 /begin AXIS_DESCR COM_AXIS MAF _CNV_A_R_LINEAR_____51_CM 8 0. 1389. FORMAT "%4.0" AXIS_PTS_REF ldpm_maf_3 /end AXIS_DESCR
/end CHARACTERISTIC
/begin CHARACTERISTIC IP_LAM_NEG_P__N__MAF "Basic value of TI_LAM proportional component out of idle during transition from lambda > 1 to lambda < 1" MAP 0x62c08 _REC_MAP_20_u1_u1_u1 0.49609375 _CNV_A_R_LINEAR_____241_CM 0. 0.49609375 FORMAT "%4.3"
 /begin AXIS_DESCR COM_AXIS N_32 _CNV_A_R_LINEAR_____15_CM 8 0. 8160. FORMAT "%4.0" AXIS_PTS_REF ldpm_n_9 /end AXIS_DESCR
 /begin AXIS_DESCR COM_AXIS MAF _CNV_A_R_LINEAR_____51_CM 8 0. 1389. FORMAT "%4.0" AXIS_PTS_REF ldpm_maf_3 /end AXIS_DESCR
/end CHARACTERISTIC
/begin CHARACTERISTIC IP_T_LAM_DLY_NEG__N__MAF "Basic LAM -P-jump delay time from rich to lean transition  " MAP 0x62d2c _REC_MAP_20_u2_u1_u1 1279.9 _CNV_A_R_LINEAR_____242_CM 0. 1279.9 FORMAT "%6.2"
 /begin AXIS_DESCR COM_AXIS N_32 _CNV_A_R_LINEAR_____15_CM 8 0. 8160. FORMAT "%4.0" AXIS_PTS_REF ldpm_n_9 /end AXIS_DESCR
 /begin AXIS_DESCR COM_AXIS MAF _CNV_A_R_LINEAR_____51_CM 8 0. 1389. FORMAT "%4.0" AXIS_PTS_REF ldpm_maf_3 /end AXIS_DESCR
/end CHARACTERISTIC
/begin CHARACTERISTIC IP_T_LAM_DLY_POS__N__MAF "Basic LAM -P-jump delay time from lean to rich transition  " MAP 0x62dac _REC_MAP_20_u2_u1_u1 1279.9 _CNV_A_R_LINEAR_____242_CM 0. 1279.9 FORMAT "%6.2"
 /begin AXIS_DESCR COM_AXIS N_32 _CNV_A_R_LINEAR_____15_CM 8 0. 8160. FORMAT "%4.0" AXIS_PTS_REF ldpm_n_9 /end AXIS_DESCR
 /begin AXIS_DESCR COM_AXIS MAF _CNV_A_R_LINEAR_____51_CM 8 0. 1389. FORMAT "%4.0" AXIS_PTS_REF ldpm_maf_3 /end AXIS_DESCR
/end CHARACTERISTIC
/begin CHARACTERISTIC C_LAM_INI_MIN "Minimum TI_LAM_i value" VALUE 0x62f62 _REC_VAL_20_s2 99.99847412 _CNV_A_R_LINEAR_____149_CM -50. 49.99847412 FORMAT "%6.2" /end CHARACTERISTIC
/begin CHARACTERISTIC C_LAM_MIN "Minimum TI_LAM_i value" VALUE 0x62f66 _REC_VAL_20_s2 99.99847412 _CNV_A_R_LINEAR_____149_CM -50. 49.99847412 FORMAT "%6.2" /end CHARACTERISTIC
/begin CHARACTERISTIC C_LAM_MAX "Maximum TI_LAM_i value" VALUE 0x62f64 _REC_VAL_20_s2 99.99847412 _CNV_A_R_LINEAR_____149_CM -50. 49.99847412 FORMAT "%6.2" /end CHARACTERISTIC
/begin CHARACTERISTIC C_LAM_INI_MAX "Maximum TI_LAM_i value" VALUE 0x62f60 _REC_VAL_20_s2 99.99847412 _CNV_A_R_LINEAR_____149_CM -50. 49.99847412 FORMAT "%6.2" /end CHARACTERISTIC
/begin CHARACTERISTIC C_LAM_MV_LPF_CRLC "correlation constant for the calculation of LAM_MV_LPF" VALUE 0x62f6e _REC_VAL_20_u1 0.9960940000000002 _CNV_A_R_LINEAR_____8_CM 0. 0.996094 FORMAT "%5.3" /end CHARACTERISTIC
/begin CHARACTERISTIC C_LAM_MV_DYW "LAM_MV_i window for limited dynamics." VALUE 0x62f6a _REC_VAL_20_u2 99.99847412 _CNV_A_R_LINEAR_____144_CM 0. 99.99847412 FORMAT "%5.2" /end CHARACTERISTIC
/begin CHARACTERISTIC C_MAF_DYW "MAF window for limited dynamics." VALUE 0x62f80 _REC_VAL_20_u1 1389. _CNV_A_R_LINEAR_____51_CM 0. 1389. FORMAT "%4.0" /end CHARACTERISTIC
/begin CHARACTERISTIC C_TI_MAF_AD_MAX "Maximum MAF for adaptive learning" VALUE 0x62fcc _REC_VAL_20_u2 1389. _CNV_A_R_LINEAR_____56_CM 0. 1389. FORMAT "%4.0" /end CHARACTERISTIC
/begin CHARACTERISTIC C_TI_TIA_AD_MAX "Maximum air temperature for adaptive learning" VALUE 0x62fd3 _REC_VAL_20_u1 190.5 _CNV_A_R_LINEAR_____22_CM -48. 142.5 FORMAT "%5.1" /end CHARACTERISTIC
/begin CHARACTERISTIC C_TI_TCO_AD_MIN "Minimum coolant temperature for adaptive learning" VALUE 0x62fd2 _REC_VAL_20_u1 190.5 _CNV_A_R_LINEAR_____22_CM -48. 142.5 FORMAT "%5.1" /end CHARACTERISTIC
/begin CHARACTERISTIC C_TI_AD_ADD_MAX "Maximum value of adaptive additive factor for injection" VALUE 0x62fbe _REC_VAL_20_s2 52.428 _CNV_A_R_LINEAR_____24_CM -131.072 131.068 /end CHARACTERISTIC
/begin CHARACTERISTIC C_TI_AD_ADD_MIN "Minimum value of adaptive additive factor for injection" VALUE 0x62fc0 _REC_VAL_20_s2 52.428 _CNV_A_R_LINEAR_____24_CM -131.072 131.068 /end CHARACTERISTIC
/begin CHARACTERISTIC C_TI_AD_FAC_MAX "Maximum value of adaptive multiplicative factor for injection" VALUE 0x62fc4 _REC_VAL_20_s2 9.999847411999999 _CNV_A_R_LINEAR_____149_CM -50. 49.99847412 FORMAT "%6.2" /end CHARACTERISTIC
/begin CHARACTERISTIC C_TI_AD_FAC_MIN "Minimum value of adaptive multiplicative factor for injection" VALUE 0x62fc6 _REC_VAL_20_s2 9.999847411999999 _CNV_A_R_LINEAR_____149_CM -50. 49.99847412 FORMAT "%6.2" /end CHARACTERISTIC
/begin CHARACTERISTIC C_CAT_DIAG_MAX_DLY "threshold of catalyst conversion capability for activation" VALUE 0x62f4c _REC_VAL_20_u1 1.984375 _CNV_A_R_LINEAR_____244_CM 0. 1.984375 FORMAT "%3.2" /end CHARACTERISTIC
/begin CHARACTERISTIC C_MAF_INT_MIN_DLY "threshold for MAF integral while restart of LAM after inactive " VALUE 0x62f84 _REC_VAL_20_u2 1820.398 _CNV_A_R_LINEAR_____98_CM 0. 1820.398 FORMAT "%7.2" /end CHARACTERISTIC
/begin CHARACTERISTIC C_MAF_INT_MIN_DLY_PUC "threshold for MAF integral while restart of LAM after PUC " VALUE 0x62f86 _REC_VAL_20_u2 1820.398 _CNV_A_R_LINEAR_____98_CM 0. 1820.398 FORMAT "%7.2" /end CHARACTERISTIC
/begin CHARACTERISTIC C_LAM_TEMP_MIN_CAT_DLY "min. TEMP_ CAT threshold for activation" VALUE 0x62f75 _REC_VAL_20_u1 1020. _CNV_A_R_LINEAR_____26_CM -33. 987. FORMAT "%4.1" /end CHARACTERISTIC
/begin CHARACTERISTIC IP_VLS_SP_DLY__N__MAF "setpoint for downstream fuel trim controller" MAP 0x62f2c _REC_MAP_20_u2_u1_u1 4.99511719 _CNV_A_R_LINEAR_____38_CM 0. 4.99511719 FORMAT "%5.3"
 /begin AXIS_DESCR COM_AXIS N_32 _CNV_A_R_LINEAR_____15_CM 4 0. 8160. FORMAT "%4.0" AXIS_PTS_REF ldp_n_ip_vls_sp_dly /end AXIS_DESCR
 /begin AXIS_DESCR COM_AXIS MAF _CNV_A_R_LINEAR_____51_CM 4 0. 1389. FORMAT "%4.0" AXIS_PTS_REF ldp_maf_ip_vls_sp_dly /end AXIS_DESCR
/end CHARACTERISTIC
/begin AXIS_PTS ldp_n_ip_vls_sp_dly "" 0x60c7c N_32 _REC_AXS_20_u1 8160. _CNV_A_R_LINEAR_____15_CM 4 0. 8160. FORMAT "%4.0" /end AXIS_PTS
/begin AXIS_PTS ldp_maf_ip_vls_sp_dly "" 0x60c2b MAF _REC_AXS_20_u1 1389. _CNV_A_R_LINEAR_____51_CM 4 0. 1389. FORMAT "%4.0" /end AXIS_PTS
/begin CHARACTERISTIC C_N_LAM_DLY_P_MAX "max N threshold for activation P-share" VALUE 0x62f94 _REC_VAL_20_u1 8160. _CNV_A_R_LINEAR_____15_CM 0. 8160. FORMAT "%4.0" /end CHARACTERISTIC
/begin CHARACTERISTIC C_N_LAM_DLY_P_MIN "min N threshold for activation P-share" VALUE 0x62f95 _REC_VAL_20_u1 8160. _CNV_A_R_LINEAR_____15_CM 0. 8160. FORMAT "%4.0" /end CHARACTERISTIC
/begin CHARACTERISTIC C_MAF_LAM_DLY_P_MAX "max MAF threshold for activation P-share" VALUE 0x62f8a _REC_VAL_20_u2 1389. _CNV_A_R_LINEAR_____56_CM 0. 1389. FORMAT "%4.0" /end CHARACTERISTIC
/begin CHARACTERISTIC C_MAF_LAM_DLY_P_MIN "min MAF threshold for activation P-share" VALUE 0x62f8c _REC_VAL_20_u2 1389. _CNV_A_R_LINEAR_____56_CM 0. 1389. FORMAT "%4.0" /end CHARACTERISTIC
/begin CHARACTERISTIC IP_T_DLY_P__VLS_DIF_DLY "LAM - P - jump delay time from P-share" CURVE 0x62d14 _REC_CUR_20_u2_u2 1279.980469 _CNV_A_R_LINEAR_____245_CM -640. 639.980469 FORMAT "%5.2"
 /begin AXIS_DESCR COM_AXIS ONLINE_DUMMY _CNV_A_R_LINEAR_____246_CM 12 -4.99517 4.99517 FORMAT "%5.3" AXIS_PTS_REF ldpm_vls_dif_dly /end AXIS_DESCR
/end CHARACTERISTIC
/begin CHARACTERISTIC IP_FAC_DLY_P__MAF_KGH "weight factor for P-share regarding engine load and speed conditions" CURVE 0x62b22 _REC_CUR_20_u1_u2 0.9960940000000002 _CNV_A_R_LINEAR_____8_CM 0. 0.996094 FORMAT "%5.3"
 /begin AXIS_DESCR COM_AXIS MAF_KGH _CNV_A_R_LINEAR_____52_CM 6 0. 2047.96875 FORMAT "%6.2" AXIS_PTS_REF ldp_maf_kgh_ip_fac_dly_p /end AXIS_DESCR
/end CHARACTERISTIC
/begin CHARACTERISTIC IP_FAC_CAT_DLY__CAT_DIAG "weight factor for P-share regarding catalyst conversion capability" CURVE 0x62b1c _REC_CUR_20_u1_u1 0.9960940000000002 _CNV_A_R_LINEAR_____8_CM 0. 0.996094 FORMAT "%5.3"
 /begin AXIS_DESCR COM_AXIS ONLINE_DUMMY _CNV_A_R_LINEAR_____70_CM 6 0. 1.9968 FORMAT "%4.2" AXIS_PTS_REF ldp_cat_ip_fac_cat_dly /end AXIS_DESCR
/end CHARACTERISTIC
/begin CHARACTERISTIC IP_MAF_LAM_DLY_I_MAX__N "max MAF threshold for activation I-share" CURVE 0x62cfc _REC_CUR_20_u2_u1 1389. _CNV_A_R_LINEAR_____56_CM 0. 1389. FORMAT "%4.0"
 /begin AXIS_DESCR COM_AXIS N_32 _CNV_A_R_LINEAR_____15_CM 6 0. 8160. FORMAT "%4.0" AXIS_PTS_REF ldpm_n_35 /end AXIS_DESCR
/end CHARACTERISTIC
/begin CHARACTERISTIC IP_MAF_LAM_DLY_I_MIN__N "min MAF threshold for activation I-share" CURVE 0x62d08 _REC_CUR_20_u2_u1 1389. _CNV_A_R_LINEAR_____56_CM 0. 1389. FORMAT "%4.0"
 /begin AXIS_DESCR COM_AXIS N_32 _CNV_A_R_LINEAR_____15_CM 6 0. 8160. FORMAT "%4.0" AXIS_PTS_REF ldpm_n_35 /end AXIS_DESCR
/end CHARACTERISTIC
/begin CHARACTERISTIC C_T_DLY_I_MIN "min limit of I-share" VALUE 0x62fa2 _REC_VAL_20_s2 1279.9804688 _CNV_A_R_LINEAR_____247_CM -640. 639.9804688 FORMAT "%5.2" /end CHARACTERISTIC
/begin CHARACTERISTIC IP_FAC_LAM_DLY__N__MAF "normalization factor for total LAM -P-jump delay time regarding engine load and speed conditions" MAP 0x62b2e _REC_MAP_20_u1_u1_u1 0.9960940000000002 _CNV_A_R_LINEAR_____8_CM 0. 0.996094 FORMAT "%5.3"
 /begin AXIS_DESCR COM_AXIS N_32 _CNV_A_R_LINEAR_____15_CM 8 0. 8160. FORMAT "%4.0" AXIS_PTS_REF ldp_n_ip_fac_lam_dly /end AXIS_DESCR
 /begin AXIS_DESCR COM_AXIS MAF _CNV_A_R_LINEAR_____51_CM 8 0. 1389. FORMAT "%4.0" AXIS_PTS_REF ldp_maf_ip_fac_lam_dly /end AXIS_DESCR
/end CHARACTERISTIC
/begin AXIS_PTS ldp_n_ip_fac_lam_dly "" 0x60c73 N_32 _REC_AXS_20_u1 8160. _CNV_A_R_LINEAR_____15_CM 8 0. 8160. FORMAT "%4.0" /end AXIS_PTS
/begin AXIS_PTS ldp_maf_ip_fac_lam_dly "" 0x60c22 MAF _REC_AXS_20_u1 1389. _CNV_A_R_LINEAR_____51_CM 8 0. 1389. FORMAT "%4.0" /end AXIS_PTS
/begin CHARACTERISTIC C_TI_N_AD_FAC_MIN "Minimum engine speed for multiplicative adaptive learning" VALUE 0x62fd0 _REC_VAL_20_u2 8159. _CNV_A_R_LINEAR_____0_CM 1. 8160. FORMAT "%4.0" /end CHARACTERISTIC
/begin CHARACTERISTIC C_TI_AD_COR_CRLC_IS "Correlation constant  Lambdaadapatation at  LV_IS = 1" VALUE 0x62fc3 _REC_VAL_20_u1 9.960940000000002e-002 _CNV_A_R_LINEAR_____8_CM 0. 0.996094 FORMAT "%5.3" /end CHARACTERISTIC
/begin CHARACTERISTIC C_TI_AD_COR_CRLC "Correlation constant  Lambdaadapatation at  LV_IS = 0" VALUE 0x62fc2 _REC_VAL_20_u1 9.960940000000002e-002 _CNV_A_R_LINEAR_____8_CM 0. 0.996094 FORMAT "%5.3" /end CHARACTERISTIC
/begin CHARACTERISTIC C_TI_N_AD_ADD_MAX "maximum engine speed for additive adaptive learning" VALUE 0x62fce _REC_VAL_20_u2 8159. _CNV_A_R_LINEAR_____0_CM 1. 8160. FORMAT "%4.0" /end CHARACTERISTIC
/begin CHARACTERISTIC C_LAM_AD_SUM_P "P component jump delay between two adaptive learning out of Idle" VALUE 0x62f59 _REC_VAL_20_u1 255. _CNV_A_R_LINEAR_____13_CM 0. 255. FORMAT "%3.0" /end CHARACTERISTIC
/begin CHARACTERISTIC C_LAM_AD_SUM_P_IS "P component jump delay between two adaptive learning in Idle" VALUE 0x62f5a _REC_VAL_20_u1 254. _CNV_A_R_LINEAR_____17_CM 1. 255. FORMAT "%3.0" /end CHARACTERISTIC
/begin CHARACTERISTIC C_TI_MAF_AD_FAC_MIN "Minimum MAF for multiplicative adaptive learning" VALUE 0x62fca _REC_VAL_20_u2 1389. _CNV_A_R_LINEAR_____56_CM 0. 1389. FORMAT "%4.0" /end CHARACTERISTIC
/begin CHARACTERISTIC C_TI_MAF_AD_ADD_MAX "Maximum MAF for additive adaptive learning" VALUE 0x62fc8 _REC_VAL_20_u2 1389. _CNV_A_R_LINEAR_____56_CM 0. 1389. FORMAT "%4.0" /end CHARACTERISTIC
/begin CHARACTERISTIC ID_TI_AD_ADD__N "Weighting factor for TI_AD_ADD versus N" CURVE 0x62af1 _REC_CUR_20_u1_u1 0.9960940000000002 _CNV_A_R_LINEAR_____8_CM 0. 0.996094 FORMAT "%5.3"
 /begin AXIS_DESCR COM_AXIS N_32 _CNV_A_R_LINEAR_____15_CM 6 0. 8160. FORMAT "%4.0" AXIS_PTS_REF ldpm_n_26 /end AXIS_DESCR
/end CHARACTERISTIC
/begin AXIS_PTS ldp_ti_fac_ti_ad_fac_fac "" 0x60cf8 TI_AD_FAC_MMV _REC_AXS_20_u2 99.99847412 _CNV_A_R_LINEAR_____248_CM 5 -50. 49.99847412 FORMAT "%5.3" /end AXIS_PTS
/begin CHARACTERISTIC IP_TI_AD_ADD_FAC__TCO__TI_ADD "Multiplicative factor on additive adaptive learning during warm-up" MAP 0x62ed0 _REC_MAP_20_u1_u1_u2 0.9960940000000002 _CNV_A_R_LINEAR_____8_CM 0. 0.996094 FORMAT "%5.3"
 /begin AXIS_DESCR COM_AXIS TCO _CNV_A_R_LINEAR_____22_CM 5 -48. 142.5 FORMAT "%5.1" AXIS_PTS_REF ldpm_tco_10 /end AXIS_DESCR
 /begin AXIS_DESCR COM_AXIS ONLINE_DUMMY _CNV_A_R_LINEAR_____115_CM 5 -131.072 131.068 FORMAT "%6.2" AXIS_PTS_REF ldp_ti_add_ti_ad_add_fac /end AXIS_DESCR
/end CHARACTERISTIC
/begin AXIS_PTS ldp_ti_add_ti_ad_add_fac "" 0x60cec TI_AD_ADD_MMV _REC_AXS_20_u2 262.14 _CNV_A_R_LINEAR_____115_CM 5 -131.072 131.068 FORMAT "%6.2" /end AXIS_PTS
/begin CHARACTERISTIC C_MAF_INT_MIN_LDC_DLY "MAF integral after setting limited dynamic conditions LV_LDC_DLY_i before starting the monitoring cycle" VALUE 0x62f88 _REC_VAL_20_u2 1820.398 _CNV_A_R_LINEAR_____98_CM 0. 1820.398 FORMAT "%7.2" /end CHARACTERISTIC
/begin CHARACTERISTIC C_TPS_GRD_DEC_DLY_SUM "time periods for calculation limited dynamic TPS gradient" VALUE 0x62fd5 _REC_VAL_20_u1 5.08 _CNV_A_R_LINEAR_____150_CM 2.e-002 5.1 FORMAT "%3.2" /end CHARACTERISTIC
/begin CHARACTERISTIC C_TPS_GRD_SUM_DLY_MIN "min threshold limited dynamic  TPS gradient" VALUE 0x62fd8 _REC_VAL_20_u2 767787.5 _CNV_A_R_LINEAR_____81_CM 0. 767787.5 FORMAT "%6.0" /end CHARACTERISTIC
/begin CHARACTERISTIC C_TPS_GRD_SUM_DLY_MAX "max threshold limited dynamic  TPS gradient" VALUE 0x62fd6 _REC_VAL_20_u2 767787.5 _CNV_A_R_LINEAR_____81_CM 0. 767787.5 FORMAT "%6.0" /end CHARACTERISTIC
/begin CHARACTERISTIC C_TPS_GRD_DEC_DLY "decrement for calculation TPS gradient" VALUE 0x62fd4 _REC_VAL_20_u1 2987.5 _CNV_A_R_LINEAR_____81_CM 0. 2987.5 FORMAT "%4.0" /end CHARACTERISTIC
/begin CHARACTERISTIC C_LAM_MV_DYW_DLY "threshold limited dynamic lambda " VALUE 0x62f6c _REC_VAL_20_u2 99.99847412 _CNV_A_R_LINEAR_____144_CM 0. 99.99847412 FORMAT "%5.2" /end CHARACTERISTIC
/begin CHARACTERISTIC C_MAF_DYW_DLY "threshold limited dynamic engine MAF " VALUE 0x62f82 _REC_VAL_20_u2 1389. _CNV_A_R_LINEAR_____56_CM 0. 1389. FORMAT "%4.0" /end CHARACTERISTIC
/begin CHARACTERISTIC C_N_DYW_DLY "threshold limited dynamic engine speed" VALUE 0x62f92 _REC_VAL_20_u2 8160. _CNV_A_R_LINEAR_____0_CM 0. 8160. FORMAT "%4.0" /end CHARACTERISTIC
/begin CHARACTERISTIC C_LAM_MV_CRLC_DLY " floating mean value calculation lambda " VALUE 0x62f68 _REC_VAL_20_u2 0.99998474 _CNV_A_R_LINEAR_____2_CM 0. 0.99998474 FORMAT "%7.5" /end CHARACTERISTIC
/begin CHARACTERISTIC C_MAF_CRLC_DLY " floating mean value calculation MAF" VALUE 0x62f7e _REC_VAL_20_u2 0.99998474 _CNV_A_R_LINEAR_____2_CM 0. 0.99998474 FORMAT "%7.5" /end CHARACTERISTIC
/begin CHARACTERISTIC C_N_CRLC_DLY " floating mean value calculation engine speed" VALUE 0x62f8e _REC_VAL_20_u2 0.99998474 _CNV_A_R_LINEAR_____2_CM 0. 0.99998474 FORMAT "%7.5" /end CHARACTERISTIC
/begin CHARACTERISTIC C_TEMP_CAT_DOWN_LS_READY "Temperature threshold above which O2 sensor recognised as operatively ready" VALUE 0x62fb6 _REC_VAL_20_u2 1023.984375 _CNV_A_R_LINEAR_____95_CM -33. 990.984375 FORMAT "%5.2" /end CHARACTERISTIC
/begin CHARACTERISTIC C_VLS_DIF_DOWN "Tolerable voltage difference for VLS_DOWN_i for resistance calculation" VALUE 0x62ff2 _REC_VAL_20_u2 4.99511719 _CNV_A_R_LINEAR_____38_CM 0. 4.99511719 FORMAT "%5.3" /end CHARACTERISTIC
/begin CHARACTERISTIC C_T_LSHPWM_DOWN_LIM_MAX "Maximum time for downstream LSH controller at the limit" VALUE 0x62fb0 _REC_VAL_20_u1 255. _CNV_A_R_LINEAR_____20_CM 0. 255. FORMAT "%3.0" /end CHARACTERISTIC
/begin CHARACTERISTIC C_T_LSH_DOWN_PREV_MAX "Maximum time for downstream LSH preheating" VALUE 0x62fab _REC_VAL_20_u1 255. _CNV_A_R_LINEAR_____20_CM 0. 255. FORMAT "%3.0" /end CHARACTERISTIC
/begin CHARACTERISTIC C_FAC_LSHPWM_DOWN_I_MIN "Minimum limit for downstream LSH-controller" VALUE 0x62f56 _REC_VAL_20_u2 1.99996948 _CNV_A_R_LINEAR_____5_CM 0. 1.99996948 FORMAT "%7.5" /end CHARACTERISTIC
/begin CHARACTERISTIC C_FAC_LSHPWM_DOWN_I_MAX "Maximum limit for downstream LSH-controller" VALUE 0x62f54 _REC_VAL_20_u2 1.99996948 _CNV_A_R_LINEAR_____5_CM 0. 1.99996948 FORMAT "%7.5" /end CHARACTERISTIC
/begin CHARACTERISTIC C_LSHPWM_DOWN_PREV_3 "PWM-value for window 3 in preheating phase" VALUE 0x62f7c _REC_VAL_20_u1 99.609375 _CNV_A_R_LINEAR_____16_CM 0. 99.609375 FORMAT "%5.2" /end CHARACTERISTIC
/begin CHARACTERISTIC C_TEMP_CAT_LSH_DOWN "Cat-temperature min-threshold, to begin with sensor heating " VALUE 0x62fb8 _REC_VAL_20_u2 1023.984375 _CNV_A_R_LINEAR_____95_CM -33. 990.984375 FORMAT "%5.2" /end CHARACTERISTIC
/begin CHARACTERISTIC C_R_DOWN_MIN_PREV "Downstream sensor resistance threshold to switch in normal heating mode" VALUE 0x62f96 _REC_VAL_20_u2 9830.25 _CNV_A_R_LINEAR_____249_CM 0. 9830.25 FORMAT "%7.2" /end CHARACTERISTIC
/begin CHARACTERISTIC C_T_LSH_DOWN_PREV_1 "Time-threshold to detect window 1in preheating phase" VALUE 0x62fa8 _REC_VAL_20_u1 255. _CNV_A_R_LINEAR_____20_CM 0. 255. FORMAT "%3.0" /end CHARACTERISTIC
/begin CHARACTERISTIC C_VB_LSH_MAX "Battery voltage threshold for LSH-protection against overvoltage" VALUE 0x62fdf _REC_VAL_20_u1 25.8984 _CNV_A_R_LINEAR_____42_CM 0. 25.8984 FORMAT "%3.1" /end CHARACTERISTIC
/begin CHARACTERISTIC C_T_LSH_DOWN_PREV_2 "Time-threshold to detect window 2 in preheating phase" VALUE 0x62fa9 _REC_VAL_20_u1 255. _CNV_A_R_LINEAR_____20_CM 0. 255. FORMAT "%3.0" /end CHARACTERISTIC
/begin CHARACTERISTIC C_LSH_DOWN_LGRD "Limitation gradient for LSHPWM_DOWN" VALUE 0x62f76 _REC_VAL_20_u1 99.609375 _CNV_A_R_LINEAR_____16_CM 0. 99.609375 FORMAT "%5.2" /end CHARACTERISTIC
/begin CHARACTERISTIC C_T_LSH_DOWN_PREV_3 "Time-threshold to detect window 3 in preheating phase" VALUE 0x62faa _REC_VAL_20_u1 255. _CNV_A_R_LINEAR_____20_CM 0. 255. FORMAT "%3.0" /end CHARACTERISTIC
/begin CHARACTERISTIC C_R_DOWN_SP_LS "Setpoint for downstream LSH-resistance during heating-state" VALUE 0x62f98 _REC_VAL_20_u2 65535. _CNV_A_R_LINEAR_____163_CM 0. 65535. FORMAT "%5.0" /end CHARACTERISTIC
/begin CHARACTERISTIC C_LSHPWM_DOWN_PREV_1 "PWM-value for window 1 in preheating phase" VALUE 0x62f7a _REC_VAL_20_u1 99.609375 _CNV_A_R_LINEAR_____16_CM 0. 99.609375 FORMAT "%5.2" /end CHARACTERISTIC
/begin CHARACTERISTIC C_LSHPWM_DOWN_MIN "LSH-duty cycle downstream sensor in case of overvoltage" VALUE 0x62f79 _REC_VAL_20_u1 99.609375 _CNV_A_R_LINEAR_____16_CM 0. 99.609375 FORMAT "%5.2" /end CHARACTERISTIC
/begin CHARACTERISTIC C_LSHPWM_DOWN_PREV_2 "PWM-value for window 2 in preheating phase" VALUE 0x62f7b _REC_VAL_20_u1 99.609375 _CNV_A_R_LINEAR_____16_CM 0. 99.609375 FORMAT "%5.2" /end CHARACTERISTIC
/begin CHARACTERISTIC IP_LSHPWM_DOWN__N__MAF "Precontrol map for lambda probe heating depending on engine speed and load" MAP 0x62cc8 _REC_MAP_20_u1_u1_u1 99.609375 _CNV_A_R_LINEAR_____16_CM 0. 99.609375 FORMAT "%5.2"
 /begin AXIS_DESCR COM_AXIS N_32 _CNV_A_R_LINEAR_____15_CM 6 0. 8160. FORMAT "%4.0" AXIS_PTS_REF ldp_n_lshpwm_down /end AXIS_DESCR
 /begin AXIS_DESCR COM_AXIS MAF _CNV_A_R_LINEAR_____51_CM 6 0. 1389. FORMAT "%4.0" AXIS_PTS_REF ldp_maf_lshpwm_down /end AXIS_DESCR
/end CHARACTERISTIC
/begin AXIS_PTS ldp_n_lshpwm_down "" 0x60c81 N_32 _REC_AXS_20_u1 8160. _CNV_A_R_LINEAR_____15_CM 6 0. 8160. FORMAT "%4.0" /end AXIS_PTS
/begin AXIS_PTS ldp_maf_lshpwm_down "" 0x60c5a MAF _REC_AXS_20_u1 1389. _CNV_A_R_LINEAR_____51_CM 6 0. 1389. FORMAT "%4.0" /end AXIS_PTS
/begin AXIS_PTS ldp_cat_ip_fac_cat_dly "" 0x60bf8 CAT_DIAG_1 _REC_AXS_20_u1 1.9968 _CNV_A_R_LINEAR_____70_CM 6 0. 1.9968 FORMAT "%4.2" /end AXIS_PTS
/begin AXIS_PTS ldp_maf_kgh_ip_fac_dly_p "" 0x60c4c MAF_KGH _REC_AXS_20_u2 2047.96875 _CNV_A_R_LINEAR_____52_CM 6 0. 2047.96875 FORMAT "%6.2" /end AXIS_PTS
/begin AXIS_PTS ldp_maf_kgh_ip_crlc_dly_i "" 0x60c3e MAF_KGH _REC_AXS_20_u2 2047.96875 _CNV_A_R_LINEAR_____52_CM 6 0. 2047.96875 FORMAT "%6.2" /end AXIS_PTS
/begin CHARACTERISTIC IP_CRLC_DLY_I__MAF_KGH "correlation constant for I-share calculation" CURVE 0x62b16 _REC_CUR_20_u1_u2 0.9960940000000002 _CNV_A_R_LINEAR_____8_CM 0. 0.996094 FORMAT "%5.3"
 /begin AXIS_DESCR COM_AXIS MAF_KGH _CNV_A_R_LINEAR_____52_CM 6 0. 2047.96875 FORMAT "%6.2" AXIS_PTS_REF ldp_maf_kgh_ip_crlc_dly_i /end AXIS_DESCR
/end CHARACTERISTIC
/begin AXIS_PTS ldpm_n_26 "" 0x60d38 N_32 _REC_AXS_20_u1 8160. _CNV_A_R_LINEAR_____15_CM 6 0. 8160. FORMAT "%4.0" /end AXIS_PTS
/begin AXIS_PTS ldpm_n_9 "" 0x60d3f N_32 _REC_AXS_20_u1 8160. _CNV_A_R_LINEAR_____15_CM 8 0. 8160. FORMAT "%4.0" /end AXIS_PTS
/begin CHARACTERISTIC C_DEC_V_EFC "Heater voltage decrement to lower temperature" VALUE 0x62f52 _REC_VAL_20_u1 25.8984 _CNV_A_R_LINEAR_____42_CM 0. 25.8984 FORMAT "%3.1" /end CHARACTERISTIC
/begin AXIS_PTS ldp_lamb_sp__fac_lam_teg "" 0x60c14 LAMB_SP _REC_AXS_20_u2 2. _CNV_A_R_LINEAR_____250_CM 6 0. 2. FORMAT "%5.4" /end AXIS_PTS
/begin AXIS_PTS ldpm_tco_10 "" 0x60d48 TCO _REC_AXS_20_u1 190.5 _CNV_A_R_LINEAR_____22_CM 5 -48. 142.5 FORMAT "%5.1" /end AXIS_PTS
/begin CHARACTERISTIC IP_FAC_LAM_TEG__LAMB_SP "temperature influence by lambda adjustments" CURVE 0x62b6e _REC_CUR_20_u1_u2 3.984375 _CNV_A_R_LINEAR_____113_CM 0. 3.984375 FORMAT "%4.2"
 /begin AXIS_DESCR COM_AXIS LAMB_SP _CNV_A_R_LINEAR_____250_CM 6 0. 2. FORMAT "%5.4" AXIS_PTS_REF ldp_lamb_sp__fac_lam_teg /end AXIS_DESCR
/end CHARACTERISTIC
/begin CHARACTERISTIC C_N_DYW "N window for limited dynamics." VALUE 0x62f90 _REC_VAL_20_u2 8160. _CNV_A_R_LINEAR_____0_CM 0. 8160. FORMAT "%4.0" /end CHARACTERISTIC
/begin AXIS_PTS ldpm_maf_3 "" 0x60d20 MAF _REC_AXS_20_u1 1389. _CNV_A_R_LINEAR_____51_CM 8 0. 1389. FORMAT "%4.0" /end AXIS_PTS
/begin CHARACTERISTIC C_T_DLY_I_MAX "max limit of I-share" VALUE 0x62fa0 _REC_VAL_20_s2 1279.9804688 _CNV_A_R_LINEAR_____247_CM -640. 639.9804688 FORMAT "%5.2" /end CHARACTERISTIC
/begin CHARACTERISTIC ID_TI_AD_FAC__N "Weighting factor for TI_AD_FAC versus N" CURVE 0x62af7 _REC_CUR_20_u1_u1 0.9960940000000002 _CNV_A_R_LINEAR_____8_CM 0. 0.996094 FORMAT "%5.3"
 /begin AXIS_DESCR COM_AXIS N_32 _CNV_A_R_LINEAR_____15_CM 6 0. 8160. FORMAT "%4.0" AXIS_PTS_REF ldpm_n_26 /end AXIS_DESCR
/end CHARACTERISTIC
/begin AXIS_PTS ldp_maf_teg "" 0x60c61 MAF _REC_AXS_20_u1 1389. _CNV_A_R_LINEAR_____51_CM 8 0. 1389. FORMAT "%4.0" /end AXIS_PTS
/begin CHARACTERISTIC IP_T_DLY_I__VLS_DIF_DLY "LAM - P - jump delay time from I-share" CURVE 0x62ffc _REC_CUR_20_u2_u2 1279.980469 _CNV_A_R_LINEAR_____245_CM -640. 639.980469 FORMAT "%5.2"
 /begin AXIS_DESCR COM_AXIS ONLINE_DUMMY _CNV_A_R_LINEAR_____246_CM 12 -4.99517 4.99517 FORMAT "%5.3" AXIS_PTS_REF ldpm_vls_dif_dly /end AXIS_DESCR
/end CHARACTERISTIC
/begin CHARACTERISTIC IP_V_EFC_LSH_UP_CTL "Heater voltage effective value after completion of the heating phase" MAP 0x62f02 _REC_MAP_20_u1_u1_u2 25.8984 _CNV_A_R_LINEAR_____42_CM 0. 25.8984 FORMAT "%3.1"
 /begin AXIS_DESCR COM_AXIS N_32 _CNV_A_R_LINEAR_____15_CM 6 0. 8160. FORMAT "%4.0" AXIS_PTS_REF ldp_n__v_efc_lsh_ctl /end AXIS_DESCR
 /begin AXIS_DESCR COM_AXIS TEG_DYN _CNV_A_R_LINEAR_____94_CM 6 0. 2047. FORMAT "%7.2" AXIS_PTS_REF ldp_teg_dyn__v_efc_lsh_up_ctl /end AXIS_DESCR
/end CHARACTERISTIC
/begin AXIS_PTS ldp_n__v_efc_lsh_ctl "" 0x60c88 N_32 _REC_AXS_20_u1 8160. _CNV_A_R_LINEAR_____15_CM 6 0. 8160. FORMAT "%4.0" /end AXIS_PTS
/begin AXIS_PTS ldp_n_32_teg "" 0x60c6a N_32 _REC_AXS_20_u1 8160. _CNV_A_R_LINEAR_____15_CM 8 0. 8160. FORMAT "%4.0" /end AXIS_PTS
/begin CHARACTERISTIC C_V_EFC_RED "Reduced heater voltage during danger of water splash damage" VALUE 0x62fde _REC_VAL_20_u1 25.8984 _CNV_A_R_LINEAR_____42_CM 0. 25.8984 FORMAT "%3.1" /end CHARACTERISTIC
/begin CHARACTERISTIC C_LAMB_SP_MAN "manual lambda setpoint" VALUE 0x63014 _REC_VAL_20_u2 31.99902344 _CNV_A_R_LINEAR_____50_CM 0. 31.99902344 FORMAT "%7.4" /end CHARACTERISTIC
/begin MEASUREMENT LAMB_SP "lambda setpoint" UWORD _CNV_A_R_LINEAR_____50_CM 1 100. 0. 31.99902344 ECU_ADDRESS 0x3fc6de /end MEASUREMENT
/begin CHARACTERISTIC IP_TEG__N32__MAF "basic value of the steady state exhaust gas temperature" MAP 0x62e2c _REC_MAP_20_u2_u1_u1 2047. _CNV_A_R_LINEAR_____94_CM 0. 2047. FORMAT "%7.2"
 /begin AXIS_DESCR COM_AXIS N_32 _CNV_A_R_LINEAR_____15_CM 8 0. 8160. FORMAT "%4.0" AXIS_PTS_REF ldp_n_32_teg /end AXIS_DESCR
 /begin AXIS_DESCR COM_AXIS MAF _CNV_A_R_LINEAR_____51_CM 8 0. 1389. FORMAT "%4.0" AXIS_PTS_REF ldp_maf_teg /end AXIS_DESCR
/end CHARACTERISTIC
/begin MEASUREMENT LV_N_MAF_DYW "Limited dynamic conditions recognised for N and MAF" UBYTE _CNV_S_2_RANGE______74_CM 1 100. 0. 1. ECU_ADDRESS 0x3fd4dd BIT_MASK 0x1 /end MEASUREMENT
/begin CHARACTERISTIC C_VLS_INI_MIN "Lower initialization value for VLS_BOL_i, VLS_MMV_MIN_i" VALUE 0x62ff6 _REC_VAL_20_u2 4.99511719 _CNV_A_R_LINEAR_____38_CM 0. 4.99511719 FORMAT "%5.3" /end CHARACTERISTIC
/begin CHARACTERISTIC C_VLS_CRLC_OFF "Filter constant for determination of VLS_MMV_xxx_i values when respective threshold not passed" VALUE 0x6301a _REC_VAL_20_u2 0.99998474 _CNV_A_R_LINEAR_____2_CM 0. 0.99998474 FORMAT "%7.5" /end CHARACTERISTIC
/begin CHARACTERISTIC C_CTR_VLS_UP_AFL_CYC_MIN "Minimum number of AF cycles after lambda controller activation prior to validating VLS_MMV_xxx_i signals" VALUE 0x6301c _REC_VAL_20_u2 65535. _CNV_A_R_LINEAR_____17_CM 0. 65535. FORMAT "%5.0" /end CHARACTERISTIC
/begin AXIS_PTS ldpm_n_32__ti_lam "" 0x60d70 N_32 _REC_AXS_20_u1 8160. _CNV_A_R_LINEAR_____15_CM 8 0. 8160. FORMAT "%4.0" /end AXIS_PTS
/begin AXIS_PTS ldpm_maf__ti_lam "" 0x60d7a MAF _REC_AXS_20_u2 1389. _CNV_A_R_LINEAR_____56_CM 8 0. 1389. FORMAT "%7.2" /end AXIS_PTS
/begin CHARACTERISTIC IP_T_AFL_LOCK "LV_AFL transition lock-out time after transition of AF mixture" MAP 0x6301e _REC_MAP_20_u1_u1_u2 2.55 _CNV_A_R_LINEAR_____21_CM 0. 2.55 FORMAT "%4.2"
 /begin AXIS_DESCR COM_AXIS N_32 _CNV_A_R_LINEAR_____15_CM 8 0. 8160. FORMAT "%4.0" AXIS_PTS_REF ldpm_n_32__ti_lam /end AXIS_DESCR
 /begin AXIS_DESCR COM_AXIS MAF _CNV_A_R_LINEAR_____56_CM 8 0. 1389. FORMAT "%7.2" AXIS_PTS_REF ldpm_maf__ti_lam /end AXIS_DESCR
/end CHARACTERISTIC
/begin CHARACTERISTIC C_T_CUR_DLY_LS_UP "Duration in which VLS_UP_i signal masked directly after Ri determination" VALUE 0x62ffa _REC_VAL_20_u1 0.255 _CNV_A_R_LINEAR_____251_CM 0. 0.255 FORMAT "%5.3" /end CHARACTERISTIC
/begin CHARACTERISTIC C_T_CUR_ON_LS_UP "Pulse duration for pump current" VALUE 0x62f9e _REC_VAL_20_u1 8.e-003 _CNV_A_R_LINEAR_____251_CM 0. 8.e-003 FORMAT "%4.3" /end CHARACTERISTIC
/begin CHARACTERISTIC C_T_CUR_OFF_LS_UP "Pulse off time for pump current" VALUE 0x62f9c _REC_VAL_20_u2 655.35 _CNV_A_R_LINEAR_____21_CM 0. 655.35 FORMAT "%6.2" /end CHARACTERISTIC
/begin CHARACTERISTIC C_VLS_MMV_MIN_RNG_TOL_LS_UP "Permitted range of VLS_UP_i above VLS_MMV_MIN_i at low gradient for Ri determination" VALUE 0x6305e _REC_VAL_20_u2 4.99992371 _CNV_A_R_LINEAR_____99_CM 0. 4.99992371 FORMAT "%7.5" /end CHARACTERISTIC
/begin CHARACTERISTIC C_VLS_MMV_MIN_RNG_BOL_LS_UP "Permitted range of VLS_UP_i below VLS_MMV_MIN_i at low gradient for Ri determination" VALUE 0x63060 _REC_VAL_20_u2 4.99992371 _CNV_A_R_LINEAR_____99_CM 0. 4.99992371 FORMAT "%7.5" /end CHARACTERISTIC
/begin CHARACTERISTIC C_DRV1_VLS_UP_MMV_THD_MIN "Minimum threshold for mean 1st derivative of VLS_UP_i signal for Ri determination" VALUE 0x63062 _REC_VAL_20_s2 4.9999 _CNV_A_R_LINEAR_____252_CM -2.5 2.4999 FORMAT "%7.4" /end CHARACTERISTIC
/begin CHARACTERISTIC C_DRV1_VLS_UP_MMV_THD_MAX "Maximum threshold for mean 1st derivative of VLS_UP_i signal for Ri determination" VALUE 0x63064 _REC_VAL_20_s2 4.9999 _CNV_A_R_LINEAR_____252_CM -2.5 2.4999 FORMAT "%7.4" /end CHARACTERISTIC
/begin CHARACTERISTIC C_FAC_STK_DRV1_VLS_UP_MMV "Multiplicative factor used to weight gradient thresholds dependent on VLS_MMV_xxx_i amplitude" VALUE 0x63066 _REC_VAL_20_u2 1.99996948 _CNV_A_R_LINEAR_____5_CM 0. 1.99996948 FORMAT "%7.5" /end CHARACTERISTIC
/begin CHARACTERISTIC C_FAC_DRV1_VLS_UP_MMV_MIN "Hysteresis factor of DRV1_VLS_UP_MMV_MIN governing limiting of DRV1_VLS_UP_MMV_MIN_THD" VALUE 0x63068 _REC_VAL_20_u1 0.99610001 _CNV_A_R_LINEAR_____68_CM 0. 0.99610001 FORMAT "%5.3" /end CHARACTERISTIC
/begin CHARACTERISTIC C_CTR_VLS_AFL_CYC_R_UP_LS "Min. no. AF cycles post lambda controller activation to permit use of T_VLS_CYC_AFL_HLD dependency" VALUE 0x6306c _REC_VAL_20_u2 65535. _CNV_A_R_LINEAR_____17_CM 0. 65535. FORMAT "%5.0" /end CHARACTERISTIC
/begin CHARACTERISTIC C_MAF_KGH_R_UP_LS "Maximum MAF_KGH threshold for activation of internal resistance determination" VALUE 0x6306e _REC_VAL_20_u2 2047.96875 _CNV_A_R_LINEAR_____52_CM 0. 2047.96875 FORMAT "%7.2" /end CHARACTERISTIC
/begin CHARACTERISTIC C_FAC_ERR_POS_R_UP_LS "Internal resistance measurement positive error (i.e. 0% to 100%)" VALUE 0x63070 _REC_VAL_20_u1 0.9960940000000002 _CNV_A_R_LINEAR_____8_CM 0. 0.996094 FORMAT "%5.3" /end CHARACTERISTIC
/begin CHARACTERISTIC C_FAC_ERR_NEG_R_UP_LS "Internal resistance measurement negative error (i.e. 100% to 0%)" VALUE 0x63071 _REC_VAL_20_u1 0.9960940000000002 _CNV_A_R_LINEAR_____8_CM 0. 0.996094 FORMAT "%5.3" /end CHARACTERISTIC
/begin CHARACTERISTIC C_CRLC_TTIP_FALL_R_UP_LS "Correlation (filter) constant for falling ceramic temperature, limit calculation" VALUE 0x63072 _REC_VAL_20_u1 0.99610001 _CNV_A_R_LINEAR_____253_CM 0. 0.99610001 FORMAT "%5.3" /end CHARACTERISTIC
/begin CHARACTERISTIC C_CRLC_TTIP_RISE_R_UP_LS "Correlation (filter) constant for rising ceramic temperature, limit calculation" VALUE 0x63073 _REC_VAL_20_u1 0.99610001 _CNV_A_R_LINEAR_____253_CM 0. 0.99610001 FORMAT "%5.3" /end CHARACTERISTIC
/begin CHARACTERISTIC C_LSHPWM_DOWN_AS_1 "Applicative correction for downstream LSHPWM" VALUE 0x63075 _REC_VAL_20_s1 99.609375 _CNV_A_R_LINEAR_____16_CM -50. 49.609375 FORMAT "%6.2" /end CHARACTERISTIC
/begin CHARACTERISTIC C_LSHPWM_DOWN_AS_2 "Applicative correction for downstream LSHPWM" VALUE 0x62f78 _REC_VAL_20_s1 99.609375 _CNV_A_R_LINEAR_____16_CM -50. 49.609375 FORMAT "%6.2" /end CHARACTERISTIC
/begin AXIS_PTS ldpm_vls_dif_dly "" 0x60d56 VLS_DIF_DLY _REC_AXS_20_u2 9.99034 _CNV_A_R_LINEAR_____246_CM 12 -4.99517 4.99517 FORMAT "%5.3" /end AXIS_PTS
/begin CHARACTERISTIC IP_TEMP_LS_INI "Initial oxygen sensor temperature value" MAP 0x62eac _REC_MAP_20_u1_u1_u1 190.5 _CNV_A_R_LINEAR_____22_CM -48. 142.5 FORMAT "%5.1"
 /begin AXIS_DESCR COM_AXIS TCO _CNV_A_R_LINEAR_____22_CM 6 -48. 142.5 FORMAT "%5.1" AXIS_PTS_REF ldp_tco_temp_ls_ini /end AXIS_DESCR
 /begin AXIS_DESCR COM_AXIS TIA _CNV_A_R_LINEAR_____22_CM 6 -48. 142.5 FORMAT "%5.1" AXIS_PTS_REF ldp_tia_temp_ls_ini /end AXIS_DESCR
/end CHARACTERISTIC
/begin CHARACTERISTIC IP_V_EFC_LSH_UP_INI "Initial heater voltage value" CURVE 0x62f26 _REC_CUR_20_u1_u1 25.8984 _CNV_A_R_LINEAR_____42_CM 0. 25.8984 FORMAT "%3.1"
 /begin AXIS_DESCR COM_AXIS TEMP_LS_INI _CNV_A_R_LINEAR_____22_CM 6 -48. 142.5 FORMAT "%5.1" AXIS_PTS_REF ldp_temp_ls_ini_v_efc_lsh_up /end AXIS_DESCR
/end CHARACTERISTIC
/begin CHARACTERISTIC IP_FAC_V_EFC_TEG "Coorection factor for the assumtion of the heat transfer exclusive for bank 2" CURVE 0x62b74 _REC_CUR_20_u1_u1 3.984375 _CNV_A_R_LINEAR_____113_CM 0. 3.984375 FORMAT "%4.2"
 /begin AXIS_DESCR COM_AXIS VS _CNV_A_R_LINEAR_____43_CM 6 0. 255. FORMAT "%3.0" AXIS_PTS_REF ldp_vs_fac_v_efc_teg /end AXIS_DESCR
/end CHARACTERISTIC
/begin CHARACTERISTIC IP_LSHPWM_I__R_DIF_DOWN_LS "Map for I-controller values depending on resistance difference" CURVE 0x62cec _REC_CUR_20_u2_u2 1.99996948 _CNV_A_R_LINEAR_____254_CM -1. 0.99996948 FORMAT "%6.5"
 /begin AXIS_DESCR COM_AXIS ONLINE_DUMMY _CNV_A_R_LINEAR_____255_CM 8 -4915.2 4915.05 FORMAT "%5.1" AXIS_PTS_REF ldp_r_dif_down_ls_lshpwm_i /end AXIS_DESCR
/end CHARACTERISTIC
/begin AXIS_PTS ldp_r_dif_down_ls_lshpwm_i "" 0x60cac R_DIF_DOWN_LS _REC_AXS_20_u2 9830.25 _CNV_A_R_LINEAR_____255_CM 8 -4915.2 4915.05 FORMAT "%5.1" /end AXIS_PTS
/begin CHARACTERISTIC C_VLS_UP_MMV_HYS_MIN "Minimum hysteresis for the computation of the thresholds VLS_TOL_i and VLS_BOL_i" VALUE 0x63018 _REC_VAL_20_u2 1. _CNV_A_R_LINEAR_____237_CM 0. 1. FORMAT "%7.5" /end CHARACTERISTIC
/begin CHARACTERISTIC C_VLS_DOWN_MMV_HYS_MIN "Minimum hysteresis for the computation of the thresholds VLS_DOWN_TOL_i and VLS_DOWN_BOL_i" VALUE 0x63096 _REC_VAL_20_u2 1. _CNV_A_R_LINEAR_____237_CM 0. 1. FORMAT "%7.5" /end CHARACTERISTIC
/begin CHARACTERISTIC C_VLS_DOWN_INI_MIN "Lower initialisation value for VLS_DOWN_TOL_i. VLS_DOWN_MMV_MIN_i" VALUE 0x63098 _REC_VAL_20_u2 4.99511719 _CNV_A_R_LINEAR_____38_CM 0. 4.99511719 FORMAT "%5.3" /end CHARACTERISTIC
/begin CHARACTERISTIC C_VLS_DOWN_INI_MAX "Upper initialisation value for VLS_DOWN_BOL_i. VLS_DOWN_MMV_MAX_i" VALUE 0x6309a _REC_VAL_20_u2 4.99511719 _CNV_A_R_LINEAR_____38_CM 0. 4.99511719 FORMAT "%5.3" /end CHARACTERISTIC
/begin CHARACTERISTIC C_VLS_DOWN_CRLC "Filter constant for determination of VLS_DOWN_MMV_xxx_i values when respective threshold passed" VALUE 0x6309c _REC_VAL_20_u2 0.99998474 _CNV_A_R_LINEAR_____2_CM 0. 0.99998474 FORMAT "%7.5" /end CHARACTERISTIC
/begin CHARACTERISTIC C_VLS_DOWN_CRLC_OFF "Filter constant for determination of VLS_DOWN_MMV_xxx_i values when respective threshold not passed" VALUE 0x6309e _REC_VAL_20_u2 0.99998474 _CNV_A_R_LINEAR_____2_CM 0. 0.99998474 FORMAT "%7.5" /end CHARACTERISTIC
/begin CHARACTERISTIC C_T_DLY_PUC_END_VLS_DOWN "Delay between completion of engine state PUC and computation of VLS_DOWN_MMV_xxx_i" VALUE 0x630a0 _REC_VAL_20_u1 25.5 _CNV_A_R_LINEAR_____18_CM 0. 25.5 FORMAT "%4.1" /end CHARACTERISTIC
/begin CHARACTERISTIC C_FAC_VLS_DOWN_MMV_HYS "Multiplicative factor governing amplitude of hysteresis" VALUE 0x630e2 _REC_VAL_20_u1 0.99610001 _CNV_A_R_LINEAR_____68_CM 0. 0.99610001 FORMAT "%5.3" /end CHARACTERISTIC
/begin CHARACTERISTIC ID_T_DLY_LS_READY "Delay time before starting detection of operability" CURVE 0x62add _REC_CUR_20_u1_u1 25.4 _CNV_A_R_LINEAR_____18_CM 0.1 25.5 FORMAT "%3.1"
 /begin AXIS_DESCR COM_AXIS TCO_ST _CNV_A_R_LINEAR_____22_CM 8 -48. 142.5 FORMAT "%5.1" AXIS_PTS_REF ldp_tco_st_t_dly_ls_ready /end AXIS_DESCR
/end CHARACTERISTIC
/begin CHARACTERISTIC C_DRV1_VLS_UP_ABS_MAX "Threshold for absolute maximum 1st derivative of VLS_UP_i signal for Ri determination" VALUE 0x6306a _REC_VAL_20_u2 4.9999237 _CNV_A_R_LINEAR_____256_CM 0. 4.9999237 FORMAT "%6.4" /end CHARACTERISTIC
/begin MEASUREMENT TEG_DYN "model output signal of the exhaust gas temperature" UWORD _CNV_A_R_LINEAR_____94_CM 1 100. 0. 2047. ECU_ADDRESS 0x3fceac FORMAT "%7.2" /end MEASUREMENT
/begin CHARACTERISTIC C_V_EFC_LSH_UP_TOL "voltage threshold to the higher voltage range of the heater" VALUE 0x62fdd _REC_VAL_20_u1 25.8984 _CNV_A_R_LINEAR_____42_CM 0. 25.8984 FORMAT "%3.1" /end CHARACTERISTIC
/begin CHARACTERISTIC C_FAC_V_EFC_LSH_UP_AS "Multiplicative correction factor to effective heater voltage" VALUE 0x630e4 _REC_VAL_20_u1 1.9921875 _CNV_A_R_LINEAR_____67_CM 0. 1.9921875 FORMAT "%5.3" /end CHARACTERISTIC
/begin CHARACTERISTIC C_T_LSHPWM_UP_FAST_VB_COR "Single engine start within wich Vbatt correction of PWM carried out at Vbatt acquisition recurrence" VALUE 0x630e5 _REC_VAL_20_u1 2.55 _CNV_A_R_LINEAR_____21_CM 0. 2.55 FORMAT "%4.2" /end CHARACTERISTIC
/begin CHARACTERISTIC C_V_EFC_LSH_UP_AS "Additive correction to effective heater voltage" VALUE 0x630e3 _REC_VAL_20_s1 26. _CNV_A_R_LINEAR_____259_CM -13.05 12.95 FORMAT "%5.1" /end CHARACTERISTIC
/begin CHARACTERISTIC C_V_EFC_LSH_UP_STEP "Additional effective heater voltage step on transition from LSH_POW_RED to LSH_POW_RISE" VALUE 0x630e6 _REC_VAL_20_s1 26. _CNV_A_R_LINEAR_____259_CM -13.05 12.95 FORMAT "%5.1" /end CHARACTERISTIC
/begin CHARACTERISTIC C_T_MIN_LS "Maximum duration with open A/F control loop if the oxygen sensors are not ready" VALUE 0x62fb2 _REC_VAL_20_u2 6553.400000000001 _CNV_A_R_LINEAR_____18_CM 0.1 6553.5 FORMAT "%6.1" /end CHARACTERISTIC
/begin CHARACTERISTIC IP_TI_AD_FAC_FAC__TCO__TI_FAC "Multiplicative factor on multiplicative adaptive learning during warm-up" MAP 0x62ee9 _REC_MAP_20_u1_u1_u2 0.9960940000000002 _CNV_A_R_LINEAR_____8_CM 0. 0.996094 FORMAT "%5.3"
 /begin AXIS_DESCR COM_AXIS TCO _CNV_A_R_LINEAR_____22_CM 5 -48. 142.5 FORMAT "%5.1" AXIS_PTS_REF ldpm_tco_10 /end AXIS_DESCR
 /begin AXIS_DESCR COM_AXIS ONLINE_DUMMY _CNV_A_R_LINEAR_____248_CM 5 -50. 49.99847412 FORMAT "%5.3" AXIS_PTS_REF ldp_ti_fac_ti_ad_fac_fac /end AXIS_DESCR
/end CHARACTERISTIC
/begin CHARACTERISTIC IP_TI_MAF_AD_MAX__N "Maximum MAF for multiplicative adaptive learning" CURVE 0x630e7 _REC_CUR_20_u1_u1 1389. _CNV_A_R_LINEAR_____51_CM 0. 1389. FORMAT "%4.0"
 /begin AXIS_DESCR COM_AXIS N_32 _CNV_A_R_LINEAR_____15_CM 6 0. 8160. FORMAT "%4.0" AXIS_PTS_REF ldpm_n_32_30 /end AXIS_DESCR
/end CHARACTERISTIC
/begin CHARACTERISTIC IP_TI_MAF_AD_MIN__N "Minimum MAF for multiplicative adaptive learning" CURVE 0x630ed _REC_CUR_20_u1_u1 1389. _CNV_A_R_LINEAR_____51_CM 0. 1389. FORMAT "%4.0"
 /begin AXIS_DESCR COM_AXIS N_32 _CNV_A_R_LINEAR_____15_CM 6 0. 8160. FORMAT "%4.0" AXIS_PTS_REF ldpm_n_32_30 /end AXIS_DESCR
/end CHARACTERISTIC
/begin CHARACTERISTIC C_FAC_VLS_UP_MMV_HYS "Multiplicative factor governing amplitude of hysteresis" VALUE 0x63016 _REC_VAL_20_u1 0.99610001 _CNV_A_R_LINEAR_____68_CM 0. 0.99610001 FORMAT "%5.3" /end CHARACTERISTIC
/begin AXIS_PTS ldp_eff_iga_av__fac_iga "" 0x60c06 EFF_IGA_AV _REC_AXS_20_u2 1.99996948 _CNV_A_R_LINEAR_____5_CM 6 0. 1.99996948 FORMAT "%7.5" /end AXIS_PTS
/begin AXIS_PTS ldp_temp_ls_ini_v_efc_lsh_up "" 0x60ce4 TEMP_LS_INI _REC_AXS_20_u1 190.5 _CNV_A_R_LINEAR_____22_CM 6 -48. 142.5 FORMAT "%5.1" /end AXIS_PTS
/begin AXIS_PTS ldp_teg_dyn__v_efc_lsh_up_ctl "" 0x60cd6 TEG_DYN _REC_AXS_20_u2 2047. _CNV_A_R_LINEAR_____94_CM 6 0. 2047. FORMAT "%7.2" /end AXIS_PTS
/begin MEASUREMENT LV_INH_LAM_DLY_1 "Activation Condition for lambda trim control" UWORD _CNV_S_2_RANGE______74_CM 1 100. 0. 1. ECU_ADDRESS 0x3fc9f0 BIT_MASK 0x10 /end MEASUREMENT
/begin MEASUREMENT LV_LAM_DLY_ACT_1 "Boolean for downstream fuel trim regulation active" UWORD _CNV_S_2_RANGE______74_CM 1 100. 0. 1. ECU_ADDRESS 0x3fc9f0 BIT_MASK 0x20 /end MEASUREMENT
/begin MEASUREMENT LV_LDC_DLY_1 "status limited dynamic " UWORD _CNV_S_2_RANGE______74_CM 1 100. 0. 1. ECU_ADDRESS 0x3fc9f0 BIT_MASK 0x8 /end MEASUREMENT
/begin MEASUREMENT FAC_CAT_DLY_1 "weight factor for P-share regarding catalyst conversion capability" UBYTE _CNV_A_R_LINEAR_____8_CM 1 100. 0. 0.996094 ECU_ADDRESS 0x3fca04 FORMAT "%5.3" /end MEASUREMENT
/begin MEASUREMENT LAM_MV_MMV_DLY_1 "floating mean value for limited lambda deviation" SWORD _CNV_A_R_LINEAR_____149_CM 1 100. -50. 49.99847412 ECU_ADDRESS 0x3fca06 FORMAT "%7.3" /end MEASUREMENT
/begin MEASUREMENT MAF_INT_DLY_1 "integral of air mass flow since LAM activation" UWORD _CNV_A_R_LINEAR_____98_CM 1 100. 0. 1820.398 ECU_ADDRESS 0x3fc9f8 FORMAT "%7.2" /end MEASUREMENT
/begin MEASUREMENT MAF_INT_LDC_DLY_1 "integral of mass air flow since limited dynamic conditions are fulfilled" UWORD _CNV_A_R_LINEAR_____98_CM 1 100. 0. 1820.398 ECU_ADDRESS 0x3fca08 FORMAT "%7.2" /end MEASUREMENT
/begin MEASUREMENT T_DLY_I_1 "LAM -P-jump delay time from I-share" SWORD _CNV_A_R_LINEAR_____247_CM 1 100. -640. 639.9804688 ECU_ADDRESS 0x3fca00 FORMAT "%7.2" /end MEASUREMENT
/begin MEASUREMENT T_DLY_I_AD_1 "initial value for the I-share (adaptation value)" SWORD _CNV_A_R_LINEAR_____247_CM 1 100. -640. 639.9804688 ECU_ADDRESS 0x3fc9f6 FORMAT "%7.2" /end MEASUREMENT
/begin MEASUREMENT T_DLY_P_1 "LAM -P-jump delay time from P-share" SWORD _CNV_A_R_LINEAR_____247_CM 1 100. -640. 639.9804688 ECU_ADDRESS 0x3fc9fc FORMAT "%7.2" /end MEASUREMENT
/begin MEASUREMENT T_LAM_DLY_1 "LAM -P-jump delay time from downstream trim controller" SWORD _CNV_A_R_LINEAR_____247_CM 1 100. -640. 639.9804688 ECU_ADDRESS 0x3fc9f4 FORMAT "%7.2" /end MEASUREMENT
/begin MEASUREMENT TPS_GRD_SUM_DLY_1 "sum. value for limited TPS gradient" UWORD _CNV_A_R_LINEAR_____81_CM 1 100. 0. 767787.5 ECU_ADDRESS 0x3fca0c FORMAT "%6.0" /end MEASUREMENT
/begin MEASUREMENT VLS_DIF_DLY_1 "difference between setpoint and actual downstream LS signal" SWORD _CNV_A_R_LINEAR_____38_CM 1 100. -4.99511719 4.99511719 ECU_ADDRESS 0x3fc9fa FORMAT "%4.3" /end MEASUREMENT
/begin MEASUREMENT LV_LAM_DYW_1 "Limited dynamic conditions recognised for LAM_i" UWORD _CNV_S_2_RANGE______74_CM 1 100. 0. 1. ECU_ADDRESS 0x3fc9b0 BIT_MASK 0x1000 /end MEASUREMENT
/begin MEASUREMENT LV_LAM_LIM_MAX_1 "lambda controller value is limited to TI_LAM_MAX" UWORD _CNV_S_2_RANGE______74_CM 1 100. 0. 1. ECU_ADDRESS 0x3fc9b0 BIT_MASK 0x4000 /end MEASUREMENT
/begin MEASUREMENT LV_LAM_LIM_MIN_1 "lambda controller value is limited to TI_LAM_MIN" UWORD _CNV_S_2_RANGE______74_CM 1 100. 0. 1. ECU_ADDRESS 0x3fc9b0 BIT_MASK 0x8000 /end MEASUREMENT
/begin MEASUREMENT LV_LSCL_1 "Close loop enable" UWORD _CNV_S_2_RANGE______74_CM 1 100. 0. 1. ECU_ADDRESS 0x3fc9b0 BIT_MASK 0x2000 /end MEASUREMENT
/begin MEASUREMENT LV_TI_AD_ACT_1 "Boolean for TI adaption activation" UWORD _CNV_S_2_RANGE______74_CM 1 100. 0. 1. ECU_ADDRESS 0x3fc9b0 BIT_MASK 0x800 /end MEASUREMENT
/begin MEASUREMENT LV_LSCL_CAT_PURGE_1 "Conditions for closed loop except cat purge cylinder bank i" UWORD _CNV_S_2_RANGE______74_CM 1 100. 0. 1. ECU_ADDRESS 0x3fc9b0 BIT_MASK 0x1 /end MEASUREMENT
/begin MEASUREMENT LAM_1 "TI_LAM_i value after a P jump" SWORD _CNV_A_R_LINEAR_____149_CM 1 100. -50. 49.99847412 ECU_ADDRESS 0x3fc9ba FORMAT "%7.3" /end MEASUREMENT
/begin MEASUREMENT LAM_MV_1 "TI_LAM_i average value" SWORD _CNV_A_R_LINEAR_____149_CM 1 100. -50. 49.99847412 ECU_ADDRESS 0x3fc9bc FORMAT "%7.3" /end MEASUREMENT
/begin MEASUREMENT LAM_MV_DYW_1 "LAM_MV_i average value for limited dynamics recognition" SWORD _CNV_A_R_LINEAR_____149_CM 1 100. -50. 49.99847412 ECU_ADDRESS 0x3fc9de FORMAT "%7.3" /end MEASUREMENT
/begin MEASUREMENT LAM_MV_LPF_1 "LAM_MV_1 average value" SWORD _CNV_A_R_LINEAR_____149_CM 1 100. -50. 49.99847412 ECU_ADDRESS 0x3fc9be FORMAT "%7.3" /end MEASUREMENT
/begin MEASUREMENT LAM_P_CTR_1 "P-jump-counter, shows the number of executed jumps" UBYTE _CNV_A_R_LINEAR_____13_CM 1 100. 0. 255. ECU_ADDRESS 0x3fc9d0 FORMAT "%3.0" /end MEASUREMENT
/begin MEASUREMENT MAF_DYW_1 "MAF average value for limited dynamics recognition" UBYTE _CNV_A_R_LINEAR_____51_CM 1 100. 0. 1389. ECU_ADDRESS 0x3fc9e0 FORMAT "%4.0" /end MEASUREMENT
/begin MEASUREMENT N_DYW_1 "N average value for limited dynamics recognition" UWORD _CNV_A_R_LINEAR_____0_CM 1 100. 0. 8160. ECU_ADDRESS 0x3fc9e2 FORMAT "%4.0" /end MEASUREMENT
/begin MEASUREMENT T_LAM_DLY_NEG_1 "total LAM -P-jump delay time from rich to lean transition  " UWORD _CNV_A_R_LINEAR_____242_CM 1 100. 0. 1279.9 ECU_ADDRESS 0x3fc9d8 FORMAT "%6.1" /end MEASUREMENT
/begin MEASUREMENT T_LAM_DLY_POS_1 "total LAM -P-jump delay time from lean to rich transition  " UWORD _CNV_A_R_LINEAR_____242_CM 1 100. 0. 1279.9 ECU_ADDRESS 0x3fc9d6 FORMAT "%6.1" /end MEASUREMENT
/begin MEASUREMENT TI_AD_ADD_MMV_1 "Additive adaptive factor" SWORD _CNV_A_R_LINEAR_____24_CM 1 100. -131.072 131.068 ECU_ADDRESS 0x3fc9c6 /end MEASUREMENT
/begin MEASUREMENT TI_AD_ADD_MMV_REL_1 "Relative additive adaptive factor" SWORD _CNV_A_R_LINEAR_____24_CM 1 100. -131.072 131.068 ECU_ADDRESS 0x3fc9ca /end MEASUREMENT
/begin MEASUREMENT TI_AD_ADD_MMV_REL_QUO_1 "Relative additive adaptive factor quotient " SWORD _CNV_A_R_LINEAR_____12_CM 1 100. -100. 99.99694824 ECU_ADDRESS 0x3fc9cc FORMAT "%8.3" /end MEASUREMENT
/begin MEASUREMENT TI_AD_FAC_MMV_1 "Multiplicative adaptive factor" SWORD _CNV_A_R_LINEAR_____149_CM 1 100. -50. 49.99847412 ECU_ADDRESS 0x3fc9c4 FORMAT "%7.3" /end MEASUREMENT
/begin MEASUREMENT TI_AD_FAC_MMV_REL_1 "Relative Multiplicative adaptive factor" SWORD _CNV_A_R_LINEAR_____149_CM 1 100. -50. 49.99847412 ECU_ADDRESS 0x3fc9c8 FORMAT "%7.3" /end MEASUREMENT
/begin MEASUREMENT TI_LAM_1 "Lambda control injection time correction" SWORD _CNV_A_R_LINEAR_____149_CM 1 100. -50. 49.99847412 ECU_ADDRESS 0x3fc9b8 FORMAT "%7.3" /end MEASUREMENT
/begin MEASUREMENT TI_LAM_MAX_1 "maximum of lambda control injection time correction" SWORD _CNV_A_R_LINEAR_____149_CM 1 100. -50. 49.99847412 ECU_ADDRESS 0x3fc9c2 FORMAT "%7.3" /end MEASUREMENT
/begin MEASUREMENT TI_LAM_MIN_1 "minimum of lambda control injection time correction" SWORD _CNV_A_R_LINEAR_____149_CM 1 100. -50. 49.99847412 ECU_ADDRESS 0x3fc9c0 FORMAT "%7.3" /end MEASUREMENT
/begin MEASUREMENT LV_DOWN_LS_1 "Logical variable for operative readiness of downstream oxygen sensor(s)" UWORD _CNV_S_2_RANGE______74_CM 1 100. 0. 1. ECU_ADDRESS 0x3fca60 BIT_MASK 0x1 /end MEASUREMENT
/begin MEASUREMENT LV_VLS_DOWN_MMV_ACT_1 "Boolean flag indicating calibrateable delay since PUC deactivation passed" UWORD _CNV_S_2_RANGE______74_CM 1 100. 0. 1. ECU_ADDRESS 0x3fca60 BIT_MASK 0x4 /end MEASUREMENT
/begin MEASUREMENT LV_VLS_DOWN_MMV_LMT_1 "Boolean flag indicating VLS_DOWN_MMV_xxx_i signals being limited when set" UWORD _CNV_S_2_RANGE______74_CM 1 100. 0. 1. ECU_ADDRESS 0x3fca60 BIT_MASK 0x2 /end MEASUREMENT
/begin MEASUREMENT DRV1_VLS_DOWN_ABS_MAX_1 "Absolute maximum value within buffer containing 1st derivative of VLS_DOWN_1 signal" UWORD _CNV_A_R_LINEAR_____256_CM 1 100. 0. 4.9999237 ECU_ADDRESS 0x3fca76 FORMAT "%6.4" /end MEASUREMENT
/begin MEASUREMENT DRV1_VLS_DOWN_MMV_1 "Mean of buffer containing 1st derivative of VLS_DOWN_1 signal" SWORD _CNV_A_R_LINEAR_____252_CM 1 100. -2.5 2.4999 ECU_ADDRESS 0x3fca72 FORMAT "%7.4" /end MEASUREMENT
/begin MEASUREMENT DRV1_VLS_DOWN_MMV_MIN_1 "Minimum value of mean of buffer containing 1st derivative of VLS_DOWN_1 signal in lean phase" SWORD _CNV_A_R_LINEAR_____252_CM 1 100. -2.5 2.4999 ECU_ADDRESS 0x3fca74 FORMAT "%7.4" /end MEASUREMENT
/begin MEASUREMENT VLS_DOWN_BOL_1 "Variable switching threshold for calculation of VLS_DOWN_MMV_MIN_i" UWORD _CNV_A_R_LINEAR_____38_CM 1 100. 0. 4.99511719 ECU_ADDRESS 0x3fca68 FORMAT "%5.3" /end MEASUREMENT
/begin MEASUREMENT VLS_DOWN_MMV_HYS_1 "Variable hysteresis used to determine switching thresholds" UWORD _CNV_A_R_LINEAR_____237_CM 1 100. 0. 1. ECU_ADDRESS 0x3fca70 FORMAT "%7.5" /end MEASUREMENT
/begin MEASUREMENT VLS_DOWN_MMV_MAX_1 "Mean oxygen sensor rich voltage" UWORD _CNV_A_R_LINEAR_____99_CM 1 100. 0. 4.99992371 ECU_ADDRESS 0x3fca6c FORMAT "%7.5" /end MEASUREMENT
/begin MEASUREMENT VLS_DOWN_MMV_MIN_1 "Mean oxygen sensor lean voltage" UWORD _CNV_A_R_LINEAR_____99_CM 1 100. 0. 4.99992371 ECU_ADDRESS 0x3fca6e FORMAT "%7.5" /end MEASUREMENT
/begin MEASUREMENT VLS_DOWN_TOL_1 "Variable switching threshold for calculation of VLS_DOWN_MMV_MAX_i" UWORD _CNV_A_R_LINEAR_____38_CM 1 100. 0. 4.99511719 ECU_ADDRESS 0x3fca6a FORMAT "%5.3" /end MEASUREMENT
/begin MEASUREMENT LV_INH_R_DOWN_LS_1 "Boolean flag indicating that downstream sensor internal resistance determiantion shall be inhibited when set" UWORD _CNV_S_2_RANGE______74_CM 1 100. 0. 1. ECU_ADDRESS 0x3fcab4 BIT_MASK 0x1 /end MEASUREMENT
/begin MEASUREMENT R_DOWN_LS_1 "Internal resistance of downstream oxygen sensor" UWORD _CNV_A_R_LINEAR_____163_CM 1 100. 0. 65535. ECU_ADDRESS 0x3fcac2 FORMAT "%5.0" /end MEASUREMENT
/begin MEASUREMENT LV_AFL_1 "" UWORD _CNV_S_2_RANGE______74_CM 1 100. 0. 1. ECU_ADDRESS 0x3fca30 BIT_MASK 0x40 /end MEASUREMENT
/begin MEASUREMENT LV_INH_LSH_UP_1 "Boolean flag indicating project specific application conditions for heating not met" UWORD _CNV_S_2_RANGE______74_CM 1 100. 0. 1. ECU_ADDRESS 0x3fca30 BIT_MASK 0x1 /end MEASUREMENT
/begin MEASUREMENT LV_UP_LS_1 "Logical variable for recognized operability of the lambda probe" UWORD _CNV_S_2_RANGE______74_CM 1 100. 0. 1. ECU_ADDRESS 0x3fca30 BIT_MASK 0x100 /end MEASUREMENT
/begin MEASUREMENT LV_UP_LS_CDN_1 "Logical variable for recognized limited operability of the lambda probe" UWORD _CNV_S_2_RANGE______74_CM 1 100. 0. 1. ECU_ADDRESS 0x3fca30 BIT_MASK 0x80 /end MEASUREMENT
/begin MEASUREMENT LV_VLS_UP_MMV_LMT_1 "Boolean flag indicating VLS_MMV_xxx_i signals being limited when set" UWORD _CNV_S_2_RANGE______74_CM 1 100. 0. 1. ECU_ADDRESS 0x3fca30 BIT_MASK 0x8 /end MEASUREMENT
/begin MEASUREMENT LV_VLS_UP_MMV_STK_VLD_1 "Boolean flag indicating VLS_MMV_xxx_i signals valid when set" UWORD _CNV_S_2_RANGE______74_CM 1 100. 0. 1. ECU_ADDRESS 0x3fca30 BIT_MASK 0x4 /end MEASUREMENT
/begin MEASUREMENT CTR_VLS_AFL_CYC_1 "Denotes number of AF cycles since lambda controller last activated" UWORD _CNV_A_R_LINEAR_____17_CM 1 100. 0. 65535. ECU_ADDRESS 0x3fca3a FORMAT "%5.0" /end MEASUREMENT
/begin MEASUREMENT DRV1_VLS_UP_ABS_MAX_1 "Absolute maximum value within buffer containing 1st derivative of VLS_UP_i signal" UWORD _CNV_A_R_LINEAR_____256_CM 1 100. 0. 4.9999237 ECU_ADDRESS 0x3fca4a FORMAT "%6.4" /end MEASUREMENT
/begin MEASUREMENT DRV1_VLS_UP_MMV_1 "Mean of buffer containing 1st derivative of VLS_UP_i signal" SWORD _CNV_A_R_LINEAR_____252_CM 1 100. -2.5 2.4999 ECU_ADDRESS 0x3fca46 FORMAT "%7.4" /end MEASUREMENT
/begin MEASUREMENT DRV1_VLS_UP_MMV_MIN_1 "Minimum value of mean of buffer containing 1st derivative of VLS_UP_i signal in lean phase" SWORD _CNV_A_R_LINEAR_____252_CM 1 100. -2.5 2.4999 ECU_ADDRESS 0x3fca48 FORMAT "%7.4" /end MEASUREMENT
/begin MEASUREMENT T_AFL_LOCK_1 "Timer indicating duration of LV_AFL lock" UBYTE _CNV_A_R_LINEAR_____21_CM 1 100. 0. 2.55 ECU_ADDRESS 0x3fca5d FORMAT "%4.2" /end MEASUREMENT
/begin MEASUREMENT T_VLS_CYC_AFL_1 "Lean mixture cycle time" UBYTE _CNV_A_R_LINEAR_____21_CM 1 100. 0. 2.55 ECU_ADDRESS 0x3fca37 FORMAT "%4.2" /end MEASUREMENT
/begin MEASUREMENT T_VLS_CYC_AFL_HLD_1 "Lean mixture cycle time, held until next new value available" UBYTE _CNV_A_R_LINEAR_____21_CM 1 100. 0. 2.55 ECU_ADDRESS 0x3fca38 FORMAT "%4.2" /end MEASUREMENT
/begin MEASUREMENT T_VLS_CYC_AFR_1 "Rich mixture cycle time" UBYTE _CNV_A_R_LINEAR_____21_CM 1 100. 0. 2.55 ECU_ADDRESS 0x3fca36 FORMAT "%4.2" /end MEASUREMENT
/begin MEASUREMENT VLS_BOL_1 "Corrected VLS_MMV_MIN" UWORD _CNV_A_R_LINEAR_____38_CM 1 100. 0. 4.99511719 ECU_ADDRESS 0x3fca40 FORMAT "%5.3" /end MEASUREMENT
/begin MEASUREMENT VLS_MMV_MAX_1 "Mean maximum sensor voltage" UWORD _CNV_A_R_LINEAR_____99_CM 1 100. 0. 4.99992371 ECU_ADDRESS 0x3fca3c FORMAT "%7.5" /end MEASUREMENT
/begin MEASUREMENT VLS_MMV_MIN_1 "Mean minimum sensor voltage" UWORD _CNV_A_R_LINEAR_____99_CM 1 100. 0. 4.99992371 ECU_ADDRESS 0x3fca3e FORMAT "%7.5" /end MEASUREMENT
/begin MEASUREMENT VLS_TOL_1 "Corrected VLS_MMV_MAX" UWORD _CNV_A_R_LINEAR_____38_CM 1 100. 0. 4.99511719 ECU_ADDRESS 0x3fca42 FORMAT "%5.3" /end MEASUREMENT
/begin MEASUREMENT VLS_UP_MMV_HYS_1 "Variable switching threshold for calculation of VLS_DOWN_MMV_MIN_i" UWORD _CNV_A_R_LINEAR_____237_CM 1 100. 0. 1. ECU_ADDRESS 0x3fca44 FORMAT "%7.5" /end MEASUREMENT
/begin MEASUREMENT FAC_LSHPWM_DOWN_CTL_1 "LSH-Controller output (Factor!)" UWORD _CNV_A_R_LINEAR_____5_CM 1 100. 0. 1.99996948 ECU_ADDRESS 0x3fcae8 FORMAT "%7.5" /end MEASUREMENT
/begin MEASUREMENT LSHPWM_DOWN_1 "Oxygen sensor heater duty cycle" UBYTE _CNV_A_R_LINEAR_____16_CM 1 100. 0. 99.609375 ECU_ADDRESS 0x3fcae4 FORMAT "%5.1" /end MEASUREMENT
/begin MEASUREMENT R_DIF_DOWN_LS_1 "Resistance difference between setpoint value and actual value" SWORD _CNV_A_R_LINEAR_____249_CM 1 100. -4915.2 4915.05 ECU_ADDRESS 0x3fcaea FORMAT "%7.2" /end MEASUREMENT
/begin MEASUREMENT STATE_LSH_DOWN_1 "State of the downstream oxygen sensor heater(s)" ULONG _CNV_S_6_STATE_LSH_261_CM 1 100. 0. 5. ECU_ADDRESS 0x3fcae0 /end MEASUREMENT
/begin MEASUREMENT T_LSH_DOWN_PREV_1 "Timer for time windows in preheating state" UBYTE _CNV_A_R_LINEAR_____20_CM 1 100. 0. 255. ECU_ADDRESS 0x3fcae5 FORMAT "%3.0" /end MEASUREMENT
/begin MEASUREMENT T_LSHPWM_DOWN_LIM_1 "Time for downstream LSH controller at the limit" UBYTE _CNV_A_R_LINEAR_____20_CM 1 100. 0. 255. ECU_ADDRESS 0x3fcae6 FORMAT "%3.0" /end MEASUREMENT
/begin MEASUREMENT LV_INH_LAM_DLY_2 "Activation Condition for lambda trim control" UWORD _CNV_S_2_RANGE______74_CM 1 100. 0. 1. ECU_ADDRESS 0x3fcb5c BIT_MASK 0x10 /end MEASUREMENT
/begin MEASUREMENT LV_LAM_DLY_ACT_2 "Boolean for downstream fuel trim regulation active" UWORD _CNV_S_2_RANGE______74_CM 1 100. 0. 1. ECU_ADDRESS 0x3fcb5c BIT_MASK 0x20 /end MEASUREMENT
/begin MEASUREMENT LV_LDC_DLY_2 "status limited dynamic " UWORD _CNV_S_2_RANGE______74_CM 1 100. 0. 1. ECU_ADDRESS 0x3fcb5c BIT_MASK 0x8 /end MEASUREMENT
/begin MEASUREMENT FAC_CAT_DLY_2 "weight factor for P-share regarding catalyst conversion capability" UBYTE _CNV_A_R_LINEAR_____8_CM 1 100. 0. 0.996094 ECU_ADDRESS 0x3fcb70 FORMAT "%5.3" /end MEASUREMENT
/begin MEASUREMENT LAM_MV_MMV_DLY_2 "floating mean value for limited lambda deviation" SWORD _CNV_A_R_LINEAR_____149_CM 1 100. -50. 49.99847412 ECU_ADDRESS 0x3fcb72 FORMAT "%7.3" /end MEASUREMENT
/begin MEASUREMENT MAF_INT_DLY_2 "integral of air mass flow since LAM activation" UWORD _CNV_A_R_LINEAR_____98_CM 1 100. 0. 1820.398 ECU_ADDRESS 0x3fcb64 FORMAT "%7.2" /end MEASUREMENT
/begin MEASUREMENT MAF_INT_LDC_DLY_2 "integral of mass air flow since limited dynamic conditions are fulfilled" UWORD _CNV_A_R_LINEAR_____98_CM 1 100. 0. 1820.398 ECU_ADDRESS 0x3fcb74 FORMAT "%7.2" /end MEASUREMENT
/begin MEASUREMENT T_DLY_I_2 "LAM -P-jump delay time from I-share" SWORD _CNV_A_R_LINEAR_____247_CM 1 100. -640. 639.9804688 ECU_ADDRESS 0x3fcb6c FORMAT "%7.2" /end MEASUREMENT
/begin MEASUREMENT T_DLY_I_AD_2 "initial value for the I-share (adaptation value)" SWORD _CNV_A_R_LINEAR_____247_CM 1 100. -640. 639.9804688 ECU_ADDRESS 0x3fcb62 FORMAT "%7.2" /end MEASUREMENT
/begin MEASUREMENT T_DLY_P_2 "LAM -P-jump delay time from P-share" SWORD _CNV_A_R_LINEAR_____247_CM 1 100. -640. 639.9804688 ECU_ADDRESS 0x3fcb68 FORMAT "%7.2" /end MEASUREMENT
/begin MEASUREMENT T_LAM_DLY_2 "LAM -P-jump delay time from downstream trim controller" SWORD _CNV_A_R_LINEAR_____247_CM 1 100. -640. 639.9804688 ECU_ADDRESS 0x3fcb60 FORMAT "%7.2" /end MEASUREMENT
/begin MEASUREMENT TPS_GRD_SUM_DLY_2 "sum. value for limited TPS gradient" UWORD _CNV_A_R_LINEAR_____81_CM 1 100. 0. 767787.5 ECU_ADDRESS 0x3fcb78 FORMAT "%6.0" /end MEASUREMENT
/begin MEASUREMENT VLS_DIF_DLY_2 "difference between setpoint and actual downstream LS signal" SWORD _CNV_A_R_LINEAR_____38_CM 1 100. -4.99511719 4.99511719 ECU_ADDRESS 0x3fcb66 FORMAT "%4.3" /end MEASUREMENT
/begin MEASUREMENT LV_LAM_DYW_2 "Limited dynamic conditions recognised for LAM_i" UWORD _CNV_S_2_RANGE______74_CM 1 100. 0. 1. ECU_ADDRESS 0x3fcb1c BIT_MASK 0x1000 /end MEASUREMENT
/begin MEASUREMENT LV_LAM_LIM_MAX_2 "lambda controller value is limited to TI_LAM_MAX" UWORD _CNV_S_2_RANGE______74_CM 1 100. 0. 1. ECU_ADDRESS 0x3fcb1c BIT_MASK 0x4000 /end MEASUREMENT
/begin MEASUREMENT LV_LAM_LIM_MIN_2 "lambda controller value is limited to TI_LAM_MIN" UWORD _CNV_S_2_RANGE______74_CM 1 100. 0. 1. ECU_ADDRESS 0x3fcb1c BIT_MASK 0x8000 /end MEASUREMENT
/begin MEASUREMENT LV_LSCL_2 "Close loop enable" UWORD _CNV_S_2_RANGE______74_CM 1 100. 0. 1. ECU_ADDRESS 0x3fcb1c BIT_MASK 0x2000 /end MEASUREMENT
/begin MEASUREMENT LV_TI_AD_ACT_2 "Boolean for TI adaption activation" UWORD _CNV_S_2_RANGE______74_CM 1 100. 0. 1. ECU_ADDRESS 0x3fcb1c BIT_MASK 0x800 /end MEASUREMENT
/begin MEASUREMENT LV_LSCL_CAT_PURGE_2 "Conditions for closed loop except cat purge cylinder bank i" UWORD _CNV_S_2_RANGE______74_CM 1 100. 0. 1. ECU_ADDRESS 0x3fcb1c BIT_MASK 0x1 /end MEASUREMENT
/begin MEASUREMENT LAM_2 "TI_LAM_i value after a P jump" SWORD _CNV_A_R_LINEAR_____149_CM 1 100. -50. 49.99847412 ECU_ADDRESS 0x3fcb26 FORMAT "%7.3" /end MEASUREMENT
/begin MEASUREMENT LAM_MV_2 "TI_LAM_i average value" SWORD _CNV_A_R_LINEAR_____149_CM 1 100. -50. 49.99847412 ECU_ADDRESS 0x3fcb28 FORMAT "%7.3" /end MEASUREMENT
/begin MEASUREMENT LAM_MV_DYW_2 "LAM_MV_i average value for limited dynamics recognition" SWORD _CNV_A_R_LINEAR_____149_CM 1 100. -50. 49.99847412 ECU_ADDRESS 0x3fcb4a FORMAT "%7.3" /end MEASUREMENT
/begin MEASUREMENT LAM_MV_LPF_2 "LAM_MV_1 average value" SWORD _CNV_A_R_LINEAR_____149_CM 1 100. -50. 49.99847412 ECU_ADDRESS 0x3fcb2a FORMAT "%7.3" /end MEASUREMENT
/begin MEASUREMENT LAM_P_CTR_2 "P-jump-counter, shows the number of executed jumps" UBYTE _CNV_A_R_LINEAR_____13_CM 1 100. 0. 255. ECU_ADDRESS 0x3fcb3c FORMAT "%3.0" /end MEASUREMENT
/begin MEASUREMENT MAF_DYW_2 "MAF average value for limited dynamics recognition" UBYTE _CNV_A_R_LINEAR_____51_CM 1 100. 0. 1389. ECU_ADDRESS 0x3fcb4c FORMAT "%4.0" /end MEASUREMENT
/begin MEASUREMENT N_DYW_2 "N average value for limited dynamics recognition" UWORD _CNV_A_R_LINEAR_____0_CM 1 100. 0. 8160. ECU_ADDRESS 0x3fcb4e FORMAT "%4.0" /end MEASUREMENT
/begin MEASUREMENT T_LAM_DLY_NEG_2 "total LAM -P-jump delay time from rich to lean transition  " UWORD _CNV_A_R_LINEAR_____242_CM 1 100. 0. 1279.9 ECU_ADDRESS 0x3fcb44 FORMAT "%6.1" /end MEASUREMENT
/begin MEASUREMENT T_LAM_DLY_POS_2 "total LAM -P-jump delay time from lean to rich transition  " UWORD _CNV_A_R_LINEAR_____242_CM 1 100. 0. 1279.9 ECU_ADDRESS 0x3fcb42 FORMAT "%6.1" /end MEASUREMENT
/begin MEASUREMENT TI_AD_ADD_MMV_2 "Additive adaptive factor" SWORD _CNV_A_R_LINEAR_____24_CM 1 100. -131.072 131.068 ECU_ADDRESS 0x3fcb32 /end MEASUREMENT
/begin MEASUREMENT TI_AD_ADD_MMV_REL_2 "Relative additive adaptive factor" SWORD _CNV_A_R_LINEAR_____24_CM 1 100. -131.072 131.068 ECU_ADDRESS 0x3fcb36 /end MEASUREMENT
/begin MEASUREMENT TI_AD_ADD_MMV_REL_QUO_2 "Relative additive adaptive factor quotient " SWORD _CNV_A_R_LINEAR_____12_CM 1 100. -100. 99.99694824 ECU_ADDRESS 0x3fcb38 FORMAT "%8.3" /end MEASUREMENT
/begin MEASUREMENT TI_AD_FAC_MMV_2 "Multiplicative adaptive factor" SWORD _CNV_A_R_LINEAR_____149_CM 1 100. -50. 49.99847412 ECU_ADDRESS 0x3fcb30 FORMAT "%7.3" /end MEASUREMENT
/begin MEASUREMENT TI_AD_FAC_MMV_REL_2 "Relative Multiplicative adaptive factor" SWORD _CNV_A_R_LINEAR_____149_CM 1 100. -50. 49.99847412 ECU_ADDRESS 0x3fcb34 FORMAT "%7.3" /end MEASUREMENT
/begin MEASUREMENT TI_LAM_2 "Lambda control injection time correction" SWORD _CNV_A_R_LINEAR_____149_CM 1 100. -50. 49.99847412 ECU_ADDRESS 0x3fcb24 FORMAT "%7.3" /end MEASUREMENT
/begin MEASUREMENT TI_LAM_MAX_2 "maximum of lambda control injection time correction" SWORD _CNV_A_R_LINEAR_____149_CM 1 100. -50. 49.99847412 ECU_ADDRESS 0x3fcb2e FORMAT "%7.3" /end MEASUREMENT
/begin MEASUREMENT TI_LAM_MIN_2 "minimum of lambda control injection time correction" SWORD _CNV_A_R_LINEAR_____149_CM 1 100. -50. 49.99847412 ECU_ADDRESS 0x3fcb2c FORMAT "%7.3" /end MEASUREMENT
/begin MEASUREMENT DRV1_VLS_DOWN_ABS_MAX_2 "Absolute maximum value within buffer containing 1st derivative of VLS_DOWN_1 signal" UWORD _CNV_A_R_LINEAR_____256_CM 1 100. 0. 4.9999237 ECU_ADDRESS 0x3fcbe2 FORMAT "%6.4" /end MEASUREMENT
/begin MEASUREMENT DRV1_VLS_DOWN_MMV_2 "Mean of buffer containing 1st derivative of VLS_DOWN_1 signal" SWORD _CNV_A_R_LINEAR_____252_CM 1 100. -2.5 2.4999 ECU_ADDRESS 0x3fcbde FORMAT "%7.4" /end MEASUREMENT
/begin MEASUREMENT DRV1_VLS_DOWN_MMV_MIN_2 "Minimum value of mean of buffer containing 1st derivative of VLS_DOWN_1 signal in lean phase" SWORD _CNV_A_R_LINEAR_____252_CM 1 100. -2.5 2.4999 ECU_ADDRESS 0x3fcbe0 FORMAT "%7.4" /end MEASUREMENT
/begin MEASUREMENT VLS_DOWN_BOL_2 "Variable switching threshold for calculation of VLS_DOWN_MMV_MIN_i" UWORD _CNV_A_R_LINEAR_____38_CM 1 100. 0. 4.99511719 ECU_ADDRESS 0x3fcbd4 FORMAT "%5.3" /end MEASUREMENT
/begin MEASUREMENT VLS_DOWN_MMV_HYS_2 "Variable hysteresis used to determine switching thresholds" UWORD _CNV_A_R_LINEAR_____237_CM 1 100. 0. 1. ECU_ADDRESS 0x3fcbdc FORMAT "%7.5" /end MEASUREMENT
/begin MEASUREMENT VLS_DOWN_MMV_MAX_2 "Mean oxygen sensor rich voltage" UWORD _CNV_A_R_LINEAR_____99_CM 1 100. 0. 4.99992371 ECU_ADDRESS 0x3fcbd8 FORMAT "%7.5" /end MEASUREMENT
/begin MEASUREMENT VLS_DOWN_MMV_MIN_2 "Mean oxygen sensor lean voltage" UWORD _CNV_A_R_LINEAR_____99_CM 1 100. 0. 4.99992371 ECU_ADDRESS 0x3fcbda FORMAT "%7.5" /end MEASUREMENT
/begin MEASUREMENT VLS_DOWN_TOL_2 "Variable switching threshold for calculation of VLS_DOWN_MMV_MAX_i" UWORD _CNV_A_R_LINEAR_____38_CM 1 100. 0. 4.99511719 ECU_ADDRESS 0x3fcbd6 FORMAT "%5.3" /end MEASUREMENT
/begin MEASUREMENT LV_INH_R_DOWN_LS_2 "Boolean flag indicating that downstream sensor internal resistance determiantion shall be inhibited when set" UWORD _CNV_S_2_RANGE______74_CM 1 100. 0. 1. ECU_ADDRESS 0x3fcc20 BIT_MASK 0x1 /end MEASUREMENT
/begin MEASUREMENT R_DOWN_LS_2 "Internal resistance of downstream oxygen sensor" UWORD _CNV_A_R_LINEAR_____163_CM 1 100. 0. 65535. ECU_ADDRESS 0x3fcc2e FORMAT "%5.0" /end MEASUREMENT
/begin MEASUREMENT LV_AFL_2 "" UWORD _CNV_S_2_RANGE______74_CM 1 100. 0. 1. ECU_ADDRESS 0x3fcb9c BIT_MASK 0x40 /end MEASUREMENT
/begin MEASUREMENT LV_INH_LSH_UP_2 "Boolean flag indicating project specific application conditions for heating not met" UWORD _CNV_S_2_RANGE______74_CM 1 100. 0. 1. ECU_ADDRESS 0x3fcb9c BIT_MASK 0x1 /end MEASUREMENT
/begin MEASUREMENT LV_UP_LS_2 "Logical variable for recognized operability of the lambda probe" UWORD _CNV_S_2_RANGE______74_CM 1 100. 0. 1. ECU_ADDRESS 0x3fcb9c BIT_MASK 0x100 /end MEASUREMENT
/begin MEASUREMENT LV_UP_LS_CDN_2 "Logical variable for recognized limited operability of the lambda probe" UWORD _CNV_S_2_RANGE______74_CM 1 100. 0. 1. ECU_ADDRESS 0x3fcb9c BIT_MASK 0x80 /end MEASUREMENT
/begin MEASUREMENT LV_VLS_UP_MMV_LMT_2 "Boolean flag indicating VLS_MMV_xxx_i signals being limited when set" UWORD _CNV_S_2_RANGE______74_CM 1 100. 0. 1. ECU_ADDRESS 0x3fcb9c BIT_MASK 0x8 /end MEASUREMENT
/begin MEASUREMENT LV_VLS_UP_MMV_STK_VLD_2 "Boolean flag indicating VLS_MMV_xxx_i signals valid when set" UWORD _CNV_S_2_RANGE______74_CM 1 100. 0. 1. ECU_ADDRESS 0x3fcb9c BIT_MASK 0x4 /end MEASUREMENT
/begin MEASUREMENT CTR_VLS_AFL_CYC_2 "Denotes number of AF cycles since lambda controller last activated" UWORD _CNV_A_R_LINEAR_____17_CM 1 100. 0. 65535. ECU_ADDRESS 0x3fcba6 FORMAT "%5.0" /end MEASUREMENT
/begin MEASUREMENT DRV1_VLS_UP_ABS_MAX_2 "Absolute maximum value within buffer containing 1st derivative of VLS_UP_i signal" UWORD _CNV_A_R_LINEAR_____256_CM 1 100. 0. 4.9999237 ECU_ADDRESS 0x3fcbb6 FORMAT "%6.4" /end MEASUREMENT
/begin MEASUREMENT DRV1_VLS_UP_MMV_2 "Mean of buffer containing 1st derivative of VLS_UP_i signal" SWORD _CNV_A_R_LINEAR_____252_CM 1 100. -2.5 2.4999 ECU_ADDRESS 0x3fcbb2 FORMAT "%7.4" /end MEASUREMENT
/begin MEASUREMENT DRV1_VLS_UP_MMV_MIN_2 "Minimum value of mean of buffer containing 1st derivative of VLS_UP_i signal in lean phase" SWORD _CNV_A_R_LINEAR_____252_CM 1 100. -2.5 2.4999 ECU_ADDRESS 0x3fcbb4 FORMAT "%7.4" /end MEASUREMENT
/begin MEASUREMENT T_AFL_LOCK_2 "Timer indicating duration of LV_AFL lock" UBYTE _CNV_A_R_LINEAR_____21_CM 1 100. 0. 2.55 ECU_ADDRESS 0x3fcbc9 FORMAT "%4.2" /end MEASUREMENT
/begin MEASUREMENT T_VLS_CYC_AFL_2 "Lean mixture cycle time" UBYTE _CNV_A_R_LINEAR_____21_CM 1 100. 0. 2.55 ECU_ADDRESS 0x3fcba3 FORMAT "%4.2" /end MEASUREMENT
/begin MEASUREMENT T_VLS_CYC_AFL_HLD_2 "Lean mixture cycle time, held until next new value available" UBYTE _CNV_A_R_LINEAR_____21_CM 1 100. 0. 2.55 ECU_ADDRESS 0x3fcba4 FORMAT "%4.2" /end MEASUREMENT
/begin MEASUREMENT T_VLS_CYC_AFR_2 "Rich mixture cycle time" UBYTE _CNV_A_R_LINEAR_____21_CM 1 100. 0. 2.55 ECU_ADDRESS 0x3fcba2 FORMAT "%4.2" /end MEASUREMENT
/begin MEASUREMENT VLS_BOL_2 "Corrected VLS_MMV_MIN" UWORD _CNV_A_R_LINEAR_____38_CM 1 100. 0. 4.99511719 ECU_ADDRESS 0x3fcbac FORMAT "%5.3" /end MEASUREMENT
/begin MEASUREMENT VLS_MMV_MAX_2 "Mean maximum sensor voltage" UWORD _CNV_A_R_LINEAR_____99_CM 1 100. 0. 4.99992371 ECU_ADDRESS 0x3fcba8 FORMAT "%7.5" /end MEASUREMENT
/begin MEASUREMENT VLS_MMV_MIN_2 "Mean minimum sensor voltage" UWORD _CNV_A_R_LINEAR_____99_CM 1 100. 0. 4.99992371 ECU_ADDRESS 0x3fcbaa FORMAT "%7.5" /end MEASUREMENT
/begin MEASUREMENT VLS_TOL_2 "Corrected VLS_MMV_MAX" UWORD _CNV_A_R_LINEAR_____38_CM 1 100. 0. 4.99511719 ECU_ADDRESS 0x3fcbae FORMAT "%5.3" /end MEASUREMENT
/begin MEASUREMENT VLS_UP_MMV_HYS_2 "Variable switching threshold for calculation of VLS_DOWN_MMV_MIN_i" UWORD _CNV_A_R_LINEAR_____237_CM 1 100. 0. 1. ECU_ADDRESS 0x3fcbb0 FORMAT "%7.5" /end MEASUREMENT
/begin MEASUREMENT FAC_LSHPWM_DOWN_CTL_2 "LSH-Controller output (Factor!)" UWORD _CNV_A_R_LINEAR_____5_CM 1 100. 0. 1.99996948 ECU_ADDRESS 0x3fcc54 FORMAT "%7.5" /end MEASUREMENT
/begin MEASUREMENT LSHPWM_DOWN_2 "Oxygen sensor heater duty cycle" UBYTE _CNV_A_R_LINEAR_____16_CM 1 100. 0. 99.609375 ECU_ADDRESS 0x3fcc50 FORMAT "%5.1" /end MEASUREMENT
/begin MEASUREMENT R_DIF_DOWN_LS_2 "Resistance difference between setpoint value and actual value" SWORD _CNV_A_R_LINEAR_____249_CM 1 100. -4915.2 4915.05 ECU_ADDRESS 0x3fcc56 FORMAT "%7.2" /end MEASUREMENT
/begin MEASUREMENT STATE_LSH_DOWN_2 "State of the downstream oxygen sensor heater(s)" ULONG _CNV_S_6_STATE_LSH_261_CM 1 100. 0. 5. ECU_ADDRESS 0x3fcc4c /end MEASUREMENT
/begin MEASUREMENT T_LSH_DOWN_PREV_2 "Timer for time windows in preheating state" UBYTE _CNV_A_R_LINEAR_____20_CM 1 100. 0. 255. ECU_ADDRESS 0x3fcc51 FORMAT "%3.0" /end MEASUREMENT
/begin MEASUREMENT T_LSHPWM_DOWN_LIM_2 "Time for downstream LSH controller at the limit" UBYTE _CNV_A_R_LINEAR_____20_CM 1 100. 0. 255. ECU_ADDRESS 0x3fcc52 FORMAT "%3.0" /end MEASUREMENT
/begin CHARACTERISTIC C_CRLC_DLY_AD "correlation constant for AD-share calculation" VALUE 0x62f4e _REC_VAL_20_u2 0.99998474 _CNV_A_R_LINEAR_____2_CM 0. 0.99998474 FORMAT "%7.5" /end CHARACTERISTIC
/begin MEASUREMENT STATE_LSH_UP_1 "Heating state recognition" ULONG _CNV_S_6_STATE_LSH__263_CM 1 100. 0. 5. ECU_ADDRESS 0x3fccac /end MEASUREMENT
/begin MEASUREMENT LSHPWM_UP_1 "" UBYTE _CNV_A_R_LINEAR_____16_CM 1 100. 0. 99.609375 ECU_ADDRESS 0x3fccb0 FORMAT "%4.1" /end MEASUREMENT
/begin MEASUREMENT T_LSH_UP_1 "Timer to determine the duration of heating phase" UBYTE _CNV_A_R_LINEAR_____20_CM 1 100. 0. 255. ECU_ADDRESS 0x3fccb1 FORMAT "%3.0" /end MEASUREMENT
/begin MEASUREMENT V_EFC_LSH_UP_1 "Effective value of heater voltage" UBYTE _CNV_A_R_LINEAR_____42_CM 1 100. 0. 25.8984 ECU_ADDRESS 0x3fccb2 FORMAT "%3.1" /end MEASUREMENT
/begin MEASUREMENT T_LSH_UP_TOL_1 "Timer to determine the duration of high voltage phases" UBYTE _CNV_A_R_LINEAR_____20_CM 1 100. 0. 255. ECU_ADDRESS 0x3fccb3 FORMAT "%3.0" /end MEASUREMENT
/begin MEASUREMENT T_LSH_UP_LIM_1 "Timer to determine the duration of heating phases after a high voltage phase" UBYTE _CNV_A_R_LINEAR_____20_CM 1 100. 0. 255. ECU_ADDRESS 0x3fccb4 FORMAT "%3.0" /end MEASUREMENT
/begin MEASUREMENT STATE_LSH_UP_2 "Heating state recognition" ULONG _CNV_S_6_STATE_LSH__263_CM 1 100. 0. 5. ECU_ADDRESS 0x3fccb8 /end MEASUREMENT
/begin MEASUREMENT LSHPWM_UP_2 "" UBYTE _CNV_A_R_LINEAR_____16_CM 1 100. 0. 99.609375 ECU_ADDRESS 0x3fccbc FORMAT "%4.1" /end MEASUREMENT
/begin MEASUREMENT T_LSH_UP_2 "Timer to determine the duration of heating phase" UBYTE _CNV_A_R_LINEAR_____20_CM 1 100. 0. 255. ECU_ADDRESS 0x3fccbd FORMAT "%3.0" /end MEASUREMENT
/begin MEASUREMENT V_EFC_LSH_UP_2 "Effective value of heater voltage" UBYTE _CNV_A_R_LINEAR_____42_CM 1 100. 0. 25.8984 ECU_ADDRESS 0x3fccbe FORMAT "%3.1" /end MEASUREMENT
/begin MEASUREMENT T_LSH_UP_TOL_2 "Timer to determine the duration of high voltage phases" UBYTE _CNV_A_R_LINEAR_____20_CM 1 100. 0. 255. ECU_ADDRESS 0x3fccbf FORMAT "%3.0" /end MEASUREMENT
/begin MEASUREMENT T_LSH_UP_LIM_2 "Timer to determine the duration of heating phases after a high voltage phase" UBYTE _CNV_A_R_LINEAR_____20_CM 1 100. 0. 255. ECU_ADDRESS 0x3fccc0 FORMAT "%3.0" /end MEASUREMENT
/begin MEASUREMENT EOI_S_0 "End of injection phase for Stratified mode" UWORD _CNV_A_R_LINEAR_____6_CM 1 100. 0. 720. ECU_ADDRESS 0x3fc67a FORMAT "%6.2" /end MEASUREMENT
/begin MEASUREMENT EOI_S_1 "End of injection phase for Stratified mode" UWORD _CNV_A_R_LINEAR_____6_CM 1 100. 0. 720. ECU_ADDRESS 0x3fc67c FORMAT "%6.2" /end MEASUREMENT
/begin MEASUREMENT EOI_S_2 "End of injection phase for Stratified mode" UWORD _CNV_A_R_LINEAR_____6_CM 1 100. 0. 720. ECU_ADDRESS 0x3fc67e FORMAT "%6.2" /end MEASUREMENT
/begin MEASUREMENT EOI_S_3 "End of injection phase for Stratified mode" UWORD _CNV_A_R_LINEAR_____6_CM 1 100. 0. 720. ECU_ADDRESS 0x3fc680 FORMAT "%6.2" /end MEASUREMENT
/begin MEASUREMENT EOI_S_4 "End of injection phase for Stratified mode" UWORD _CNV_A_R_LINEAR_____6_CM 1 100. 0. 720. ECU_ADDRESS 0x3fc682 FORMAT "%6.2" /end MEASUREMENT
/begin MEASUREMENT EOI_S_5 "End of injection phase for Stratified mode" UWORD _CNV_A_R_LINEAR_____6_CM 1 100. 0. 720. ECU_ADDRESS 0x3fc684 FORMAT "%6.2" /end MEASUREMENT
/begin MEASUREMENT EOI_S_CLC_0 "End of injection phase for Stratified mode" UWORD _CNV_A_R_LINEAR_____6_CM 1 100. 0. 720. ECU_ADDRESS 0x3fc686 FORMAT "%6.2" /end MEASUREMENT
/begin MEASUREMENT EOI_S_CLC_1 "End of injection phase for Stratified mode" UWORD _CNV_A_R_LINEAR_____6_CM 1 100. 0. 720. ECU_ADDRESS 0x3fc688 FORMAT "%6.2" /end MEASUREMENT
/begin MEASUREMENT EOI_S_CLC_2 "End of injection phase for Stratified mode" UWORD _CNV_A_R_LINEAR_____6_CM 1 100. 0. 720. ECU_ADDRESS 0x3fc68a FORMAT "%6.2" /end MEASUREMENT
/begin MEASUREMENT EOI_S_CLC_3 "End of injection phase for Stratified mode" UWORD _CNV_A_R_LINEAR_____6_CM 1 100. 0. 720. ECU_ADDRESS 0x3fc68c FORMAT "%6.2" /end MEASUREMENT
/begin MEASUREMENT EOI_S_CLC_4 "End of injection phase for Stratified mode" UWORD _CNV_A_R_LINEAR_____6_CM 1 100. 0. 720. ECU_ADDRESS 0x3fc68e FORMAT "%6.2" /end MEASUREMENT
/begin MEASUREMENT EOI_S_CLC_5 "End of injection phase for Stratified mode" UWORD _CNV_A_R_LINEAR_____6_CM 1 100. 0. 720. ECU_ADDRESS 0x3fc690 FORMAT "%6.2" /end MEASUREMENT
/begin MEASUREMENT EOI_DIF_S "Difference of end of injection phase for Stratified mode" SWORD _CNV_A_R_LINEAR_____6_CM 1 100. -360. 360. ECU_ADDRESS 0x3fc69e FORMAT "%5.1" /end MEASUREMENT
/begin MEASUREMENT FAC_TI_PRS_S "factor  for correction of fuel injection time due to a change of pressure decrease at the injector (stratified mode)" UWORD _CNV_A_R_LINEAR_____191_CM 1 100. 0. 15.99975586 ECU_ADDRESS 0x3fcfc8 /end MEASUREMENT
/begin MEASUREMENT PRS_INJ_MV_S "mean cylinder pressure during injection (stratified mode)" UWORD _CNV_A_R_LINEAR_____114_CM 1 100. 0. 173888. ECU_ADDRESS 0x3fcfca FORMAT "%6.0" /end MEASUREMENT
/begin MEASUREMENT CRK_INJ_S "rough value for injection angle (EOI-SOI) (stratified mode)" UWORD _CNV_A_R_LINEAR_____6_CM 1 100. 0. 600. ECU_ADDRESS 0x3fcfcc FORMAT "%5.1" /end MEASUREMENT
/begin MEASUREMENT PRS_DEC_INJ_S "pressure decrease at the injector at the end of injection (stratified mode)" UWORD _CNV_A_R_LINEAR_____114_CM 1 100. 0. 173888. ECU_ADDRESS 0x3fcfce FORMAT "%6.0" /end MEASUREMENT
/begin MEASUREMENT TI_STND_S "fuel injection time without fuel pressure correction for stratified mode" UWORD _CNV_A_R_LINEAR_____24_CM 1 100. 0. 262.14 ECU_ADDRESS 0x3fcfd0 FORMAT "%7.3" /end MEASUREMENT
/begin MEASUREMENT TI_S_CLC "calculated fuel injection time for stratified mode" UWORD _CNV_A_R_LINEAR_____24_CM 1 100. 0. 262.14 ECU_ADDRESS 0x3fcfd2 FORMAT "%7.3" /end MEASUREMENT
/begin MEASUREMENT TQI_SP_MFF "Engine torque in stratified combustion for injection setpoint." UWORD _CNV_A_R_LINEAR_____37_CM 1 100. 0. 1023.96875 ECU_ADDRESS 0x3fcccc FORMAT "%7.2" /end MEASUREMENT
/begin MEASUREMENT TQI_SP_MFF_1 "Engine torque in stratified combustion for injection setpoint before manual switch." UWORD _CNV_A_R_LINEAR_____37_CM 1 100. 0. 1023.96875 ECU_ADDRESS 0x3fccce FORMAT "%7.2" /end MEASUREMENT
/begin MEASUREMENT MFF_SP_S_1 "fuel mass flow setpoint intermitted value for stratified mode" UWORD _CNV_A_R_LINEAR_____56_CM 1 100. 0. 1389. ECU_ADDRESS 0x3fccca FORMAT "%7.2" /end MEASUREMENT
/begin MEASUREMENT MFF_SP_S "Fuel mass in stratified combustion." UWORD _CNV_A_R_LINEAR_____56_CM 1 100. 0. 1389. ECU_ADDRESS 0x3fccc6 FORMAT "%7.2" /end MEASUREMENT
/begin MEASUREMENT MFF_SP_S_ENG "calculated mass fuel flow output for canister purge" UWORD _CNV_A_R_LINEAR_____56_CM 1 100. 0. 1389. ECU_ADDRESS 0x3fccc8 FORMAT "%7.2" /end MEASUREMENT
/begin MEASUREMENT EFF_TOT_BAS_S "Total basic efficiency for stratified mode" UWORD _CNV_A_R_LINEAR_____5_CM 1 100. 0. 1.99996948 ECU_ADDRESS 0x3fccd0 FORMAT "%7.5" /end MEASUREMENT
/begin AXIS_PTS ldp_n__eoi_dif_s "" 0x60e5c N_32 _REC_AXS_20_u1 8160. _CNV_A_R_LINEAR_____15_CM 6 0. 8160. FORMAT "%4.0" /end AXIS_PTS
/begin AXIS_PTS ldp_eoi__prs_inc_cmp "" 0x60e84 EOI_HOM _REC_AXS_20_u2 -30. _CNV_A_R_LINEAR_____308_CM 12 420. -180. FORMAT "%6.1" /end AXIS_PTS
/begin AXIS_PTS ldp_crk_inj__prs_inc_cmp "" 0x60e9e CRK_INJ _REC_AXS_20_u2 30. _CNV_A_R_LINEAR_____6_CM 16 0. 600. FORMAT "%5.1" /end AXIS_PTS
/begin AXIS_PTS ldpm_prs_dec_inj__fac_ti_prs "" 0x60ec0 FUP _REC_AXS_20_u2 173888. _CNV_A_R_LINEAR_____114_CM 12 0. 173888. FORMAT "%6.0" /end AXIS_PTS
/begin AXIS_PTS ldp_n_32_ip_lamb_rgn_afr "" 0x60e7b N_32 _REC_AXS_20_u1 8160. _CNV_A_R_LINEAR_____15_CM 8 0. 8160. FORMAT "%4.0" /end AXIS_PTS
/begin AXIS_PTS ldpm_n_32_s "" 0x60eda N_32 _REC_AXS_20_u1 8160. _CNV_A_R_LINEAR_____15_CM 16 0. 8160. FORMAT "%4.0" /end AXIS_PTS
/begin AXIS_PTS ldpm_tqi_sp_mff_s "" 0x60eec TQI_SP_MFF _REC_AXS_20_u2 1023.96875 _CNV_A_R_LINEAR_____37_CM 12 0. 1023.96875 FORMAT "%7.2" /end AXIS_PTS
/begin CHARACTERISTIC IP_EOI_DIF_S "End of injection for stratified mode relative to ignition angle" MAP 0x632f8 _REC_MAP_20_u2_u1_u2 720. _CNV_A_R_LINEAR_____309_CM -360. 360. FORMAT "%6.1"
 /begin AXIS_DESCR COM_AXIS N_32 _CNV_A_R_LINEAR_____15_CM 6 0. 8160. FORMAT "%4.0" AXIS_PTS_REF ldp_n__eoi_dif_s /end AXIS_DESCR
 /begin AXIS_DESCR COM_AXIS MFF_SP_S _CNV_A_R_LINEAR_____56_CM 6 0. 1389. FORMAT "%7.2" AXIS_PTS_REF ldp_mff_sp_s__eoi_dif_s /end AXIS_DESCR
/end CHARACTERISTIC
/begin CHARACTERISTIC IP_PRS_INC_CMP "mean pressure increase in cylinder due to compression" MAP 0x633c0 _REC_MAP_20_u2_u2_u2 31.99951171875 _CNV_A_R_LINEAR_____181_CM 0. 31.99951171875 FORMAT "%7.4"
 /begin AXIS_DESCR COM_AXIS EOI_HOM _CNV_A_R_LINEAR_____308_CM 12 420. -180. FORMAT "%6.1" AXIS_PTS_REF ldp_eoi__prs_inc_cmp /end AXIS_DESCR
 /begin AXIS_DESCR COM_AXIS CRK_INJ[0] _CNV_A_R_LINEAR_____6_CM 16 0. 600. FORMAT "%5.1" AXIS_PTS_REF ldp_crk_inj__prs_inc_cmp /end AXIS_DESCR
/end CHARACTERISTIC
/begin CHARACTERISTIC IP_MFF_SP_S "Fuel mass stratified mode" MAP 0x63558 _REC_MAP_20_u2_u1_u2 1389. _CNV_A_R_LINEAR_____56_CM 0. 1389. FORMAT "%7.2"
 /begin AXIS_DESCR COM_AXIS N_32 _CNV_A_R_LINEAR_____15_CM 16 0. 8160. FORMAT "%4.0" AXIS_PTS_REF ldpm_n_32_s /end AXIS_DESCR
 /begin AXIS_DESCR COM_AXIS TQI_SP_MFF _CNV_A_R_LINEAR_____37_CM 12 0. 1023.96875 FORMAT "%7.2" AXIS_PTS_REF ldpm_tqi_sp_mff_s /end AXIS_DESCR
/end CHARACTERISTIC
/begin CHARACTERISTIC C_EOI_S_AS "Global application assistance" VALUE 0x63886 _REC_VAL_20_s2 1440. _CNV_A_R_LINEAR_____6_CM -720. 720. FORMAT "%6.1" /end CHARACTERISTIC
/begin CHARACTERISTIC C_EOI_S_MAN "Global application assistance " VALUE 0x63888 _REC_VAL_20_u2 720. _CNV_A_R_LINEAR_____6_CM 0. 720. FORMAT "%6.2" /end CHARACTERISTIC
/begin CHARACTERISTIC C_LAMB_RGN_PAS "passive value for catalyst regeneration" VALUE 0x6388c _REC_VAL_20_u2 31.99902344 _CNV_A_R_LINEAR_____50_CM 0. 31.99902344 FORMAT "%7.4" /end CHARACTERISTIC
/begin CHARACTERISTIC C_LAMB_RGN_MAX "maximum value for regeneration lambda value" VALUE 0x6388e _REC_VAL_20_u2 31.99902344 _CNV_A_R_LINEAR_____50_CM 0. 31.99902344 FORMAT "%7.4" /end CHARACTERISTIC
/begin CHARACTERISTIC C_T_RGN_LAMB_CON "time to stay on base map lambda value" VALUE 0x63890 _REC_VAL_20_u2 655.35 _CNV_A_R_LINEAR_____21_CM 0. 655.35 FORMAT "%6.2" /end CHARACTERISTIC
/begin CHARACTERISTIC LC_EOI_S_MAN_ACT "Global application assistance switch passive/active" VALUE 0x6388a _REC_VAL_20_u1 1. _CNV_A_R_LINEAR_____17_CM 0. 1. FORMAT "%2.0" /end CHARACTERISTIC
/begin CHARACTERISTIC LC_TI_S_MAN_ACT "switch for manual setpoint for injection time in stratified mode " VALUE 0x63894 _REC_VAL_20_u1 1. _CNV_A_R_LINEAR_____17_CM 0. 1. FORMAT "%2.0" /end CHARACTERISTIC
/begin CHARACTERISTIC LC_TQI_SP_MFF_MAN_ACT "Logiacl constant for manual torque-switch" VALUE 0x63895 _REC_VAL_20_u1 1. _CNV_A_R_LINEAR_____17_CM 0. 1. FORMAT "%2.0" /end CHARACTERISTIC
/begin CHARACTERISTIC C_TQI_SP_MFF_MAN "manual torque switch value" VALUE 0x63898 _REC_VAL_20_u2 1023.96875 _CNV_A_R_LINEAR_____37_CM 0. 1023.96875 FORMAT "%7.2" /end CHARACTERISTIC
/begin CHARACTERISTIC LC_MFF_SP_S_MAN_ACT "Logical constant for manual MFF-switch" VALUE 0x63896 _REC_VAL_20_u1 1. _CNV_A_R_LINEAR_____17_CM 0. 1. FORMAT "%2.0" /end CHARACTERISTIC
/begin CHARACTERISTIC C_MFF_SP_S_MAN "Manual fuel mass flow setpoint for stratified mode" VALUE 0x6389a _REC_VAL_20_u2 1389. _CNV_A_R_LINEAR_____56_CM 0. 1389. FORMAT "%7.2" /end CHARACTERISTIC
/begin CHARACTERISTIC C_MFF_SP_S_OFS_AS "Manual fuel mass flow setpoint for application" VALUE 0x6389c _REC_VAL_20_u2 1389. _CNV_A_R_LINEAR_____56_CM 0. 1389. FORMAT "%7.2" /end CHARACTERISTIC
/begin AXIS_PTS ldp_mff_sp_s__eoi_dif_s "" 0x60e64 MFF_SP_S _REC_AXS_20_u2 1389. _CNV_A_R_LINEAR_____56_CM 6 0. 1389. FORMAT "%7.2" /end AXIS_PTS
/begin MEASUREMENT T_RGN "Time counter for active regeneration" UWORD _CNV_A_R_LINEAR_____21_CM 1 100. 0. 655.35 ECU_ADDRESS 0x3fcca0 FORMAT "%5.2" /end MEASUREMENT
/begin MEASUREMENT LV_LAMB_RGN_FAC_SENS "Flag determining the mode of lambda variation" UBYTE _CNV_S_2_RANGE______76_CM 1 100. 0. 1. ECU_ADDRESS 0x3fd4e7 BIT_MASK 0x1 /end MEASUREMENT
/begin AXIS_PTS ldp_ntl_ip_lamb_rgn_fac_mdl "" 0x63964 NTL _REC_AXS_20_u2 10485.6 _CNV_A_R_LINEAR_____310_CM 8 0. 10485.6 FORMAT "%7.1" /end AXIS_PTS
/begin CHARACTERISTIC LC_LAMB_RGN_FAC_SENS "Logical constant determining the mode of lambda correction" VALUE 0x63976 _REC_VAL_20_u1 1. _CNV_S_2_RANGE______74_CM 0. 1. /end CHARACTERISTIC
/begin CHARACTERISTIC IP_LAMB_RGN_AFR__MAF__N_32 "lambda setpoint for catalyst regeneration" MAP 0x63340 _REC_MAP_20_u2_u1_u1 31.99902344 _CNV_A_R_LINEAR_____50_CM 0. 31.99902344 FORMAT "%7.4"
 /begin AXIS_DESCR COM_AXIS MAF _CNV_A_R_LINEAR_____51_CM 8 0. 1389. FORMAT "%4.0" AXIS_PTS_REF ldp_maf_ip_lamb_rgn_afr /end AXIS_DESCR
 /begin AXIS_DESCR COM_AXIS N_32 _CNV_A_R_LINEAR_____15_CM 8 0. 8160. FORMAT "%4.0" AXIS_PTS_REF ldp_n_32_ip_lamb_rgn_afr /end AXIS_DESCR
/end CHARACTERISTIC
/begin CHARACTERISTIC IP_LAMB_RGN_FAC_SENS "lambda setpoint correction factor depending on sensor signal" CURVE 0x63978 _REC_CUR_20_u2_u2 0.99 _CNV_A_R_LINEAR_____312_CM 1. 1.99 FORMAT "%6.4"
 /begin AXIS_DESCR COM_AXIS ONLINE_DUMMY _CNV_A_R_LINEAR_____38_CM 8 0. 4.99511719 FORMAT "%5.3" AXIS_PTS_REF ldp_vls_down_ip_lamb_rgn /end AXIS_DESCR
/end CHARACTERISTIC
/begin CHARACTERISTIC IP_LAMB_RGN_FAC_MDL "lambda setpoint correction factor depending on remaining modelled loading" CURVE 0x63988 _REC_CUR_20_u2_u2 0.99 _CNV_A_R_LINEAR_____312_CM 1. 1.99 FORMAT "%6.4"
 /begin AXIS_DESCR COM_AXIS NTL _CNV_A_R_LINEAR_____310_CM 8 0. 10485.6 FORMAT "%7.1" AXIS_PTS_REF ldp_ntl_ip_lamb_rgn_fac_mdl /end AXIS_DESCR
/end CHARACTERISTIC
/begin AXIS_PTS ldp_vls_down_ip_lamb_rgn "" 0x60f62 VLS_DOWN _REC_AXS_20_u2 4.99511719 _CNV_A_R_LINEAR_____38_CM 8 0. 4.99511719 FORMAT "%5.3" /end AXIS_PTS
/begin MEASUREMENT LAMB_RGN_1 "lambda setpoint for catalyst regeneration" UWORD _CNV_A_R_LINEAR_____50_CM 1 100. 0. 31.99902344 ECU_ADDRESS 0x3fcc9e FORMAT "%7.4" /end MEASUREMENT
/begin MEASUREMENT LAMB_RGN_2 "lambda setpoint for catalyst regeneration" UWORD _CNV_A_R_LINEAR_____50_CM 1 100. 0. 31.99902344 ECU_ADDRESS 0x3fcca2 FORMAT "%7.4" /end MEASUREMENT
/begin MEASUREMENT TI_S_1 "fuel injection time for stratified mode" UWORD _CNV_A_R_LINEAR_____24_CM 1 100. 0. 262.14 ECU_ADDRESS 0x3faa4a FORMAT "%7.3" /end MEASUREMENT
/begin MEASUREMENT LV_TI_S_LIM_MIN "bolean variable for injection time limitation" UBYTE _CNV_S_2_RANGE______74_CM 1 100. 0. 1. ECU_ADDRESS 0x3fd547 /end MEASUREMENT
/begin CHARACTERISTIC C_TI_S_MAN "manual setpoint for injection time in stratified mode " VALUE 0x63892 _REC_VAL_20_u2 262.14 _CNV_A_R_LINEAR_____24_CM 0. 262.14 FORMAT "%7.3" /end CHARACTERISTIC
/begin CHARACTERISTIC C_TI_MIN_THD "minimum threshold of the injection time limitation" VALUE 0x63998 _REC_VAL_20_u2 262.14 _CNV_A_R_LINEAR_____24_CM 0. 262.14 FORMAT "%7.3" /end CHARACTERISTIC
/begin CHARACTERISTIC C_TI_MIN "minimum injection time limitation" VALUE 0x6399a _REC_VAL_20_u2 262.14 _CNV_A_R_LINEAR_____24_CM 0. 262.14 FORMAT "%7.3" /end CHARACTERISTIC
/begin CHARACTERISTIC IP_FAC_TI_PRS "Factor for correction of fuel injection due to pressure decrease at the injector" CURVE 0x63540 _REC_CUR_20_u2_u2 31.99951171875 _CNV_A_R_LINEAR_____181_CM 0. 31.99951171875 FORMAT "%7.4"
 /begin AXIS_DESCR COM_AXIS FUP _CNV_A_R_LINEAR_____114_CM 12 0. 173888. FORMAT "%6.0" AXIS_PTS_REF ldpm_prs_dec_inj__fac_ti_prs /end AXIS_DESCR
/end CHARACTERISTIC
/begin AXIS_PTS ldp_maf_ip_lamb_rgn_afr "" 0x60e72 MAF _REC_AXS_20_u1 1389. _CNV_A_R_LINEAR_____51_CM 8 0. 1389. FORMAT "%4.0" /end AXIS_PTS
/begin COMPU_METHOD _CNV_A_R_LINEAR_____0_CM "" RAT_FUNC "%6.3" "rpm" COEFFS 0 1. 0. 0 0 1 /end COMPU_METHOD
/begin COMPU_METHOD _CNV_A_R_LINEAR_____1_CM "" RAT_FUNC "%6.3" "hPa" COEFFS 0 12.06017666543982 0. 0 0 1 /end COMPU_METHOD
/begin COMPU_METHOD _CNV_A_R_LINEAR_____2_CM "" RAT_FUNC "%6.3" "-" COEFFS 0 65536.00007936121 0. 0 0 1 /end COMPU_METHOD
/begin COMPU_METHOD _CNV_A_R_LINEAR_____5_CM "" RAT_FUNC "%6.3" "-" COEFFS 0 32768.00003968061 0. 0 0 1 /end COMPU_METHOD
/begin COMPU_METHOD _CNV_A_R_LINEAR_____6_CM "" RAT_FUNC "%6.3" "°CRK" COEFFS 0 2.666666666666667 0. 0 0 1 /end COMPU_METHOD
/begin COMPU_METHOD _CNV_A_R_LINEAR_____8_CM "" RAT_FUNC "%6.3" "[-]" COEFFS 0 255.9999357490357 0. 0 0 1 /end COMPU_METHOD
/begin COMPU_METHOD _CNV_A_R_LINEAR_____12_CM "" RAT_FUNC "%6.3" "%" COEFFS 0 327.680000003584 3.584063961170614e-007 0 0 1 /end COMPU_METHOD
/begin COMPU_METHOD _CNV_A_R_LINEAR_____13_CM "" RAT_FUNC "%6.3" "[-]" COEFFS 0 1. 0. 0 0 1 /end COMPU_METHOD
/begin COMPU_METHOD _CNV_A_R_LINEAR_____15_CM "" RAT_FUNC "%6.3" "rpm" COEFFS 0 3.125e-002 0. 0 0 1 /end COMPU_METHOD
/begin COMPU_METHOD _CNV_A_R_LINEAR_____16_CM "" RAT_FUNC "%6.3" "%" COEFFS 0 2.56 0. 0 0 1 /end COMPU_METHOD
/begin COMPU_METHOD _CNV_A_R_LINEAR_____17_CM "" RAT_FUNC "%6.3" "-" COEFFS 0 1. 0. 0 0 1 /end COMPU_METHOD
/begin COMPU_METHOD _CNV_A_R_LINEAR_____18_CM "" RAT_FUNC "%6.3" "s" COEFFS 0 10. 0. 0 0 1 /end COMPU_METHOD
/begin COMPU_METHOD _CNV_A_R_LINEAR_____20_CM "" RAT_FUNC "%6.3" "s" COEFFS 0 1. 0. 0 0 1 /end COMPU_METHOD
/begin COMPU_METHOD _CNV_A_R_LINEAR_____21_CM "" RAT_FUNC "%6.3" "s" COEFFS 0 100. 0. 0 0 1 /end COMPU_METHOD
/begin COMPU_METHOD _CNV_A_R_LINEAR_____22_CM "" RAT_FUNC "%6.3" "°C" COEFFS 0 1.333333333333333 64. 0 0 1 /end COMPU_METHOD
/begin COMPU_METHOD _CNV_A_R_LINEAR_____24_CM "" RAT_FUNC "%6.3" "ms" COEFFS 0 250. 0. 0 0 1 /end COMPU_METHOD
/begin COMPU_METHOD _CNV_A_R_LINEAR_____26_CM "" RAT_FUNC "%6.3" "°C" COEFFS 0 0.25 8.25 0 0 1 /end COMPU_METHOD
/begin COMPU_METHOD _CNV_A_R_LINEAR_____27_CM "" RAT_FUNC "%6.3" "-" COEFFS 0 511.9999948599216 0. 0 0 1 /end COMPU_METHOD
/begin COMPU_METHOD _CNV_A_R_LINEAR_____28_CM "" RAT_FUNC "%6.3" "1/Seg" COEFFS 0 1. 0. 0 0 1 /end COMPU_METHOD
/begin COMPU_METHOD _CNV_A_R_LINEAR_____37_CM "" RAT_FUNC "%6.3" "Nm" COEFFS 0 32. 0. 0 0 1 /end COMPU_METHOD
/begin COMPU_METHOD _CNV_A_R_LINEAR_____38_CM "" RAT_FUNC "%6.3" "V" COEFFS 0 204.7999998974999 0. 0 0 1 /end COMPU_METHOD
/begin COMPU_METHOD _CNV_A_R_LINEAR_____42_CM "" RAT_FUNC "%6.3" "V" COEFFS 0 9.846168103048838 0. 0 0 1 /end COMPU_METHOD
/begin COMPU_METHOD _CNV_A_R_LINEAR_____43_CM "" RAT_FUNC "%6.3" "km/h" COEFFS 0 1. 0. 0 0 1 /end COMPU_METHOD
/begin COMPU_METHOD _CNV_A_R_LINEAR_____46_CM "" RAT_FUNC "%6.3" "Seg" COEFFS 0 1. 0. 0 0 1 /end COMPU_METHOD
/begin COMPU_METHOD _CNV_A_R_LINEAR_____50_CM "" RAT_FUNC "%6.3" "-" COEFFS 0 1023.999999919998 0. 0 0 1 /end COMPU_METHOD
/begin COMPU_METHOD _CNV_A_R_LINEAR_____51_CM "" RAT_FUNC "%6.3" "mg/stk" COEFFS 0 0.183585313174946 0. 0 0 1 /end COMPU_METHOD
/begin COMPU_METHOD _CNV_A_R_LINEAR_____52_CM "" RAT_FUNC "%6.3" "kg/h" COEFFS 0 32. 0. 0 0 1 /end COMPU_METHOD
/begin COMPU_METHOD _CNV_A_R_LINEAR_____56_CM "" RAT_FUNC "%6.3" "mg/stk" COEFFS 0 47.18142548596112 0. 0 0 1 /end COMPU_METHOD
/begin COMPU_METHOD _CNV_A_R_LINEAR_____64_CM "" RAT_FUNC "%6.3" "-" COEFFS 0 127.9991955827809 0. 0 0 1 /end COMPU_METHOD
/begin COMPU_METHOD _CNV_A_R_LINEAR_____65_CM "" RAT_FUNC "%6.3" "Nm" COEFFS 0 32. 32768. 0 0 1 /end COMPU_METHOD
/begin COMPU_METHOD _CNV_A_R_LINEAR_____67_CM "" RAT_FUNC "%6.3" "[-]" COEFFS 0 128. 0. 0 0 1 /end COMPU_METHOD
/begin COMPU_METHOD _CNV_A_R_LINEAR_____68_CM "" RAT_FUNC "%6.3" "-" COEFFS 0 255.9983911655618 0. 0 0 1 /end COMPU_METHOD
/begin COMPU_METHOD _CNV_A_R_LINEAR_____69_CM "" RAT_FUNC "%6.3" "-" COEFFS 0 2. 0. 0 0 1 /end COMPU_METHOD
/begin COMPU_METHOD _CNV_A_R_LINEAR_____70_CM "" RAT_FUNC "%6.3" "-" COEFFS 0 63.60176282051283 0. 0 0 1 /end COMPU_METHOD
/begin COMPU_METHOD _CNV_A_R_LINEAR_____72_CM "" RAT_FUNC "%6.3" "-" COEFFS 0 16383.75 0. 0 0 1 /end COMPU_METHOD
/begin COMPU_METHOD _CNV_S_2_RANGE______74_CM "" TAB_VERB "%6.3" "[-]" COMPU_TAB_REF _CNV_S_2_RANGE______74 /end COMPU_METHOD
/begin COMPU_VTAB _CNV_S_2_RANGE______74 "" TAB_VERB 2 0 "0" 1 "1" /end COMPU_VTAB
/begin COMPU_METHOD _CNV_S_2_RANGE______76_CM "" TAB_VERB "%6.3" "-" COMPU_TAB_REF _CNV_S_2_RANGE______76 /end COMPU_METHOD
/begin COMPU_VTAB _CNV_S_2_RANGE______76 "" TAB_VERB 2 0 "0" 1 "1" /end COMPU_VTAB
/begin COMPU_METHOD _CNV_A_R_LINEAR_____81_CM "" RAT_FUNC "%6.3" "°TPS/s" COEFFS 0 8.535564853556485e-002 0. 0 0 1 /end COMPU_METHOD
/begin COMPU_METHOD _CNV_A_R_LINEAR_____87_CM "" RAT_FUNC "%6.3" "-" COEFFS 0 16. 0. 0 0 1 /end COMPU_METHOD
/begin COMPU_METHOD _CNV_A_R_LINEAR_____94_CM "" RAT_FUNC "%6.3" "°C" COEFFS 0 16. 0. 0 0 1 /end COMPU_METHOD
/begin COMPU_METHOD _CNV_A_R_LINEAR_____95_CM "" RAT_FUNC "%6.3" "°C" COEFFS 0 64. 2112. 0 0 1 /end COMPU_METHOD
/begin COMPU_METHOD _CNV_A_R_LINEAR_____98_CM "" RAT_FUNC "%6.3" "g" COEFFS 0 36.00036915004301 0. 0 0 1 /end COMPU_METHOD
/begin COMPU_METHOD _CNV_A_R_LINEAR_____99_CM "" RAT_FUNC "%6.3" "V" COEFFS 0 13107.19998965744 0. 0 0 1 /end COMPU_METHOD
/begin COMPU_METHOD _CNV_A_R_LINEAR_____105_CM "" RAT_FUNC "%6.3" "[-]" COEFFS 0 1023.999999959999 32767.99999871998 0 0 1 /end COMPU_METHOD
/begin COMPU_METHOD _CNV_A_R_LINEAR_____108_CM "" RAT_FUNC "%6.3" "mg/stk" COEFFS 0 47.18214541280769 -1.080506262951531e-005 0 0 1 /end COMPU_METHOD
/begin COMPU_METHOD _CNV_A_R_LINEAR_____109_CM "" RAT_FUNC "%6.3" "-" COEFFS 0 524280. 0. 0 0 1 /end COMPU_METHOD
/begin COMPU_METHOD _CNV_A_R_LINEAR_____110_CM "" RAT_FUNC "%6.3" "°C" COEFFS 0 15.99975585564965 0. 0 0 1 /end COMPU_METHOD
/begin COMPU_METHOD _CNV_A_R_LINEAR_____111_CM "" RAT_FUNC "%6.3" "1/°C" COEFFS 0 16710013.00390117 0. 0 0 1 /end COMPU_METHOD
/begin COMPU_METHOD _CNV_A_R_LINEAR_____112_CM "" RAT_FUNC "%6.3" "ms/(mg/stk)" COEFFS 0 86812.82289044907 0. 0 0 1 /end COMPU_METHOD
/begin COMPU_METHOD _CNV_A_R_LINEAR_____113_CM "" RAT_FUNC "%6.3" "[-]" COEFFS 0 64. 0. 0 0 1 /end COMPU_METHOD
/begin COMPU_METHOD _CNV_A_R_LINEAR_____114_CM "" RAT_FUNC "%6.3" "hPa" COEFFS 0 0.3768805207949945 0. 0 0 1 /end COMPU_METHOD
/begin COMPU_METHOD _CNV_A_R_LINEAR_____115_CM "" RAT_FUNC "%6.3" "ms" COEFFS 0 250. 32768. 0 0 1 /end COMPU_METHOD
/begin COMPU_METHOD _CNV_A_R_LINEAR_____116_CM "" RAT_FUNC "%6.3" "hPa" COEFFS 0 1.466461170408539e-003 0. 0 0 1 /end COMPU_METHOD
/begin COMPU_METHOD _CNV_A_R_LINEAR_____144_CM "" RAT_FUNC "%6.3" "%" COEFFS 0 655.3600000071681 0. 0 0 1 /end COMPU_METHOD
/begin COMPU_METHOD _CNV_A_R_LINEAR_____146_CM "" RAT_FUNC "%6.3" "[-]" COEFFS 0 1024.000014000427 16384.00022400684 0 0 1 /end COMPU_METHOD
/begin COMPU_METHOD _CNV_A_R_LINEAR_____149_CM "" RAT_FUNC "%6.3" "%" COEFFS 0 655.3600000071681 3.584063961170614e-007 0 0 1 /end COMPU_METHOD
/begin COMPU_METHOD _CNV_A_R_LINEAR_____150_CM "" RAT_FUNC "%6.3" "s" COEFFS 0 50. 0. 0 0 1 /end COMPU_METHOD
/begin COMPU_METHOD _CNV_A_R_LINEAR_____156_CM "" RAT_FUNC "%6.3" "ms/(mg/stk)" COEFFS 0 173625.6457808981 0. 0 0 1 /end COMPU_METHOD
/begin COMPU_METHOD _CNV_A_R_LINEAR_____163_CM "" RAT_FUNC "%6.3" "ohm" COEFFS 0 1. 0. 0 0 1 /end COMPU_METHOD
/begin COMPU_METHOD _CNV_A_R_LINEAR_____181_CM "" RAT_FUNC "%6.3" "-" COEFFS 0 2048. 0. 0 0 1 /end COMPU_METHOD
/begin COMPU_METHOD _CNV_A_R_LINEAR_____185_CM "" RAT_FUNC "%6.3" "-" COEFFS 0 16383.75 32767.5 0 0 1 /end COMPU_METHOD
/begin COMPU_METHOD _CNV_A_R_LINEAR_____186_CM "" RAT_FUNC "%6.3" "-" COEFFS 0 16383.99985599781 0. 0 0 1 /end COMPU_METHOD
/begin COMPU_METHOD _CNV_A_R_LINEAR_____191_CM "" RAT_FUNC "%6.3" "-" COEFFS 0 4095.999999839998 0. 0 0 1 /end COMPU_METHOD
/begin COMPU_METHOD _CNV_A_R_LINEAR_____236_CM "" RAT_FUNC "%6.3" "g" COEFFS 0 28.8000105470398 0. 0 0 1 /end COMPU_METHOD
/begin COMPU_METHOD _CNV_A_R_LINEAR_____237_CM "" RAT_FUNC "%6.3" "V" COEFFS 0 13107. 0. 0 0 1 /end COMPU_METHOD
/begin COMPU_METHOD _CNV_A_R_LINEAR_____238_CM "" RAT_FUNC "%6.3" "kNm/s" COEFFS 0 937.5877572644921 0. 0 0 1 /end COMPU_METHOD
/begin COMPU_METHOD _CNV_A_R_LINEAR_____239_CM "" RAT_FUNC "%6.3" "-" COEFFS 0 192. 0. 0 0 1 /end COMPU_METHOD
/begin COMPU_METHOD _CNV_A_R_LINEAR_____240_CM "" RAT_FUNC "%6.3" "-" COEFFS 0 1.333170493404983 0. 0 0 1 /end COMPU_METHOD
/begin COMPU_METHOD _CNV_A_R_LINEAR_____241_CM "" RAT_FUNC "%6.3" "-" COEFFS 0 256. 0. 0 0 1 /end COMPU_METHOD
/begin COMPU_METHOD _CNV_A_R_LINEAR_____242_CM "" RAT_FUNC "%6.3" "ms" COEFFS 0 51.20321900148448 0. 0 0 1 /end COMPU_METHOD
/begin COMPU_METHOD _CNV_A_R_LINEAR_____243_CM "" RAT_FUNC "%6.3" "-" COEFFS 0 100. 0. 0 0 1 /end COMPU_METHOD
/begin COMPU_METHOD _CNV_A_R_LINEAR_____244_CM "" RAT_FUNC "%6.3" "-" COEFFS 0 64. 0. 0 0 1 /end COMPU_METHOD
/begin COMPU_METHOD _CNV_A_R_LINEAR_____245_CM "" RAT_FUNC "%6.3" "ms" COEFFS 0 51.19999998999985 32767.9999935999 0 0 1 /end COMPU_METHOD
/begin COMPU_METHOD _CNV_A_R_LINEAR_____246_CM "" RAT_FUNC "%6.3" "V" COEFFS 0 204.8979314017341 1023.5 0 0 1 /end COMPU_METHOD
/begin COMPU_METHOD _CNV_A_R_LINEAR_____247_CM "" RAT_FUNC "%6.3" "ms" COEFFS 0 51.19999999799997 -1.280015567317605e-006 0 0 1 /end COMPU_METHOD
/begin COMPU_METHOD _CNV_A_R_LINEAR_____248_CM "" RAT_FUNC "%6.3" "-" COEFFS 0 655.3600000071681 32768.00000035841 0 0 1 /end COMPU_METHOD
/begin COMPU_METHOD _CNV_A_R_LINEAR_____249_CM "" RAT_FUNC "%6.3" "ohm" COEFFS 0 6.666666666666667 0. 0 0 1 /end COMPU_METHOD
/begin COMPU_METHOD _CNV_A_R_LINEAR_____250_CM "" RAT_FUNC "%6.3" "-" COEFFS 0 1024. 0. 0 0 1 /end COMPU_METHOD
/begin COMPU_METHOD _CNV_A_R_LINEAR_____251_CM "" RAT_FUNC "%6.3" "s" COEFFS 0 1000. 0. 0 0 1 /end COMPU_METHOD
/begin COMPU_METHOD _CNV_A_R_LINEAR_____252_CM "" RAT_FUNC "%6.3" "V/10ms" COEFFS 0 13107.26214524291 0.1553631072602002 0 0 1 /end COMPU_METHOD
/begin COMPU_METHOD _CNV_A_R_LINEAR_____253_CM "" RAT_FUNC "%6.3" "1/s" COEFFS 0 255.9983911655618 0. 0 0 1 /end COMPU_METHOD
/begin COMPU_METHOD _CNV_A_R_LINEAR_____254_CM "" RAT_FUNC "%6.3" "-" COEFFS 0 32768.00003968061 32768.00003968061 0 0 1 /end COMPU_METHOD
/begin COMPU_METHOD _CNV_A_R_LINEAR_____255_CM "" RAT_FUNC "%6.3" "ohm" COEFFS 0 6.666666666666667 32768. 0 0 1 /end COMPU_METHOD
/begin COMPU_METHOD _CNV_A_R_LINEAR_____256_CM "" RAT_FUNC "%6.3" "V/10ms" COEFFS 0 13107.20001587224 0. 0 0 1 /end COMPU_METHOD
/begin COMPU_METHOD _CNV_A_R_LINEAR_____259_CM "" RAT_FUNC "%6.3" "V" COEFFS 0 9.807692307692308 -9.615384615372591e-003 0 0 1 /end COMPU_METHOD
/begin COMPU_METHOD _CNV_S_6_STATE_LSH_261_CM "" TAB_VERB "%6.3" "[-]" COMPU_TAB_REF _CNV_S_6_STATE_LSH_261 /end COMPU_METHOD
/begin COMPU_VTAB _CNV_S_6_STATE_LSH_261 "" TAB_VERB 6 0 "LSH_OFF" 1 "LSH_DELAY" 2 "PREHEATING" 3 "HEATING_GRD" 4 "HEATING" 5 "VB_PROTECTION" /end COMPU_VTAB
/begin COMPU_METHOD _CNV_S_6_STATE_LSH__263_CM "" TAB_VERB "%6.3" "[-]" COMPU_TAB_REF _CNV_S_6_STATE_LSH__263 /end COMPU_METHOD
/begin COMPU_VTAB _CNV_S_6_STATE_LSH__263 "" TAB_VERB 6 0 "LSH_OFF" 1 "LSH_POW_RISE" 2 "LSH_POW_RED" 3 "LSH_POW_FALL" 4 "LSH_POW_CTL" 5 "LSH_VB_PROT" /end COMPU_VTAB
/begin COMPU_METHOD _CNV_A_R_LINEAR_____308_CM "" RAT_FUNC "%6.3" "°CRK" COEFFS 0 -2.666666666666667 1120. 0 0 1 /end COMPU_METHOD
/begin COMPU_METHOD _CNV_A_R_LINEAR_____309_CM "" RAT_FUNC "%6.3" "°CRK" COEFFS 0 2.666666666666667 960. 0 0 1 /end COMPU_METHOD
/begin COMPU_METHOD _CNV_A_R_LINEAR_____310_CM "" RAT_FUNC "%6.3" "mg" COEFFS 0 6.25 0. 0 0 1 /end COMPU_METHOD
/begin COMPU_METHOD _CNV_A_R_LINEAR_____312_CM "" RAT_FUNC "%6.3" "-" COEFFS 0 33097.9797979798 -329.979797979795 0 0 1 /end COMPU_METHOD
/begin RECORD_LAYOUT _REC_VAL_20_u2 FNC_VALUES 1 UWORD COLUMN_DIR DIRECT /end RECORD_LAYOUT
/begin RECORD_LAYOUT _REC_VAL_20_s2 FNC_VALUES 1 SWORD COLUMN_DIR DIRECT /end RECORD_LAYOUT
/begin RECORD_LAYOUT _REC_VAL_20_u1 FNC_VALUES 1 UBYTE COLUMN_DIR DIRECT /end RECORD_LAYOUT
/begin RECORD_LAYOUT _REC_VAL_20_s1 FNC_VALUES 1 SBYTE COLUMN_DIR DIRECT /end RECORD_LAYOUT
/begin RECORD_LAYOUT _REC_AXS_20_u2 NO_AXIS_PTS_X 1 UWORD AXIS_PTS_X 2 UWORD INDEX_INCR DIRECT /end RECORD_LAYOUT
/begin RECORD_LAYOUT _REC_AXS_20_u1 NO_AXIS_PTS_X 1 UBYTE AXIS_PTS_X 2 UBYTE INDEX_INCR DIRECT /end RECORD_LAYOUT
/begin RECORD_LAYOUT _REC_CUR_20_u2_u2 FNC_VALUES 1 UWORD COLUMN_DIR DIRECT /end RECORD_LAYOUT
/begin RECORD_LAYOUT _REC_MAP_20_u1_u1_u1 FNC_VALUES 1 UBYTE COLUMN_DIR DIRECT /end RECORD_LAYOUT
/begin RECORD_LAYOUT _REC_CUR_20_u2_u1 FNC_VALUES 1 UWORD COLUMN_DIR DIRECT /end RECORD_LAYOUT
/begin RECORD_LAYOUT _REC_CUR_20_u1_u1 FNC_VALUES 1 UBYTE COLUMN_DIR DIRECT /end RECORD_LAYOUT
/begin RECORD_LAYOUT _REC_CUR_20_s2_u1 FNC_VALUES 1 SWORD COLUMN_DIR DIRECT /end RECORD_LAYOUT
/begin RECORD_LAYOUT _REC_MAP_20_u1_u2_u1 FNC_VALUES 1 UBYTE COLUMN_DIR DIRECT /end RECORD_LAYOUT
/begin RECORD_LAYOUT _REC_CUR_20_u1_u2 FNC_VALUES 1 UBYTE COLUMN_DIR DIRECT /end RECORD_LAYOUT
/begin RECORD_LAYOUT _REC_MAP_20_u1_u1_u2 FNC_VALUES 1 UBYTE COLUMN_DIR DIRECT /end RECORD_LAYOUT
/begin RECORD_LAYOUT _REC_MAP_20_u2_u1_u1 FNC_VALUES 1 UWORD COLUMN_DIR DIRECT /end RECORD_LAYOUT
/begin RECORD_LAYOUT _REC_MAP_20_u2_u2_u1 FNC_VALUES 1 UWORD COLUMN_DIR DIRECT /end RECORD_LAYOUT
/begin RECORD_LAYOUT _REC_MAP_20_u2_u1_u2 FNC_VALUES 1 UWORD COLUMN_DIR DIRECT /end RECORD_LAYOUT
/begin RECORD_LAYOUT _REC_MAP_20_u2_u2_u2 FNC_VALUES 1 UWORD COLUMN_DIR DIRECT /end RECORD_LAYOUT
/begin FUNCTION INJ_Start_injection_time_for_sta "_Start injection time for start injection amount"
 /begin DEF_CHARACTERISTIC IP_TI_ST_REST__TCO C_CYC_CAST_H_PRS IP_MFF_CST IP_MFF_DEAC_CST IP_FUP_MIN_INJ_ST C_TCO_ST_H_PRS /end DEF_CHARACTERISTIC
/end FUNCTION
/begin FUNCTION INJ_Injector_dead_time_correctio "_Injector dead time correction" /begin DEF_CHARACTERISTIC IP_TI_ADD_DLY ldp_fup_map_dif__ti_add_dly /end DEF_CHARACTERISTIC /end FUNCTION
/begin FUNCTION INJ_Cold_post_start_correction "_Cold post start correction" /begin DEF_CHARACTERISTIC IP_TI_CAST__TIA__TCO IP_TI_DEAC_CAST__CYC_CAST__TCO /end DEF_CHARACTERISTIC /end FUNCTION
/begin FUNCTION INJ_Warm_up_correction "_Warm up correction" /begin DEF_CHARACTERISTIC IP_TI_TCO_WUP__TCO__TCO_ST IP_TI_WUP__N__MAF /end DEF_CHARACTERISTIC /end FUNCTION
/begin FUNCTION INJ_Catalyst_heating_correction "_Catalyst heating correction" /begin DEF_CHARACTERISTIC IP_LAMB_ADD_AFL_CH IP_LAMB_CH_RGL IP_LAMB_CH_IS /end DEF_CHARACTERISTIC /begin OUT_MEASUREMENT LAMB_CH LAMB_AFL_CH /end OUT_MEASUREMENT /end FUNCTION
/begin FUNCTION INJ_High_torque_request_enrichme "_High torque request enrichment" /begin DEF_CHARACTERISTIC C_LAMB_FL_PAS IP_LAMB_FL__N /end DEF_CHARACTERISTIC /begin OUT_MEASUREMENT LAMB_FL /end OUT_MEASUREMENT /end FUNCTION
/begin FUNCTION INJ_Idle_speed_correction_TI_IS "_Idle speed correction TI_IS" /end FUNCTION
/begin FUNCTION INJ_Wall_film_correction_TI_ADD_ "_Wall film correction TI_ADD_WF"
 /begin DEF_CHARACTERISTIC C_FAC_WF_PUC C_SEG_CTR_WF_INI C_TI_CRLC_FAST_WF_IS IP_SEG_CTR_FAC_WF__SEG_CTR_WF IP_TI_CRLC_NEG_FAST_WF__N IP_TI_CRLC_NEG_SLOW_WF__N IP_TI_CRLC_POS_FAST_WF__N IP_TI_CRLC_POS_SLOW_WF__N IP_TI_DIF_WF_THD__TCO IP_TI_FAC_NEG_FAST_WF__N__MAF IP_TI_FAC_NEG_SLOW_WF__N__MAF IP_TI_FAC_POS_SLOW_WF__N__MAF IP_TI_FAST_WF_THD__TIB IP_TI_SLOW_WF_THD__TIB IP_TI_TCO_NEG_FAST_WF__N__TCO IP_TI_TCO_NEG_SLOW_WF__N__TCO IP_TI_TCO_POS_FAST_WF__N__TCO IP_TI_TCO_POS_SLOW_WF__N__TCO IP_TI_TCO_ST_FAC_WF__TCO_ST IP_TI_VO_FAST_WF__VO IP_TI_VO_SLOW_WF__VO C_FAC_WF_PU IP_TI_FAC_POS_FAST_WF__N__MAF /end DEF_CHARACTERISTIC
 /begin OUT_MEASUREMENT SEG_CTR_WF TIB TI_ADD_WF TI_FAST_WF_POST_THD TI_SLOW_WF_POST_THD MFF_ADD_WF MFF_ADD_REAC MFF_AD_ADD_MMV_REL_2 MFF_AD_ADD_MMV_REL_1 MFF_AD_FAC_MMV_REL_1 MFF_AD_FAC_MMV_REL_2 /end OUT_MEASUREMENT
/end FUNCTION
/begin FUNCTION INJ_Injection_time_correction_at "_Injection time correction at intercept function ID_TI_ADD_REAC_INF" /begin DEF_CHARACTERISTIC ID_TI_ADD_INF__TCO /end DEF_CHARACTERISTIC /begin OUT_MEASUREMENT TI_ADD_REAC_INF /end OUT_MEASUREMENT /end FUNCTION
/begin FUNCTION INJ_Cylinder_shut_off "_Cylinder shut off" /begin DEF_CHARACTERISTIC ID_PAT_IND__NR_PAT /end DEF_CHARACTERISTIC
 /begin OUT_MEASUREMENT LV_SCC TI_WF_COR INH_CYC_IV INH_IV_FCUT INH_IV_IGK INH_SWI_IV LV_INJ_CUT LV_IND_FCUT TI_ADD_REAC INH_IV /end OUT_MEASUREMENT
/end FUNCTION
/begin FUNCTION INJ_Injection_time_at_reactivati "_Injection time at reactivation fuel feed TI_ADD_REAC"
 /begin DEF_CHARACTERISTIC C_TI_CYCNR_PUC C_TI_DEC_REAC C_TI_DEC_RIS C_TI_INC_REAC ID_TI_ADD_RAE__TCO ID_TI_ADD_RIS__TCO ID_TI_ADD_RPL__TCO /end DEF_CHARACTERISTIC
/end FUNCTION
/begin FUNCTION INJ_Upstream_oxygen_sensor_signa "_Upstream oxygen sensor signal voltage VLS"
 /begin DEF_CHARACTERISTIC C_T_VLS_FL C_VLS_CUR_ON_MIN C_TEMP_MIN_LS_UP C_R_MIN_LS_READY C_VLS_AFL_MAX_DIAG C_VLS_AFR_MIN_DIAG C_VLS_AFR_READY C_VLS_AFL_READY C_VLS_AFL C_VLS_AFR C_VLS_CRLC C_VLS_INI_MAX C_VLS_MMV_HYS C_VLS_INI_MIN C_VLS_CRLC_OFF C_CTR_VLS_UP_AFL_CYC_MIN IP_T_AFL_LOCK C_T_CUR_DLY_LS_UP C_T_CUR_ON_LS_UP C_T_CUR_OFF_LS_UP C_VLS_MMV_MIN_RNG_TOL_LS_UP C_VLS_MMV_MIN_RNG_BOL_LS_UP C_DRV1_VLS_UP_MMV_THD_MIN C_DRV1_VLS_UP_MMV_THD_MAX C_FAC_STK_DRV1_VLS_UP_MMV C_FAC_DRV1_VLS_UP_MMV_MIN C_CTR_VLS_AFL_CYC_R_UP_LS C_MAF_KGH_R_UP_LS C_FAC_ERR_POS_R_UP_LS C_FAC_ERR_NEG_R_UP_LS C_CRLC_TTIP_FALL_R_UP_LS C_CRLC_TTIP_RISE_R_UP_LS C_VLS_UP_MMV_HYS_MIN ID_T_DLY_LS_READY C_DRV1_VLS_UP_ABS_MAX C_T_MIN_LS C_FAC_VLS_UP_MMV_HYS /end DEF_CHARACTERISTIC
 /begin OUT_MEASUREMENT LV_DLY_LS_READY LV_T_MIN_LS LV_AFL_1 LV_UP_LS_1 LV_UP_LS_CDN_1 LV_VLS_UP_MMV_LMT_1 LV_VLS_UP_MMV_STK_VLD_1 CTR_VLS_AFL_CYC_1 DRV1_VLS_UP_ABS_MAX_1 DRV1_VLS_UP_MMV_1 DRV1_VLS_UP_MMV_MIN_1 T_AFL_LOCK_1 T_VLS_CYC_AFL_1 T_VLS_CYC_AFL_HLD_1 T_VLS_CYC_AFR_1 VLS_BOL_1 VLS_MMV_MAX_1 VLS_MMV_MIN_1 VLS_TOL_1 LV_AFL_2 LV_UP_LS_2 LV_UP_LS_CDN_2 LV_VLS_UP_MMV_LMT_2 LV_VLS_UP_MMV_STK_VLD_2 CTR_VLS_AFL_CYC_2 DRV1_VLS_UP_ABS_MAX_2 DRV1_VLS_UP_MMV_2 DRV1_VLS_UP_MMV_MIN_2 T_AFL_LOCK_2 T_VLS_CYC_AFL_2 T_VLS_CYC_AFL_HLD_2 T_VLS_CYC_AFR_2 VLS_BOL_2 VLS_MMV_MAX_2 VLS_MMV_MIN_2 VLS_TOL_2 /end OUT_MEASUREMENT
/end FUNCTION
/begin FUNCTION INJ_Upstream_oxygen_sensor_heate "_Upstream oxygen sensor heater managment LSH"
 /begin DEF_CHARACTERISTIC C_LSHPWM_AS C_V_EFC_LSH_UP_MAX C_V_EFC_LSH_UP_PROT C_T_LSH_UP_TOL C_T_LSH_UP_LIM C_V_EFC_LSH_UP_LIM C_VB_PROT_MAX C_T_LSH_RISE C_INC_V_EFC C_T_LSH_TEMP_THD C_DEC_V_EFC IP_V_EFC_LSH_UP_CTL C_V_EFC_RED IP_TEMP_LS_INI IP_V_EFC_LSH_UP_INI IP_FAC_V_EFC_TEG C_V_EFC_LSH_UP_TOL C_FAC_V_EFC_LSH_UP_AS C_T_LSHPWM_UP_FAST_VB_COR C_V_EFC_LSH_UP_AS C_V_EFC_LSH_UP_STEP /end DEF_CHARACTERISTIC
 /begin OUT_MEASUREMENT LV_INH_LSH_UP_1 LV_INH_LSH_UP_2 STATE_LSH_UP_1 LSHPWM_UP_1 T_LSH_UP_1 V_EFC_LSH_UP_1 T_LSH_UP_TOL_1 T_LSH_UP_LIM_1 STATE_LSH_UP_2 LSHPWM_UP_2 T_LSH_UP_2 V_EFC_LSH_UP_2 T_LSH_UP_TOL_2 T_LSH_UP_LIM_2 /end OUT_MEASUREMENT
/end FUNCTION
/begin FUNCTION INJ_Exhaust_gas_temperature_mode "_Exhaust gas temperature model and dew-point recognition"
 /begin DEF_CHARACTERISTIC IP_INT_TEG_MAF_THD__TCO_ST__TIA IP_FAC_IGA__EFF_IGA_AV ID_FAC_CTR_COLD_ST__CTR_COLD_ST IP_ADD_TEG_IGA__POW_DIF ID_FAC_SCC_TEG__NR_PAT IP_ADD_TEG_STAT_SCC__MAF_KGH IP_FAC_VS_TEG__VS ID_CRLC_TEG_INC__MAF_KGH ID_CRLC_TEG_DEC__MAF_KGH C_TEG_STAT_MIN C_CRLC_TEG_DEC_PU IP_FAC_LAM_TEG__LAMB_SP IP_TEG__N32__MAF /end DEF_CHARACTERISTIC
 /begin OUT_MEASUREMENT TEG_STAT INT_TEG_MAF LV_TEG_MIN_THD CTR_COLD_ST TEG_DYN /end OUT_MEASUREMENT
/end FUNCTION
/begin FUNCTION INJ_Lambda_control_A_F_Feedback_ "_Lambda control A/F Feedback Loop"
 /begin DEF_CHARACTERISTIC C_LAM_N_MIN ID_TCO_LAM_MIN_IS__TCO_ST ID_TCO_LAM_MIN__TCO_ST /end DEF_CHARACTERISTIC
 /begin OUT_MEASUREMENT LV_LAM_TCO_LSCL LV_LSCL_1 LV_LSCL_CAT_PURGE_1 LV_LSCL_2 LV_LSCL_CAT_PURGE_2 /end OUT_MEASUREMENT
/end FUNCTION
/begin FUNCTION INJ_Lambda_control_correction_TI "_Lambda control correction TI_LAM"
 /begin DEF_CHARACTERISTIC C_LAM_FAC_I C_LAM_FAC_P C_LAM_NEG_I_IS C_LAM_POS_I_IS C_LAM_NEG_P_IS C_LAM_POS_P_IS C_LAM_SUM_P_IS C_T_LAM_DLY_NEG_IS C_T_LAM_DLY_POS_IS C_LAM_CYCNR IP_LAM_NEG_I__N__MAF IP_LAM_POS_P__N__MAF IP_LAM_POS_I__N__MAF IP_LAM_NEG_P__N__MAF IP_T_LAM_DLY_NEG__N__MAF IP_T_LAM_DLY_POS__N__MAF C_LAM_INI_MIN C_LAM_MIN C_LAM_MAX C_LAM_INI_MAX C_LAM_MV_LPF_CRLC C_LAM_MV_DYW C_MAF_DYW C_N_DYW /end DEF_CHARACTERISTIC
 /begin OUT_MEASUREMENT LV_N_MAF_DYW LV_LAM_DYW_1 LV_LAM_LIM_MAX_1 LV_LAM_LIM_MIN_1 LAM_1 LAM_MV_1 LAM_MV_DYW_1 LAM_MV_LPF_1 LAM_P_CTR_1 MAF_DYW_1 N_DYW_1 T_LAM_DLY_NEG_1 T_LAM_DLY_POS_1 TI_LAM_1 TI_LAM_MAX_1 TI_LAM_MIN_1 LV_LAM_DYW_2 LV_LAM_LIM_MAX_2 LV_LAM_LIM_MIN_2 LAM_2 LAM_MV_2 LAM_MV_DYW_2 LAM_MV_LPF_2 LAM_P_CTR_2 MAF_DYW_2 N_DYW_2 T_LAM_DLY_NEG_2 T_LAM_DLY_POS_2 TI_LAM_2 TI_LAM_MAX_2 TI_LAM_MIN_2 /end OUT_MEASUREMENT
/end FUNCTION
/begin FUNCTION INJ_Lambda_adaption_TI_AD_ADD_MM "_Lambda adaption TI_AD_ADD_MMV_i, TI_AD_FAC_MMV_i"
 /begin DEF_CHARACTERISTIC C_TI_AD_ADD_MAX C_TI_AD_ADD_MIN C_TI_AD_FAC_MAX C_TI_AD_FAC_MIN C_TI_N_AD_FAC_MIN C_TI_AD_COR_CRLC_IS C_TI_AD_COR_CRLC C_TI_N_AD_ADD_MAX C_LAM_AD_SUM_P C_LAM_AD_SUM_P_IS C_TI_MAF_AD_FAC_MIN C_TI_MAF_AD_ADD_MAX ID_TI_AD_ADD__N IP_TI_AD_ADD_FAC__TCO__TI_ADD ID_TI_AD_FAC__N IP_TI_AD_FAC_FAC__TCO__TI_FAC IP_TI_MAF_AD_MAX__N IP_TI_MAF_AD_MIN__N /end DEF_CHARACTERISTIC
 /begin OUT_MEASUREMENT TI_AD_ADD_MMV_1 TI_AD_ADD_MMV_REL_1 TI_AD_ADD_MMV_REL_QUO_1 TI_AD_FAC_MMV_1 TI_AD_FAC_MMV_REL_1 TI_AD_ADD_MMV_2 TI_AD_ADD_MMV_REL_2 TI_AD_ADD_MMV_REL_QUO_2 TI_AD_FAC_MMV_2 TI_AD_FAC_MMV_REL_2 /end OUT_MEASUREMENT
/end FUNCTION
/begin FUNCTION INJ_Application_incidence_for_th "_Application incidence for the lambda adaption" /begin DEF_CHARACTERISTIC C_TI_MAF_AD_MAX C_TI_TIA_AD_MAX C_TI_TCO_AD_MIN /end DEF_CHARACTERISTIC /begin OUT_MEASUREMENT LV_TI_AD_ACT_1 LV_TI_AD_ACT_2 /end OUT_MEASUREMENT /end FUNCTION
/begin FUNCTION INJ_Downstream_fuel_trim_regulat "_Downstream fuel trim regulation by LAM - P - Jump delay time"
 /begin DEF_CHARACTERISTIC C_CAT_DIAG_MAX_DLY C_MAF_INT_MIN_DLY C_MAF_INT_MIN_DLY_PUC C_LAM_TEMP_MIN_CAT_DLY IP_VLS_SP_DLY__N__MAF C_N_LAM_DLY_P_MAX C_N_LAM_DLY_P_MIN C_MAF_LAM_DLY_P_MAX C_MAF_LAM_DLY_P_MIN IP_T_DLY_P__VLS_DIF_DLY IP_FAC_DLY_P__MAF_KGH IP_FAC_CAT_DLY__CAT_DIAG IP_MAF_LAM_DLY_I_MAX__N IP_MAF_LAM_DLY_I_MIN__N C_T_DLY_I_MIN IP_FAC_LAM_DLY__N__MAF IP_CRLC_DLY_I__MAF_KGH C_T_DLY_I_MAX IP_T_DLY_I__VLS_DIF_DLY C_CRLC_DLY_AD /end DEF_CHARACTERISTIC
 /begin OUT_MEASUREMENT LV_INH_LAM_DLY_1 LV_LAM_DLY_ACT_1 FAC_CAT_DLY_1 T_DLY_I_1 T_DLY_I_AD_1 T_DLY_P_1 T_LAM_DLY_1 VLS_DIF_DLY_1 LV_INH_LAM_DLY_2 LV_LAM_DLY_ACT_2 FAC_CAT_DLY_2 T_DLY_I_2 T_DLY_I_AD_2 T_DLY_P_2 T_LAM_DLY_2 VLS_DIF_DLY_2 /end OUT_MEASUREMENT
/end FUNCTION
/begin FUNCTION INJ_Detection_of_limited_dynamic "_Detection of limited dynamic condition for dynamic fuel trim"
 /begin DEF_CHARACTERISTIC C_MAF_INT_MIN_LDC_DLY C_TPS_GRD_DEC_DLY_SUM C_TPS_GRD_SUM_DLY_MIN C_TPS_GRD_SUM_DLY_MAX C_TPS_GRD_DEC_DLY C_LAM_MV_DYW_DLY C_MAF_DYW_DLY C_N_DYW_DLY C_LAM_MV_CRLC_DLY C_MAF_CRLC_DLY C_N_CRLC_DLY /end DEF_CHARACTERISTIC
 /begin OUT_MEASUREMENT N_MMV_DLY MAF_MMV_DLY LV_LDC_DLY_1 LAM_MV_MMV_DLY_1 MAF_INT_LDC_DLY_1 TPS_GRD_SUM_DLY_1 LV_LDC_DLY_2 LAM_MV_MMV_DLY_2 MAF_INT_LDC_DLY_2 TPS_GRD_SUM_DLY_2 /end OUT_MEASUREMENT
/end FUNCTION
/begin FUNCTION INJ_Downstream_oxygen_sensor_sig "_Downstream oxygen sensor signal voltage"
 /begin DEF_CHARACTERISTIC C_TEMP_CAT_DOWN_LS_READY C_VLS_DIF_DOWN C_VLS_DOWN_MMV_HYS_MIN C_VLS_DOWN_INI_MIN C_VLS_DOWN_INI_MAX C_VLS_DOWN_CRLC C_VLS_DOWN_CRLC_OFF C_T_DLY_PUC_END_VLS_DOWN C_FAC_VLS_DOWN_MMV_HYS /end DEF_CHARACTERISTIC
 /begin OUT_MEASUREMENT LV_DOWN_LS_1 LV_VLS_DOWN_MMV_ACT_1 LV_VLS_DOWN_MMV_LMT_1 DRV1_VLS_DOWN_ABS_MAX_1 DRV1_VLS_DOWN_MMV_1 DRV1_VLS_DOWN_MMV_MIN_1 VLS_DOWN_BOL_1 VLS_DOWN_MMV_HYS_1 VLS_DOWN_MMV_MAX_1 VLS_DOWN_MMV_MIN_1 VLS_DOWN_TOL_1 LV_INH_R_DOWN_LS_1 R_DOWN_LS_1 VLS_UP_MMV_HYS_1 LV_DOWN_LS_1 LV_VLS_DOWN_MMV_ACT_1 LV_VLS_DOWN_MMV_LMT_1 DRV1_VLS_DOWN_ABS_MAX_2 DRV1_VLS_DOWN_MMV_2 DRV1_VLS_DOWN_MMV_MIN_2 VLS_DOWN_BOL_2 VLS_DOWN_MMV_HYS_2 VLS_DOWN_MMV_MAX_2 VLS_DOWN_MMV_MIN_2 VLS_DOWN_TOL_2 LV_INH_R_DOWN_LS_2 R_DOWN_LS_2 VLS_UP_MMV_HYS_2 /end OUT_MEASUREMENT
/end FUNCTION
/begin FUNCTION INJ_Downstream_oxygen_sensor_hea "_Downstream oxygen sensor heater managment LSH_DOWN"
 /begin DEF_CHARACTERISTIC C_T_LSHPWM_DOWN_LIM_MAX C_T_LSH_DOWN_PREV_MAX C_FAC_LSHPWM_DOWN_I_MIN C_FAC_LSHPWM_DOWN_I_MAX C_LSHPWM_DOWN_PREV_3 C_TEMP_CAT_LSH_DOWN C_R_DOWN_MIN_PREV C_T_LSH_DOWN_PREV_1 C_VB_LSH_MAX C_T_LSH_DOWN_PREV_2 C_LSH_DOWN_LGRD C_T_LSH_DOWN_PREV_3 C_R_DOWN_SP_LS C_LSHPWM_DOWN_PREV_1 C_LSHPWM_DOWN_MIN C_LSHPWM_DOWN_PREV_2 IP_LSHPWM_DOWN__N__MAF C_LSHPWM_DOWN_AS_1 C_LSHPWM_DOWN_AS_2 IP_LSHPWM_I__R_DIF_DOWN_LS /end DEF_CHARACTERISTIC
 /begin OUT_MEASUREMENT FAC_LSHPWM_DOWN_CTL_1 LSHPWM_DOWN_1 R_DIF_DOWN_LS_1 STATE_LSH_DOWN_1 T_LSH_DOWN_PREV_1 T_LSHPWM_DOWN_LIM_1 FAC_LSHPWM_DOWN_CTL_2 LSHPWM_DOWN_2 R_DIF_DOWN_LS_2 STATE_LSH_DOWN_2 T_LSH_DOWN_PREV_2 T_LSHPWM_DOWN_LIM_2 /end OUT_MEASUREMENT
/end FUNCTION
/begin FUNCTION INJ_Injection_fuel_setpoint_for_ "_Injection fuel setpoint for homogeneous mode"
 /begin DEF_CHARACTERISTIC C_MFF_SP_MAN C_MFF_SP_HOM_OFS_AS C_MFF_FAC IP_MFF_LGRD_AST IP_MFF_COR_2 IP_MFF_COR_1 LC_MFF_SP_HOM_MAN_ACT /end DEF_CHARACTERISTIC
 /begin OUT_MEASUREMENT TI_ADD_DLY TI_WUP TI_CAST LV_ST_H_PRS TI_ST_REST TI_ST_AMP MFF_CST MFF_SP_HOM_2 MFF_BAS MFF_SP_CLC_1 MFF_SP_CLC_2 LV_MFF_CST_FUP_ACT MFF_SP_HOM_1 MFF_SP_HOM_ENG_1 MFF_SP_HOM_ENG_2 CYC_CAST_FUP_THD CYC_CAST LV_AST_END MAF_INT_DLY_1 MAF_INT_DLY_2 /end OUT_MEASUREMENT
/end FUNCTION
/begin FUNCTION INJ_Injection_pressure_correctio "_Injection pressure correction"
 /begin DEF_CHARACTERISTIC C_TI_HOM_MAN LC_TI_HOM_MAN_ACT C_FAC_MFF_TI_STND IP_PRS_INC_CMP IP_FAC_TI_PRS /end DEF_CHARACTERISTIC
 /begin OUT_MEASUREMENT TI_HOM_2 TI_HOM_1 LV_TI_LIM_MIN FAC_TI_PRS_1 FAC_TI_PRS_2 PRS_INJ_MV_1 PRS_INJ_MV_2 PRS_DEC_INJ_1 PRS_DEC_INJ_2 TI_STND_HOM_1 TI_STND_HOM_2 TI_HOM_CLC_1 TI_HOM_CLC_2 CRK_INJ_1 CRK_INJ_2 /end OUT_MEASUREMENT
/end FUNCTION
/begin FUNCTION INJ_Lambda_coordination "_Lambda coordination"
 /begin DEF_CHARACTERISTIC C_LAMB_BAS_COR_MIN C_LAMB_SP_1_HYS C_LAMB_SA_CH_HYS C_LAMB_SP_OFS_AS LC_LAMB_SP_MAN_ACT C_LAMB_SP_MAN /end DEF_CHARACTERISTIC
 /begin OUT_MEASUREMENT LAMB_SP_2 LAMB_BAS_COR_2 LAMB_BAS_COR_1 LAMB_BAS_COR_1_1 LAMB_BAS_COR_1_2 LAMB_SP_1 LAMB_SP_BAS_1 LAMB_SP_BAS_2 LV_LAMB_SP_1_1 LV_LAMB_SP_1_2 LV_LAMB_SP_CH_1 LV_LAMB_SP_CH_2 LAMB_SP /end OUT_MEASUREMENT
/end FUNCTION
/begin FUNCTION INJ_Lambda_Catalyst_overheating_ "_Lambda Catalyst overheating prevention"
 /begin DEF_CHARACTERISTIC C_LAMB_COP_MIN C_TEG_COP_BOL C_LAMB_COP_PAS C_LAMB_COP_I C_TEG_COP_SP /end DEF_CHARACTERISTIC
 /begin OUT_MEASUREMENT LAMB_COP TEG_COP_DIF LV_LAMB_COP /end OUT_MEASUREMENT
/end FUNCTION
/begin FUNCTION INJ_Conversion_MFF_to_TI "_Conversion MFF to TI" /begin DEF_CHARACTERISTIC C_FAC_MFF_TI_STND_2 /end DEF_CHARACTERISTIC /end FUNCTION
/begin FUNCTION INJ_Basic_lambda_setpoint "_Basic lambda setpoint"
 /begin DEF_CHARACTERISTIC IP_LAMB_LAMB_WUP IP_LAMB_BAS_WUP_COR IP_LAMB_HOM_AFL IP_LAMB_AFL_1 IP_LAMB_BAS /end DEF_CHARACTERISTIC
 /begin OUT_MEASUREMENT LAMB_HOM_AFS LAMB_HOM_AFL LAMB_AFL_1 LAMB_BAS LAMB_BAS_COR /end OUT_MEASUREMENT
/end FUNCTION
/begin FUNCTION INJ_Ambient_pressure_correction "_Ambient pressure correction" /begin DEF_CHARACTERISTIC IP_TI_ST_AMP_FAC__AMP /end DEF_CHARACTERISTIC /end FUNCTION
/begin FUNCTION INJ_Injection_phase_for_stratifi "_Injection phase for stratified mode" /begin DEF_CHARACTERISTIC IP_EOI_DIF_S C_EOI_S_AS C_EOI_S_MAN LC_EOI_S_MAN_ACT /end DEF_CHARACTERISTIC
 /begin OUT_MEASUREMENT EOI_S_0 EOI_S_1 EOI_S_2 EOI_S_3 EOI_S_4 EOI_S_5 EOI_S_CLC_0 EOI_S_CLC_1 EOI_S_CLC_2 EOI_S_CLC_3 EOI_S_CLC_4 EOI_S_CLC_5 EOI_DIF_S /end OUT_MEASUREMENT
/end FUNCTION
/begin FUNCTION INJ_Lambda_setpoint_for_catalyst "_Lambda setpoint for catalyst regeneration"
 /begin DEF_CHARACTERISTIC C_LAMB_RGN_PAS C_LAMB_RGN_MAX C_T_RGN_LAMB_CON LC_LAMB_RGN_FAC_SENS IP_LAMB_RGN_AFR__MAF__N_32 IP_LAMB_RGN_FAC_SENS IP_LAMB_RGN_FAC_MDL /end DEF_CHARACTERISTIC
 /begin OUT_MEASUREMENT T_RGN LV_LAMB_RGN_FAC_SENS LAMB_RGN_1 LAMB_RGN_2 /end OUT_MEASUREMENT
/end FUNCTION
/begin FUNCTION INJ_Injection_press_correction_s "_Injection press correction stratified" /begin DEF_CHARACTERISTIC LC_TI_S_MAN_ACT C_TI_S_MAN C_TI_MIN_THD C_TI_MIN /end DEF_CHARACTERISTIC
 /begin OUT_MEASUREMENT FAC_TI_PRS_S PRS_INJ_MV_S CRK_INJ_S PRS_DEC_INJ_S TI_STND_S TI_S_CLC TI_S_1 LV_TI_S_LIM_MIN /end OUT_MEASUREMENT
/end FUNCTION
/begin FUNCTION INJ_Injection_setpoint_for_strat "_Injection setpoint for stratified mode"
 /begin DEF_CHARACTERISTIC IP_MFF_SP_S LC_TQI_SP_MFF_MAN_ACT C_TQI_SP_MFF_MAN LC_MFF_SP_S_MAN_ACT C_MFF_SP_S_MAN C_MFF_SP_S_OFS_AS /end DEF_CHARACTERISTIC
/end FUNCTION
/begin FUNCTION INJ_Mass_Fuel_Flow_Setpoint_for_ "_Mass Fuel Flow Setpoint for Stratified Mode"
 /begin OUT_MEASUREMENT TQI_SP_MFF TQI_SP_MFF_1 MFF_SP_S_1 MFF_SP_S MFF_SP_S_ENG EFF_TOT_BAS_S /end OUT_MEASUREMENT
/end FUNCTION
/begin FUNCTION INJ_NOx_catalyst_management_cata "_NOx catalyst management-catalyst states" /end FUNCTION
/begin FUNCTION INJ_NOx_catalyst_management_requ "_NOx catalyst management-request coordination" /end FUNCTION
/begin FUNCTION INJ_NOx_engine_out_emission_homo "_NOx engine out emission homogeneous mode" /end FUNCTION
/begin FUNCTION INJ_LAMB_RATIO_calculation "_LAMB_RATIO calculation" /begin DEF_CHARACTERISTIC IP_LAMB_IGA_AFL__N_32__MAF_HB C_LAMB_IGA_AFR /end DEF_CHARACTERISTIC /begin OUT_MEASUREMENT LAMB_RATIO /end OUT_MEASUREMENT /end FUNCTION
/begin FUNCTION INJ_NOx_engine_out_emission_stra "_NOx engine out emission stratified mode" /end FUNCTION
/begin FUNCTION INJ_Catalyst_heating_with_second "_Catalyst heating with secondary air" /begin DEF_CHARACTERISTIC IP_LAMB_SAWUP IP_LAMB_SAWUP_IS IP_LAMB_ADD_SAWUP /end DEF_CHARACTERISTIC /begin OUT_MEASUREMENT LAMB_SAWUP FAC_LAMB_DE_SA LAMB_SA_CH /end OUT_MEASUREMENT /end FUNCTION
/begin FUNCTION INJ_Injection_Time_Correction_by "_Injection Time Correction by the Application System"
 /begin DEF_CHARACTERISTIC C_TI_AS C_TI_AS_CYL_0 C_TI_AS_CYL_1 C_TI_AS_CYL_2 C_TI_AS_CYL_3 C_TI_AS_CYL_4 C_TI_AS_CYL_5 /end DEF_CHARACTERISTIC
 /begin OUT_MEASUREMENT BIOS_TI_0 BIOS_TI_1 BIOS_TI_2 BIOS_TI_3 BIOS_TI_4 BIOS_TI_5 INJ_HOM_REQ /end OUT_MEASUREMENT
/end FUNCTION
/end MODULE
/end PROJECT
