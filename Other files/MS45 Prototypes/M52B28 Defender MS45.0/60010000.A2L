ASAP2_VERSION 1 31
/begin PROJECT MS45 "Rover Motorsteuerung V6"
/begin HEADER "_default_HeaderComment" PROJECT_NO _50 /end HEADER
/begin MODULE _default_ModuleName "_default_ModuleLongIdentifier"
/begin MOD_COMMON "_default_ModCommonComment" DEPOSIT ABSOLUTE BYTE_ORDER MSB_FIRST ALIGNMENT_BYTE 1 ALIGNMENT_WORD 2 ALIGNMENT_LONG 4 ALIGNMENT_FLOAT32_IEEE 4 ALIGNMENT_FLOAT64_IEEE 8 /end MOD_COMMON
/begin CHARACTERISTIC ID_ERR_DTC_TEG_PCAT_DOWN_1 "" CURVE 0x60184 _REC_CUR_20_u2_u2 65535. _CNV_A_R_LINEAR_____17_CM 0. 65535. FORMAT "%5.0"
 /begin AXIS_DESCR COM_AXIS ONLINE_DUMMY _CNV_S_6_RANGE_FMY__320_CM 6 0. 5. AXIS_PTS_REF ldp_fmy_dtc /end AXIS_DESCR
/end CHARACTERISTIC
/begin CHARACTERISTIC ID_ERR_ENVD_TEG_PCAT_DOWN_1 "" CURVE 0x60180 _REC_CUR_20_u1_u1 17. _CNV_S_6_RANGE_DIAG_321_CM 4. 21.
 /begin AXIS_DESCR COM_AXIS ONLINE_DUMMY _CNV_S_4_RANGE_FMY__322_CM 4 0. 3. AXIS_PTS_REF ldp_fmy_envd /end AXIS_DESCR
/end CHARACTERISTIC
/begin CHARACTERISTIC C_DIAG_CONF_TEG_PCAT_DOWN_1 "" VALUE 0x60190 _REC_VAL_20_u1 255. _CNV_A_R_LINEAR_____13_CM 0. 255. FORMAT "%3.0" /end CHARACTERISTIC
/begin CHARACTERISTIC C_DC_INC_TEG_PCAT_DOWN_1 "" VALUE 0x60191 _REC_VAL_20_u1 255. _CNV_A_R_LINEAR_____13_CM 0. 255. FORMAT "%3.0" /end CHARACTERISTIC
/begin CHARACTERISTIC C_DC_MAX_TEG_PCAT_DOWN_1 "" VALUE 0x60193 _REC_VAL_20_u1 255. _CNV_A_R_LINEAR_____13_CM 0. 255. FORMAT "%3.0" /end CHARACTERISTIC
/begin CHARACTERISTIC C_DC_DEC_TEG_PCAT_DOWN_1 "" VALUE 0x60192 _REC_VAL_20_u1 255. _CNV_A_R_LINEAR_____13_CM 0. 255. FORMAT "%3.0" /end CHARACTERISTIC
/begin CHARACTERISTIC ID_ERR_DTC_TEG_PCAT_DOWN_2 "" CURVE 0x60198 _REC_CUR_20_u2_u2 65535. _CNV_A_R_LINEAR_____17_CM 0. 65535. FORMAT "%5.0"
 /begin AXIS_DESCR COM_AXIS ONLINE_DUMMY _CNV_S_6_RANGE_FMY__320_CM 6 0. 5. AXIS_PTS_REF ldp_fmy_dtc /end AXIS_DESCR
/end CHARACTERISTIC
/begin CHARACTERISTIC ID_ERR_ENVD_TEG_PCAT_DOWN_2 "" CURVE 0x60194 _REC_CUR_20_u1_u1 17. _CNV_S_6_RANGE_DIAG_321_CM 4. 21.
 /begin AXIS_DESCR COM_AXIS ONLINE_DUMMY _CNV_S_4_RANGE_FMY__322_CM 4 0. 3. AXIS_PTS_REF ldp_fmy_envd /end AXIS_DESCR
/end CHARACTERISTIC
/begin CHARACTERISTIC C_DIAG_CONF_TEG_PCAT_DOWN_2 "" VALUE 0x601a4 _REC_VAL_20_u1 255. _CNV_A_R_LINEAR_____13_CM 0. 255. FORMAT "%3.0" /end CHARACTERISTIC
/begin CHARACTERISTIC C_DC_INC_TEG_PCAT_DOWN_2 "" VALUE 0x601a5 _REC_VAL_20_u1 255. _CNV_A_R_LINEAR_____13_CM 0. 255. FORMAT "%3.0" /end CHARACTERISTIC
/begin CHARACTERISTIC C_DC_MAX_TEG_PCAT_DOWN_2 "" VALUE 0x601a7 _REC_VAL_20_u1 255. _CNV_A_R_LINEAR_____13_CM 0. 255. FORMAT "%3.0" /end CHARACTERISTIC
/begin CHARACTERISTIC C_DC_DEC_TEG_PCAT_DOWN_2 "" VALUE 0x601a6 _REC_VAL_20_u1 255. _CNV_A_R_LINEAR_____13_CM 0. 255. FORMAT "%3.0" /end CHARACTERISTIC
/begin CHARACTERISTIC ID_ERR_DTC_TOIL "" CURVE 0x601ac _REC_CUR_20_u2_u2 65535. _CNV_A_R_LINEAR_____17_CM 0. 65535. FORMAT "%5.0"
 /begin AXIS_DESCR COM_AXIS ONLINE_DUMMY _CNV_S_6_RANGE_FMY__320_CM 6 0. 5. AXIS_PTS_REF ldp_fmy_dtc /end AXIS_DESCR
/end CHARACTERISTIC
/begin CHARACTERISTIC ID_ERR_ENVD_TOIL "" CURVE 0x601a8 _REC_CUR_20_u1_u1 17. _CNV_S_6_RANGE_DIAG_321_CM 4. 21.
 /begin AXIS_DESCR COM_AXIS ONLINE_DUMMY _CNV_S_4_RANGE_FMY__322_CM 4 0. 3. AXIS_PTS_REF ldp_fmy_envd /end AXIS_DESCR
/end CHARACTERISTIC
/begin CHARACTERISTIC C_DIAG_CONF_TOIL "" VALUE 0x601b8 _REC_VAL_20_u1 255. _CNV_A_R_LINEAR_____13_CM 0. 255. FORMAT "%3.0" /end CHARACTERISTIC
/begin CHARACTERISTIC C_DC_INC_TOIL "" VALUE 0x601b9 _REC_VAL_20_u1 255. _CNV_A_R_LINEAR_____13_CM 0. 255. FORMAT "%3.0" /end CHARACTERISTIC
/begin CHARACTERISTIC C_DC_MAX_TOIL "" VALUE 0x601bb _REC_VAL_20_u1 255. _CNV_A_R_LINEAR_____13_CM 0. 255. FORMAT "%3.0" /end CHARACTERISTIC
/begin CHARACTERISTIC C_DC_DEC_TOIL "" VALUE 0x601ba _REC_VAL_20_u1 255. _CNV_A_R_LINEAR_____13_CM 0. 255. FORMAT "%3.0" /end CHARACTERISTIC
/begin CHARACTERISTIC ID_ERR_DTC_TCO_EX "" CURVE 0x601c0 _REC_CUR_20_u2_u2 65535. _CNV_A_R_LINEAR_____17_CM 0. 65535. FORMAT "%5.0"
 /begin AXIS_DESCR COM_AXIS ONLINE_DUMMY _CNV_S_6_RANGE_FMY__320_CM 6 0. 5. AXIS_PTS_REF ldp_fmy_dtc /end AXIS_DESCR
/end CHARACTERISTIC
/begin CHARACTERISTIC ID_ERR_ENVD_TCO_EX "" CURVE 0x601bc _REC_CUR_20_u1_u1 17. _CNV_S_6_RANGE_DIAG_321_CM 4. 21.
 /begin AXIS_DESCR COM_AXIS ONLINE_DUMMY _CNV_S_4_RANGE_FMY__322_CM 4 0. 3. AXIS_PTS_REF ldp_fmy_envd /end AXIS_DESCR
/end CHARACTERISTIC
/begin CHARACTERISTIC C_DIAG_CONF_TCO_EX "" VALUE 0x601cc _REC_VAL_20_u1 255. _CNV_A_R_LINEAR_____13_CM 0. 255. FORMAT "%3.0" /end CHARACTERISTIC
/begin CHARACTERISTIC C_DC_INC_TCO_EX "" VALUE 0x601cd _REC_VAL_20_u1 255. _CNV_A_R_LINEAR_____13_CM 0. 255. FORMAT "%3.0" /end CHARACTERISTIC
/begin CHARACTERISTIC C_DC_MAX_TCO_EX "" VALUE 0x601cf _REC_VAL_20_u1 255. _CNV_A_R_LINEAR_____13_CM 0. 255. FORMAT "%3.0" /end CHARACTERISTIC
/begin CHARACTERISTIC C_DC_DEC_TCO_EX "" VALUE 0x601ce _REC_VAL_20_u1 255. _CNV_A_R_LINEAR_____13_CM 0. 255. FORMAT "%3.0" /end CHARACTERISTIC
/begin CHARACTERISTIC ID_ERR_DTC_TIA "" CURVE 0x601d4 _REC_CUR_20_u2_u2 65535. _CNV_A_R_LINEAR_____17_CM 0. 65535. FORMAT "%5.0"
 /begin AXIS_DESCR COM_AXIS ONLINE_DUMMY _CNV_S_6_RANGE_FMY__320_CM 6 0. 5. AXIS_PTS_REF ldp_fmy_dtc /end AXIS_DESCR
/end CHARACTERISTIC
/begin CHARACTERISTIC ID_ERR_ENVD_TIA "" CURVE 0x601d0 _REC_CUR_20_u1_u1 17. _CNV_S_6_RANGE_DIAG_321_CM 4. 21.
 /begin AXIS_DESCR COM_AXIS ONLINE_DUMMY _CNV_S_4_RANGE_FMY__322_CM 4 0. 3. AXIS_PTS_REF ldp_fmy_envd /end AXIS_DESCR
/end CHARACTERISTIC
/begin CHARACTERISTIC C_DIAG_CONF_TIA "" VALUE 0x601e0 _REC_VAL_20_u1 255. _CNV_A_R_LINEAR_____13_CM 0. 255. FORMAT "%3.0" /end CHARACTERISTIC
/begin CHARACTERISTIC C_DC_INC_TIA "" VALUE 0x601e1 _REC_VAL_20_u1 255. _CNV_A_R_LINEAR_____13_CM 0. 255. FORMAT "%3.0" /end CHARACTERISTIC
/begin CHARACTERISTIC C_DC_MAX_TIA "" VALUE 0x601e3 _REC_VAL_20_u1 255. _CNV_A_R_LINEAR_____13_CM 0. 255. FORMAT "%3.0" /end CHARACTERISTIC
/begin CHARACTERISTIC C_DC_DEC_TIA "" VALUE 0x601e2 _REC_VAL_20_u1 255. _CNV_A_R_LINEAR_____13_CM 0. 255. FORMAT "%3.0" /end CHARACTERISTIC
/begin CHARACTERISTIC ID_ERR_DTC_AMP "" CURVE 0x601e8 _REC_CUR_20_u2_u2 65535. _CNV_A_R_LINEAR_____17_CM 0. 65535. FORMAT "%5.0"
 /begin AXIS_DESCR COM_AXIS ONLINE_DUMMY _CNV_S_6_RANGE_FMY__320_CM 6 0. 5. AXIS_PTS_REF ldp_fmy_dtc /end AXIS_DESCR
/end CHARACTERISTIC
/begin CHARACTERISTIC ID_ERR_ENVD_AMP "" CURVE 0x601e4 _REC_CUR_20_u1_u1 17. _CNV_S_6_RANGE_DIAG_321_CM 4. 21.
 /begin AXIS_DESCR COM_AXIS ONLINE_DUMMY _CNV_S_4_RANGE_FMY__322_CM 4 0. 3. AXIS_PTS_REF ldp_fmy_envd /end AXIS_DESCR
/end CHARACTERISTIC
/begin CHARACTERISTIC C_DIAG_CONF_AMP "" VALUE 0x601f4 _REC_VAL_20_u1 255. _CNV_A_R_LINEAR_____13_CM 0. 255. FORMAT "%3.0" /end CHARACTERISTIC
/begin CHARACTERISTIC C_DC_INC_AMP "" VALUE 0x601f5 _REC_VAL_20_u1 255. _CNV_A_R_LINEAR_____13_CM 0. 255. FORMAT "%3.0" /end CHARACTERISTIC
/begin CHARACTERISTIC C_DC_MAX_AMP "" VALUE 0x601f7 _REC_VAL_20_u1 255. _CNV_A_R_LINEAR_____13_CM 0. 255. FORMAT "%3.0" /end CHARACTERISTIC
/begin CHARACTERISTIC C_DC_DEC_AMP "" VALUE 0x601f6 _REC_VAL_20_u1 255. _CNV_A_R_LINEAR_____13_CM 0. 255. FORMAT "%3.0" /end CHARACTERISTIC
/begin CHARACTERISTIC ID_ERR_DTC_MAF "" CURVE 0x601fc _REC_CUR_20_u2_u2 65535. _CNV_A_R_LINEAR_____17_CM 0. 65535. FORMAT "%5.0"
 /begin AXIS_DESCR COM_AXIS ONLINE_DUMMY _CNV_S_6_RANGE_FMY__320_CM 6 0. 5. AXIS_PTS_REF ldp_fmy_dtc /end AXIS_DESCR
/end CHARACTERISTIC
/begin CHARACTERISTIC ID_ERR_ENVD_MAF "" CURVE 0x601f8 _REC_CUR_20_u1_u1 17. _CNV_S_6_RANGE_DIAG_321_CM 4. 21.
 /begin AXIS_DESCR COM_AXIS ONLINE_DUMMY _CNV_S_4_RANGE_FMY__322_CM 4 0. 3. AXIS_PTS_REF ldp_fmy_envd /end AXIS_DESCR
/end CHARACTERISTIC
/begin CHARACTERISTIC C_DIAG_CONF_MAF "" VALUE 0x60208 _REC_VAL_20_u1 255. _CNV_A_R_LINEAR_____13_CM 0. 255. FORMAT "%3.0" /end CHARACTERISTIC
/begin CHARACTERISTIC C_DC_INC_MAF "" VALUE 0x60209 _REC_VAL_20_u1 255. _CNV_A_R_LINEAR_____13_CM 0. 255. FORMAT "%3.0" /end CHARACTERISTIC
/begin CHARACTERISTIC C_DC_MAX_MAF "" VALUE 0x6020b _REC_VAL_20_u1 255. _CNV_A_R_LINEAR_____13_CM 0. 255. FORMAT "%3.0" /end CHARACTERISTIC
/begin CHARACTERISTIC C_DC_DEC_MAF "" VALUE 0x6020a _REC_VAL_20_u1 255. _CNV_A_R_LINEAR_____13_CM 0. 255. FORMAT "%3.0" /end CHARACTERISTIC
/begin CHARACTERISTIC ID_ERR_DTC_VLS_UP_SCB_1 "" CURVE 0x60210 _REC_CUR_20_u2_u2 65535. _CNV_A_R_LINEAR_____17_CM 0. 65535. FORMAT "%5.0"
 /begin AXIS_DESCR COM_AXIS ONLINE_DUMMY _CNV_S_6_RANGE_FMY__320_CM 6 0. 5. AXIS_PTS_REF ldp_fmy_dtc /end AXIS_DESCR
/end CHARACTERISTIC
/begin CHARACTERISTIC ID_ERR_ENVD_VLS_UP_SCB_1 "" CURVE 0x6020c _REC_CUR_20_u1_u1 17. _CNV_S_6_RANGE_DIAG_321_CM 4. 21.
 /begin AXIS_DESCR COM_AXIS ONLINE_DUMMY _CNV_S_4_RANGE_FMY__322_CM 4 0. 3. AXIS_PTS_REF ldp_fmy_envd /end AXIS_DESCR
/end CHARACTERISTIC
/begin CHARACTERISTIC C_DIAG_CONF_VLS_UP_SCB_1 "" VALUE 0x6021c _REC_VAL_20_u1 255. _CNV_A_R_LINEAR_____13_CM 0. 255. FORMAT "%3.0" /end CHARACTERISTIC
/begin CHARACTERISTIC C_DC_INC_VLS_UP_SCB_1 "" VALUE 0x6021d _REC_VAL_20_u1 255. _CNV_A_R_LINEAR_____13_CM 0. 255. FORMAT "%3.0" /end CHARACTERISTIC
/begin CHARACTERISTIC C_DC_MAX_VLS_UP_SCB_1 "" VALUE 0x6021f _REC_VAL_20_u1 255. _CNV_A_R_LINEAR_____13_CM 0. 255. FORMAT "%3.0" /end CHARACTERISTIC
/begin CHARACTERISTIC C_DC_DEC_VLS_UP_SCB_1 "" VALUE 0x6021e _REC_VAL_20_u1 255. _CNV_A_R_LINEAR_____13_CM 0. 255. FORMAT "%3.0" /end CHARACTERISTIC
/begin CHARACTERISTIC ID_ERR_DTC_VLS_UP_SCB_2 "" CURVE 0x60224 _REC_CUR_20_u2_u2 65535. _CNV_A_R_LINEAR_____17_CM 0. 65535. FORMAT "%5.0"
 /begin AXIS_DESCR COM_AXIS ONLINE_DUMMY _CNV_S_6_RANGE_FMY__320_CM 6 0. 5. AXIS_PTS_REF ldp_fmy_dtc /end AXIS_DESCR
/end CHARACTERISTIC
/begin CHARACTERISTIC ID_ERR_ENVD_VLS_UP_SCB_2 "" CURVE 0x60220 _REC_CUR_20_u1_u1 17. _CNV_S_6_RANGE_DIAG_321_CM 4. 21.
 /begin AXIS_DESCR COM_AXIS ONLINE_DUMMY _CNV_S_4_RANGE_FMY__322_CM 4 0. 3. AXIS_PTS_REF ldp_fmy_envd /end AXIS_DESCR
/end CHARACTERISTIC
/begin CHARACTERISTIC C_DIAG_CONF_VLS_UP_SCB_2 "" VALUE 0x60230 _REC_VAL_20_u1 255. _CNV_A_R_LINEAR_____13_CM 0. 255. FORMAT "%3.0" /end CHARACTERISTIC
/begin CHARACTERISTIC C_DC_INC_VLS_UP_SCB_2 "" VALUE 0x60231 _REC_VAL_20_u1 255. _CNV_A_R_LINEAR_____13_CM 0. 255. FORMAT "%3.0" /end CHARACTERISTIC
/begin CHARACTERISTIC C_DC_MAX_VLS_UP_SCB_2 "" VALUE 0x60233 _REC_VAL_20_u1 255. _CNV_A_R_LINEAR_____13_CM 0. 255. FORMAT "%3.0" /end CHARACTERISTIC
/begin CHARACTERISTIC C_DC_DEC_VLS_UP_SCB_2 "" VALUE 0x60232 _REC_VAL_20_u1 255. _CNV_A_R_LINEAR_____13_CM 0. 255. FORMAT "%3.0" /end CHARACTERISTIC
/begin CHARACTERISTIC ID_ERR_DTC_VLS_UP_SCG_1 "" CURVE 0x60238 _REC_CUR_20_u2_u2 65535. _CNV_A_R_LINEAR_____17_CM 0. 65535. FORMAT "%5.0"
 /begin AXIS_DESCR COM_AXIS ONLINE_DUMMY _CNV_S_6_RANGE_FMY__320_CM 6 0. 5. AXIS_PTS_REF ldp_fmy_dtc /end AXIS_DESCR
/end CHARACTERISTIC
/begin CHARACTERISTIC ID_ERR_ENVD_VLS_UP_SCG_1 "" CURVE 0x60234 _REC_CUR_20_u1_u1 17. _CNV_S_6_RANGE_DIAG_321_CM 4. 21.
 /begin AXIS_DESCR COM_AXIS ONLINE_DUMMY _CNV_S_4_RANGE_FMY__322_CM 4 0. 3. AXIS_PTS_REF ldp_fmy_envd /end AXIS_DESCR
/end CHARACTERISTIC
/begin CHARACTERISTIC C_DIAG_CONF_VLS_UP_SCG_1 "" VALUE 0x60244 _REC_VAL_20_u1 255. _CNV_A_R_LINEAR_____13_CM 0. 255. FORMAT "%3.0" /end CHARACTERISTIC
/begin CHARACTERISTIC C_DC_INC_VLS_UP_SCG_1 "" VALUE 0x60245 _REC_VAL_20_u1 255. _CNV_A_R_LINEAR_____13_CM 0. 255. FORMAT "%3.0" /end CHARACTERISTIC
/begin CHARACTERISTIC C_DC_MAX_VLS_UP_SCG_1 "" VALUE 0x60247 _REC_VAL_20_u1 255. _CNV_A_R_LINEAR_____13_CM 0. 255. FORMAT "%3.0" /end CHARACTERISTIC
/begin CHARACTERISTIC C_DC_DEC_VLS_UP_SCG_1 "" VALUE 0x60246 _REC_VAL_20_u1 255. _CNV_A_R_LINEAR_____13_CM 0. 255. FORMAT "%3.0" /end CHARACTERISTIC
/begin CHARACTERISTIC ID_ERR_DTC_VLS_UP_SCG_2 "" CURVE 0x6024c _REC_CUR_20_u2_u2 65535. _CNV_A_R_LINEAR_____17_CM 0. 65535. FORMAT "%5.0"
 /begin AXIS_DESCR COM_AXIS ONLINE_DUMMY _CNV_S_6_RANGE_FMY__320_CM 6 0. 5. AXIS_PTS_REF ldp_fmy_dtc /end AXIS_DESCR
/end CHARACTERISTIC
/begin CHARACTERISTIC ID_ERR_ENVD_VLS_UP_SCG_2 "" CURVE 0x60248 _REC_CUR_20_u1_u1 17. _CNV_S_6_RANGE_DIAG_321_CM 4. 21.
 /begin AXIS_DESCR COM_AXIS ONLINE_DUMMY _CNV_S_4_RANGE_FMY__322_CM 4 0. 3. AXIS_PTS_REF ldp_fmy_envd /end AXIS_DESCR
/end CHARACTERISTIC
/begin CHARACTERISTIC C_DIAG_CONF_VLS_UP_SCG_2 "" VALUE 0x60258 _REC_VAL_20_u1 255. _CNV_A_R_LINEAR_____13_CM 0. 255. FORMAT "%3.0" /end CHARACTERISTIC
/begin CHARACTERISTIC C_DC_INC_VLS_UP_SCG_2 "" VALUE 0x60259 _REC_VAL_20_u1 255. _CNV_A_R_LINEAR_____13_CM 0. 255. FORMAT "%3.0" /end CHARACTERISTIC
/begin CHARACTERISTIC C_DC_MAX_VLS_UP_SCG_2 "" VALUE 0x6025b _REC_VAL_20_u1 255. _CNV_A_R_LINEAR_____13_CM 0. 255. FORMAT "%3.0" /end CHARACTERISTIC
/begin CHARACTERISTIC C_DC_DEC_VLS_UP_SCG_2 "" VALUE 0x6025a _REC_VAL_20_u1 255. _CNV_A_R_LINEAR_____13_CM 0. 255. FORMAT "%3.0" /end CHARACTERISTIC
/begin CHARACTERISTIC ID_ERR_DTC_VLS_UP_OL_1 "" CURVE 0x60260 _REC_CUR_20_u2_u2 65535. _CNV_A_R_LINEAR_____17_CM 0. 65535. FORMAT "%5.0"
 /begin AXIS_DESCR COM_AXIS ONLINE_DUMMY _CNV_S_6_RANGE_FMY__320_CM 6 0. 5. AXIS_PTS_REF ldp_fmy_dtc /end AXIS_DESCR
/end CHARACTERISTIC
/begin CHARACTERISTIC ID_ERR_ENVD_VLS_UP_OL_1 "" CURVE 0x6025c _REC_CUR_20_u1_u1 17. _CNV_S_6_RANGE_DIAG_321_CM 4. 21.
 /begin AXIS_DESCR COM_AXIS ONLINE_DUMMY _CNV_S_4_RANGE_FMY__322_CM 4 0. 3. AXIS_PTS_REF ldp_fmy_envd /end AXIS_DESCR
/end CHARACTERISTIC
/begin CHARACTERISTIC C_DIAG_CONF_VLS_UP_OL_1 "" VALUE 0x6026c _REC_VAL_20_u1 255. _CNV_A_R_LINEAR_____13_CM 0. 255. FORMAT "%3.0" /end CHARACTERISTIC
/begin CHARACTERISTIC C_DC_INC_VLS_UP_OL_1 "" VALUE 0x6026d _REC_VAL_20_u1 255. _CNV_A_R_LINEAR_____13_CM 0. 255. FORMAT "%3.0" /end CHARACTERISTIC
/begin CHARACTERISTIC C_DC_MAX_VLS_UP_OL_1 "" VALUE 0x6026f _REC_VAL_20_u1 255. _CNV_A_R_LINEAR_____13_CM 0. 255. FORMAT "%3.0" /end CHARACTERISTIC
/begin CHARACTERISTIC C_DC_DEC_VLS_UP_OL_1 "" VALUE 0x6026e _REC_VAL_20_u1 255. _CNV_A_R_LINEAR_____13_CM 0. 255. FORMAT "%3.0" /end CHARACTERISTIC
/begin CHARACTERISTIC ID_ERR_DTC_VLS_UP_OL_2 "" CURVE 0x60274 _REC_CUR_20_u2_u2 65535. _CNV_A_R_LINEAR_____17_CM 0. 65535. FORMAT "%5.0"
 /begin AXIS_DESCR COM_AXIS ONLINE_DUMMY _CNV_S_6_RANGE_FMY__320_CM 6 0. 5. AXIS_PTS_REF ldp_fmy_dtc /end AXIS_DESCR
/end CHARACTERISTIC
/begin CHARACTERISTIC ID_ERR_ENVD_VLS_UP_OL_2 "" CURVE 0x60270 _REC_CUR_20_u1_u1 17. _CNV_S_6_RANGE_DIAG_321_CM 4. 21.
 /begin AXIS_DESCR COM_AXIS ONLINE_DUMMY _CNV_S_4_RANGE_FMY__322_CM 4 0. 3. AXIS_PTS_REF ldp_fmy_envd /end AXIS_DESCR
/end CHARACTERISTIC
/begin CHARACTERISTIC C_DIAG_CONF_VLS_UP_OL_2 "" VALUE 0x60280 _REC_VAL_20_u1 255. _CNV_A_R_LINEAR_____13_CM 0. 255. FORMAT "%3.0" /end CHARACTERISTIC
/begin CHARACTERISTIC C_DC_INC_VLS_UP_OL_2 "" VALUE 0x60281 _REC_VAL_20_u1 255. _CNV_A_R_LINEAR_____13_CM 0. 255. FORMAT "%3.0" /end CHARACTERISTIC
/begin CHARACTERISTIC C_DC_MAX_VLS_UP_OL_2 "" VALUE 0x60283 _REC_VAL_20_u1 255. _CNV_A_R_LINEAR_____13_CM 0. 255. FORMAT "%3.0" /end CHARACTERISTIC
/begin CHARACTERISTIC C_DC_DEC_VLS_UP_OL_2 "" VALUE 0x60282 _REC_VAL_20_u1 255. _CNV_A_R_LINEAR_____13_CM 0. 255. FORMAT "%3.0" /end CHARACTERISTIC
/begin CHARACTERISTIC ID_ERR_DTC_VLS_DOWN_SCB_1 "" CURVE 0x60288 _REC_CUR_20_u2_u2 65535. _CNV_A_R_LINEAR_____17_CM 0. 65535. FORMAT "%5.0"
 /begin AXIS_DESCR COM_AXIS ONLINE_DUMMY _CNV_S_6_RANGE_FMY__320_CM 6 0. 5. AXIS_PTS_REF ldp_fmy_dtc /end AXIS_DESCR
/end CHARACTERISTIC
/begin CHARACTERISTIC ID_ERR_ENVD_VLS_DOWN_SCB_1 "" CURVE 0x60284 _REC_CUR_20_u1_u1 17. _CNV_S_6_RANGE_DIAG_321_CM 4. 21.
 /begin AXIS_DESCR COM_AXIS ONLINE_DUMMY _CNV_S_4_RANGE_FMY__322_CM 4 0. 3. AXIS_PTS_REF ldp_fmy_envd /end AXIS_DESCR
/end CHARACTERISTIC
/begin CHARACTERISTIC C_DIAG_CONF_VLS_DOWN_SCB_1 "" VALUE 0x60294 _REC_VAL_20_u1 255. _CNV_A_R_LINEAR_____13_CM 0. 255. FORMAT "%3.0" /end CHARACTERISTIC
/begin CHARACTERISTIC C_DC_INC_VLS_DOWN_SCB_1 "" VALUE 0x60295 _REC_VAL_20_u1 255. _CNV_A_R_LINEAR_____13_CM 0. 255. FORMAT "%3.0" /end CHARACTERISTIC
/begin CHARACTERISTIC C_DC_MAX_VLS_DOWN_SCB_1 "" VALUE 0x60297 _REC_VAL_20_u1 255. _CNV_A_R_LINEAR_____13_CM 0. 255. FORMAT "%3.0" /end CHARACTERISTIC
/begin CHARACTERISTIC C_DC_DEC_VLS_DOWN_SCB_1 "" VALUE 0x60296 _REC_VAL_20_u1 255. _CNV_A_R_LINEAR_____13_CM 0. 255. FORMAT "%3.0" /end CHARACTERISTIC
/begin CHARACTERISTIC ID_ERR_DTC_VLS_DOWN_SCB_2 "" CURVE 0x6029c _REC_CUR_20_u2_u2 65535. _CNV_A_R_LINEAR_____17_CM 0. 65535. FORMAT "%5.0"
 /begin AXIS_DESCR COM_AXIS ONLINE_DUMMY _CNV_S_6_RANGE_FMY__320_CM 6 0. 5. AXIS_PTS_REF ldp_fmy_dtc /end AXIS_DESCR
/end CHARACTERISTIC
/begin CHARACTERISTIC ID_ERR_ENVD_VLS_DOWN_SCB_2 "" CURVE 0x60298 _REC_CUR_20_u1_u1 17. _CNV_S_6_RANGE_DIAG_321_CM 4. 21.
 /begin AXIS_DESCR COM_AXIS ONLINE_DUMMY _CNV_S_4_RANGE_FMY__322_CM 4 0. 3. AXIS_PTS_REF ldp_fmy_envd /end AXIS_DESCR
/end CHARACTERISTIC
/begin CHARACTERISTIC C_DIAG_CONF_VLS_DOWN_SCB_2 "" VALUE 0x602a8 _REC_VAL_20_u1 255. _CNV_A_R_LINEAR_____13_CM 0. 255. FORMAT "%3.0" /end CHARACTERISTIC
/begin CHARACTERISTIC C_DC_INC_VLS_DOWN_SCB_2 "" VALUE 0x602a9 _REC_VAL_20_u1 255. _CNV_A_R_LINEAR_____13_CM 0. 255. FORMAT "%3.0" /end CHARACTERISTIC
/begin CHARACTERISTIC C_DC_MAX_VLS_DOWN_SCB_2 "" VALUE 0x602ab _REC_VAL_20_u1 255. _CNV_A_R_LINEAR_____13_CM 0. 255. FORMAT "%3.0" /end CHARACTERISTIC
/begin CHARACTERISTIC C_DC_DEC_VLS_DOWN_SCB_2 "" VALUE 0x602aa _REC_VAL_20_u1 255. _CNV_A_R_LINEAR_____13_CM 0. 255. FORMAT "%3.0" /end CHARACTERISTIC
/begin CHARACTERISTIC ID_ERR_DTC_VLS_DOWN_SCG_1 "" CURVE 0x602b0 _REC_CUR_20_u2_u2 65535. _CNV_A_R_LINEAR_____17_CM 0. 65535. FORMAT "%5.0"
 /begin AXIS_DESCR COM_AXIS ONLINE_DUMMY _CNV_S_6_RANGE_FMY__320_CM 6 0. 5. AXIS_PTS_REF ldp_fmy_dtc /end AXIS_DESCR
/end CHARACTERISTIC
/begin CHARACTERISTIC ID_ERR_ENVD_VLS_DOWN_SCG_1 "" CURVE 0x602ac _REC_CUR_20_u1_u1 17. _CNV_S_6_RANGE_DIAG_321_CM 4. 21.
 /begin AXIS_DESCR COM_AXIS ONLINE_DUMMY _CNV_S_4_RANGE_FMY__322_CM 4 0. 3. AXIS_PTS_REF ldp_fmy_envd /end AXIS_DESCR
/end CHARACTERISTIC
/begin CHARACTERISTIC C_DIAG_CONF_VLS_DOWN_SCG_1 "" VALUE 0x602bc _REC_VAL_20_u1 255. _CNV_A_R_LINEAR_____13_CM 0. 255. FORMAT "%3.0" /end CHARACTERISTIC
/begin CHARACTERISTIC C_DC_INC_VLS_DOWN_SCG_1 "" VALUE 0x602bd _REC_VAL_20_u1 255. _CNV_A_R_LINEAR_____13_CM 0. 255. FORMAT "%3.0" /end CHARACTERISTIC
/begin CHARACTERISTIC C_DC_MAX_VLS_DOWN_SCG_1 "" VALUE 0x602bf _REC_VAL_20_u1 255. _CNV_A_R_LINEAR_____13_CM 0. 255. FORMAT "%3.0" /end CHARACTERISTIC
/begin CHARACTERISTIC C_DC_DEC_VLS_DOWN_SCG_1 "" VALUE 0x602be _REC_VAL_20_u1 255. _CNV_A_R_LINEAR_____13_CM 0. 255. FORMAT "%3.0" /end CHARACTERISTIC
/begin CHARACTERISTIC ID_ERR_DTC_VLS_DOWN_SCG_2 "" CURVE 0x602c4 _REC_CUR_20_u2_u2 65535. _CNV_A_R_LINEAR_____17_CM 0. 65535. FORMAT "%5.0"
 /begin AXIS_DESCR COM_AXIS ONLINE_DUMMY _CNV_S_6_RANGE_FMY__320_CM 6 0. 5. AXIS_PTS_REF ldp_fmy_dtc /end AXIS_DESCR
/end CHARACTERISTIC
/begin CHARACTERISTIC ID_ERR_ENVD_VLS_DOWN_SCG_2 "" CURVE 0x602c0 _REC_CUR_20_u1_u1 17. _CNV_S_6_RANGE_DIAG_321_CM 4. 21.
 /begin AXIS_DESCR COM_AXIS ONLINE_DUMMY _CNV_S_4_RANGE_FMY__322_CM 4 0. 3. AXIS_PTS_REF ldp_fmy_envd /end AXIS_DESCR
/end CHARACTERISTIC
/begin CHARACTERISTIC C_DIAG_CONF_VLS_DOWN_SCG_2 "" VALUE 0x602d0 _REC_VAL_20_u1 255. _CNV_A_R_LINEAR_____13_CM 0. 255. FORMAT "%3.0" /end CHARACTERISTIC
/begin CHARACTERISTIC C_DC_INC_VLS_DOWN_SCG_2 "" VALUE 0x602d1 _REC_VAL_20_u1 255. _CNV_A_R_LINEAR_____13_CM 0. 255. FORMAT "%3.0" /end CHARACTERISTIC
/begin CHARACTERISTIC C_DC_MAX_VLS_DOWN_SCG_2 "" VALUE 0x602d3 _REC_VAL_20_u1 255. _CNV_A_R_LINEAR_____13_CM 0. 255. FORMAT "%3.0" /end CHARACTERISTIC
/begin CHARACTERISTIC C_DC_DEC_VLS_DOWN_SCG_2 "" VALUE 0x602d2 _REC_VAL_20_u1 255. _CNV_A_R_LINEAR_____13_CM 0. 255. FORMAT "%3.0" /end CHARACTERISTIC
/begin CHARACTERISTIC ID_ERR_DTC_VLS_DOWN_OL_1 "" CURVE 0x602d8 _REC_CUR_20_u2_u2 65535. _CNV_A_R_LINEAR_____17_CM 0. 65535. FORMAT "%5.0"
 /begin AXIS_DESCR COM_AXIS ONLINE_DUMMY _CNV_S_6_RANGE_FMY__320_CM 6 0. 5. AXIS_PTS_REF ldp_fmy_dtc /end AXIS_DESCR
/end CHARACTERISTIC
/begin CHARACTERISTIC ID_ERR_ENVD_VLS_DOWN_OL_1 "" CURVE 0x602d4 _REC_CUR_20_u1_u1 17. _CNV_S_6_RANGE_DIAG_321_CM 4. 21.
 /begin AXIS_DESCR COM_AXIS ONLINE_DUMMY _CNV_S_4_RANGE_FMY__322_CM 4 0. 3. AXIS_PTS_REF ldp_fmy_envd /end AXIS_DESCR
/end CHARACTERISTIC
/begin CHARACTERISTIC C_DIAG_CONF_VLS_DOWN_OL_1 "" VALUE 0x602e4 _REC_VAL_20_u1 255. _CNV_A_R_LINEAR_____13_CM 0. 255. FORMAT "%3.0" /end CHARACTERISTIC
/begin CHARACTERISTIC C_DC_INC_VLS_DOWN_OL_1 "" VALUE 0x602e5 _REC_VAL_20_u1 255. _CNV_A_R_LINEAR_____13_CM 0. 255. FORMAT "%3.0" /end CHARACTERISTIC
/begin CHARACTERISTIC C_DC_MAX_VLS_DOWN_OL_1 "" VALUE 0x602e7 _REC_VAL_20_u1 255. _CNV_A_R_LINEAR_____13_CM 0. 255. FORMAT "%3.0" /end CHARACTERISTIC
/begin CHARACTERISTIC C_DC_DEC_VLS_DOWN_OL_1 "" VALUE 0x602e6 _REC_VAL_20_u1 255. _CNV_A_R_LINEAR_____13_CM 0. 255. FORMAT "%3.0" /end CHARACTERISTIC
/begin CHARACTERISTIC ID_ERR_DTC_VLS_DOWN_OL_2 "" CURVE 0x602ec _REC_CUR_20_u2_u2 65535. _CNV_A_R_LINEAR_____17_CM 0. 65535. FORMAT "%5.0"
 /begin AXIS_DESCR COM_AXIS ONLINE_DUMMY _CNV_S_6_RANGE_FMY__320_CM 6 0. 5. AXIS_PTS_REF ldp_fmy_dtc /end AXIS_DESCR
/end CHARACTERISTIC
/begin CHARACTERISTIC ID_ERR_ENVD_VLS_DOWN_OL_2 "" CURVE 0x602e8 _REC_CUR_20_u1_u1 17. _CNV_S_6_RANGE_DIAG_321_CM 4. 21.
 /begin AXIS_DESCR COM_AXIS ONLINE_DUMMY _CNV_S_4_RANGE_FMY__322_CM 4 0. 3. AXIS_PTS_REF ldp_fmy_envd /end AXIS_DESCR
/end CHARACTERISTIC
/begin CHARACTERISTIC C_DIAG_CONF_VLS_DOWN_OL_2 "" VALUE 0x602f8 _REC_VAL_20_u1 255. _CNV_A_R_LINEAR_____13_CM 0. 255. FORMAT "%3.0" /end CHARACTERISTIC
/begin CHARACTERISTIC C_DC_INC_VLS_DOWN_OL_2 "" VALUE 0x602f9 _REC_VAL_20_u1 255. _CNV_A_R_LINEAR_____13_CM 0. 255. FORMAT "%3.0" /end CHARACTERISTIC
/begin CHARACTERISTIC C_DC_MAX_VLS_DOWN_OL_2 "" VALUE 0x602fb _REC_VAL_20_u1 255. _CNV_A_R_LINEAR_____13_CM 0. 255. FORMAT "%3.0" /end CHARACTERISTIC
/begin CHARACTERISTIC C_DC_DEC_VLS_DOWN_OL_2 "" VALUE 0x602fa _REC_VAL_20_u1 255. _CNV_A_R_LINEAR_____13_CM 0. 255. FORMAT "%3.0" /end CHARACTERISTIC
/begin CHARACTERISTIC ID_ERR_DTC_VLS_STK_1 "" CURVE 0x60300 _REC_CUR_20_u2_u2 65535. _CNV_A_R_LINEAR_____17_CM 0. 65535. FORMAT "%5.0"
 /begin AXIS_DESCR COM_AXIS ONLINE_DUMMY _CNV_S_6_RANGE_FMY__320_CM 6 0. 5. AXIS_PTS_REF ldp_fmy_dtc /end AXIS_DESCR
/end CHARACTERISTIC
/begin CHARACTERISTIC ID_ERR_ENVD_VLS_STK_1 "" CURVE 0x602fc _REC_CUR_20_u1_u1 17. _CNV_S_6_RANGE_DIAG_321_CM 4. 21.
 /begin AXIS_DESCR COM_AXIS ONLINE_DUMMY _CNV_S_4_RANGE_FMY__322_CM 4 0. 3. AXIS_PTS_REF ldp_fmy_envd /end AXIS_DESCR
/end CHARACTERISTIC
/begin CHARACTERISTIC C_DIAG_CONF_VLS_STK_1 "" VALUE 0x6030c _REC_VAL_20_u1 255. _CNV_A_R_LINEAR_____13_CM 0. 255. FORMAT "%3.0" /end CHARACTERISTIC
/begin CHARACTERISTIC C_DC_INC_VLS_STK_1 "" VALUE 0x6030d _REC_VAL_20_u1 255. _CNV_A_R_LINEAR_____13_CM 0. 255. FORMAT "%3.0" /end CHARACTERISTIC
/begin CHARACTERISTIC C_DC_MAX_VLS_STK_1 "" VALUE 0x6030f _REC_VAL_20_u1 255. _CNV_A_R_LINEAR_____13_CM 0. 255. FORMAT "%3.0" /end CHARACTERISTIC
/begin CHARACTERISTIC C_DC_DEC_VLS_STK_1 "" VALUE 0x6030e _REC_VAL_20_u1 255. _CNV_A_R_LINEAR_____13_CM 0. 255. FORMAT "%3.0" /end CHARACTERISTIC
/begin CHARACTERISTIC ID_ERR_DTC_VLS_STK_2 "" CURVE 0x60314 _REC_CUR_20_u2_u2 65535. _CNV_A_R_LINEAR_____17_CM 0. 65535. FORMAT "%5.0"
 /begin AXIS_DESCR COM_AXIS ONLINE_DUMMY _CNV_S_6_RANGE_FMY__320_CM 6 0. 5. AXIS_PTS_REF ldp_fmy_dtc /end AXIS_DESCR
/end CHARACTERISTIC
/begin CHARACTERISTIC ID_ERR_ENVD_VLS_STK_2 "" CURVE 0x60310 _REC_CUR_20_u1_u1 17. _CNV_S_6_RANGE_DIAG_321_CM 4. 21.
 /begin AXIS_DESCR COM_AXIS ONLINE_DUMMY _CNV_S_4_RANGE_FMY__322_CM 4 0. 3. AXIS_PTS_REF ldp_fmy_envd /end AXIS_DESCR
/end CHARACTERISTIC
/begin CHARACTERISTIC C_DIAG_CONF_VLS_STK_2 "" VALUE 0x60320 _REC_VAL_20_u1 255. _CNV_A_R_LINEAR_____13_CM 0. 255. FORMAT "%3.0" /end CHARACTERISTIC
/begin CHARACTERISTIC C_DC_INC_VLS_STK_2 "" VALUE 0x60321 _REC_VAL_20_u1 255. _CNV_A_R_LINEAR_____13_CM 0. 255. FORMAT "%3.0" /end CHARACTERISTIC
/begin CHARACTERISTIC C_DC_MAX_VLS_STK_2 "" VALUE 0x60323 _REC_VAL_20_u1 255. _CNV_A_R_LINEAR_____13_CM 0. 255. FORMAT "%3.0" /end CHARACTERISTIC
/begin CHARACTERISTIC C_DC_DEC_VLS_STK_2 "" VALUE 0x60322 _REC_VAL_20_u1 255. _CNV_A_R_LINEAR_____13_CM 0. 255. FORMAT "%3.0" /end CHARACTERISTIC
/begin CHARACTERISTIC ID_ERR_DTC_LAM_LIM_1 "" CURVE 0x60328 _REC_CUR_20_u2_u2 65535. _CNV_A_R_LINEAR_____17_CM 0. 65535. FORMAT "%5.0"
 /begin AXIS_DESCR COM_AXIS ONLINE_DUMMY _CNV_S_6_RANGE_FMY__320_CM 6 0. 5. AXIS_PTS_REF ldp_fmy_dtc /end AXIS_DESCR
/end CHARACTERISTIC
/begin CHARACTERISTIC ID_ERR_ENVD_LAM_LIM_1 "" CURVE 0x60324 _REC_CUR_20_u1_u1 17. _CNV_S_6_RANGE_DIAG_321_CM 4. 21.
 /begin AXIS_DESCR COM_AXIS ONLINE_DUMMY _CNV_S_4_RANGE_FMY__322_CM 4 0. 3. AXIS_PTS_REF ldp_fmy_envd /end AXIS_DESCR
/end CHARACTERISTIC
/begin CHARACTERISTIC C_DIAG_CONF_LAM_LIM_1 "" VALUE 0x60334 _REC_VAL_20_u1 255. _CNV_A_R_LINEAR_____13_CM 0. 255. FORMAT "%3.0" /end CHARACTERISTIC
/begin CHARACTERISTIC C_DC_INC_LAM_LIM_1 "" VALUE 0x60335 _REC_VAL_20_u1 255. _CNV_A_R_LINEAR_____13_CM 0. 255. FORMAT "%3.0" /end CHARACTERISTIC
/begin CHARACTERISTIC C_DC_MAX_LAM_LIM_1 "" VALUE 0x60337 _REC_VAL_20_u1 255. _CNV_A_R_LINEAR_____13_CM 0. 255. FORMAT "%3.0" /end CHARACTERISTIC
/begin CHARACTERISTIC C_DC_DEC_LAM_LIM_1 "" VALUE 0x60336 _REC_VAL_20_u1 255. _CNV_A_R_LINEAR_____13_CM 0. 255. FORMAT "%3.0" /end CHARACTERISTIC
/begin CHARACTERISTIC ID_ERR_DTC_LAM_LIM_2 "" CURVE 0x6033c _REC_CUR_20_u2_u2 65535. _CNV_A_R_LINEAR_____17_CM 0. 65535. FORMAT "%5.0"
 /begin AXIS_DESCR COM_AXIS ONLINE_DUMMY _CNV_S_6_RANGE_FMY__320_CM 6 0. 5. AXIS_PTS_REF ldp_fmy_dtc /end AXIS_DESCR
/end CHARACTERISTIC
/begin CHARACTERISTIC ID_ERR_ENVD_LAM_LIM_2 "" CURVE 0x60338 _REC_CUR_20_u1_u1 17. _CNV_S_6_RANGE_DIAG_321_CM 4. 21.
 /begin AXIS_DESCR COM_AXIS ONLINE_DUMMY _CNV_S_4_RANGE_FMY__322_CM 4 0. 3. AXIS_PTS_REF ldp_fmy_envd /end AXIS_DESCR
/end CHARACTERISTIC
/begin CHARACTERISTIC C_DIAG_CONF_LAM_LIM_2 "" VALUE 0x60348 _REC_VAL_20_u1 255. _CNV_A_R_LINEAR_____13_CM 0. 255. FORMAT "%3.0" /end CHARACTERISTIC
/begin CHARACTERISTIC C_DC_INC_LAM_LIM_2 "" VALUE 0x60349 _REC_VAL_20_u1 255. _CNV_A_R_LINEAR_____13_CM 0. 255. FORMAT "%3.0" /end CHARACTERISTIC
/begin CHARACTERISTIC C_DC_MAX_LAM_LIM_2 "" VALUE 0x6034b _REC_VAL_20_u1 255. _CNV_A_R_LINEAR_____13_CM 0. 255. FORMAT "%3.0" /end CHARACTERISTIC
/begin CHARACTERISTIC C_DC_DEC_LAM_LIM_2 "" VALUE 0x6034a _REC_VAL_20_u1 255. _CNV_A_R_LINEAR_____13_CM 0. 255. FORMAT "%3.0" /end CHARACTERISTIC
/begin CHARACTERISTIC ID_ERR_DTC_IV_0 "" CURVE 0x60350 _REC_CUR_20_u2_u2 65535. _CNV_A_R_LINEAR_____17_CM 0. 65535. FORMAT "%5.0"
 /begin AXIS_DESCR COM_AXIS ONLINE_DUMMY _CNV_S_6_RANGE_FMY__320_CM 6 0. 5. AXIS_PTS_REF ldp_fmy_dtc /end AXIS_DESCR
/end CHARACTERISTIC
/begin CHARACTERISTIC ID_ERR_ENVD_IV_0 "" CURVE 0x6034c _REC_CUR_20_u1_u1 17. _CNV_S_6_RANGE_DIAG_321_CM 4. 21.
 /begin AXIS_DESCR COM_AXIS ONLINE_DUMMY _CNV_S_4_RANGE_FMY__322_CM 4 0. 3. AXIS_PTS_REF ldp_fmy_envd /end AXIS_DESCR
/end CHARACTERISTIC
/begin CHARACTERISTIC C_DIAG_CONF_IV_0 "" VALUE 0x6035c _REC_VAL_20_u1 255. _CNV_A_R_LINEAR_____13_CM 0. 255. FORMAT "%3.0" /end CHARACTERISTIC
/begin CHARACTERISTIC C_DC_INC_IV_0 "" VALUE 0x6035d _REC_VAL_20_u1 255. _CNV_A_R_LINEAR_____13_CM 0. 255. FORMAT "%3.0" /end CHARACTERISTIC
/begin CHARACTERISTIC C_DC_MAX_IV_0 "" VALUE 0x6035f _REC_VAL_20_u1 255. _CNV_A_R_LINEAR_____13_CM 0. 255. FORMAT "%3.0" /end CHARACTERISTIC
/begin CHARACTERISTIC C_DC_DEC_IV_0 "" VALUE 0x6035e _REC_VAL_20_u1 255. _CNV_A_R_LINEAR_____13_CM 0. 255. FORMAT "%3.0" /end CHARACTERISTIC
/begin CHARACTERISTIC ID_ERR_DTC_IV_1 "" CURVE 0x60364 _REC_CUR_20_u2_u2 65535. _CNV_A_R_LINEAR_____17_CM 0. 65535. FORMAT "%5.0"
 /begin AXIS_DESCR COM_AXIS ONLINE_DUMMY _CNV_S_6_RANGE_FMY__320_CM 6 0. 5. AXIS_PTS_REF ldp_fmy_dtc /end AXIS_DESCR
/end CHARACTERISTIC
/begin CHARACTERISTIC ID_ERR_ENVD_IV_1 "" CURVE 0x60360 _REC_CUR_20_u1_u1 17. _CNV_S_6_RANGE_DIAG_321_CM 4. 21.
 /begin AXIS_DESCR COM_AXIS ONLINE_DUMMY _CNV_S_4_RANGE_FMY__322_CM 4 0. 3. AXIS_PTS_REF ldp_fmy_envd /end AXIS_DESCR
/end CHARACTERISTIC
/begin CHARACTERISTIC C_DIAG_CONF_IV_1 "" VALUE 0x60370 _REC_VAL_20_u1 255. _CNV_A_R_LINEAR_____13_CM 0. 255. FORMAT "%3.0" /end CHARACTERISTIC
/begin CHARACTERISTIC C_DC_INC_IV_1 "" VALUE 0x60371 _REC_VAL_20_u1 255. _CNV_A_R_LINEAR_____13_CM 0. 255. FORMAT "%3.0" /end CHARACTERISTIC
/begin CHARACTERISTIC C_DC_MAX_IV_1 "" VALUE 0x60373 _REC_VAL_20_u1 255. _CNV_A_R_LINEAR_____13_CM 0. 255. FORMAT "%3.0" /end CHARACTERISTIC
/begin CHARACTERISTIC C_DC_DEC_IV_1 "" VALUE 0x60372 _REC_VAL_20_u1 255. _CNV_A_R_LINEAR_____13_CM 0. 255. FORMAT "%3.0" /end CHARACTERISTIC
/begin CHARACTERISTIC ID_ERR_DTC_IV_2 "" CURVE 0x60378 _REC_CUR_20_u2_u2 65535. _CNV_A_R_LINEAR_____17_CM 0. 65535. FORMAT "%5.0"
 /begin AXIS_DESCR COM_AXIS ONLINE_DUMMY _CNV_S_6_RANGE_FMY__320_CM 6 0. 5. AXIS_PTS_REF ldp_fmy_dtc /end AXIS_DESCR
/end CHARACTERISTIC
/begin CHARACTERISTIC ID_ERR_ENVD_IV_2 "" CURVE 0x60374 _REC_CUR_20_u1_u1 17. _CNV_S_6_RANGE_DIAG_321_CM 4. 21.
 /begin AXIS_DESCR COM_AXIS ONLINE_DUMMY _CNV_S_4_RANGE_FMY__322_CM 4 0. 3. AXIS_PTS_REF ldp_fmy_envd /end AXIS_DESCR
/end CHARACTERISTIC
/begin CHARACTERISTIC C_DIAG_CONF_IV_2 "" VALUE 0x60384 _REC_VAL_20_u1 255. _CNV_A_R_LINEAR_____13_CM 0. 255. FORMAT "%3.0" /end CHARACTERISTIC
/begin CHARACTERISTIC C_DC_INC_IV_2 "" VALUE 0x60385 _REC_VAL_20_u1 255. _CNV_A_R_LINEAR_____13_CM 0. 255. FORMAT "%3.0" /end CHARACTERISTIC
/begin CHARACTERISTIC C_DC_MAX_IV_2 "" VALUE 0x60387 _REC_VAL_20_u1 255. _CNV_A_R_LINEAR_____13_CM 0. 255. FORMAT "%3.0" /end CHARACTERISTIC
/begin CHARACTERISTIC C_DC_DEC_IV_2 "" VALUE 0x60386 _REC_VAL_20_u1 255. _CNV_A_R_LINEAR_____13_CM 0. 255. FORMAT "%3.0" /end CHARACTERISTIC
/begin CHARACTERISTIC ID_ERR_DTC_IV_3 "" CURVE 0x6038c _REC_CUR_20_u2_u2 65535. _CNV_A_R_LINEAR_____17_CM 0. 65535. FORMAT "%5.0"
 /begin AXIS_DESCR COM_AXIS ONLINE_DUMMY _CNV_S_6_RANGE_FMY__320_CM 6 0. 5. AXIS_PTS_REF ldp_fmy_dtc /end AXIS_DESCR
/end CHARACTERISTIC
/begin CHARACTERISTIC ID_ERR_ENVD_IV_3 "" CURVE 0x60388 _REC_CUR_20_u1_u1 17. _CNV_S_6_RANGE_DIAG_321_CM 4. 21.
 /begin AXIS_DESCR COM_AXIS ONLINE_DUMMY _CNV_S_4_RANGE_FMY__322_CM 4 0. 3. AXIS_PTS_REF ldp_fmy_envd /end AXIS_DESCR
/end CHARACTERISTIC
/begin CHARACTERISTIC C_DIAG_CONF_IV_3 "" VALUE 0x60398 _REC_VAL_20_u1 255. _CNV_A_R_LINEAR_____13_CM 0. 255. FORMAT "%3.0" /end CHARACTERISTIC
/begin CHARACTERISTIC C_DC_INC_IV_3 "" VALUE 0x60399 _REC_VAL_20_u1 255. _CNV_A_R_LINEAR_____13_CM 0. 255. FORMAT "%3.0" /end CHARACTERISTIC
/begin CHARACTERISTIC C_DC_MAX_IV_3 "" VALUE 0x6039b _REC_VAL_20_u1 255. _CNV_A_R_LINEAR_____13_CM 0. 255. FORMAT "%3.0" /end CHARACTERISTIC
/begin CHARACTERISTIC C_DC_DEC_IV_3 "" VALUE 0x6039a _REC_VAL_20_u1 255. _CNV_A_R_LINEAR_____13_CM 0. 255. FORMAT "%3.0" /end CHARACTERISTIC
/begin CHARACTERISTIC ID_ERR_DTC_IV_4 "" CURVE 0x603a0 _REC_CUR_20_u2_u2 65535. _CNV_A_R_LINEAR_____17_CM 0. 65535. FORMAT "%5.0"
 /begin AXIS_DESCR COM_AXIS ONLINE_DUMMY _CNV_S_6_RANGE_FMY__320_CM 6 0. 5. AXIS_PTS_REF ldp_fmy_dtc /end AXIS_DESCR
/end CHARACTERISTIC
/begin CHARACTERISTIC ID_ERR_ENVD_IV_4 "" CURVE 0x6039c _REC_CUR_20_u1_u1 17. _CNV_S_6_RANGE_DIAG_321_CM 4. 21.
 /begin AXIS_DESCR COM_AXIS ONLINE_DUMMY _CNV_S_4_RANGE_FMY__322_CM 4 0. 3. AXIS_PTS_REF ldp_fmy_envd /end AXIS_DESCR
/end CHARACTERISTIC
/begin CHARACTERISTIC C_DIAG_CONF_IV_4 "" VALUE 0x603ac _REC_VAL_20_u1 255. _CNV_A_R_LINEAR_____13_CM 0. 255. FORMAT "%3.0" /end CHARACTERISTIC
/begin CHARACTERISTIC C_DC_INC_IV_4 "" VALUE 0x603ad _REC_VAL_20_u1 255. _CNV_A_R_LINEAR_____13_CM 0. 255. FORMAT "%3.0" /end CHARACTERISTIC
/begin CHARACTERISTIC C_DC_MAX_IV_4 "" VALUE 0x603af _REC_VAL_20_u1 255. _CNV_A_R_LINEAR_____13_CM 0. 255. FORMAT "%3.0" /end CHARACTERISTIC
/begin CHARACTERISTIC C_DC_DEC_IV_4 "" VALUE 0x603ae _REC_VAL_20_u1 255. _CNV_A_R_LINEAR_____13_CM 0. 255. FORMAT "%3.0" /end CHARACTERISTIC
/begin CHARACTERISTIC ID_ERR_DTC_IV_5 "" CURVE 0x603b4 _REC_CUR_20_u2_u2 65535. _CNV_A_R_LINEAR_____17_CM 0. 65535. FORMAT "%5.0"
 /begin AXIS_DESCR COM_AXIS ONLINE_DUMMY _CNV_S_6_RANGE_FMY__320_CM 6 0. 5. AXIS_PTS_REF ldp_fmy_dtc /end AXIS_DESCR
/end CHARACTERISTIC
/begin CHARACTERISTIC ID_ERR_ENVD_IV_5 "" CURVE 0x603b0 _REC_CUR_20_u1_u1 17. _CNV_S_6_RANGE_DIAG_321_CM 4. 21.
 /begin AXIS_DESCR COM_AXIS ONLINE_DUMMY _CNV_S_4_RANGE_FMY__322_CM 4 0. 3. AXIS_PTS_REF ldp_fmy_envd /end AXIS_DESCR
/end CHARACTERISTIC
/begin CHARACTERISTIC C_DIAG_CONF_IV_5 "" VALUE 0x603c0 _REC_VAL_20_u1 255. _CNV_A_R_LINEAR_____13_CM 0. 255. FORMAT "%3.0" /end CHARACTERISTIC
/begin CHARACTERISTIC C_DC_INC_IV_5 "" VALUE 0x603c1 _REC_VAL_20_u1 255. _CNV_A_R_LINEAR_____13_CM 0. 255. FORMAT "%3.0" /end CHARACTERISTIC
/begin CHARACTERISTIC C_DC_MAX_IV_5 "" VALUE 0x603c3 _REC_VAL_20_u1 255. _CNV_A_R_LINEAR_____13_CM 0. 255. FORMAT "%3.0" /end CHARACTERISTIC
/begin CHARACTERISTIC C_DC_DEC_IV_5 "" VALUE 0x603c2 _REC_VAL_20_u1 255. _CNV_A_R_LINEAR_____13_CM 0. 255. FORMAT "%3.0" /end CHARACTERISTIC
/begin CHARACTERISTIC ID_ERR_DTC_LSH_UP_1 "" CURVE 0x603c8 _REC_CUR_20_u2_u2 65535. _CNV_A_R_LINEAR_____17_CM 0. 65535. FORMAT "%5.0"
 /begin AXIS_DESCR COM_AXIS ONLINE_DUMMY _CNV_S_6_RANGE_FMY__320_CM 6 0. 5. AXIS_PTS_REF ldp_fmy_dtc /end AXIS_DESCR
/end CHARACTERISTIC
/begin CHARACTERISTIC ID_ERR_ENVD_LSH_UP_1 "" CURVE 0x603c4 _REC_CUR_20_u1_u1 17. _CNV_S_6_RANGE_DIAG_321_CM 4. 21.
 /begin AXIS_DESCR COM_AXIS ONLINE_DUMMY _CNV_S_4_RANGE_FMY__322_CM 4 0. 3. AXIS_PTS_REF ldp_fmy_envd /end AXIS_DESCR
/end CHARACTERISTIC
/begin CHARACTERISTIC C_DIAG_CONF_LSH_UP_1 "" VALUE 0x603d4 _REC_VAL_20_u1 255. _CNV_A_R_LINEAR_____13_CM 0. 255. FORMAT "%3.0" /end CHARACTERISTIC
/begin CHARACTERISTIC C_DC_INC_LSH_UP_1 "" VALUE 0x603d5 _REC_VAL_20_u1 255. _CNV_A_R_LINEAR_____13_CM 0. 255. FORMAT "%3.0" /end CHARACTERISTIC
/begin CHARACTERISTIC C_DC_MAX_LSH_UP_1 "" VALUE 0x603d7 _REC_VAL_20_u1 255. _CNV_A_R_LINEAR_____13_CM 0. 255. FORMAT "%3.0" /end CHARACTERISTIC
/begin CHARACTERISTIC C_DC_DEC_LSH_UP_1 "" VALUE 0x603d6 _REC_VAL_20_u1 255. _CNV_A_R_LINEAR_____13_CM 0. 255. FORMAT "%3.0" /end CHARACTERISTIC
/begin CHARACTERISTIC ID_ERR_DTC_LSH_UP_2 "" CURVE 0x603dc _REC_CUR_20_u2_u2 65535. _CNV_A_R_LINEAR_____17_CM 0. 65535. FORMAT "%5.0"
 /begin AXIS_DESCR COM_AXIS ONLINE_DUMMY _CNV_S_6_RANGE_FMY__320_CM 6 0. 5. AXIS_PTS_REF ldp_fmy_dtc /end AXIS_DESCR
/end CHARACTERISTIC
/begin CHARACTERISTIC ID_ERR_ENVD_LSH_UP_2 "" CURVE 0x603d8 _REC_CUR_20_u1_u1 17. _CNV_S_6_RANGE_DIAG_321_CM 4. 21.
 /begin AXIS_DESCR COM_AXIS ONLINE_DUMMY _CNV_S_4_RANGE_FMY__322_CM 4 0. 3. AXIS_PTS_REF ldp_fmy_envd /end AXIS_DESCR
/end CHARACTERISTIC
/begin CHARACTERISTIC C_DIAG_CONF_LSH_UP_2 "" VALUE 0x603e8 _REC_VAL_20_u1 255. _CNV_A_R_LINEAR_____13_CM 0. 255. FORMAT "%3.0" /end CHARACTERISTIC
/begin CHARACTERISTIC C_DC_INC_LSH_UP_2 "" VALUE 0x603e9 _REC_VAL_20_u1 255. _CNV_A_R_LINEAR_____13_CM 0. 255. FORMAT "%3.0" /end CHARACTERISTIC
/begin CHARACTERISTIC C_DC_MAX_LSH_UP_2 "" VALUE 0x603eb _REC_VAL_20_u1 255. _CNV_A_R_LINEAR_____13_CM 0. 255. FORMAT "%3.0" /end CHARACTERISTIC
/begin CHARACTERISTIC C_DC_DEC_LSH_UP_2 "" VALUE 0x603ea _REC_VAL_20_u1 255. _CNV_A_R_LINEAR_____13_CM 0. 255. FORMAT "%3.0" /end CHARACTERISTIC
/begin CHARACTERISTIC ID_ERR_DTC_LSH_DOWN_1 "" CURVE 0x603f0 _REC_CUR_20_u2_u2 65535. _CNV_A_R_LINEAR_____17_CM 0. 65535. FORMAT "%5.0"
 /begin AXIS_DESCR COM_AXIS ONLINE_DUMMY _CNV_S_6_RANGE_FMY__320_CM 6 0. 5. AXIS_PTS_REF ldp_fmy_dtc /end AXIS_DESCR
/end CHARACTERISTIC
/begin CHARACTERISTIC ID_ERR_ENVD_LSH_DOWN_1 "" CURVE 0x603ec _REC_CUR_20_u1_u1 17. _CNV_S_6_RANGE_DIAG_321_CM 4. 21.
 /begin AXIS_DESCR COM_AXIS ONLINE_DUMMY _CNV_S_4_RANGE_FMY__322_CM 4 0. 3. AXIS_PTS_REF ldp_fmy_envd /end AXIS_DESCR
/end CHARACTERISTIC
/begin CHARACTERISTIC C_DIAG_CONF_LSH_DOWN_1 "" VALUE 0x603fc _REC_VAL_20_u1 255. _CNV_A_R_LINEAR_____13_CM 0. 255. FORMAT "%3.0" /end CHARACTERISTIC
/begin CHARACTERISTIC C_DC_INC_LSH_DOWN_1 "" VALUE 0x603fd _REC_VAL_20_u1 255. _CNV_A_R_LINEAR_____13_CM 0. 255. FORMAT "%3.0" /end CHARACTERISTIC
/begin CHARACTERISTIC C_DC_MAX_LSH_DOWN_1 "" VALUE 0x603ff _REC_VAL_20_u1 255. _CNV_A_R_LINEAR_____13_CM 0. 255. FORMAT "%3.0" /end CHARACTERISTIC
/begin CHARACTERISTIC C_DC_DEC_LSH_DOWN_1 "" VALUE 0x603fe _REC_VAL_20_u1 255. _CNV_A_R_LINEAR_____13_CM 0. 255. FORMAT "%3.0" /end CHARACTERISTIC
/begin CHARACTERISTIC ID_ERR_DTC_LSH_DOWN_2 "" CURVE 0x60404 _REC_CUR_20_u2_u2 65535. _CNV_A_R_LINEAR_____17_CM 0. 65535. FORMAT "%5.0"
 /begin AXIS_DESCR COM_AXIS ONLINE_DUMMY _CNV_S_6_RANGE_FMY__320_CM 6 0. 5. AXIS_PTS_REF ldp_fmy_dtc /end AXIS_DESCR
/end CHARACTERISTIC
/begin CHARACTERISTIC ID_ERR_ENVD_LSH_DOWN_2 "" CURVE 0x60400 _REC_CUR_20_u1_u1 17. _CNV_S_6_RANGE_DIAG_321_CM 4. 21.
 /begin AXIS_DESCR COM_AXIS ONLINE_DUMMY _CNV_S_4_RANGE_FMY__322_CM 4 0. 3. AXIS_PTS_REF ldp_fmy_envd /end AXIS_DESCR
/end CHARACTERISTIC
/begin CHARACTERISTIC C_DIAG_CONF_LSH_DOWN_2 "" VALUE 0x60410 _REC_VAL_20_u1 255. _CNV_A_R_LINEAR_____13_CM 0. 255. FORMAT "%3.0" /end CHARACTERISTIC
/begin CHARACTERISTIC C_DC_INC_LSH_DOWN_2 "" VALUE 0x60411 _REC_VAL_20_u1 255. _CNV_A_R_LINEAR_____13_CM 0. 255. FORMAT "%3.0" /end CHARACTERISTIC
/begin CHARACTERISTIC C_DC_MAX_LSH_DOWN_2 "" VALUE 0x60413 _REC_VAL_20_u1 255. _CNV_A_R_LINEAR_____13_CM 0. 255. FORMAT "%3.0" /end CHARACTERISTIC
/begin CHARACTERISTIC C_DC_DEC_LSH_DOWN_2 "" VALUE 0x60412 _REC_VAL_20_u1 255. _CNV_A_R_LINEAR_____13_CM 0. 255. FORMAT "%3.0" /end CHARACTERISTIC
/begin CHARACTERISTIC ID_ERR_DTC_RLY_EFP "" CURVE 0x60418 _REC_CUR_20_u2_u2 65535. _CNV_A_R_LINEAR_____17_CM 0. 65535. FORMAT "%5.0"
 /begin AXIS_DESCR COM_AXIS ONLINE_DUMMY _CNV_S_6_RANGE_FMY__320_CM 6 0. 5. AXIS_PTS_REF ldp_fmy_dtc /end AXIS_DESCR
/end CHARACTERISTIC
/begin CHARACTERISTIC ID_ERR_ENVD_RLY_EFP "" CURVE 0x60414 _REC_CUR_20_u1_u1 17. _CNV_S_6_RANGE_DIAG_321_CM 4. 21.
 /begin AXIS_DESCR COM_AXIS ONLINE_DUMMY _CNV_S_4_RANGE_FMY__322_CM 4 0. 3. AXIS_PTS_REF ldp_fmy_envd /end AXIS_DESCR
/end CHARACTERISTIC
/begin CHARACTERISTIC C_DIAG_CONF_RLY_EFP "" VALUE 0x60424 _REC_VAL_20_u1 255. _CNV_A_R_LINEAR_____13_CM 0. 255. FORMAT "%3.0" /end CHARACTERISTIC
/begin CHARACTERISTIC C_DC_INC_RLY_EFP "" VALUE 0x60425 _REC_VAL_20_u1 255. _CNV_A_R_LINEAR_____13_CM 0. 255. FORMAT "%3.0" /end CHARACTERISTIC
/begin CHARACTERISTIC C_DC_MAX_RLY_EFP "" VALUE 0x60427 _REC_VAL_20_u1 255. _CNV_A_R_LINEAR_____13_CM 0. 255. FORMAT "%3.0" /end CHARACTERISTIC
/begin CHARACTERISTIC C_DC_DEC_RLY_EFP "" VALUE 0x60426 _REC_VAL_20_u1 255. _CNV_A_R_LINEAR_____13_CM 0. 255. FORMAT "%3.0" /end CHARACTERISTIC
/begin CHARACTERISTIC ID_ERR_DTC_CPS "" CURVE 0x6042c _REC_CUR_20_u2_u2 65535. _CNV_A_R_LINEAR_____17_CM 0. 65535. FORMAT "%5.0"
 /begin AXIS_DESCR COM_AXIS ONLINE_DUMMY _CNV_S_6_RANGE_FMY__320_CM 6 0. 5. AXIS_PTS_REF ldp_fmy_dtc /end AXIS_DESCR
/end CHARACTERISTIC
/begin CHARACTERISTIC ID_ERR_ENVD_CPS "" CURVE 0x60428 _REC_CUR_20_u1_u1 17. _CNV_S_6_RANGE_DIAG_321_CM 4. 21.
 /begin AXIS_DESCR COM_AXIS ONLINE_DUMMY _CNV_S_4_RANGE_FMY__322_CM 4 0. 3. AXIS_PTS_REF ldp_fmy_envd /end AXIS_DESCR
/end CHARACTERISTIC
/begin CHARACTERISTIC C_DIAG_CONF_CPS "" VALUE 0x60438 _REC_VAL_20_u1 255. _CNV_A_R_LINEAR_____13_CM 0. 255. FORMAT "%3.0" /end CHARACTERISTIC
/begin CHARACTERISTIC C_DC_INC_CPS "" VALUE 0x60439 _REC_VAL_20_u1 255. _CNV_A_R_LINEAR_____13_CM 0. 255. FORMAT "%3.0" /end CHARACTERISTIC
/begin CHARACTERISTIC C_DC_MAX_CPS "" VALUE 0x6043b _REC_VAL_20_u1 255. _CNV_A_R_LINEAR_____13_CM 0. 255. FORMAT "%3.0" /end CHARACTERISTIC
/begin CHARACTERISTIC C_DC_DEC_CPS "" VALUE 0x6043a _REC_VAL_20_u1 255. _CNV_A_R_LINEAR_____13_CM 0. 255. FORMAT "%3.0" /end CHARACTERISTIC
/begin CHARACTERISTIC ID_ERR_DTC_IVVT_0 "" CURVE 0x60440 _REC_CUR_20_u2_u2 65535. _CNV_A_R_LINEAR_____17_CM 0. 65535. FORMAT "%5.0"
 /begin AXIS_DESCR COM_AXIS ONLINE_DUMMY _CNV_S_6_RANGE_FMY__320_CM 6 0. 5. AXIS_PTS_REF ldp_fmy_dtc /end AXIS_DESCR
/end CHARACTERISTIC
/begin CHARACTERISTIC ID_ERR_ENVD_IVVT_0 "" CURVE 0x6043c _REC_CUR_20_u1_u1 17. _CNV_S_6_RANGE_DIAG_321_CM 4. 21.
 /begin AXIS_DESCR COM_AXIS ONLINE_DUMMY _CNV_S_4_RANGE_FMY__322_CM 4 0. 3. AXIS_PTS_REF ldp_fmy_envd /end AXIS_DESCR
/end CHARACTERISTIC
/begin CHARACTERISTIC C_DIAG_CONF_IVVT_0 "" VALUE 0x6044c _REC_VAL_20_u1 255. _CNV_A_R_LINEAR_____13_CM 0. 255. FORMAT "%3.0" /end CHARACTERISTIC
/begin CHARACTERISTIC C_DC_INC_IVVT_0 "" VALUE 0x6044d _REC_VAL_20_u1 255. _CNV_A_R_LINEAR_____13_CM 0. 255. FORMAT "%3.0" /end CHARACTERISTIC
/begin CHARACTERISTIC C_DC_MAX_IVVT_0 "" VALUE 0x6044f _REC_VAL_20_u1 255. _CNV_A_R_LINEAR_____13_CM 0. 255. FORMAT "%3.0" /end CHARACTERISTIC
/begin CHARACTERISTIC C_DC_DEC_IVVT_0 "" VALUE 0x6044e _REC_VAL_20_u1 255. _CNV_A_R_LINEAR_____13_CM 0. 255. FORMAT "%3.0" /end CHARACTERISTIC
/begin CHARACTERISTIC ID_ERR_DTC_IVVT_1 "" CURVE 0x60454 _REC_CUR_20_u2_u2 65535. _CNV_A_R_LINEAR_____17_CM 0. 65535. FORMAT "%5.0"
 /begin AXIS_DESCR COM_AXIS ONLINE_DUMMY _CNV_S_6_RANGE_FMY__320_CM 6 0. 5. AXIS_PTS_REF ldp_fmy_dtc /end AXIS_DESCR
/end CHARACTERISTIC
/begin CHARACTERISTIC ID_ERR_ENVD_IVVT_1 "" CURVE 0x60450 _REC_CUR_20_u1_u1 17. _CNV_S_6_RANGE_DIAG_321_CM 4. 21.
 /begin AXIS_DESCR COM_AXIS ONLINE_DUMMY _CNV_S_4_RANGE_FMY__322_CM 4 0. 3. AXIS_PTS_REF ldp_fmy_envd /end AXIS_DESCR
/end CHARACTERISTIC
/begin CHARACTERISTIC C_DIAG_CONF_IVVT_1 "" VALUE 0x60460 _REC_VAL_20_u1 255. _CNV_A_R_LINEAR_____13_CM 0. 255. FORMAT "%3.0" /end CHARACTERISTIC
/begin CHARACTERISTIC C_DC_INC_IVVT_1 "" VALUE 0x60461 _REC_VAL_20_u1 255. _CNV_A_R_LINEAR_____13_CM 0. 255. FORMAT "%3.0" /end CHARACTERISTIC
/begin CHARACTERISTIC C_DC_MAX_IVVT_1 "" VALUE 0x60463 _REC_VAL_20_u1 255. _CNV_A_R_LINEAR_____13_CM 0. 255. FORMAT "%3.0" /end CHARACTERISTIC
/begin CHARACTERISTIC C_DC_DEC_IVVT_1 "" VALUE 0x60462 _REC_VAL_20_u1 255. _CNV_A_R_LINEAR_____13_CM 0. 255. FORMAT "%3.0" /end CHARACTERISTIC
/begin CHARACTERISTIC ID_ERR_DTC_CKS_ECU_SW "" CURVE 0x60468 _REC_CUR_20_u2_u2 65535. _CNV_A_R_LINEAR_____17_CM 0. 65535. FORMAT "%5.0"
 /begin AXIS_DESCR COM_AXIS ONLINE_DUMMY _CNV_S_6_RANGE_FMY__320_CM 6 0. 5. AXIS_PTS_REF ldp_fmy_dtc /end AXIS_DESCR
/end CHARACTERISTIC
/begin CHARACTERISTIC ID_ERR_ENVD_CKS_ECU_SW "" CURVE 0x60464 _REC_CUR_20_u1_u1 17. _CNV_S_6_RANGE_DIAG_321_CM 4. 21.
 /begin AXIS_DESCR COM_AXIS ONLINE_DUMMY _CNV_S_4_RANGE_FMY__322_CM 4 0. 3. AXIS_PTS_REF ldp_fmy_envd /end AXIS_DESCR
/end CHARACTERISTIC
/begin CHARACTERISTIC C_DIAG_CONF_CKS_ECU_SW "" VALUE 0x60474 _REC_VAL_20_u1 255. _CNV_A_R_LINEAR_____13_CM 0. 255. FORMAT "%3.0" /end CHARACTERISTIC
/begin CHARACTERISTIC C_DC_INC_CKS_ECU_SW "" VALUE 0x60475 _REC_VAL_20_u1 255. _CNV_A_R_LINEAR_____13_CM 0. 255. FORMAT "%3.0" /end CHARACTERISTIC
/begin CHARACTERISTIC C_DC_MAX_CKS_ECU_SW "" VALUE 0x60477 _REC_VAL_20_u1 255. _CNV_A_R_LINEAR_____13_CM 0. 255. FORMAT "%3.0" /end CHARACTERISTIC
/begin CHARACTERISTIC C_DC_DEC_CKS_ECU_SW "" VALUE 0x60476 _REC_VAL_20_u1 255. _CNV_A_R_LINEAR_____13_CM 0. 255. FORMAT "%3.0" /end CHARACTERISTIC
/begin CHARACTERISTIC ID_ERR_DTC_TOUT_ECTU_1 "" CURVE 0x6047c _REC_CUR_20_u2_u2 65535. _CNV_A_R_LINEAR_____17_CM 0. 65535. FORMAT "%5.0"
 /begin AXIS_DESCR COM_AXIS ONLINE_DUMMY _CNV_S_6_RANGE_FMY__320_CM 6 0. 5. AXIS_PTS_REF ldp_fmy_dtc /end AXIS_DESCR
/end CHARACTERISTIC
/begin CHARACTERISTIC ID_ERR_ENVD_TOUT_ECTU_1 "" CURVE 0x60478 _REC_CUR_20_u1_u1 17. _CNV_S_6_RANGE_DIAG_321_CM 4. 21.
 /begin AXIS_DESCR COM_AXIS ONLINE_DUMMY _CNV_S_4_RANGE_FMY__322_CM 4 0. 3. AXIS_PTS_REF ldp_fmy_envd /end AXIS_DESCR
/end CHARACTERISTIC
/begin CHARACTERISTIC C_DIAG_CONF_TOUT_ECTU_1 "" VALUE 0x60488 _REC_VAL_20_u1 255. _CNV_A_R_LINEAR_____13_CM 0. 255. FORMAT "%3.0" /end CHARACTERISTIC
/begin CHARACTERISTIC C_DC_INC_TOUT_ECTU_1 "" VALUE 0x60489 _REC_VAL_20_u1 255. _CNV_A_R_LINEAR_____13_CM 0. 255. FORMAT "%3.0" /end CHARACTERISTIC
/begin CHARACTERISTIC C_DC_MAX_TOUT_ECTU_1 "" VALUE 0x6048b _REC_VAL_20_u1 255. _CNV_A_R_LINEAR_____13_CM 0. 255. FORMAT "%3.0" /end CHARACTERISTIC
/begin CHARACTERISTIC C_DC_DEC_TOUT_ECTU_1 "" VALUE 0x6048a _REC_VAL_20_u1 255. _CNV_A_R_LINEAR_____13_CM 0. 255. FORMAT "%3.0" /end CHARACTERISTIC
/begin CHARACTERISTIC ID_ERR_DTC_TOUT_ICL_2 "" CURVE 0x60490 _REC_CUR_20_u2_u2 65535. _CNV_A_R_LINEAR_____17_CM 0. 65535. FORMAT "%5.0"
 /begin AXIS_DESCR COM_AXIS ONLINE_DUMMY _CNV_S_6_RANGE_FMY__320_CM 6 0. 5. AXIS_PTS_REF ldp_fmy_dtc /end AXIS_DESCR
/end CHARACTERISTIC
/begin CHARACTERISTIC ID_ERR_ENVD_TOUT_ICL_2 "" CURVE 0x6048c _REC_CUR_20_u1_u1 17. _CNV_S_6_RANGE_DIAG_321_CM 4. 21.
 /begin AXIS_DESCR COM_AXIS ONLINE_DUMMY _CNV_S_4_RANGE_FMY__322_CM 4 0. 3. AXIS_PTS_REF ldp_fmy_envd /end AXIS_DESCR
/end CHARACTERISTIC
/begin CHARACTERISTIC C_DIAG_CONF_TOUT_ICL_2 "" VALUE 0x6049c _REC_VAL_20_u1 255. _CNV_A_R_LINEAR_____13_CM 0. 255. FORMAT "%3.0" /end CHARACTERISTIC
/begin CHARACTERISTIC C_DC_INC_TOUT_ICL_2 "" VALUE 0x6049d _REC_VAL_20_u1 255. _CNV_A_R_LINEAR_____13_CM 0. 255. FORMAT "%3.0" /end CHARACTERISTIC
/begin CHARACTERISTIC C_DC_MAX_TOUT_ICL_2 "" VALUE 0x6049f _REC_VAL_20_u1 255. _CNV_A_R_LINEAR_____13_CM 0. 255. FORMAT "%3.0" /end CHARACTERISTIC
/begin CHARACTERISTIC C_DC_DEC_TOUT_ICL_2 "" VALUE 0x6049e _REC_VAL_20_u1 255. _CNV_A_R_LINEAR_____13_CM 0. 255. FORMAT "%3.0" /end CHARACTERISTIC
/begin CHARACTERISTIC ID_ERR_DTC_TOUT_ICL_3 "" CURVE 0x604a4 _REC_CUR_20_u2_u2 65535. _CNV_A_R_LINEAR_____17_CM 0. 65535. FORMAT "%5.0"
 /begin AXIS_DESCR COM_AXIS ONLINE_DUMMY _CNV_S_6_RANGE_FMY__320_CM 6 0. 5. AXIS_PTS_REF ldp_fmy_dtc /end AXIS_DESCR
/end CHARACTERISTIC
/begin CHARACTERISTIC ID_ERR_ENVD_TOUT_ICL_3 "" CURVE 0x604a0 _REC_CUR_20_u1_u1 17. _CNV_S_6_RANGE_DIAG_321_CM 4. 21.
 /begin AXIS_DESCR COM_AXIS ONLINE_DUMMY _CNV_S_4_RANGE_FMY__322_CM 4 0. 3. AXIS_PTS_REF ldp_fmy_envd /end AXIS_DESCR
/end CHARACTERISTIC
/begin CHARACTERISTIC C_DIAG_CONF_TOUT_ICL_3 "" VALUE 0x604b0 _REC_VAL_20_u1 255. _CNV_A_R_LINEAR_____13_CM 0. 255. FORMAT "%3.0" /end CHARACTERISTIC
/begin CHARACTERISTIC C_DC_INC_TOUT_ICL_3 "" VALUE 0x604b1 _REC_VAL_20_u1 255. _CNV_A_R_LINEAR_____13_CM 0. 255. FORMAT "%3.0" /end CHARACTERISTIC
/begin CHARACTERISTIC C_DC_MAX_TOUT_ICL_3 "" VALUE 0x604b3 _REC_VAL_20_u1 255. _CNV_A_R_LINEAR_____13_CM 0. 255. FORMAT "%3.0" /end CHARACTERISTIC
/begin CHARACTERISTIC C_DC_DEC_TOUT_ICL_3 "" VALUE 0x604b2 _REC_VAL_20_u1 255. _CNV_A_R_LINEAR_____13_CM 0. 255. FORMAT "%3.0" /end CHARACTERISTIC
/begin CHARACTERISTIC ID_ERR_DTC_TOUT_ASR_1 "" CURVE 0x604b8 _REC_CUR_20_u2_u2 65535. _CNV_A_R_LINEAR_____17_CM 0. 65535. FORMAT "%5.0"
 /begin AXIS_DESCR COM_AXIS ONLINE_DUMMY _CNV_S_6_RANGE_FMY__320_CM 6 0. 5. AXIS_PTS_REF ldp_fmy_dtc /end AXIS_DESCR
/end CHARACTERISTIC
/begin CHARACTERISTIC ID_ERR_ENVD_TOUT_ASR_1 "" CURVE 0x604b4 _REC_CUR_20_u1_u1 17. _CNV_S_6_RANGE_DIAG_321_CM 4. 21.
 /begin AXIS_DESCR COM_AXIS ONLINE_DUMMY _CNV_S_4_RANGE_FMY__322_CM 4 0. 3. AXIS_PTS_REF ldp_fmy_envd /end AXIS_DESCR
/end CHARACTERISTIC
/begin CHARACTERISTIC C_DIAG_CONF_TOUT_ASR_1 "" VALUE 0x604c4 _REC_VAL_20_u1 255. _CNV_A_R_LINEAR_____13_CM 0. 255. FORMAT "%3.0" /end CHARACTERISTIC
/begin CHARACTERISTIC C_DC_INC_TOUT_ASR_1 "" VALUE 0x604c5 _REC_VAL_20_u1 255. _CNV_A_R_LINEAR_____13_CM 0. 255. FORMAT "%3.0" /end CHARACTERISTIC
/begin CHARACTERISTIC C_DC_MAX_TOUT_ASR_1 "" VALUE 0x604c7 _REC_VAL_20_u1 255. _CNV_A_R_LINEAR_____13_CM 0. 255. FORMAT "%3.0" /end CHARACTERISTIC
/begin CHARACTERISTIC C_DC_DEC_TOUT_ASR_1 "" VALUE 0x604c6 _REC_VAL_20_u1 255. _CNV_A_R_LINEAR_____13_CM 0. 255. FORMAT "%3.0" /end CHARACTERISTIC
/begin CHARACTERISTIC ID_ERR_DTC_TOUT_ASR_3 "" CURVE 0x604cc _REC_CUR_20_u2_u2 65535. _CNV_A_R_LINEAR_____17_CM 0. 65535. FORMAT "%5.0"
 /begin AXIS_DESCR COM_AXIS ONLINE_DUMMY _CNV_S_6_RANGE_FMY__320_CM 6 0. 5. AXIS_PTS_REF ldp_fmy_dtc /end AXIS_DESCR
/end CHARACTERISTIC
/begin CHARACTERISTIC ID_ERR_ENVD_TOUT_ASR_3 "" CURVE 0x604c8 _REC_CUR_20_u1_u1 17. _CNV_S_6_RANGE_DIAG_321_CM 4. 21.
 /begin AXIS_DESCR COM_AXIS ONLINE_DUMMY _CNV_S_4_RANGE_FMY__322_CM 4 0. 3. AXIS_PTS_REF ldp_fmy_envd /end AXIS_DESCR
/end CHARACTERISTIC
/begin CHARACTERISTIC C_DIAG_CONF_TOUT_ASR_3 "" VALUE 0x604d8 _REC_VAL_20_u1 255. _CNV_A_R_LINEAR_____13_CM 0. 255. FORMAT "%3.0" /end CHARACTERISTIC
/begin CHARACTERISTIC C_DC_INC_TOUT_ASR_3 "" VALUE 0x604d9 _REC_VAL_20_u1 255. _CNV_A_R_LINEAR_____13_CM 0. 255. FORMAT "%3.0" /end CHARACTERISTIC
/begin CHARACTERISTIC C_DC_MAX_TOUT_ASR_3 "" VALUE 0x604db _REC_VAL_20_u1 255. _CNV_A_R_LINEAR_____13_CM 0. 255. FORMAT "%3.0" /end CHARACTERISTIC
/begin CHARACTERISTIC C_DC_DEC_TOUT_ASR_3 "" VALUE 0x604da _REC_VAL_20_u1 255. _CNV_A_R_LINEAR_____13_CM 0. 255. FORMAT "%3.0" /end CHARACTERISTIC
/begin CHARACTERISTIC ID_ERR_DTC_VS "" CURVE 0x604e0 _REC_CUR_20_u2_u2 65535. _CNV_A_R_LINEAR_____17_CM 0. 65535. FORMAT "%5.0"
 /begin AXIS_DESCR COM_AXIS ONLINE_DUMMY _CNV_S_6_RANGE_FMY__320_CM 6 0. 5. AXIS_PTS_REF ldp_fmy_dtc /end AXIS_DESCR
/end CHARACTERISTIC
/begin CHARACTERISTIC ID_ERR_ENVD_VS "" CURVE 0x604dc _REC_CUR_20_u1_u1 17. _CNV_S_6_RANGE_DIAG_321_CM 4. 21.
 /begin AXIS_DESCR COM_AXIS ONLINE_DUMMY _CNV_S_4_RANGE_FMY__322_CM 4 0. 3. AXIS_PTS_REF ldp_fmy_envd /end AXIS_DESCR
/end CHARACTERISTIC
/begin CHARACTERISTIC C_DIAG_CONF_VS "" VALUE 0x604ec _REC_VAL_20_u1 255. _CNV_A_R_LINEAR_____13_CM 0. 255. FORMAT "%3.0" /end CHARACTERISTIC
/begin CHARACTERISTIC C_DC_INC_VS "" VALUE 0x604ed _REC_VAL_20_u1 255. _CNV_A_R_LINEAR_____13_CM 0. 255. FORMAT "%3.0" /end CHARACTERISTIC
/begin CHARACTERISTIC C_DC_MAX_VS "" VALUE 0x604ef _REC_VAL_20_u1 255. _CNV_A_R_LINEAR_____13_CM 0. 255. FORMAT "%3.0" /end CHARACTERISTIC
/begin CHARACTERISTIC C_DC_DEC_VS "" VALUE 0x604ee _REC_VAL_20_u1 255. _CNV_A_R_LINEAR_____13_CM 0. 255. FORMAT "%3.0" /end CHARACTERISTIC
/begin CHARACTERISTIC ID_ERR_DTC_KNKS_1 "" CURVE 0x604f4 _REC_CUR_20_u2_u2 65535. _CNV_A_R_LINEAR_____17_CM 0. 65535. FORMAT "%5.0"
 /begin AXIS_DESCR COM_AXIS ONLINE_DUMMY _CNV_S_6_RANGE_FMY__320_CM 6 0. 5. AXIS_PTS_REF ldp_fmy_dtc /end AXIS_DESCR
/end CHARACTERISTIC
/begin CHARACTERISTIC ID_ERR_ENVD_KNKS_1 "" CURVE 0x604f0 _REC_CUR_20_u1_u1 17. _CNV_S_6_RANGE_DIAG_321_CM 4. 21.
 /begin AXIS_DESCR COM_AXIS ONLINE_DUMMY _CNV_S_4_RANGE_FMY__322_CM 4 0. 3. AXIS_PTS_REF ldp_fmy_envd /end AXIS_DESCR
/end CHARACTERISTIC
/begin CHARACTERISTIC C_DIAG_CONF_KNKS_1 "" VALUE 0x60500 _REC_VAL_20_u1 255. _CNV_A_R_LINEAR_____13_CM 0. 255. FORMAT "%3.0" /end CHARACTERISTIC
/begin CHARACTERISTIC C_DC_INC_KNKS_1 "" VALUE 0x60501 _REC_VAL_20_u1 255. _CNV_A_R_LINEAR_____13_CM 0. 255. FORMAT "%3.0" /end CHARACTERISTIC
/begin CHARACTERISTIC C_DC_MAX_KNKS_1 "" VALUE 0x60503 _REC_VAL_20_u1 255. _CNV_A_R_LINEAR_____13_CM 0. 255. FORMAT "%3.0" /end CHARACTERISTIC
/begin CHARACTERISTIC C_DC_DEC_KNKS_1 "" VALUE 0x60502 _REC_VAL_20_u1 255. _CNV_A_R_LINEAR_____13_CM 0. 255. FORMAT "%3.0" /end CHARACTERISTIC
/begin CHARACTERISTIC ID_ERR_DTC_KNKS_2 "" CURVE 0x60508 _REC_CUR_20_u2_u2 65535. _CNV_A_R_LINEAR_____17_CM 0. 65535. FORMAT "%5.0"
 /begin AXIS_DESCR COM_AXIS ONLINE_DUMMY _CNV_S_6_RANGE_FMY__320_CM 6 0. 5. AXIS_PTS_REF ldp_fmy_dtc /end AXIS_DESCR
/end CHARACTERISTIC
/begin CHARACTERISTIC ID_ERR_ENVD_KNKS_2 "" CURVE 0x60504 _REC_CUR_20_u1_u1 17. _CNV_S_6_RANGE_DIAG_321_CM 4. 21.
 /begin AXIS_DESCR COM_AXIS ONLINE_DUMMY _CNV_S_4_RANGE_FMY__322_CM 4 0. 3. AXIS_PTS_REF ldp_fmy_envd /end AXIS_DESCR
/end CHARACTERISTIC
/begin CHARACTERISTIC C_DIAG_CONF_KNKS_2 "" VALUE 0x60514 _REC_VAL_20_u1 255. _CNV_A_R_LINEAR_____13_CM 0. 255. FORMAT "%3.0" /end CHARACTERISTIC
/begin CHARACTERISTIC C_DC_INC_KNKS_2 "" VALUE 0x60515 _REC_VAL_20_u1 255. _CNV_A_R_LINEAR_____13_CM 0. 255. FORMAT "%3.0" /end CHARACTERISTIC
/begin CHARACTERISTIC C_DC_MAX_KNKS_2 "" VALUE 0x60517 _REC_VAL_20_u1 255. _CNV_A_R_LINEAR_____13_CM 0. 255. FORMAT "%3.0" /end CHARACTERISTIC
/begin CHARACTERISTIC C_DC_DEC_KNKS_2 "" VALUE 0x60516 _REC_VAL_20_u1 255. _CNV_A_R_LINEAR_____13_CM 0. 255. FORMAT "%3.0" /end CHARACTERISTIC
/begin CHARACTERISTIC ID_ERR_DTC_TD_IGC_CUT_0 "" CURVE 0x6051c _REC_CUR_20_u2_u2 65535. _CNV_A_R_LINEAR_____17_CM 0. 65535. FORMAT "%5.0"
 /begin AXIS_DESCR COM_AXIS ONLINE_DUMMY _CNV_S_6_RANGE_FMY__320_CM 6 0. 5. AXIS_PTS_REF ldp_fmy_dtc /end AXIS_DESCR
/end CHARACTERISTIC
/begin CHARACTERISTIC ID_ERR_ENVD_TD_IGC_CUT_0 "" CURVE 0x60518 _REC_CUR_20_u1_u1 17. _CNV_S_6_RANGE_DIAG_321_CM 4. 21.
 /begin AXIS_DESCR COM_AXIS ONLINE_DUMMY _CNV_S_4_RANGE_FMY__322_CM 4 0. 3. AXIS_PTS_REF ldp_fmy_envd /end AXIS_DESCR
/end CHARACTERISTIC
/begin CHARACTERISTIC C_DIAG_CONF_TD_IGC_CUT_0 "" VALUE 0x60528 _REC_VAL_20_u1 255. _CNV_A_R_LINEAR_____13_CM 0. 255. FORMAT "%3.0" /end CHARACTERISTIC
/begin CHARACTERISTIC C_DC_INC_TD_IGC_CUT_0 "" VALUE 0x60529 _REC_VAL_20_u1 255. _CNV_A_R_LINEAR_____13_CM 0. 255. FORMAT "%3.0" /end CHARACTERISTIC
/begin AXIS_PTS ldp_fmy_dtc "" 0x69b92 DTC _REC_AXS_20_u2 5. _CNV_S_6_RANGE_FMY__320_CM 6 0. 5. /end AXIS_PTS
/begin MEASUREMENT ERR_INFO_STAT "" UWORD _CNV_S_2_RANGE______77_R_CM 1 100. 0. 255. ECU_ADDRESS 0x3fc2dc /end MEASUREMENT
/begin MEASUREMENT LV_ERR_SYM_CHG_CPS "" UWORD _CNV_S_2_RANGE______77_R_CM 1 100. 0. 255. ECU_ADDRESS 0x3fc3a8 BIT_MASK 0x400 /end MEASUREMENT
/begin MEASUREMENT LV_CDN_DIAG_CPS "" UWORD _CNV_S_2_RANGE______77_R_CM 1 100. 0. 255. ECU_ADDRESS 0x3fc3a8 BIT_MASK 0x800 /end MEASUREMENT
/begin MEASUREMENT ERR_SYM_CPS "" UWORD _CNV_S_5_RANGE_ERR__323_CM 1 100. 0. 8. ECU_ADDRESS 0x3fc3a8 BIT_MASK 0xF /end MEASUREMENT
/begin MEASUREMENT LV_END_DIAG_CPS "" UWORD _CNV_S_2_RANGE______77_R_CM 1 100. 0. 255. ECU_ADDRESS 0x3fc3a8 BIT_MASK 0x1000 /end MEASUREMENT
/begin MEASUREMENT CTR_ABC_END_DIAG_CPS "" UBYTE _CNV_A_R_LINEAR_____13_CM 1 100. 0. 255. ECU_ADDRESS 0x3fc3aa FORMAT "%3.0" /end MEASUREMENT
/begin MEASUREMENT CTR_ABC_IVVT_0 "" UBYTE _CNV_A_R_LINEAR_____13_CM 1 100. 0. 255. ECU_ADDRESS 0x3fc3ac FORMAT "%3.0" /end MEASUREMENT
/begin MEASUREMENT LV_ERR_DET_IVVT_0 "" UWORD _CNV_S_2_RANGE______77_R_CM 1 100. 0. 255. ECU_ADDRESS 0x3fc3ae BIT_MASK 0x100 /end MEASUREMENT
/begin MEASUREMENT LV_ERR_SYM_CHG_IVVT_0 "" UWORD _CNV_S_2_RANGE______77_R_CM 1 100. 0. 255. ECU_ADDRESS 0x3fc3ae BIT_MASK 0x400 /end MEASUREMENT
/begin MEASUREMENT LV_CDN_DIAG_IVVT_0 "" UWORD _CNV_S_2_RANGE______77_R_CM 1 100. 0. 255. ECU_ADDRESS 0x3fc3ae BIT_MASK 0x800 /end MEASUREMENT
/begin MEASUREMENT ERR_SYM_IVVT_0 "" UWORD _CNV_S_5_RANGE_ERR__323_CM 1 100. 0. 8. ECU_ADDRESS 0x3fc3ae BIT_MASK 0xF /end MEASUREMENT
/begin MEASUREMENT LV_END_DIAG_IVVT_0 "" UWORD _CNV_S_2_RANGE______77_R_CM 1 100. 0. 255. ECU_ADDRESS 0x3fc3ae BIT_MASK 0x1000 /end MEASUREMENT
/begin MEASUREMENT CTR_ABC_END_DIAG_IVVT_0 "" UBYTE _CNV_A_R_LINEAR_____13_CM 1 100. 0. 255. ECU_ADDRESS 0x3fc3b0 FORMAT "%3.0" /end MEASUREMENT
/begin MEASUREMENT CTR_ABC_IVVT_1 "" UBYTE _CNV_A_R_LINEAR_____13_CM 1 100. 0. 255. ECU_ADDRESS 0x3fc3b2 FORMAT "%3.0" /end MEASUREMENT
/begin MEASUREMENT LV_ERR_DET_IVVT_1 "" UWORD _CNV_S_2_RANGE______77_R_CM 1 100. 0. 255. ECU_ADDRESS 0x3fc3b4 BIT_MASK 0x100 /end MEASUREMENT
/begin MEASUREMENT LV_ERR_SYM_CHG_IVVT_1 "" UWORD _CNV_S_2_RANGE______77_R_CM 1 100. 0. 255. ECU_ADDRESS 0x3fc3b4 BIT_MASK 0x400 /end MEASUREMENT
/begin MEASUREMENT LV_CDN_DIAG_IVVT_1 "" UWORD _CNV_S_2_RANGE______77_R_CM 1 100. 0. 255. ECU_ADDRESS 0x3fc3b4 BIT_MASK 0x800 /end MEASUREMENT
/begin MEASUREMENT ERR_SYM_IVVT_1 "" UWORD _CNV_S_5_RANGE_ERR__323_CM 1 100. 0. 8. ECU_ADDRESS 0x3fc3b4 BIT_MASK 0xF /end MEASUREMENT
/begin MEASUREMENT LV_END_DIAG_IVVT_1 "" UWORD _CNV_S_2_RANGE______77_R_CM 1 100. 0. 255. ECU_ADDRESS 0x3fc3b4 BIT_MASK 0x1000 /end MEASUREMENT
/begin MEASUREMENT CTR_ABC_END_DIAG_IVVT_1 "" UBYTE _CNV_A_R_LINEAR_____13_CM 1 100. 0. 255. ECU_ADDRESS 0x3fc3b6 FORMAT "%3.0" /end MEASUREMENT
/begin MEASUREMENT CTR_ABC_CKS_ECU_SW "" UBYTE _CNV_A_R_LINEAR_____13_CM 1 100. 0. 255. ECU_ADDRESS 0x3fc3b8 FORMAT "%3.0" /end MEASUREMENT
/begin MEASUREMENT LV_ERR_DET_CKS_ECU_SW "" UWORD _CNV_S_2_RANGE______77_R_CM 1 100. 0. 255. ECU_ADDRESS 0x3fc3ba BIT_MASK 0x100 /end MEASUREMENT
/begin MEASUREMENT LV_ERR_SYM_CHG_CKS_ECU_SW "" UWORD _CNV_S_2_RANGE______77_R_CM 1 100. 0. 255. ECU_ADDRESS 0x3fc3ba BIT_MASK 0x400 /end MEASUREMENT
/begin MEASUREMENT LV_CDN_DIAG_CKS_ECU_SW "" UWORD _CNV_S_2_RANGE______77_R_CM 1 100. 0. 255. ECU_ADDRESS 0x3fc3ba BIT_MASK 0x800 /end MEASUREMENT
/begin MEASUREMENT ERR_SYM_CKS_ECU_SW "" UWORD _CNV_S_5_RANGE_ERR__323_CM 1 100. 0. 8. ECU_ADDRESS 0x3fc3ba BIT_MASK 0xF /end MEASUREMENT
/begin MEASUREMENT LV_END_DIAG_CKS_ECU_SW "" UWORD _CNV_S_2_RANGE______77_R_CM 1 100. 0. 255. ECU_ADDRESS 0x3fc3ba BIT_MASK 0x1000 /end MEASUREMENT
/begin MEASUREMENT CTR_ABC_END_DIAG_CKS_ECU_SW "" UBYTE _CNV_A_R_LINEAR_____13_CM 1 100. 0. 255. ECU_ADDRESS 0x3fc3bc FORMAT "%3.0" /end MEASUREMENT
/begin MEASUREMENT CTR_ABC_TOUT_ETCU_1 "" UBYTE _CNV_A_R_LINEAR_____13_CM 1 100. 0. 255. ECU_ADDRESS 0x3fc3be FORMAT "%3.0" /end MEASUREMENT
/begin MEASUREMENT LV_ERR_DET_TOUT_ETCU_1 "" UWORD _CNV_S_2_RANGE______77_R_CM 1 100. 0. 255. ECU_ADDRESS 0x3fc3c0 BIT_MASK 0x100 /end MEASUREMENT
/begin MEASUREMENT LV_ERR_SYM_CHG_TOUT_ETCU_1 "" UWORD _CNV_S_2_RANGE______77_R_CM 1 100. 0. 255. ECU_ADDRESS 0x3fc3c0 BIT_MASK 0x400 /end MEASUREMENT
/begin MEASUREMENT LV_CDN_DIAG_TOUT_ETCU_1 "" UWORD _CNV_S_2_RANGE______77_R_CM 1 100. 0. 255. ECU_ADDRESS 0x3fc3c0 BIT_MASK 0x800 /end MEASUREMENT
/begin MEASUREMENT ERR_SYM_TOUT_ETCU_1 "" UWORD _CNV_S_5_RANGE_ERR__323_CM 1 100. 0. 8. ECU_ADDRESS 0x3fc3c0 BIT_MASK 0xF /end MEASUREMENT
/begin MEASUREMENT LV_END_DIAG_TOUT_ETCU_1 "" UWORD _CNV_S_2_RANGE______77_R_CM 1 100. 0. 255. ECU_ADDRESS 0x3fc3c0 BIT_MASK 0x1000 /end MEASUREMENT
/begin MEASUREMENT CTR_ABC_END_DIAG_TOUT_ETCU_1 "" UBYTE _CNV_A_R_LINEAR_____13_CM 1 100. 0. 255. ECU_ADDRESS 0x3fc3c2 FORMAT "%3.0" /end MEASUREMENT
/begin MEASUREMENT CTR_ABC_TOUT_ICL_2 "" UBYTE _CNV_A_R_LINEAR_____13_CM 1 100. 0. 255. ECU_ADDRESS 0x3fc3c4 FORMAT "%3.0" /end MEASUREMENT
/begin MEASUREMENT LV_ERR_DET_TOUT_ICL_2 "" UWORD _CNV_S_2_RANGE______77_R_CM 1 100. 0. 255. ECU_ADDRESS 0x3fc3c6 BIT_MASK 0x100 /end MEASUREMENT
/begin MEASUREMENT LV_ERR_SYM_CHG_TOUT_ICL_2 "" UWORD _CNV_S_2_RANGE______77_R_CM 1 100. 0. 255. ECU_ADDRESS 0x3fc3c6 BIT_MASK 0x400 /end MEASUREMENT
/begin MEASUREMENT LV_CDN_DIAG_TOUT_ICL_2 "" UWORD _CNV_S_2_RANGE______77_R_CM 1 100. 0. 255. ECU_ADDRESS 0x3fc3c6 BIT_MASK 0x800 /end MEASUREMENT
/begin MEASUREMENT ERR_SYM_TOUT_ICL_2 "" UWORD _CNV_S_5_RANGE_ERR__323_CM 1 100. 0. 8. ECU_ADDRESS 0x3fc3c6 BIT_MASK 0xF /end MEASUREMENT
/begin MEASUREMENT LV_END_DIAG_TOUT_ICL_2 "" UWORD _CNV_S_2_RANGE______77_R_CM 1 100. 0. 255. ECU_ADDRESS 0x3fc3c6 BIT_MASK 0x1000 /end MEASUREMENT
/begin MEASUREMENT CTR_ABC_END_DIAG_TOUT_ICL__ "" UBYTE _CNV_A_R_LINEAR_____13_CM 1 100. 0. 255. ECU_ADDRESS 0x3fc3c8 FORMAT "%3.0" /end MEASUREMENT
/begin MEASUREMENT CTR_ABC_TOUT_ICL_3 "" UBYTE _CNV_A_R_LINEAR_____13_CM 1 100. 0. 255. ECU_ADDRESS 0x3fc3ca FORMAT "%3.0" /end MEASUREMENT
/begin MEASUREMENT LV_ERR_DET_TOUT_ICL_3 "" UWORD _CNV_S_2_RANGE______77_R_CM 1 100. 0. 255. ECU_ADDRESS 0x3fc3cc BIT_MASK 0x100 /end MEASUREMENT
/begin MEASUREMENT LV_ERR_SYM_CHG_TOUT_ICL_3 "" UWORD _CNV_S_2_RANGE______77_R_CM 1 100. 0. 255. ECU_ADDRESS 0x3fc3cc BIT_MASK 0x400 /end MEASUREMENT
/begin MEASUREMENT LV_CDN_DIAG_TOUT_ICL_3 "" UWORD _CNV_S_2_RANGE______77_R_CM 1 100. 0. 255. ECU_ADDRESS 0x3fc3cc BIT_MASK 0x800 /end MEASUREMENT
/begin MEASUREMENT ERR_SYM_TOUT_ICL_3 "" UWORD _CNV_S_5_RANGE_ERR__323_CM 1 100. 0. 8. ECU_ADDRESS 0x3fc3cc BIT_MASK 0xF /end MEASUREMENT
/begin MEASUREMENT LV_END_DIAG_TOUT_ICL_3 "" UWORD _CNV_S_2_RANGE______77_R_CM 1 100. 0. 255. ECU_ADDRESS 0x3fc3cc BIT_MASK 0x1000 /end MEASUREMENT
/begin MEASUREMENT CTR_ABC_END_DIAG_TOUT_ICL_3 "" UBYTE _CNV_A_R_LINEAR_____13_CM 1 100. 0. 255. ECU_ADDRESS 0x3fc3ce FORMAT "%3.0" /end MEASUREMENT
/begin MEASUREMENT CTR_ABC_TOUT_ASR_1 "" UBYTE _CNV_A_R_LINEAR_____13_CM 1 100. 0. 255. ECU_ADDRESS 0x3fc3d0 FORMAT "%3.0" /end MEASUREMENT
/begin MEASUREMENT LV_ERR_DET_TOUT_ASR_1 "" UWORD _CNV_S_2_RANGE______77_R_CM 1 100. 0. 255. ECU_ADDRESS 0x3fc3d2 BIT_MASK 0x100 /end MEASUREMENT
/begin MEASUREMENT LV_ERR_SYM_CHG_TOUT_ASR_1 "" UWORD _CNV_S_2_RANGE______77_R_CM 1 100. 0. 255. ECU_ADDRESS 0x3fc3d2 BIT_MASK 0x400 /end MEASUREMENT
/begin MEASUREMENT LV_CDN_DIAG_TOUT_ASR_1 "" UWORD _CNV_S_2_RANGE______77_R_CM 1 100. 0. 255. ECU_ADDRESS 0x3fc3d2 BIT_MASK 0x800 /end MEASUREMENT
/begin MEASUREMENT ERR_SYM_TOUT_ASR_1 "" UWORD _CNV_S_5_RANGE_ERR__323_CM 1 100. 0. 8. ECU_ADDRESS 0x3fc3d2 BIT_MASK 0xF /end MEASUREMENT
/begin MEASUREMENT LV_END_DIAG_TOUT_ASR_1 "" UWORD _CNV_S_2_RANGE______77_R_CM 1 100. 0. 255. ECU_ADDRESS 0x3fc3d2 BIT_MASK 0x1000 /end MEASUREMENT
/begin MEASUREMENT CTR_ABC_END_DIAG_TOUT_ASR_1 "" UBYTE _CNV_A_R_LINEAR_____13_CM 1 100. 0. 255. ECU_ADDRESS 0x3fc3d4 FORMAT "%3.0" /end MEASUREMENT
/begin MEASUREMENT CTR_ABC_TOUT_ASR_3 "" UBYTE _CNV_A_R_LINEAR_____13_CM 1 100. 0. 255. ECU_ADDRESS 0x3fc3d6 FORMAT "%3.0" /end MEASUREMENT
/begin MEASUREMENT LV_ERR_DET_TOUT_ASR_3 "" UWORD _CNV_S_2_RANGE______77_R_CM 1 100. 0. 255. ECU_ADDRESS 0x3fc3d8 BIT_MASK 0x100 /end MEASUREMENT
/begin MEASUREMENT LV_ERR_SYM_CHG_TOUT_ASR_3 "" UWORD _CNV_S_2_RANGE______77_R_CM 1 100. 0. 255. ECU_ADDRESS 0x3fc3d8 BIT_MASK 0x400 /end MEASUREMENT
/begin MEASUREMENT LV_CDN_DIAG_TOUT_ASR_3 "" UWORD _CNV_S_2_RANGE______77_R_CM 1 100. 0. 255. ECU_ADDRESS 0x3fc3d8 BIT_MASK 0x800 /end MEASUREMENT
/begin MEASUREMENT ERR_SYM_TOUT_ASR_3 "" UWORD _CNV_S_5_RANGE_ERR__323_CM 1 100. 0. 8. ECU_ADDRESS 0x3fc3d8 BIT_MASK 0xF /end MEASUREMENT
/begin MEASUREMENT LV_END_DIAG_TOUT_ASR_3 "" UWORD _CNV_S_2_RANGE______77_R_CM 1 100. 0. 255. ECU_ADDRESS 0x3fc3d8 BIT_MASK 0x1000 /end MEASUREMENT
/begin MEASUREMENT CTR_ABC_END_DIAG_TOUT_ASR_3 "" UBYTE _CNV_A_R_LINEAR_____13_CM 1 100. 0. 255. ECU_ADDRESS 0x3fc3da FORMAT "%3.0" /end MEASUREMENT
/begin MEASUREMENT CTR_ABC_VS "" UBYTE _CNV_A_R_LINEAR_____13_CM 1 100. 0. 255. ECU_ADDRESS 0x3fc3dc FORMAT "%3.0" /end MEASUREMENT
/begin MEASUREMENT LV_ERR_DET_VS "" UWORD _CNV_S_2_RANGE______77_R_CM 1 100. 0. 255. ECU_ADDRESS 0x3fc3de BIT_MASK 0x100 /end MEASUREMENT
/begin MEASUREMENT LV_ERR_SYM_CHG_VS "" UWORD _CNV_S_2_RANGE______77_R_CM 1 100. 0. 255. ECU_ADDRESS 0x3fc3de BIT_MASK 0x400 /end MEASUREMENT
/begin MEASUREMENT LV_CDN_DIAG_VS "" UWORD _CNV_S_2_RANGE______77_R_CM 1 100. 0. 255. ECU_ADDRESS 0x3fc3de BIT_MASK 0x800 /end MEASUREMENT
/begin MEASUREMENT ERR_SYM_VS "" UWORD _CNV_S_5_RANGE_ERR__323_CM 1 100. 0. 8. ECU_ADDRESS 0x3fc3de BIT_MASK 0xF /end MEASUREMENT
/begin MEASUREMENT LV_END_DIAG_VS "" UWORD _CNV_S_2_RANGE______77_R_CM 1 100. 0. 255. ECU_ADDRESS 0x3fc3de BIT_MASK 0x1000 /end MEASUREMENT
/begin MEASUREMENT CTR_ABC_END_DIAG_VS "" UBYTE _CNV_A_R_LINEAR_____13_CM 1 100. 0. 255. ECU_ADDRESS 0x3fc3e0 FORMAT "%3.0" /end MEASUREMENT
/begin MEASUREMENT CTR_ABC_KNKS_1 "" UBYTE _CNV_A_R_LINEAR_____13_CM 1 100. 0. 255. ECU_ADDRESS 0x3fc3e2 FORMAT "%3.0" /end MEASUREMENT
/begin MEASUREMENT LV_ERR_DET_KNKS_1 "" UWORD _CNV_S_2_RANGE______77_R_CM 1 100. 0. 255. ECU_ADDRESS 0x3fc3e4 BIT_MASK 0x100 /end MEASUREMENT
/begin MEASUREMENT LV_ERR_SYM_CHG_KNKS_1 "" UWORD _CNV_S_2_RANGE______77_R_CM 1 100. 0. 255. ECU_ADDRESS 0x3fc3e4 BIT_MASK 0x400 /end MEASUREMENT
/begin MEASUREMENT LV_CDN_DIAG_KNKS_1 "" UWORD _CNV_S_2_RANGE______77_R_CM 1 100. 0. 255. ECU_ADDRESS 0x3fc3e4 BIT_MASK 0x800 /end MEASUREMENT
/begin MEASUREMENT ERR_SYM_KNKS_1 "" UWORD _CNV_S_5_RANGE_ERR__323_CM 1 100. 0. 8. ECU_ADDRESS 0x3fc3e4 BIT_MASK 0xF /end MEASUREMENT
/begin MEASUREMENT LV_END_DIAG_KNKS_1 "" UWORD _CNV_S_2_RANGE______77_R_CM 1 100. 0. 255. ECU_ADDRESS 0x3fc3e4 BIT_MASK 0x1000 /end MEASUREMENT
/begin MEASUREMENT CTR_ABC_END_DIAG_KNKS_1 "" UBYTE _CNV_A_R_LINEAR_____13_CM 1 100. 0. 255. ECU_ADDRESS 0x3fc3e6 FORMAT "%3.0" /end MEASUREMENT
/begin MEASUREMENT CTR_ABC_KNKS_2 "" UBYTE _CNV_A_R_LINEAR_____13_CM 1 100. 0. 255. ECU_ADDRESS 0x3fc3e8 FORMAT "%3.0" /end MEASUREMENT
/begin MEASUREMENT LV_ERR_DET_KNKS_2 "" UWORD _CNV_S_2_RANGE______77_R_CM 1 100. 0. 255. ECU_ADDRESS 0x3fc3ea BIT_MASK 0x100 /end MEASUREMENT
/begin MEASUREMENT LV_ERR_SYM_CHG_KNKS_2 "" UWORD _CNV_S_2_RANGE______77_R_CM 1 100. 0. 255. ECU_ADDRESS 0x3fc3ea BIT_MASK 0x400 /end MEASUREMENT
/begin MEASUREMENT LV_CDN_DIAG_KNKS_2 "" UWORD _CNV_S_2_RANGE______77_R_CM 1 100. 0. 255. ECU_ADDRESS 0x3fc3ea BIT_MASK 0x800 /end MEASUREMENT
/begin MEASUREMENT ERR_SYM_KNKS_2 "" UWORD _CNV_S_5_RANGE_ERR__323_CM 1 100. 0. 8. ECU_ADDRESS 0x3fc3ea BIT_MASK 0xF /end MEASUREMENT
/begin MEASUREMENT LV_END_DIAG_KNKS_2 "" UWORD _CNV_S_2_RANGE______77_R_CM 1 100. 0. 255. ECU_ADDRESS 0x3fc3ea BIT_MASK 0x1000 /end MEASUREMENT
/begin MEASUREMENT CTR_ABC_END_DIAG_KNKS_2 "" UBYTE _CNV_A_R_LINEAR_____13_CM 1 100. 0. 255. ECU_ADDRESS 0x3fc3ec FORMAT "%3.0" /end MEASUREMENT
/begin MEASUREMENT CTR_ABC_TD_IGC_CUT_0 "" UBYTE _CNV_A_R_LINEAR_____13_CM 1 100. 0. 255. ECU_ADDRESS 0x3fc3ee FORMAT "%3.0" /end MEASUREMENT
/begin MEASUREMENT LV_ERR_DET_TD_IGC_CUT_0 "" UWORD _CNV_S_2_RANGE______77_R_CM 1 100. 0. 255. ECU_ADDRESS 0x3fc3f0 BIT_MASK 0x100 /end MEASUREMENT
/begin MEASUREMENT LV_ERR_SYM_CHG_TD_IGC_CUT_0 "" UWORD _CNV_S_2_RANGE______77_R_CM 1 100. 0. 255. ECU_ADDRESS 0x3fc3f0 BIT_MASK 0x400 /end MEASUREMENT
/begin MEASUREMENT LV_CDN_DIAG_TD_IGC_CUT_0 "" UWORD _CNV_S_2_RANGE______77_R_CM 1 100. 0. 255. ECU_ADDRESS 0x3fc3f0 BIT_MASK 0x800 /end MEASUREMENT
/begin MEASUREMENT ERR_SYM_TD_IGC_CUT_0 "" UWORD _CNV_S_5_RANGE_ERR__323_CM 1 100. 0. 8. ECU_ADDRESS 0x3fc3f0 BIT_MASK 0xF /end MEASUREMENT
/begin MEASUREMENT LV_END_DIAG_TD_IGC_CUT_0 "" UWORD _CNV_S_2_RANGE______77_R_CM 1 100. 0. 255. ECU_ADDRESS 0x3fc3f0 BIT_MASK 0x1000 /end MEASUREMENT
/begin MEASUREMENT CTR_ABC_END_DIAG_TD_IGC_CUT_0 "" UBYTE _CNV_A_R_LINEAR_____13_CM 1 100. 0. 255. ECU_ADDRESS 0x3fc3f2 FORMAT "%3.0" /end MEASUREMENT
/begin MEASUREMENT CTR_ABC_TD_IGC_CUT_1 "" UBYTE _CNV_A_R_LINEAR_____13_CM 1 100. 0. 255. ECU_ADDRESS 0x3fc3f4 FORMAT "%3.0" /end MEASUREMENT
/begin MEASUREMENT LV_ERR_DET_TD_IGC_CUT_1 "" UWORD _CNV_S_2_RANGE______77_R_CM 1 100. 0. 255. ECU_ADDRESS 0x3fc3f6 BIT_MASK 0x100 /end MEASUREMENT
/begin MEASUREMENT LV_ERR_SYM_CHG_TD_IGC_CUT_1 "" UWORD _CNV_S_2_RANGE______77_R_CM 1 100. 0. 255. ECU_ADDRESS 0x3fc3f6 BIT_MASK 0x400 /end MEASUREMENT
/begin MEASUREMENT LV_CDN_DIAG_TD_IGC_CUT_1 "" UWORD _CNV_S_2_RANGE______77_R_CM 1 100. 0. 255. ECU_ADDRESS 0x3fc3f6 BIT_MASK 0x800 /end MEASUREMENT
/begin MEASUREMENT ERR_SYM_TD_IGC_CUT_1 "" UWORD _CNV_S_5_RANGE_ERR__323_CM 1 100. 0. 8. ECU_ADDRESS 0x3fc3f6 BIT_MASK 0xF /end MEASUREMENT
/begin MEASUREMENT LV_END_DIAG_TD_IGC_CUT_1 "" UWORD _CNV_S_2_RANGE______77_R_CM 1 100. 0. 255. ECU_ADDRESS 0x3fc3f6 BIT_MASK 0x1000 /end MEASUREMENT
/begin MEASUREMENT CTR_ABC_END_DIAG_TD_IGC_CUT_1 "" UBYTE _CNV_A_R_LINEAR_____13_CM 1 100. 0. 255. ECU_ADDRESS 0x3fc3f8 FORMAT "%3.0" /end MEASUREMENT
/begin MEASUREMENT CTR_ABC_TD_IGC_CUT_2 "" UBYTE _CNV_A_R_LINEAR_____13_CM 1 100. 0. 255. ECU_ADDRESS 0x3fc3fa FORMAT "%3.0" /end MEASUREMENT
/begin MEASUREMENT LV_ERR_DET_TD_IGC_CUT_2 "" UWORD _CNV_S_2_RANGE______77_R_CM 1 100. 0. 255. ECU_ADDRESS 0x3fc3fc BIT_MASK 0x100 /end MEASUREMENT
/begin MEASUREMENT LV_ERR_SYM_CHG_TD_IGC_CUT_2 "" UWORD _CNV_S_2_RANGE______77_R_CM 1 100. 0. 255. ECU_ADDRESS 0x3fc3fc BIT_MASK 0x400 /end MEASUREMENT
/begin MEASUREMENT LV_CDN_DIAG_TD_IGC_CUT_2 "" UWORD _CNV_S_2_RANGE______77_R_CM 1 100. 0. 255. ECU_ADDRESS 0x3fc3fc BIT_MASK 0x800 /end MEASUREMENT
/begin MEASUREMENT ERR_SYM_TD_IGC_CUT_2 "" UWORD _CNV_S_5_RANGE_ERR__323_CM 1 100. 0. 8. ECU_ADDRESS 0x3fc3fc BIT_MASK 0xF /end MEASUREMENT
/begin MEASUREMENT LV_END_DIAG_TD_IGC_CUT_2 "" UWORD _CNV_S_2_RANGE______77_R_CM 1 100. 0. 255. ECU_ADDRESS 0x3fc3fc BIT_MASK 0x1000 /end MEASUREMENT
/begin MEASUREMENT CTR_ABC_END_DIAG_TD_IGC_CUT_2 "" UBYTE _CNV_A_R_LINEAR_____13_CM 1 100. 0. 255. ECU_ADDRESS 0x3fc3fe FORMAT "%3.0" /end MEASUREMENT
/begin MEASUREMENT CTR_ABC_TD_IGC_CUT_3 "" UBYTE _CNV_A_R_LINEAR_____13_CM 1 100. 0. 255. ECU_ADDRESS 0x3fc400 FORMAT "%3.0" /end MEASUREMENT
/begin MEASUREMENT LV_ERR_DET_TD_IGC_CUT_3 "" UWORD _CNV_S_2_RANGE______77_R_CM 1 100. 0. 255. ECU_ADDRESS 0x3fc402 BIT_MASK 0x100 /end MEASUREMENT
/begin MEASUREMENT LV_ERR_SYM_CHG_TD_IGC_CUT_3 "" UWORD _CNV_S_2_RANGE______77_R_CM 1 100. 0. 255. ECU_ADDRESS 0x3fc402 BIT_MASK 0x400 /end MEASUREMENT
/begin MEASUREMENT LV_CDN_DIAG_TD_IGC_CUT_3 "" UWORD _CNV_S_2_RANGE______77_R_CM 1 100. 0. 255. ECU_ADDRESS 0x3fc402 BIT_MASK 0x800 /end MEASUREMENT
/begin MEASUREMENT ERR_SYM_TD_IGC_CUT_3 "" UWORD _CNV_S_5_RANGE_ERR__323_CM 1 100. 0. 8. ECU_ADDRESS 0x3fc402 BIT_MASK 0xF /end MEASUREMENT
/begin MEASUREMENT LV_END_DIAG_TD_IGC_CUT_3 "" UWORD _CNV_S_2_RANGE______77_R_CM 1 100. 0. 255. ECU_ADDRESS 0x3fc402 BIT_MASK 0x1000 /end MEASUREMENT
/begin MEASUREMENT CTR_ABC_END_DIAG_TD_IGC_CUT_3 "" UBYTE _CNV_A_R_LINEAR_____13_CM 1 100. 0. 255. ECU_ADDRESS 0x3fc404 FORMAT "%3.0" /end MEASUREMENT
/begin MEASUREMENT CTR_ABC_TD_IGC_CUT_4 "" UBYTE _CNV_A_R_LINEAR_____13_CM 1 100. 0. 255. ECU_ADDRESS 0x3fc406 FORMAT "%3.0" /end MEASUREMENT
/begin MEASUREMENT LV_ERR_DET_TD_IGC_CUT_4 "" UWORD _CNV_S_2_RANGE______77_R_CM 1 100. 0. 255. ECU_ADDRESS 0x3fc408 BIT_MASK 0x100 /end MEASUREMENT
/begin MEASUREMENT LV_ERR_SYM_CHG_TD_IGC_CUT_4 "" UWORD _CNV_S_2_RANGE______77_R_CM 1 100. 0. 255. ECU_ADDRESS 0x3fc408 BIT_MASK 0x400 /end MEASUREMENT
/begin MEASUREMENT LV_CDN_DIAG_TD_IGC_CUT_4 "" UWORD _CNV_S_2_RANGE______77_R_CM 1 100. 0. 255. ECU_ADDRESS 0x3fc408 BIT_MASK 0x800 /end MEASUREMENT
/begin MEASUREMENT ERR_SYM_TD_IGC_CUT_4 "" UWORD _CNV_S_5_RANGE_ERR__323_CM 1 100. 0. 8. ECU_ADDRESS 0x3fc408 BIT_MASK 0xF /end MEASUREMENT
/begin MEASUREMENT LV_END_DIAG_TD_IGC_CUT_4 "" UWORD _CNV_S_2_RANGE______77_R_CM 1 100. 0. 255. ECU_ADDRESS 0x3fc408 BIT_MASK 0x1000 /end MEASUREMENT
/begin MEASUREMENT CTR_ABC_END_DIAG_TD_IGC_CUT_4 "" UBYTE _CNV_A_R_LINEAR_____13_CM 1 100. 0. 255. ECU_ADDRESS 0x3fc40a FORMAT "%3.0" /end MEASUREMENT
/begin MEASUREMENT CTR_ABC_TD_IGC_CUT_5 "" UBYTE _CNV_A_R_LINEAR_____13_CM 1 100. 0. 255. ECU_ADDRESS 0x3fc40c FORMAT "%3.0" /end MEASUREMENT
/begin MEASUREMENT LV_ERR_DET_TD_IGC_CUT_5 "" UWORD _CNV_S_2_RANGE______77_R_CM 1 100. 0. 255. ECU_ADDRESS 0x3fc40e BIT_MASK 0x100 /end MEASUREMENT
/begin MEASUREMENT LV_ERR_SYM_CHG_TD_IGC_CUT_5 "" UWORD _CNV_S_2_RANGE______77_R_CM 1 100. 0. 255. ECU_ADDRESS 0x3fc40e BIT_MASK 0x400 /end MEASUREMENT
/begin MEASUREMENT LV_CDN_DIAG_TD_IGC_CUT_5 "" UWORD _CNV_S_2_RANGE______77_R_CM 1 100. 0. 255. ECU_ADDRESS 0x3fc40e BIT_MASK 0x800 /end MEASUREMENT
/begin MEASUREMENT ERR_SYM_TD_IGC_CUT_5 "" UWORD _CNV_S_5_RANGE_ERR__323_CM 1 100. 0. 8. ECU_ADDRESS 0x3fc40e BIT_MASK 0xF /end MEASUREMENT
/begin MEASUREMENT LV_END_DIAG_TD_IGC_CUT_5 "" UWORD _CNV_S_2_RANGE______77_R_CM 1 100. 0. 255. ECU_ADDRESS 0x3fc40e BIT_MASK 0x1000 /end MEASUREMENT
/begin MEASUREMENT CTR_ABC_END_DIAG_TD_IGC_CUT_5 "" UBYTE _CNV_A_R_LINEAR_____13_CM 1 100. 0. 255. ECU_ADDRESS 0x3fc410 FORMAT "%3.0" /end MEASUREMENT
/begin MEASUREMENT CTR_ABC_DUR_IGC_0 "" UBYTE _CNV_A_R_LINEAR_____13_CM 1 100. 0. 255. ECU_ADDRESS 0x3fc412 FORMAT "%3.0" /end MEASUREMENT
/begin MEASUREMENT LV_ERR_DET_DUR_IGC_0 "" UWORD _CNV_S_2_RANGE______77_R_CM 1 100. 0. 255. ECU_ADDRESS 0x3fc414 BIT_MASK 0x100 /end MEASUREMENT
/begin MEASUREMENT LV_ERR_SYM_CHG_DUR_IGC_0 "" UWORD _CNV_S_2_RANGE______77_R_CM 1 100. 0. 255. ECU_ADDRESS 0x3fc414 BIT_MASK 0x400 /end MEASUREMENT
/begin MEASUREMENT LV_CDN_DIAG_DUR_IGC_0 "" UWORD _CNV_S_2_RANGE______77_R_CM 1 100. 0. 255. ECU_ADDRESS 0x3fc414 BIT_MASK 0x800 /end MEASUREMENT
/begin MEASUREMENT ERR_SYM_DUR_IGC_0 "" UWORD _CNV_S_5_RANGE_ERR__323_CM 1 100. 0. 8. ECU_ADDRESS 0x3fc414 BIT_MASK 0xF /end MEASUREMENT
/begin MEASUREMENT LV_END_DIAG_DUR_IGC_0 "" UWORD _CNV_S_2_RANGE______77_R_CM 1 100. 0. 255. ECU_ADDRESS 0x3fc414 BIT_MASK 0x1000 /end MEASUREMENT
/begin MEASUREMENT CTR_ABC_END_DIAG_DUR_IGC_0 "" UBYTE _CNV_A_R_LINEAR_____13_CM 1 100. 0. 255. ECU_ADDRESS 0x3fc416 FORMAT "%3.0" /end MEASUREMENT
/begin MEASUREMENT CTR_ABC_DUR_IGC_1 "" UBYTE _CNV_A_R_LINEAR_____13_CM 1 100. 0. 255. ECU_ADDRESS 0x3fc418 FORMAT "%3.0" /end MEASUREMENT
/begin MEASUREMENT LV_ERR_DET_DUR_IGC_1 "" UWORD _CNV_S_2_RANGE______77_R_CM 1 100. 0. 255. ECU_ADDRESS 0x3fc41a BIT_MASK 0x100 /end MEASUREMENT
/begin MEASUREMENT LV_ERR_SYM_CHG_DUR_IGC_1 "" UWORD _CNV_S_2_RANGE______77_R_CM 1 100. 0. 255. ECU_ADDRESS 0x3fc41a BIT_MASK 0x400 /end MEASUREMENT
/begin MEASUREMENT LV_CDN_DIAG_DUR_IGC_1 "" UWORD _CNV_S_2_RANGE______77_R_CM 1 100. 0. 255. ECU_ADDRESS 0x3fc41a BIT_MASK 0x800 /end MEASUREMENT
/begin MEASUREMENT ERR_SYM_DUR_IGC_1 "" UWORD _CNV_S_5_RANGE_ERR__323_CM 1 100. 0. 8. ECU_ADDRESS 0x3fc41a BIT_MASK 0xF /end MEASUREMENT
/begin MEASUREMENT LV_END_DIAG_DUR_IGC_1 "" UWORD _CNV_S_2_RANGE______77_R_CM 1 100. 0. 255. ECU_ADDRESS 0x3fc41a BIT_MASK 0x1000 /end MEASUREMENT
/begin MEASUREMENT CTR_ABC_END_DIAG_DUR_IGC_1 "" UBYTE _CNV_A_R_LINEAR_____13_CM 1 100. 0. 255. ECU_ADDRESS 0x3fc41c FORMAT "%3.0" /end MEASUREMENT
/begin MEASUREMENT CTR_ABC_DUR_IGC_2 "" UBYTE _CNV_A_R_LINEAR_____13_CM 1 100. 0. 255. ECU_ADDRESS 0x3fc41e FORMAT "%3.0" /end MEASUREMENT
/begin MEASUREMENT LV_ERR_DET_DUR_IGC_2 "" UWORD _CNV_S_2_RANGE______77_R_CM 1 100. 0. 255. ECU_ADDRESS 0x3fc420 BIT_MASK 0x100 /end MEASUREMENT
/begin MEASUREMENT LV_ERR_SYM_CHG_DUR_IGC_2 "" UWORD _CNV_S_2_RANGE______77_R_CM 1 100. 0. 255. ECU_ADDRESS 0x3fc420 BIT_MASK 0x400 /end MEASUREMENT
/begin MEASUREMENT LV_CDN_DIAG_DUR_IGC_2 "" UWORD _CNV_S_2_RANGE______77_R_CM 1 100. 0. 255. ECU_ADDRESS 0x3fc420 BIT_MASK 0x800 /end MEASUREMENT
/begin MEASUREMENT ERR_SYM_DUR_IGC_2 "" UWORD _CNV_S_5_RANGE_ERR__323_CM 1 100. 0. 8. ECU_ADDRESS 0x3fc420 BIT_MASK 0xF /end MEASUREMENT
/begin MEASUREMENT LV_END_DIAG_DUR_IGC_2 "" UWORD _CNV_S_2_RANGE______77_R_CM 1 100. 0. 255. ECU_ADDRESS 0x3fc420 BIT_MASK 0x1000 /end MEASUREMENT
/begin MEASUREMENT CTR_ABC_END_DIAG_DUR_IGC_2 "" UBYTE _CNV_A_R_LINEAR_____13_CM 1 100. 0. 255. ECU_ADDRESS 0x3fc422 FORMAT "%3.0" /end MEASUREMENT
/begin MEASUREMENT CTR_ABC_DUR_IGC_3 "" UBYTE _CNV_A_R_LINEAR_____13_CM 1 100. 0. 255. ECU_ADDRESS 0x3fc424 FORMAT "%3.0" /end MEASUREMENT
/begin MEASUREMENT LV_ERR_DET_DUR_IGC_3 "" UWORD _CNV_S_2_RANGE______77_R_CM 1 100. 0. 255. ECU_ADDRESS 0x3fc426 BIT_MASK 0x100 /end MEASUREMENT
/begin MEASUREMENT LV_ERR_SYM_CHG_DUR_IGC_3 "" UWORD _CNV_S_2_RANGE______77_R_CM 1 100. 0. 255. ECU_ADDRESS 0x3fc426 BIT_MASK 0x400 /end MEASUREMENT
/begin MEASUREMENT LV_CDN_DIAG_DUR_IGC_3 "" UWORD _CNV_S_2_RANGE______77_R_CM 1 100. 0. 255. ECU_ADDRESS 0x3fc426 BIT_MASK 0x800 /end MEASUREMENT
/begin MEASUREMENT ERR_SYM_DUR_IGC_3 "" UWORD _CNV_S_5_RANGE_ERR__323_CM 1 100. 0. 8. ECU_ADDRESS 0x3fc426 BIT_MASK 0xF /end MEASUREMENT
/begin MEASUREMENT LV_END_DIAG_DUR_IGC_3 "" UWORD _CNV_S_2_RANGE______77_R_CM 1 100. 0. 255. ECU_ADDRESS 0x3fc426 BIT_MASK 0x1000 /end MEASUREMENT
/begin MEASUREMENT CTR_END "" UBYTE _CNV_A_R_LINEAR_____13_CM 1 100. 0. 255. ECU_ADDRESS 0x3fc428 FORMAT "%3.0" /end MEASUREMENT
/begin MEASUREMENT CTR_ABC_DUR_IGC_4 "" UBYTE _CNV_A_R_LINEAR_____13_CM 1 100. 0. 255. ECU_ADDRESS 0x3fc42a FORMAT "%3.0" /end MEASUREMENT
/begin MEASUREMENT LV_ERR_DET_DUR_IGC_4 "" UWORD _CNV_S_2_RANGE______77_R_CM 1 100. 0. 255. ECU_ADDRESS 0x3fc42c BIT_MASK 0x100 /end MEASUREMENT
/begin MEASUREMENT LV_ERR_SYM_CHG_DUR_IGC_4 "" UWORD _CNV_S_2_RANGE______77_R_CM 1 100. 0. 255. ECU_ADDRESS 0x3fc42c BIT_MASK 0x400 /end MEASUREMENT
/begin MEASUREMENT LV_CDN_DIAG_DUR_IGC_4 "" UWORD _CNV_S_2_RANGE______77_R_CM 1 100. 0. 255. ECU_ADDRESS 0x3fc42c BIT_MASK 0x800 /end MEASUREMENT
/begin MEASUREMENT ERR_SYM_DUR_IGC_4 "" UWORD _CNV_S_5_RANGE_ERR__323_CM 1 100. 0. 8. ECU_ADDRESS 0x3fc42c BIT_MASK 0xF /end MEASUREMENT
/begin MEASUREMENT LV_END_DIAG_DUR_IGC_4 "" UWORD _CNV_S_2_RANGE______77_R_CM 1 100. 0. 255. ECU_ADDRESS 0x3fc42c BIT_MASK 0x1000 /end MEASUREMENT
/begin MEASUREMENT CTR_ABC_END_DIAG_DUR_IGC_4 "" UBYTE _CNV_A_R_LINEAR_____13_CM 1 100. 0. 255. ECU_ADDRESS 0x3fc42e FORMAT "%3.0" /end MEASUREMENT
/begin MEASUREMENT CTR_ABC_DUR_IGC_5 "" UBYTE _CNV_A_R_LINEAR_____13_CM 1 100. 0. 255. ECU_ADDRESS 0x3fc430 FORMAT "%3.0" /end MEASUREMENT
/begin MEASUREMENT LV_ERR_DET_DUR_IGC_5 "" UWORD _CNV_S_2_RANGE______77_R_CM 1 100. 0. 255. ECU_ADDRESS 0x3fc432 BIT_MASK 0x100 /end MEASUREMENT
/begin MEASUREMENT LV_ERR_SYM_CHG_DUR_IGC_5 "" UWORD _CNV_S_2_RANGE______77_R_CM 1 100. 0. 255. ECU_ADDRESS 0x3fc432 BIT_MASK 0x400 /end MEASUREMENT
/begin MEASUREMENT LV_CDN_DIAG_DUR_IGC_5 "" UWORD _CNV_S_2_RANGE______77_R_CM 1 100. 0. 255. ECU_ADDRESS 0x3fc432 BIT_MASK 0x800 /end MEASUREMENT
/begin MEASUREMENT ERR_SYM_DUR_IGC_5 "" UWORD _CNV_S_5_RANGE_ERR__323_CM 1 100. 0. 8. ECU_ADDRESS 0x3fc432 BIT_MASK 0xF /end MEASUREMENT
/begin MEASUREMENT LV_END_DIAG_DUR_IGC_5 "" UWORD _CNV_S_2_RANGE______77_R_CM 1 100. 0. 255. ECU_ADDRESS 0x3fc432 BIT_MASK 0x1000 /end MEASUREMENT
/begin MEASUREMENT CTR_ABC_END_DIAG_DUR_IGC_5 "" UBYTE _CNV_A_R_LINEAR_____13_CM 1 100. 0. 255. ECU_ADDRESS 0x3fc434 FORMAT "%3.0" /end MEASUREMENT
/begin MEASUREMENT CTR_ABC_TPS_1 "" UBYTE _CNV_A_R_LINEAR_____13_CM 1 100. 0. 255. ECU_ADDRESS 0x3fc436 FORMAT "%3.0" /end MEASUREMENT
/begin MEASUREMENT LV_ERR_DET_TPS_1 "" UWORD _CNV_S_2_RANGE______77_R_CM 1 100. 0. 255. ECU_ADDRESS 0x3fc438 BIT_MASK 0x100 /end MEASUREMENT
/begin MEASUREMENT LV_ERR_SYM_CHG_TPS_1 "" UWORD _CNV_S_2_RANGE______77_R_CM 1 100. 0. 255. ECU_ADDRESS 0x3fc438 BIT_MASK 0x400 /end MEASUREMENT
/begin MEASUREMENT LV_CDN_DIAG_TPS_1 "" UWORD _CNV_S_2_RANGE______77_R_CM 1 100. 0. 255. ECU_ADDRESS 0x3fc438 BIT_MASK 0x800 /end MEASUREMENT
/begin MEASUREMENT ERR_SYM_TPS_1 "" UWORD _CNV_S_5_RANGE_ERR__323_CM 1 100. 0. 8. ECU_ADDRESS 0x3fc438 BIT_MASK 0xF /end MEASUREMENT
/begin MEASUREMENT LV_END_DIAG_TPS_1 "" UWORD _CNV_S_2_RANGE______77_R_CM 1 100. 0. 255. ECU_ADDRESS 0x3fc438 BIT_MASK 0x1000 /end MEASUREMENT
/begin MEASUREMENT CTR_ABC_END_DIAG_TPS_1 "" UBYTE _CNV_A_R_LINEAR_____13_CM 1 100. 0. 255. ECU_ADDRESS 0x3fc43a FORMAT "%3.0" /end MEASUREMENT
/begin MEASUREMENT CTR_ABC_TPS_2 "" UBYTE _CNV_A_R_LINEAR_____13_CM 1 100. 0. 255. ECU_ADDRESS 0x3fc43c FORMAT "%3.0" /end MEASUREMENT
/begin MEASUREMENT LV_ERR_DET_TPS_2 "" UWORD _CNV_S_2_RANGE______77_R_CM 1 100. 0. 255. ECU_ADDRESS 0x3fc43e BIT_MASK 0x100 /end MEASUREMENT
/begin MEASUREMENT LV_ERR_SYM_CHG_TPS_2 "" UWORD _CNV_S_2_RANGE______77_R_CM 1 100. 0. 255. ECU_ADDRESS 0x3fc43e BIT_MASK 0x400 /end MEASUREMENT
/begin MEASUREMENT LV_CDN_DIAG_TPS_2 "" UWORD _CNV_S_2_RANGE______77_R_CM 1 100. 0. 255. ECU_ADDRESS 0x3fc43e BIT_MASK 0x800 /end MEASUREMENT
/begin MEASUREMENT ERR_SYM_TPS_2 "" UWORD _CNV_S_5_RANGE_ERR__323_CM 1 100. 0. 8. ECU_ADDRESS 0x3fc43e BIT_MASK 0xF /end MEASUREMENT
/begin MEASUREMENT LV_END_DIAG_TPS_2 "" UWORD _CNV_S_2_RANGE______77_R_CM 1 100. 0. 255. ECU_ADDRESS 0x3fc43e BIT_MASK 0x1000 /end MEASUREMENT
/begin MEASUREMENT CTR_ABC_END_DIAG_TPS_2 "" UBYTE _CNV_A_R_LINEAR_____13_CM 1 100. 0. 255. ECU_ADDRESS 0x3fc440 FORMAT "%3.0" /end MEASUREMENT
/begin MEASUREMENT CTR_ABC_TPS_MAF_1 "" UBYTE _CNV_A_R_LINEAR_____13_CM 1 100. 0. 255. ECU_ADDRESS 0x3fc442 FORMAT "%3.0" /end MEASUREMENT
/begin MEASUREMENT LV_ERR_DET_TPS_MAF_1 "" UWORD _CNV_S_2_RANGE______77_R_CM 1 100. 0. 255. ECU_ADDRESS 0x3fc444 BIT_MASK 0x100 /end MEASUREMENT
/begin MEASUREMENT LV_ERR_SYM_CHG_TPS_MAF_1 "" UWORD _CNV_S_2_RANGE______77_R_CM 1 100. 0. 255. ECU_ADDRESS 0x3fc444 BIT_MASK 0x400 /end MEASUREMENT
/begin MEASUREMENT LV_CDN_DIAG_TPS_MAF_1 "" UWORD _CNV_S_2_RANGE______77_R_CM 1 100. 0. 255. ECU_ADDRESS 0x3fc444 BIT_MASK 0x800 /end MEASUREMENT
/begin MEASUREMENT ERR_SYM_TPS_MAF_1 "" UWORD _CNV_S_5_RANGE_ERR__323_CM 1 100. 0. 8. ECU_ADDRESS 0x3fc444 BIT_MASK 0xF /end MEASUREMENT
/begin MEASUREMENT LV_END_DIAG_TPS_MAF_1 "" UWORD _CNV_S_2_RANGE______77_R_CM 1 100. 0. 255. ECU_ADDRESS 0x3fc444 BIT_MASK 0x1000 /end MEASUREMENT
/begin MEASUREMENT CTR_ABC_END_DIAG_TPS_MAF_1 "" UBYTE _CNV_A_R_LINEAR_____13_CM 1 100. 0. 255. ECU_ADDRESS 0x3fc446 FORMAT "%3.0" /end MEASUREMENT
/begin MEASUREMENT CTR_ABC_TPS_MAF_2 "" UBYTE _CNV_A_R_LINEAR_____13_CM 1 100. 0. 255. ECU_ADDRESS 0x3fc448 FORMAT "%3.0" /end MEASUREMENT
/begin MEASUREMENT LV_ERR_DET_TPS_MAF_2 "" UWORD _CNV_S_2_RANGE______77_R_CM 1 100. 0. 255. ECU_ADDRESS 0x3fc44a BIT_MASK 0x100 /end MEASUREMENT
/begin MEASUREMENT LV_ERR_SYM_CHG_TPS_MAF_2 "" UWORD _CNV_S_2_RANGE______77_R_CM 1 100. 0. 255. ECU_ADDRESS 0x3fc44a BIT_MASK 0x400 /end MEASUREMENT
/begin MEASUREMENT LV_CDN_DIAG_TPS_MAF_2 "" UWORD _CNV_S_2_RANGE______77_R_CM 1 100. 0. 255. ECU_ADDRESS 0x3fc44a BIT_MASK 0x800 /end MEASUREMENT
/begin MEASUREMENT ERR_SYM_TPS_MAF_2 "" UWORD _CNV_S_5_RANGE_ERR__323_CM 1 100. 0. 8. ECU_ADDRESS 0x3fc44a BIT_MASK 0xF /end MEASUREMENT
/begin MEASUREMENT LV_END_DIAG_TPS_MAF_2 "" UWORD _CNV_S_2_RANGE______77_R_CM 1 100. 0. 255. ECU_ADDRESS 0x3fc44a BIT_MASK 0x1000 /end MEASUREMENT
/begin MEASUREMENT CTR_ABC_END_DIAG_TPS_MAF_2 "" UBYTE _CNV_A_R_LINEAR_____13_CM 1 100. 0. 255. ECU_ADDRESS 0x3fc44c FORMAT "%3.0" /end MEASUREMENT
/begin MEASUREMENT CTR_ABC_TD "" UBYTE _CNV_A_R_LINEAR_____13_CM 1 100. 0. 255. ECU_ADDRESS 0x3fc44e FORMAT "%3.0" /end MEASUREMENT
/begin MEASUREMENT LV_ERR_DET_TD "" UWORD _CNV_S_2_RANGE______77_R_CM 1 100. 0. 255. ECU_ADDRESS 0x3fc450 BIT_MASK 0x100 /end MEASUREMENT
/begin MEASUREMENT LV_ERR_SYM_CHG_TD "" UWORD _CNV_S_2_RANGE______77_R_CM 1 100. 0. 255. ECU_ADDRESS 0x3fc450 BIT_MASK 0x400 /end MEASUREMENT
/begin MEASUREMENT LV_CDN_DIAG_TD "" UWORD _CNV_S_2_RANGE______77_R_CM 1 100. 0. 255. ECU_ADDRESS 0x3fc450 BIT_MASK 0x800 /end MEASUREMENT
/begin MEASUREMENT ERR_SYM_TD "" UWORD _CNV_S_5_RANGE_ERR__323_CM 1 100. 0. 8. ECU_ADDRESS 0x3fc450 BIT_MASK 0xF /end MEASUREMENT
/begin MEASUREMENT LV_END_DIAG_TD "" UWORD _CNV_S_2_RANGE______77_R_CM 1 100. 0. 255. ECU_ADDRESS 0x3fc450 BIT_MASK 0x1000 /end MEASUREMENT
/begin MEASUREMENT CTR_ABC_END_DIAG_TD "" UBYTE _CNV_A_R_LINEAR_____13_CM 1 100. 0. 255. ECU_ADDRESS 0x3fc452 FORMAT "%3.0" /end MEASUREMENT
/begin MEASUREMENT CTR_ABC_V_REF_1 "" UBYTE _CNV_A_R_LINEAR_____13_CM 1 100. 0. 255. ECU_ADDRESS 0x3fc454 FORMAT "%3.0" /end MEASUREMENT
/begin MEASUREMENT LV_ERR_DET_V_REF_1 "" UWORD _CNV_S_2_RANGE______77_R_CM 1 100. 0. 255. ECU_ADDRESS 0x3fc456 BIT_MASK 0x100 /end MEASUREMENT
/begin MEASUREMENT LV_ERR_SYM_CHG_V_REF_1 "" UWORD _CNV_S_2_RANGE______77_R_CM 1 100. 0. 255. ECU_ADDRESS 0x3fc456 BIT_MASK 0x400 /end MEASUREMENT
/begin MEASUREMENT LV_CDN_DIAG_V_REF_1 "" UWORD _CNV_S_2_RANGE______77_R_CM 1 100. 0. 255. ECU_ADDRESS 0x3fc456 BIT_MASK 0x800 /end MEASUREMENT
/begin MEASUREMENT ERR_SYM_V_REF_1 "" UWORD _CNV_S_5_RANGE_ERR__323_CM 1 100. 0. 8. ECU_ADDRESS 0x3fc456 BIT_MASK 0xF /end MEASUREMENT
/begin MEASUREMENT LV_END_DIAG_V_REF_1 "" UWORD _CNV_S_2_RANGE______77_R_CM 1 100. 0. 255. ECU_ADDRESS 0x3fc456 BIT_MASK 0x1000 /end MEASUREMENT
/begin MEASUREMENT CTR_ABC_END_DIAG_V_REF_1 "" UBYTE _CNV_A_R_LINEAR_____13_CM 1 100. 0. 255. ECU_ADDRESS 0x3fc458 FORMAT "%3.0" /end MEASUREMENT
/begin MEASUREMENT CTR_ABC_V_REF_2 "" UBYTE _CNV_A_R_LINEAR_____13_CM 1 100. 0. 255. ECU_ADDRESS 0x3fc45a FORMAT "%3.0" /end MEASUREMENT
/begin MEASUREMENT LV_ERR_DET_V_REF_2 "" UWORD _CNV_S_2_RANGE______77_R_CM 1 100. 0. 255. ECU_ADDRESS 0x3fc45c BIT_MASK 0x100 /end MEASUREMENT
/begin MEASUREMENT LV_ERR_SYM_CHG_V_REF_2 "" UWORD _CNV_S_2_RANGE______77_R_CM 1 100. 0. 255. ECU_ADDRESS 0x3fc45c BIT_MASK 0x400 /end MEASUREMENT
/begin MEASUREMENT LV_CDN_DIAG_V_REF_2 "" UWORD _CNV_S_2_RANGE______77_R_CM 1 100. 0. 255. ECU_ADDRESS 0x3fc45c BIT_MASK 0x800 /end MEASUREMENT
/begin MEASUREMENT ERR_SYM_V_REF_2 "" UWORD _CNV_S_5_RANGE_ERR__323_CM 1 100. 0. 8. ECU_ADDRESS 0x3fc45c BIT_MASK 0xF /end MEASUREMENT
/begin MEASUREMENT LV_END_DIAG_V_REF_2 "" UWORD _CNV_S_2_RANGE______77_R_CM 1 100. 0. 255. ECU_ADDRESS 0x3fc45c BIT_MASK 0x1000 /end MEASUREMENT
/begin MEASUREMENT CTR_ABC_END_DIAG_V_REF_2 "" UBYTE _CNV_A_R_LINEAR_____13_CM 1 100. 0. 255. ECU_ADDRESS 0x3fc45e FORMAT "%3.0" /end MEASUREMENT
/begin MEASUREMENT CTR_ABC_PVS_1 "" UBYTE _CNV_A_R_LINEAR_____13_CM 1 100. 0. 255. ECU_ADDRESS 0x3fc460 FORMAT "%3.0" /end MEASUREMENT
/begin MEASUREMENT LV_ERR_DET_PVS_1 "" UWORD _CNV_S_2_RANGE______77_R_CM 1 100. 0. 255. ECU_ADDRESS 0x3fc462 BIT_MASK 0x100 /end MEASUREMENT
/begin MEASUREMENT LV_ERR_SYM_CHG_PVS_1 "" UWORD _CNV_S_2_RANGE______77_R_CM 1 100. 0. 255. ECU_ADDRESS 0x3fc462 BIT_MASK 0x400 /end MEASUREMENT
/begin MEASUREMENT LV_CDN_DIAG_PVS_1 "" UWORD _CNV_S_2_RANGE______77_R_CM 1 100. 0. 255. ECU_ADDRESS 0x3fc462 BIT_MASK 0x800 /end MEASUREMENT
/begin MEASUREMENT ERR_SYM_PVS_1 "" UWORD _CNV_S_5_RANGE_ERR__323_CM 1 100. 0. 8. ECU_ADDRESS 0x3fc462 BIT_MASK 0xF /end MEASUREMENT
/begin MEASUREMENT LV_END_DIAG_PVS_1 "" UWORD _CNV_S_2_RANGE______77_R_CM 1 100. 0. 255. ECU_ADDRESS 0x3fc462 BIT_MASK 0x1000 /end MEASUREMENT
/begin MEASUREMENT CTR_ABC_END_DIAG_PVS_1 "" UBYTE _CNV_A_R_LINEAR_____13_CM 1 100. 0. 255. ECU_ADDRESS 0x3fc464 FORMAT "%3.0" /end MEASUREMENT
/begin MEASUREMENT CTR_ABC_PVS_2 "" UBYTE _CNV_A_R_LINEAR_____13_CM 1 100. 0. 255. ECU_ADDRESS 0x3fc466 FORMAT "%3.0" /end MEASUREMENT
/begin MEASUREMENT LV_ERR_DET_PVS_2 "" UWORD _CNV_S_2_RANGE______77_R_CM 1 100. 0. 255. ECU_ADDRESS 0x3fc468 BIT_MASK 0x100 /end MEASUREMENT
/begin MEASUREMENT LV_ERR_SYM_CHG_PVS_2 "" UWORD _CNV_S_2_RANGE______77_R_CM 1 100. 0. 255. ECU_ADDRESS 0x3fc468 BIT_MASK 0x400 /end MEASUREMENT
/begin MEASUREMENT LV_CDN_DIAG_PVS_2 "" UWORD _CNV_S_2_RANGE______77_R_CM 1 100. 0. 255. ECU_ADDRESS 0x3fc468 BIT_MASK 0x800 /end MEASUREMENT
/begin MEASUREMENT ERR_SYM_PVS_2 "" UWORD _CNV_S_5_RANGE_ERR__323_CM 1 100. 0. 8. ECU_ADDRESS 0x3fc468 BIT_MASK 0xF /end MEASUREMENT
/begin MEASUREMENT LV_END_DIAG_PVS_2 "" UWORD _CNV_S_2_RANGE______77_R_CM 1 100. 0. 255. ECU_ADDRESS 0x3fc468 BIT_MASK 0x1000 /end MEASUREMENT
/begin MEASUREMENT CTR_ABC_END_DIAG_PVS_2 "" UBYTE _CNV_A_R_LINEAR_____13_CM 1 100. 0. 255. ECU_ADDRESS 0x3fc46a FORMAT "%3.0" /end MEASUREMENT
/begin MEASUREMENT CTR_ABC_PVS_RATIO "" UBYTE _CNV_A_R_LINEAR_____13_CM 1 100. 0. 255. ECU_ADDRESS 0x3fc46c FORMAT "%3.0" /end MEASUREMENT
/begin MEASUREMENT LV_ERR_DET_PVS_RATIO "" UWORD _CNV_S_2_RANGE______77_R_CM 1 100. 0. 255. ECU_ADDRESS 0x3fc46e BIT_MASK 0x100 /end MEASUREMENT
/begin MEASUREMENT LV_ERR_SYM_CHG_PVS_RATIO "" UWORD _CNV_S_2_RANGE______77_R_CM 1 100. 0. 255. ECU_ADDRESS 0x3fc46e BIT_MASK 0x400 /end MEASUREMENT
/begin MEASUREMENT LV_CDN_DIAG_PVS_RATIO "" UWORD _CNV_S_2_RANGE______77_R_CM 1 100. 0. 255. ECU_ADDRESS 0x3fc46e BIT_MASK 0x800 /end MEASUREMENT
/begin MEASUREMENT ERR_SYM_PVS_RATIO "" UWORD _CNV_S_5_RANGE_ERR__323_CM 1 100. 0. 8. ECU_ADDRESS 0x3fc46e BIT_MASK 0xF /end MEASUREMENT
/begin MEASUREMENT LV_END_DIAG_PVS_RATIO "" UWORD _CNV_S_2_RANGE______77_R_CM 1 100. 0. 255. ECU_ADDRESS 0x3fc46e BIT_MASK 0x1000 /end MEASUREMENT
/begin MEASUREMENT CTR_ABC_END_DIAG_PVS_RATIO "" UBYTE _CNV_A_R_LINEAR_____13_CM 1 100. 0. 255. ECU_ADDRESS 0x3fc470 FORMAT "%3.0" /end MEASUREMENT
/begin MEASUREMENT CTR_ABC_PVS_DOUBLE "" UBYTE _CNV_A_R_LINEAR_____13_CM 1 100. 0. 255. ECU_ADDRESS 0x3fc472 FORMAT "%3.0" /end MEASUREMENT
/begin MEASUREMENT LV_ERR_DET_PVS_DOUBLE "" UWORD _CNV_S_2_RANGE______77_R_CM 1 100. 0. 255. ECU_ADDRESS 0x3fc474 BIT_MASK 0x100 /end MEASUREMENT
/begin MEASUREMENT LV_ERR_SYM_CHG_PVS_DOUBLE "" UWORD _CNV_S_2_RANGE______77_R_CM 1 100. 0. 255. ECU_ADDRESS 0x3fc474 BIT_MASK 0x400 /end MEASUREMENT
/begin MEASUREMENT LV_CDN_DIAG_PVS_DOUBLE "" UWORD _CNV_S_2_RANGE______77_R_CM 1 100. 0. 255. ECU_ADDRESS 0x3fc474 BIT_MASK 0x800 /end MEASUREMENT
/begin MEASUREMENT ERR_SYM_PVS_DOUBLE "" UWORD _CNV_S_5_RANGE_ERR__323_CM 1 100. 0. 8. ECU_ADDRESS 0x3fc474 BIT_MASK 0xF /end MEASUREMENT
/begin MEASUREMENT LV_END_DIAG_PVS_DOUBLE "" UWORD _CNV_S_2_RANGE______77_R_CM 1 100. 0. 255. ECU_ADDRESS 0x3fc474 BIT_MASK 0x1000 /end MEASUREMENT
/begin MEASUREMENT CTR_ABC_END_DIAG_PVS_DOUBLE "" UBYTE _CNV_A_R_LINEAR_____13_CM 1 100. 0. 255. ECU_ADDRESS 0x3fc476 FORMAT "%3.0" /end MEASUREMENT
/begin MEASUREMENT CTR_ABC_MTC_DR "" UBYTE _CNV_A_R_LINEAR_____13_CM 1 100. 0. 255. ECU_ADDRESS 0x3fc478 FORMAT "%3.0" /end MEASUREMENT
/begin MEASUREMENT LV_ERR_DET_MTC_DR "" UWORD _CNV_S_2_RANGE______77_R_CM 1 100. 0. 255. ECU_ADDRESS 0x3fc47a BIT_MASK 0x100 /end MEASUREMENT
/begin MEASUREMENT LV_ERR_SYM_CHG_MTC_DR "" UWORD _CNV_S_2_RANGE______77_R_CM 1 100. 0. 255. ECU_ADDRESS 0x3fc47a BIT_MASK 0x400 /end MEASUREMENT
/begin MEASUREMENT LV_CDN_DIAG_MTC_DR "" UWORD _CNV_S_2_RANGE______77_R_CM 1 100. 0. 255. ECU_ADDRESS 0x3fc47a BIT_MASK 0x800 /end MEASUREMENT
/begin MEASUREMENT ERR_SYM_MTC_DR "" UWORD _CNV_S_5_RANGE_ERR__323_CM 1 100. 0. 8. ECU_ADDRESS 0x3fc47a BIT_MASK 0xF /end MEASUREMENT
/begin MEASUREMENT LV_END_DIAG_MTC_DR "" UWORD _CNV_S_2_RANGE______77_R_CM 1 100. 0. 255. ECU_ADDRESS 0x3fc47a BIT_MASK 0x1000 /end MEASUREMENT
/begin MEASUREMENT CTR_ABC_END_DIAG_MTC_DR "" UBYTE _CNV_A_R_LINEAR_____13_CM 1 100. 0. 255. ECU_ADDRESS 0x3fc47c FORMAT "%3.0" /end MEASUREMENT
/begin MEASUREMENT CTR_ABC_MTC_CTL_1 "" UBYTE _CNV_A_R_LINEAR_____13_CM 1 100. 0. 255. ECU_ADDRESS 0x3fc47e FORMAT "%3.0" /end MEASUREMENT
/begin MEASUREMENT LV_ERR_DET_MTC_CTL_1 "" UWORD _CNV_S_2_RANGE______77_R_CM 1 100. 0. 255. ECU_ADDRESS 0x3fc480 BIT_MASK 0x100 /end MEASUREMENT
/begin MEASUREMENT LV_ERR_SYM_CHG_MTC_CTL_1 "" UWORD _CNV_S_2_RANGE______77_R_CM 1 100. 0. 255. ECU_ADDRESS 0x3fc480 BIT_MASK 0x400 /end MEASUREMENT
/begin MEASUREMENT LV_CDN_DIAG_MTC_CTL_1 "" UWORD _CNV_S_2_RANGE______77_R_CM 1 100. 0. 255. ECU_ADDRESS 0x3fc480 BIT_MASK 0x800 /end MEASUREMENT
/begin MEASUREMENT ERR_SYM_MTC_CTL_1 "" UWORD _CNV_S_5_RANGE_ERR__323_CM 1 100. 0. 8. ECU_ADDRESS 0x3fc480 BIT_MASK 0xF /end MEASUREMENT
/begin MEASUREMENT LV_END_DIAG_MTC_CTL_1 "" UWORD _CNV_S_2_RANGE______77_R_CM 1 100. 0. 255. ECU_ADDRESS 0x3fc480 BIT_MASK 0x1000 /end MEASUREMENT
/begin MEASUREMENT CTR_ABC_END_DIAG_MTC_CTL_1 "" UBYTE _CNV_A_R_LINEAR_____13_CM 1 100. 0. 255. ECU_ADDRESS 0x3fc482 FORMAT "%3.0" /end MEASUREMENT
/begin MEASUREMENT CTR_ABC_MTC_CTL_2 "" UBYTE _CNV_A_R_LINEAR_____13_CM 1 100. 0. 255. ECU_ADDRESS 0x3fc484 FORMAT "%3.0" /end MEASUREMENT
/begin MEASUREMENT LV_ERR_DET_MTC_CTL_2 "" UWORD _CNV_S_2_RANGE______77_R_CM 1 100. 0. 255. ECU_ADDRESS 0x3fc486 BIT_MASK 0x100 /end MEASUREMENT
/begin MEASUREMENT LV_ERR_SYM_CHG_MTC_CTL_2 "" UWORD _CNV_S_2_RANGE______77_R_CM 1 100. 0. 255. ECU_ADDRESS 0x3fc486 BIT_MASK 0x400 /end MEASUREMENT
/begin MEASUREMENT LV_CDN_DIAG_MTC_CTL_2 "" UWORD _CNV_S_2_RANGE______77_R_CM 1 100. 0. 255. ECU_ADDRESS 0x3fc486 BIT_MASK 0x800 /end MEASUREMENT
/begin MEASUREMENT ERR_SYM_MTC_CTL_2 "" UWORD _CNV_S_5_RANGE_ERR__323_CM 1 100. 0. 8. ECU_ADDRESS 0x3fc486 BIT_MASK 0xF /end MEASUREMENT
/begin MEASUREMENT LV_END_DIAG_MTC_CTL_2 "" UWORD _CNV_S_2_RANGE______77_R_CM 1 100. 0. 255. ECU_ADDRESS 0x3fc486 BIT_MASK 0x1000 /end MEASUREMENT
/begin MEASUREMENT CTR_ABC_END_DIAG_MTC_CTL_2 "" UBYTE _CNV_A_R_LINEAR_____13_CM 1 100. 0. 255. ECU_ADDRESS 0x3fc488 FORMAT "%3.0" /end MEASUREMENT
/begin MEASUREMENT CTR_ABC_MTC_CTL_3 "" UBYTE _CNV_A_R_LINEAR_____13_CM 1 100. 0. 255. ECU_ADDRESS 0x3fc48a FORMAT "%3.0" /end MEASUREMENT
/begin MEASUREMENT LV_ERR_DET_MTC_CTL_3 "" UWORD _CNV_S_2_RANGE______77_R_CM 1 100. 0. 255. ECU_ADDRESS 0x3fc48c BIT_MASK 0x100 /end MEASUREMENT
/begin MEASUREMENT LV_ERR_SYM_CHG_MTC_CTL_3 "" UWORD _CNV_S_2_RANGE______77_R_CM 1 100. 0. 255. ECU_ADDRESS 0x3fc48c BIT_MASK 0x400 /end MEASUREMENT
/begin MEASUREMENT LV_CDN_DIAG_MTC_CTL_3 "" UWORD _CNV_S_2_RANGE______77_R_CM 1 100. 0. 255. ECU_ADDRESS 0x3fc48c BIT_MASK 0x800 /end MEASUREMENT
/begin MEASUREMENT ERR_SYM_MTC_CTL_3 "" UWORD _CNV_S_5_RANGE_ERR__323_CM 1 100. 0. 8. ECU_ADDRESS 0x3fc48c BIT_MASK 0xF /end MEASUREMENT
/begin MEASUREMENT LV_END_DIAG_MTC_CTL_3 "" UWORD _CNV_S_2_RANGE______77_R_CM 1 100. 0. 255. ECU_ADDRESS 0x3fc48c BIT_MASK 0x1000 /end MEASUREMENT
/begin MEASUREMENT CTR_ABC_END_DIAG_MTC_CTL_3 "" UBYTE _CNV_A_R_LINEAR_____13_CM 1 100. 0. 255. ECU_ADDRESS 0x3fc48e FORMAT "%3.0" /end MEASUREMENT
/begin MEASUREMENT CTR_ABC_TPS_AD "" UBYTE _CNV_A_R_LINEAR_____13_CM 1 100. 0. 255. ECU_ADDRESS 0x3fc490 FORMAT "%3.0" /end MEASUREMENT
/begin MEASUREMENT LV_ERR_DET_TPS_AD "" UWORD _CNV_S_2_RANGE______77_R_CM 1 100. 0. 255. ECU_ADDRESS 0x3fc492 BIT_MASK 0x100 /end MEASUREMENT
/begin MEASUREMENT LV_ERR_SYM_CHG_TPS_AD "" UWORD _CNV_S_2_RANGE______77_R_CM 1 100. 0. 255. ECU_ADDRESS 0x3fc492 BIT_MASK 0x400 /end MEASUREMENT
/begin MEASUREMENT LV_CDN_DIAG_TPS_AD "" UWORD _CNV_S_2_RANGE______77_R_CM 1 100. 0. 255. ECU_ADDRESS 0x3fc492 BIT_MASK 0x800 /end MEASUREMENT
/begin MEASUREMENT ERR_SYM_TPS_AD "" UWORD _CNV_S_5_RANGE_ERR__323_CM 1 100. 0. 8. ECU_ADDRESS 0x3fc492 BIT_MASK 0xF /end MEASUREMENT
/begin MEASUREMENT LV_END_DIAG_TPS_AD "" UWORD _CNV_S_2_RANGE______77_R_CM 1 100. 0. 255. ECU_ADDRESS 0x3fc492 BIT_MASK 0x1000 /end MEASUREMENT
/begin MEASUREMENT CTR_ABC_END_DIAG_TPS_AD "" UBYTE _CNV_A_R_LINEAR_____13_CM 1 100. 0. 255. ECU_ADDRESS 0x3fc494 FORMAT "%3.0" /end MEASUREMENT
/begin MEASUREMENT CTR_ABC_TPS_ST_CHK_1 "" UBYTE _CNV_A_R_LINEAR_____13_CM 1 100. 0. 255. ECU_ADDRESS 0x3fc496 FORMAT "%3.0" /end MEASUREMENT
/begin MEASUREMENT LV_ERR_DET_TPS_ST_CHK_1 "" UWORD _CNV_S_2_RANGE______77_R_CM 1 100. 0. 255. ECU_ADDRESS 0x3fc498 BIT_MASK 0x100 /end MEASUREMENT
/begin MEASUREMENT LV_ERR_SYM_CHG_TPS_ST_CHK_1 "" UWORD _CNV_S_2_RANGE______77_R_CM 1 100. 0. 255. ECU_ADDRESS 0x3fc498 BIT_MASK 0x400 /end MEASUREMENT
/begin MEASUREMENT LV_CDN_DIAG_TPS_ST_CHK_1 "" UWORD _CNV_S_2_RANGE______77_R_CM 1 100. 0. 255. ECU_ADDRESS 0x3fc498 BIT_MASK 0x800 /end MEASUREMENT
/begin MEASUREMENT ERR_SYM_TPS_ST_CHK_1 "" UWORD _CNV_S_5_RANGE_ERR__323_CM 1 100. 0. 8. ECU_ADDRESS 0x3fc498 BIT_MASK 0xF /end MEASUREMENT
/begin MEASUREMENT LV_END_DIAG_TPS_ST_CHK_1 "" UWORD _CNV_S_2_RANGE______77_R_CM 1 100. 0. 255. ECU_ADDRESS 0x3fc498 BIT_MASK 0x1000 /end MEASUREMENT
/begin MEASUREMENT CTR_ABC_END_DIAG_TPS_ST_CHK_1 "" UBYTE _CNV_A_R_LINEAR_____13_CM 1 100. 0. 255. ECU_ADDRESS 0x3fc49a FORMAT "%3.0" /end MEASUREMENT
/begin MEASUREMENT CTR_ABC_TPS_ST_CHK_2 "" UBYTE _CNV_A_R_LINEAR_____13_CM 1 100. 0. 255. ECU_ADDRESS 0x3fc49c FORMAT "%3.0" /end MEASUREMENT
/begin MEASUREMENT LV_ERR_DET_TPS_ST_CHK_2 "" UWORD _CNV_S_2_RANGE______77_R_CM 1 100. 0. 255. ECU_ADDRESS 0x3fc49e BIT_MASK 0x100 /end MEASUREMENT
/begin MEASUREMENT LV_ERR_SYM_CHG_TPS_ST_CHK_2 "" UWORD _CNV_S_2_RANGE______77_R_CM 1 100. 0. 255. ECU_ADDRESS 0x3fc49e BIT_MASK 0x400 /end MEASUREMENT
/begin MEASUREMENT LV_CDN_DIAG_TPS_ST_CHK_2 "" UWORD _CNV_S_2_RANGE______77_R_CM 1 100. 0. 255. ECU_ADDRESS 0x3fc49e BIT_MASK 0x800 /end MEASUREMENT
/begin MEASUREMENT ERR_SYM_TPS_ST_CHK_2 "" UWORD _CNV_S_5_RANGE_ERR__323_CM 1 100. 0. 8. ECU_ADDRESS 0x3fc49e BIT_MASK 0xF /end MEASUREMENT
/begin MEASUREMENT LV_END_DIAG_TPS_ST_CHK_2 "" UWORD _CNV_S_2_RANGE______77_R_CM 1 100. 0. 255. ECU_ADDRESS 0x3fc49e BIT_MASK 0x1000 /end MEASUREMENT
/begin MEASUREMENT CTR_ABC_END_DIAG_TPS_ST_CHK_2 "" UBYTE _CNV_A_R_LINEAR_____13_CM 1 100. 0. 255. ECU_ADDRESS 0x3fc4a0 FORMAT "%3.0" /end MEASUREMENT
/begin MEASUREMENT CTR_ABC_GEN "" UBYTE _CNV_A_R_LINEAR_____13_CM 1 100. 0. 255. ECU_ADDRESS 0x3fc4a2 FORMAT "%3.0" /end MEASUREMENT
/begin MEASUREMENT LV_ERR_DET_GEN "" UWORD _CNV_S_2_RANGE______77_R_CM 1 100. 0. 255. ECU_ADDRESS 0x3fc4a4 BIT_MASK 0x100 /end MEASUREMENT
/begin MEASUREMENT LV_ERR_SYM_CHG_GEN "" UWORD _CNV_S_2_RANGE______77_R_CM 1 100. 0. 255. ECU_ADDRESS 0x3fc4a4 BIT_MASK 0x400 /end MEASUREMENT
/begin MEASUREMENT LV_CDN_DIAG_GEN "" UWORD _CNV_S_2_RANGE______77_R_CM 1 100. 0. 255. ECU_ADDRESS 0x3fc4a4 BIT_MASK 0x800 /end MEASUREMENT
/begin MEASUREMENT ERR_SYM_GEN "" UWORD _CNV_S_5_RANGE_ERR__323_CM 1 100. 0. 8. ECU_ADDRESS 0x3fc4a4 BIT_MASK 0xF /end MEASUREMENT
/begin MEASUREMENT LV_END_DIAG_GEN "" UWORD _CNV_S_2_RANGE______77_R_CM 1 100. 0. 255. ECU_ADDRESS 0x3fc4a4 BIT_MASK 0x1000 /end MEASUREMENT
/begin MEASUREMENT CTR_ABC_END_DIAG_GEN "" UBYTE _CNV_A_R_LINEAR_____13_CM 1 100. 0. 255. ECU_ADDRESS 0x3fc4a6 FORMAT "%3.0" /end MEASUREMENT
/begin MEASUREMENT CTR_ABC_VIM "" UBYTE _CNV_A_R_LINEAR_____13_CM 1 100. 0. 255. ECU_ADDRESS 0x3fc4a8 FORMAT "%3.0" /end MEASUREMENT
/begin MEASUREMENT LV_ERR_DET_VIM "" UWORD _CNV_S_2_RANGE______77_R_CM 1 100. 0. 255. ECU_ADDRESS 0x3fc4aa BIT_MASK 0x100 /end MEASUREMENT
/begin MEASUREMENT LV_ERR_SYM_CHG_VIM "" UWORD _CNV_S_2_RANGE______77_R_CM 1 100. 0. 255. ECU_ADDRESS 0x3fc4aa BIT_MASK 0x400 /end MEASUREMENT
/begin MEASUREMENT LV_CDN_DIAG_VIM "" UWORD _CNV_S_2_RANGE______77_R_CM 1 100. 0. 255. ECU_ADDRESS 0x3fc4aa BIT_MASK 0x800 /end MEASUREMENT
/begin MEASUREMENT ERR_SYM_VIM "" UWORD _CNV_S_5_RANGE_ERR__323_CM 1 100. 0. 8. ECU_ADDRESS 0x3fc4aa BIT_MASK 0xF /end MEASUREMENT
/begin MEASUREMENT LV_END_DIAG_VIM "" UWORD _CNV_S_2_RANGE______77_R_CM 1 100. 0. 255. ECU_ADDRESS 0x3fc4aa BIT_MASK 0x1000 /end MEASUREMENT
/begin MEASUREMENT CTR_ABC_END_DIAG_VIM "" UBYTE _CNV_A_R_LINEAR_____13_CM 1 100. 0. 255. ECU_ADDRESS 0x3fc4ac FORMAT "%3.0" /end MEASUREMENT
/begin MEASUREMENT CTR_ABC_ENG_PSN "" UBYTE _CNV_A_R_LINEAR_____13_CM 1 100. 0. 255. ECU_ADDRESS 0x3fc4ae FORMAT "%3.0" /end MEASUREMENT
/begin MEASUREMENT LV_ERR_DET_ENG_PSN "" UWORD _CNV_S_2_RANGE______77_R_CM 1 100. 0. 255. ECU_ADDRESS 0x3fc4b0 BIT_MASK 0x100 /end MEASUREMENT
/begin MEASUREMENT LV_ERR_SYM_CHG_ENG_PSN "" UWORD _CNV_S_2_RANGE______77_R_CM 1 100. 0. 255. ECU_ADDRESS 0x3fc4b0 BIT_MASK 0x400 /end MEASUREMENT
/begin MEASUREMENT LV_CDN_DIAG_ENG_PSN "" UWORD _CNV_S_2_RANGE______77_R_CM 1 100. 0. 255. ECU_ADDRESS 0x3fc4b0 BIT_MASK 0x800 /end MEASUREMENT
/begin MEASUREMENT ERR_SYM_ENG_PSN "" UWORD _CNV_S_5_RANGE_ERR__323_CM 1 100. 0. 8. ECU_ADDRESS 0x3fc4b0 BIT_MASK 0xF /end MEASUREMENT
/begin MEASUREMENT LV_END_DIAG_ENG_PSN "" UWORD _CNV_S_2_RANGE______77_R_CM 1 100. 0. 255. ECU_ADDRESS 0x3fc4b0 BIT_MASK 0x1000 /end MEASUREMENT
/begin MEASUREMENT CTR_ABC_END_DIAG_ENG_PSN "" UBYTE _CNV_A_R_LINEAR_____13_CM 1 100. 0. 255. ECU_ADDRESS 0x3fc4b2 FORMAT "%3.0" /end MEASUREMENT
/begin MEASUREMENT CTR_ABC_TOOTH_PER "" UBYTE _CNV_A_R_LINEAR_____13_CM 1 100. 0. 255. ECU_ADDRESS 0x3fc4b4 FORMAT "%3.0" /end MEASUREMENT
/begin MEASUREMENT LV_ERR_DET_TOOTH_PER "" UWORD _CNV_S_2_RANGE______77_R_CM 1 100. 0. 255. ECU_ADDRESS 0x3fc4b6 BIT_MASK 0x100 /end MEASUREMENT
/begin MEASUREMENT LV_ERR_SYM_CHG_TOOTH_PER "" UWORD _CNV_S_2_RANGE______77_R_CM 1 100. 0. 255. ECU_ADDRESS 0x3fc4b6 BIT_MASK 0x400 /end MEASUREMENT
/begin MEASUREMENT LV_CDN_DIAG_TOOTH_PER "" UWORD _CNV_S_2_RANGE______77_R_CM 1 100. 0. 255. ECU_ADDRESS 0x3fc4b6 BIT_MASK 0x800 /end MEASUREMENT
/begin MEASUREMENT ERR_SYM_TOOTH_PER "" UWORD _CNV_S_5_RANGE_ERR__323_CM 1 100. 0. 8. ECU_ADDRESS 0x3fc4b6 BIT_MASK 0xF /end MEASUREMENT
/begin MEASUREMENT LV_END_DIAG_TOOTH_PER "" UWORD _CNV_S_2_RANGE______77_R_CM 1 100. 0. 255. ECU_ADDRESS 0x3fc4b6 BIT_MASK 0x1000 /end MEASUREMENT
/begin MEASUREMENT CTR_ABC_END_DIAG_TOOTH_PER "" UBYTE _CNV_A_R_LINEAR_____13_CM 1 100. 0. 255. ECU_ADDRESS 0x3fc4b8 FORMAT "%3.0" /end MEASUREMENT
/begin MEASUREMENT CTR_ABC_TPU_SYN "" UBYTE _CNV_A_R_LINEAR_____13_CM 1 100. 0. 255. ECU_ADDRESS 0x3fc4ba FORMAT "%3.0" /end MEASUREMENT
/begin MEASUREMENT LV_ERR_DET_TPU_SYN "" UWORD _CNV_S_2_RANGE______77_R_CM 1 100. 0. 255. ECU_ADDRESS 0x3fc4bc BIT_MASK 0x100 /end MEASUREMENT
/begin MEASUREMENT LV_ERR_SYM_CHG_TPU_SYN "" UWORD _CNV_S_2_RANGE______77_R_CM 1 100. 0. 255. ECU_ADDRESS 0x3fc4bc BIT_MASK 0x400 /end MEASUREMENT
/begin MEASUREMENT LV_CDN_DIAG_TPU_SYN "" UWORD _CNV_S_2_RANGE______77_R_CM 1 100. 0. 255. ECU_ADDRESS 0x3fc4bc BIT_MASK 0x800 /end MEASUREMENT
/begin MEASUREMENT ERR_SYM_TPU_SYN "" UWORD _CNV_S_5_RANGE_ERR__323_CM 1 100. 0. 8. ECU_ADDRESS 0x3fc4bc BIT_MASK 0xF /end MEASUREMENT
/begin MEASUREMENT LV_END_DIAG_TPU_SYN "" UWORD _CNV_S_2_RANGE______77_R_CM 1 100. 0. 255. ECU_ADDRESS 0x3fc4bc BIT_MASK 0x1000 /end MEASUREMENT
/begin MEASUREMENT CTR_ABC_END_DIAG_TPU_SYN "" UBYTE _CNV_A_R_LINEAR_____13_CM 1 100. 0. 255. ECU_ADDRESS 0x3fc4be FORMAT "%3.0" /end MEASUREMENT
/begin MEASUREMENT CTR_ABC_CAM_PER_0 "" UBYTE _CNV_A_R_LINEAR_____13_CM 1 100. 0. 255. ECU_ADDRESS 0x3fc4c0 FORMAT "%3.0" /end MEASUREMENT
/begin MEASUREMENT LV_ERR_DET_CAM_PER_0 "" UWORD _CNV_S_2_RANGE______77_R_CM 1 100. 0. 255. ECU_ADDRESS 0x3fc4c2 BIT_MASK 0x100 /end MEASUREMENT
/begin MEASUREMENT LV_ERR_SYM_CHG_CAM_PER_0 "" UWORD _CNV_S_2_RANGE______77_R_CM 1 100. 0. 255. ECU_ADDRESS 0x3fc4c2 BIT_MASK 0x400 /end MEASUREMENT
/begin MEASUREMENT LV_CDN_DIAG_CAM_PER_0 "" UWORD _CNV_S_2_RANGE______77_R_CM 1 100. 0. 255. ECU_ADDRESS 0x3fc4c2 BIT_MASK 0x800 /end MEASUREMENT
/begin MEASUREMENT ERR_SYM_CAM_PER_0 "" UWORD _CNV_S_5_RANGE_ERR__323_CM 1 100. 0. 8. ECU_ADDRESS 0x3fc4c2 BIT_MASK 0xF /end MEASUREMENT
/begin MEASUREMENT LV_END_DIAG_CAM_PER_0 "" UWORD _CNV_S_2_RANGE______77_R_CM 1 100. 0. 255. ECU_ADDRESS 0x3fc4c2 BIT_MASK 0x1000 /end MEASUREMENT
/begin MEASUREMENT CTR_ABC_END_DIAG_CAM_PER_0 "" UBYTE _CNV_A_R_LINEAR_____13_CM 1 100. 0. 255. ECU_ADDRESS 0x3fc4c4 FORMAT "%3.0" /end MEASUREMENT
/begin MEASUREMENT CTR_ABC_CAM_PER_1 "" UBYTE _CNV_A_R_LINEAR_____13_CM 1 100. 0. 255. ECU_ADDRESS 0x3fc4c6 FORMAT "%3.0" /end MEASUREMENT
/begin MEASUREMENT LV_ERR_DET_CAM_PER_1 "" UWORD _CNV_S_2_RANGE______77_R_CM 1 100. 0. 255. ECU_ADDRESS 0x3fc4c8 BIT_MASK 0x100 /end MEASUREMENT
/begin MEASUREMENT LV_ERR_SYM_CHG_CAM_PER_1 "" UWORD _CNV_S_2_RANGE______77_R_CM 1 100. 0. 255. ECU_ADDRESS 0x3fc4c8 BIT_MASK 0x400 /end MEASUREMENT
/begin MEASUREMENT LV_CDN_DIAG_CAM_PER_1 "" UWORD _CNV_S_2_RANGE______77_R_CM 1 100. 0. 255. ECU_ADDRESS 0x3fc4c8 BIT_MASK 0x800 /end MEASUREMENT
/begin MEASUREMENT ERR_SYM_CAM_PER_1 "" UWORD _CNV_S_5_RANGE_ERR__323_CM 1 100. 0. 8. ECU_ADDRESS 0x3fc4c8 BIT_MASK 0xF /end MEASUREMENT
/begin MEASUREMENT LV_END_DIAG_CAM_PER_1 "" UWORD _CNV_S_2_RANGE______77_R_CM 1 100. 0. 255. ECU_ADDRESS 0x3fc4c8 BIT_MASK 0x1000 /end MEASUREMENT
/begin MEASUREMENT CTR_ABC_END_DIAG_CAM_PER_1 "" UBYTE _CNV_A_R_LINEAR_____13_CM 1 100. 0. 255. ECU_ADDRESS 0x3fc4ca FORMAT "%3.0" /end MEASUREMENT
/begin MEASUREMENT CTR_ABC_CAM_PSN_0 "" UBYTE _CNV_A_R_LINEAR_____13_CM 1 100. 0. 255. ECU_ADDRESS 0x3fc4cc FORMAT "%3.0" /end MEASUREMENT
/begin MEASUREMENT LV_ERR_DET_CAM_PSN_0 "" UWORD _CNV_S_2_RANGE______77_R_CM 1 100. 0. 255. ECU_ADDRESS 0x3fc4ce BIT_MASK 0x100 /end MEASUREMENT
/begin MEASUREMENT LV_ERR_SYM_CHG_CAM_PSN_0 "" UWORD _CNV_S_2_RANGE______77_R_CM 1 100. 0. 255. ECU_ADDRESS 0x3fc4ce BIT_MASK 0x400 /end MEASUREMENT
/begin MEASUREMENT LV_CDN_DIAG_CAM_PSN_0 "" UWORD _CNV_S_2_RANGE______77_R_CM 1 100. 0. 255. ECU_ADDRESS 0x3fc4ce BIT_MASK 0x800 /end MEASUREMENT
/begin MEASUREMENT ERR_SYM_CAM_PSN_0 "" UWORD _CNV_S_5_RANGE_ERR__323_CM 1 100. 0. 8. ECU_ADDRESS 0x3fc4ce BIT_MASK 0xF /end MEASUREMENT
/begin MEASUREMENT LV_END_DIAG_CAM_PSN_0 "" UWORD _CNV_S_2_RANGE______77_R_CM 1 100. 0. 255. ECU_ADDRESS 0x3fc4ce BIT_MASK 0x1000 /end MEASUREMENT
/begin MEASUREMENT CTR_ABC_END_DIAG_CAM_PSN_0 "" UBYTE _CNV_A_R_LINEAR_____13_CM 1 100. 0. 255. ECU_ADDRESS 0x3fc4d0 FORMAT "%3.0" /end MEASUREMENT
/begin MEASUREMENT CTR_ABC_CAM_PSN_1 "" UBYTE _CNV_A_R_LINEAR_____13_CM 1 100. 0. 255. ECU_ADDRESS 0x3fc4d2 FORMAT "%3.0" /end MEASUREMENT
/begin MEASUREMENT LV_ERR_DET_CAM_PSN_1 "" UWORD _CNV_S_2_RANGE______77_R_CM 1 100. 0. 255. ECU_ADDRESS 0x3fc4d4 BIT_MASK 0x100 /end MEASUREMENT
/begin MEASUREMENT LV_ERR_SYM_CHG_CAM_PSN_1 "" UWORD _CNV_S_2_RANGE______77_R_CM 1 100. 0. 255. ECU_ADDRESS 0x3fc4d4 BIT_MASK 0x400 /end MEASUREMENT
/begin MEASUREMENT LV_CDN_DIAG_CAM_PSN_1 "" UWORD _CNV_S_2_RANGE______77_R_CM 1 100. 0. 255. ECU_ADDRESS 0x3fc4d4 BIT_MASK 0x800 /end MEASUREMENT
/begin MEASUREMENT ERR_SYM_CAM_PSN_1 "" UWORD _CNV_S_5_RANGE_ERR__323_CM 1 100. 0. 8. ECU_ADDRESS 0x3fc4d4 BIT_MASK 0xF /end MEASUREMENT
/begin MEASUREMENT LV_END_DIAG_CAM_PSN_1 "" UWORD _CNV_S_2_RANGE______77_R_CM 1 100. 0. 255. ECU_ADDRESS 0x3fc4d4 BIT_MASK 0x1000 /end MEASUREMENT
/begin MEASUREMENT CTR_ABC_END_DIAG_CAMPSN_1 "" UBYTE _CNV_A_R_LINEAR_____13_CM 1 100. 0. 255. ECU_ADDRESS 0x3fc4d6 FORMAT "%3.0" /end MEASUREMENT
/begin MEASUREMENT CTR_ABC_TOUT_TXU_1 "" UBYTE _CNV_A_R_LINEAR_____13_CM 1 100. 0. 255. ECU_ADDRESS 0x3fc4d8 FORMAT "%3.0" /end MEASUREMENT
/begin MEASUREMENT LV_ERR_DET_TOUT_TXU_1 "" UWORD _CNV_S_2_RANGE______77_R_CM 1 100. 0. 255. ECU_ADDRESS 0x3fc4da BIT_MASK 0x100 /end MEASUREMENT
/begin MEASUREMENT LV_ERR_SYM_CHG_TOUT_TXU_1 "" UWORD _CNV_S_2_RANGE______77_R_CM 1 100. 0. 255. ECU_ADDRESS 0x3fc4da BIT_MASK 0x400 /end MEASUREMENT
/begin MEASUREMENT LV_CDN_DIAG_TOUT_TXU_1 "" UWORD _CNV_S_2_RANGE______77_R_CM 1 100. 0. 255. ECU_ADDRESS 0x3fc4da BIT_MASK 0x800 /end MEASUREMENT
/begin MEASUREMENT ERR_SYM_TOUT_TXU_1 "" UWORD _CNV_S_5_RANGE_ERR__323_CM 1 100. 0. 8. ECU_ADDRESS 0x3fc4da BIT_MASK 0xF /end MEASUREMENT
/begin MEASUREMENT CTR_ABC_END_DIAG_TOUT_TXU_1 "" UBYTE _CNV_A_R_LINEAR_____13_CM 1 100. 0. 255. ECU_ADDRESS 0x3fc4dc FORMAT "%3.0" /end MEASUREMENT
/begin MEASUREMENT CTR_ABC_CAN_BOFF "" UBYTE _CNV_A_R_LINEAR_____13_CM 1 100. 0. 255. ECU_ADDRESS 0x3fc4de FORMAT "%3.0" /end MEASUREMENT
/begin MEASUREMENT LV_ERR_DET_CAN_BOFF "" UWORD _CNV_S_2_RANGE______77_R_CM 1 100. 0. 255. ECU_ADDRESS 0x3fc4e0 BIT_MASK 0x100 /end MEASUREMENT
/begin MEASUREMENT LV_ERR_SYM_CHG_CAN_BOFF "" UWORD _CNV_S_2_RANGE______77_R_CM 1 100. 0. 255. ECU_ADDRESS 0x3fc4e0 BIT_MASK 0x400 /end MEASUREMENT
/begin MEASUREMENT LV_CDN_DIAG_CAN_BOFF "" UWORD _CNV_S_2_RANGE______77_R_CM 1 100. 0. 255. ECU_ADDRESS 0x3fc4e0 BIT_MASK 0x800 /end MEASUREMENT
/begin MEASUREMENT ERR_SYM_CAN_BOFF "" UWORD _CNV_S_5_RANGE_ERR__323_CM 1 100. 0. 8. ECU_ADDRESS 0x3fc4e0 BIT_MASK 0xF /end MEASUREMENT
/begin MEASUREMENT LV_END_DIAG_CAN_BOFF "" UWORD _CNV_S_2_RANGE______77_R_CM 1 100. 0. 255. ECU_ADDRESS 0x3fc4e0 BIT_MASK 0x1000 /end MEASUREMENT
/begin MEASUREMENT CTR_ABC_END_DIAG_CAN_BOFF "" UBYTE _CNV_A_R_LINEAR_____13_CM 1 100. 0. 255. ECU_ADDRESS 0x3fc4e2 FORMAT "%3.0" /end MEASUREMENT
/begin MEASUREMENT CTR_ABC_RLY_MAIN "" UBYTE _CNV_A_R_LINEAR_____13_CM 1 100. 0. 255. ECU_ADDRESS 0x3fc4e4 FORMAT "%3.0" /end MEASUREMENT
/begin MEASUREMENT LV_ERR_DET_RLY_MAIN "" UWORD _CNV_S_2_RANGE______77_R_CM 1 100. 0. 255. ECU_ADDRESS 0x3fc4e6 BIT_MASK 0x100 /end MEASUREMENT
/begin MEASUREMENT LV_ERR_SYM_CHG_RLY_MAIN "" UWORD _CNV_S_2_RANGE______77_R_CM 1 100. 0. 255. ECU_ADDRESS 0x3fc4e6 BIT_MASK 0x400 /end MEASUREMENT
/begin MEASUREMENT LV_CDN_DIAG_RLY_MAIN "" UWORD _CNV_S_2_RANGE______77_R_CM 1 100. 0. 255. ECU_ADDRESS 0x3fc4e6 BIT_MASK 0x800 /end MEASUREMENT
/begin MEASUREMENT ERR_SYM_RLY_MAIN "" UWORD _CNV_S_5_RANGE_ERR__323_CM 1 100. 0. 8. ECU_ADDRESS 0x3fc4e6 BIT_MASK 0xF /end MEASUREMENT
/begin MEASUREMENT LV_END_DIAG_RLY_MAIN "" UWORD _CNV_S_2_RANGE______77_R_CM 1 100. 0. 255. ECU_ADDRESS 0x3fc4e6 BIT_MASK 0x1000 /end MEASUREMENT
/begin MEASUREMENT CTR_ABC_END_DIAG_RLY_MAIN "" UBYTE _CNV_A_R_LINEAR_____13_CM 1 100. 0. 255. ECU_ADDRESS 0x3fc4e8 FORMAT "%3.0" /end MEASUREMENT
/begin MEASUREMENT CTR_ABC_RLY_ACCOUT "" UBYTE _CNV_A_R_LINEAR_____13_CM 1 100. 0. 255. ECU_ADDRESS 0x3fc4ea FORMAT "%3.0" /end MEASUREMENT
/begin MEASUREMENT LV_ERR_DET_RLY_ACCOUT "" UWORD _CNV_S_2_RANGE______77_R_CM 1 100. 0. 255. ECU_ADDRESS 0x3fc4ec BIT_MASK 0x100 /end MEASUREMENT
/begin MEASUREMENT LV_ERR_SYM_CHG_RLY_ACCOUT "" UWORD _CNV_S_2_RANGE______77_R_CM 1 100. 0. 255. ECU_ADDRESS 0x3fc4ec BIT_MASK 0x400 /end MEASUREMENT
/begin MEASUREMENT LV_CDN_DIAG_RLY_ACCOUT "" UWORD _CNV_S_2_RANGE______77_R_CM 1 100. 0. 255. ECU_ADDRESS 0x3fc4ec BIT_MASK 0x800 /end MEASUREMENT
/begin MEASUREMENT ERR_SYM_RLY_ACCOUT "" UWORD _CNV_S_5_RANGE_ERR__323_CM 1 100. 0. 8. ECU_ADDRESS 0x3fc4ec BIT_MASK 0xF /end MEASUREMENT
/begin MEASUREMENT LV_END_DIAG_RLY_ACCOUT "" UWORD _CNV_S_2_RANGE______77_R_CM 1 100. 0. 255. ECU_ADDRESS 0x3fc4ec BIT_MASK 0x1000 /end MEASUREMENT
/begin MEASUREMENT CTR_ABC_END_DIAG_RLY_ACCOUT "" UBYTE _CNV_A_R_LINEAR_____13_CM 1 100. 0. 255. ECU_ADDRESS 0x3fc4ee FORMAT "%3.0" /end MEASUREMENT
/begin MEASUREMENT CTR_ABC_SAP "" UBYTE _CNV_A_R_LINEAR_____13_CM 1 100. 0. 255. ECU_ADDRESS 0x3fc4f0 FORMAT "%3.0" /end MEASUREMENT
/begin MEASUREMENT LV_ERR_DET_SAP "" UWORD _CNV_S_2_RANGE______77_R_CM 1 100. 0. 255. ECU_ADDRESS 0x3fc4f2 BIT_MASK 0x100 /end MEASUREMENT
/begin MEASUREMENT LV_ERR_SYM_CHG_SAP "" UWORD _CNV_S_2_RANGE______77_R_CM 1 100. 0. 255. ECU_ADDRESS 0x3fc4f2 BIT_MASK 0x400 /end MEASUREMENT
/begin MEASUREMENT LV_CDN_DIAG_SAP "" UWORD _CNV_S_2_RANGE______77_R_CM 1 100. 0. 255. ECU_ADDRESS 0x3fc4f2 BIT_MASK 0x800 /end MEASUREMENT
/begin MEASUREMENT ERR_SYM_SAP "" UWORD _CNV_S_5_RANGE_ERR__323_CM 1 100. 0. 8. ECU_ADDRESS 0x3fc4f2 BIT_MASK 0xF /end MEASUREMENT
/begin MEASUREMENT LV_END_DIAG_SAP "" UWORD _CNV_S_2_RANGE______77_R_CM 1 100. 0. 255. ECU_ADDRESS 0x3fc4f2 BIT_MASK 0x1000 /end MEASUREMENT
/begin MEASUREMENT CTR_ABC_END_DIAG_SAP "" UBYTE _CNV_A_R_LINEAR_____13_CM 1 100. 0. 255. ECU_ADDRESS 0x3fc4f4 FORMAT "%3.0" /end MEASUREMENT
/begin MEASUREMENT CTR_ABC_SAV "" UBYTE _CNV_A_R_LINEAR_____13_CM 1 100. 0. 255. ECU_ADDRESS 0x3fc4f6 FORMAT "%3.0" /end MEASUREMENT
/begin MEASUREMENT LV_ERR_DET_SAV "" UWORD _CNV_S_2_RANGE______77_R_CM 1 100. 0. 255. ECU_ADDRESS 0x3fc4f8 BIT_MASK 0x100 /end MEASUREMENT
/begin MEASUREMENT LV_ERR_SYM_CHG_SAV "" UWORD _CNV_S_2_RANGE______77_R_CM 1 100. 0. 255. ECU_ADDRESS 0x3fc4f8 BIT_MASK 0x400 /end MEASUREMENT
/begin MEASUREMENT LV_CDN_DIAG_SAV "" UWORD _CNV_S_2_RANGE______77_R_CM 1 100. 0. 255. ECU_ADDRESS 0x3fc4f8 BIT_MASK 0x800 /end MEASUREMENT
/begin MEASUREMENT ERR_SYM_SAV "" UWORD _CNV_S_5_RANGE_ERR__323_CM 1 100. 0. 8. ECU_ADDRESS 0x3fc4f8 BIT_MASK 0xF /end MEASUREMENT
/begin MEASUREMENT LV_END_DIAG_SAV "" UWORD _CNV_S_2_RANGE______77_R_CM 1 100. 0. 255. ECU_ADDRESS 0x3fc4f8 BIT_MASK 0x1000 /end MEASUREMENT
/begin MEASUREMENT CTR_ABC_END_DIAG_SAV "" UBYTE _CNV_A_R_LINEAR_____13_CM 1 100. 0. 255. ECU_ADDRESS 0x3fc4fa FORMAT "%3.0" /end MEASUREMENT
/begin MEASUREMENT CTR_ABC_ECF "" UBYTE _CNV_A_R_LINEAR_____13_CM 1 100. 0. 255. ECU_ADDRESS 0x3fc4fc FORMAT "%3.0" /end MEASUREMENT
/begin MEASUREMENT LV_ERR_DET_ECF "" UWORD _CNV_S_2_RANGE______77_R_CM 1 100. 0. 255. ECU_ADDRESS 0x3fc4fe BIT_MASK 0x100 /end MEASUREMENT
/begin MEASUREMENT LV_ERR_SYM_CHG_ECF "" UWORD _CNV_S_2_RANGE______77_R_CM 1 100. 0. 255. ECU_ADDRESS 0x3fc4fe BIT_MASK 0x400 /end MEASUREMENT
/begin MEASUREMENT LV_CDN_DIAG_ECF "" UWORD _CNV_S_2_RANGE______77_R_CM 1 100. 0. 255. ECU_ADDRESS 0x3fc4fe BIT_MASK 0x800 /end MEASUREMENT
/begin MEASUREMENT ERR_SYM_ECF "" UWORD _CNV_S_5_RANGE_ERR__323_CM 1 100. 0. 8. ECU_ADDRESS 0x3fc4fe BIT_MASK 0xF /end MEASUREMENT
/begin MEASUREMENT LV_END_DIAG_ECF "" UWORD _CNV_S_2_RANGE______77_R_CM 1 100. 0. 255. ECU_ADDRESS 0x3fc4fe BIT_MASK 0x1000 /end MEASUREMENT
/begin MEASUREMENT CTR_ABC_END_DIAG_ECF "" UBYTE _CNV_A_R_LINEAR_____13_CM 1 100. 0. 255. ECU_ADDRESS 0x3fc500 FORMAT "%3.0" /end MEASUREMENT
/begin MEASUREMENT CTR_ABC_TCO_EL "" UBYTE _CNV_A_R_LINEAR_____13_CM 1 100. 0. 255. ECU_ADDRESS 0x3fc502 FORMAT "%3.0" /end MEASUREMENT
/begin MEASUREMENT LV_ERR_DET_TCO_EL "" UWORD _CNV_S_2_RANGE______77_R_CM 1 100. 0. 255. ECU_ADDRESS 0x3fc504 BIT_MASK 0x100 /end MEASUREMENT
/begin MEASUREMENT LV_ERR_SYM_CHG_TCO_EL "" UWORD _CNV_S_2_RANGE______77_R_CM 1 100. 0. 255. ECU_ADDRESS 0x3fc504 BIT_MASK 0x400 /end MEASUREMENT
/begin MEASUREMENT LV_CDN_DIAG_TCO_EL "" UWORD _CNV_S_2_RANGE______77_R_CM 1 100. 0. 255. ECU_ADDRESS 0x3fc504 BIT_MASK 0x800 /end MEASUREMENT
/begin MEASUREMENT ERR_SYM_TCO_EL "" UWORD _CNV_S_5_RANGE_ERR__323_CM 1 100. 0. 8. ECU_ADDRESS 0x3fc504 BIT_MASK 0xF /end MEASUREMENT
/begin MEASUREMENT LV_END_DIAG_TCO_EL "" UWORD _CNV_S_2_RANGE______77_R_CM 1 100. 0. 255. ECU_ADDRESS 0x3fc504 BIT_MASK 0x1000 /end MEASUREMENT
/begin MEASUREMENT CTR_ABC_END_DIAG_TCO_EL "" UBYTE _CNV_A_R_LINEAR_____13_CM 1 100. 0. 255. ECU_ADDRESS 0x3fc506 FORMAT "%3.0" /end MEASUREMENT
/begin MEASUREMENT CTR_ABC_TCO_STUCK "" UBYTE _CNV_A_R_LINEAR_____13_CM 1 100. 0. 255. ECU_ADDRESS 0x3fc508 FORMAT "%3.0" /end MEASUREMENT
/begin MEASUREMENT LV_ERR_DET_TCO_STUCK "" UWORD _CNV_S_2_RANGE______77_R_CM 1 100. 0. 255. ECU_ADDRESS 0x3fc50a BIT_MASK 0x100 /end MEASUREMENT
/begin MEASUREMENT LV_ERR_SYM_CHG_TCO_STUCK "" UWORD _CNV_S_2_RANGE______77_R_CM 1 100. 0. 255. ECU_ADDRESS 0x3fc50a BIT_MASK 0x400 /end MEASUREMENT
/begin MEASUREMENT LV_CDN_DIAG_TCO_STUCK "" UWORD _CNV_S_2_RANGE______77_R_CM 1 100. 0. 255. ECU_ADDRESS 0x3fc50a BIT_MASK 0x800 /end MEASUREMENT
/begin MEASUREMENT ERR_SYM_TCO_STUCK "" UWORD _CNV_S_5_RANGE_ERR__323_CM 1 100. 0. 8. ECU_ADDRESS 0x3fc50a BIT_MASK 0xF /end MEASUREMENT
/begin MEASUREMENT LV_END_DIAG_TCO_STUCK "" UWORD _CNV_S_2_RANGE______77_R_CM 1 100. 0. 255. ECU_ADDRESS 0x3fc50a BIT_MASK 0x1000 /end MEASUREMENT
/begin MEASUREMENT CTR_ABC_END_DIAG_TCO_STUCK "" UBYTE _CNV_A_R_LINEAR_____13_CM 1 100. 0. 255. ECU_ADDRESS 0x3fc50c FORMAT "%3.0" /end MEASUREMENT
/begin MEASUREMENT CTR_ABC_TCO_GRD "" UBYTE _CNV_A_R_LINEAR_____13_CM 1 100. 0. 255. ECU_ADDRESS 0x3fc50e FORMAT "%3.0" /end MEASUREMENT
/begin MEASUREMENT LV_ERR_DET_TCO_GRD "" UWORD _CNV_S_2_RANGE______77_R_CM 1 100. 0. 255. ECU_ADDRESS 0x3fc510 BIT_MASK 0x100 /end MEASUREMENT
/begin MEASUREMENT LV_ERR_SYM_CHG_TCO_GRD "" UWORD _CNV_S_2_RANGE______77_R_CM 1 100. 0. 255. ECU_ADDRESS 0x3fc510 BIT_MASK 0x400 /end MEASUREMENT
/begin MEASUREMENT LV_CDN_DIAG_TCO_GRD "" UWORD _CNV_S_2_RANGE______77_R_CM 1 100. 0. 255. ECU_ADDRESS 0x3fc510 BIT_MASK 0x800 /end MEASUREMENT
/begin MEASUREMENT ERR_SYM_TCO_GRD "" UWORD _CNV_S_5_RANGE_ERR__323_CM 1 100. 0. 8. ECU_ADDRESS 0x3fc510 BIT_MASK 0xF /end MEASUREMENT
/begin MEASUREMENT LV_END_DIAG_TCO_GRD "" UWORD _CNV_S_2_RANGE______77_R_CM 1 100. 0. 255. ECU_ADDRESS 0x3fc510 BIT_MASK 0x1000 /end MEASUREMENT
/begin MEASUREMENT CTR_ABC_END_DIAG_TCO_GRD "" UBYTE _CNV_A_R_LINEAR_____13_CM 1 100. 0. 255. ECU_ADDRESS 0x3fc512 FORMAT "%3.0" /end MEASUREMENT
/begin MEASUREMENT CTR_ABC_ECT_MEC "" UBYTE _CNV_A_R_LINEAR_____13_CM 1 100. 0. 255. ECU_ADDRESS 0x3fc514 FORMAT "%3.0" /end MEASUREMENT
/begin MEASUREMENT LV_ERR_DET_ECT_MEC "" UWORD _CNV_S_2_RANGE______77_R_CM 1 100. 0. 255. ECU_ADDRESS 0x3fc516 BIT_MASK 0x100 /end MEASUREMENT
/begin MEASUREMENT LV_ERR_SYM_CHG_ECT_MEC "" UWORD _CNV_S_2_RANGE______77_R_CM 1 100. 0. 255. ECU_ADDRESS 0x3fc516 BIT_MASK 0x400 /end MEASUREMENT
/begin MEASUREMENT LV_CDN_DIAG_ECT_MEC "" UWORD _CNV_S_2_RANGE______77_R_CM 1 100. 0. 255. ECU_ADDRESS 0x3fc516 BIT_MASK 0x800 /end MEASUREMENT
/begin MEASUREMENT ERR_SYM_ECT_MEC "" UWORD _CNV_S_5_RANGE_ERR__323_CM 1 100. 0. 8. ECU_ADDRESS 0x3fc516 BIT_MASK 0xF /end MEASUREMENT
/begin MEASUREMENT LV_END_DIAG_ECT_MEC "" UWORD _CNV_S_2_RANGE______77_R_CM 1 100. 0. 255. ECU_ADDRESS 0x3fc516 BIT_MASK 0x1000 /end MEASUREMENT
/begin MEASUREMENT CTR_ABC_END_DIAG_ECT_MEC "" UBYTE _CNV_A_R_LINEAR_____13_CM 1 100. 0. 255. ECU_ADDRESS 0x3fc518 FORMAT "%3.0" /end MEASUREMENT
/begin MEASUREMENT CTR_ABC_ECT_EL "" UBYTE _CNV_A_R_LINEAR_____13_CM 1 100. 0. 255. ECU_ADDRESS 0x3fc51a FORMAT "%3.0" /end MEASUREMENT
/begin MEASUREMENT LV_ERR_DET_ECT_EL "" UWORD _CNV_S_2_RANGE______77_R_CM 1 100. 0. 255. ECU_ADDRESS 0x3fc51c BIT_MASK 0x100 /end MEASUREMENT
/begin MEASUREMENT LV_ERR_SYM_CHG_ECT_EL "" UWORD _CNV_S_2_RANGE______77_R_CM 1 100. 0. 255. ECU_ADDRESS 0x3fc51c BIT_MASK 0x400 /end MEASUREMENT
/begin MEASUREMENT LV_CDN_DIAG_ECT_EL "" UWORD _CNV_S_2_RANGE______77_R_CM 1 100. 0. 255. ECU_ADDRESS 0x3fc51c BIT_MASK 0x800 /end MEASUREMENT
/begin MEASUREMENT ERR_SYM_ECT_EL "" UWORD _CNV_S_5_RANGE_ERR__323_CM 1 100. 0. 8. ECU_ADDRESS 0x3fc51c BIT_MASK 0xF /end MEASUREMENT
/begin MEASUREMENT LV_END_DIAG_ECT_EL "" UWORD _CNV_S_2_RANGE______77_R_CM 1 100. 0. 255. ECU_ADDRESS 0x3fc51c BIT_MASK 0x1000 /end MEASUREMENT
/begin MEASUREMENT CTR_ABC_END_DIAG_ECT_EL "" UBYTE _CNV_A_R_LINEAR_____13_CM 1 100. 0. 255. ECU_ADDRESS 0x3fc51e FORMAT "%3.0" /end MEASUREMENT
/begin MEASUREMENT CTR_ABC_TCO_PLAUS "" UBYTE _CNV_A_R_LINEAR_____13_CM 1 100. 0. 255. ECU_ADDRESS 0x3fc520 FORMAT "%3.0" /end MEASUREMENT
/begin MEASUREMENT LV_ERR_DET_TCO_PLAUS "" UWORD _CNV_S_2_RANGE______77_R_CM 1 100. 0. 255. ECU_ADDRESS 0x3fc522 BIT_MASK 0x100 /end MEASUREMENT
/begin MEASUREMENT LV_ERR_SYM_CHG_TCO_PLAUS "" UWORD _CNV_S_2_RANGE______77_R_CM 1 100. 0. 255. ECU_ADDRESS 0x3fc522 BIT_MASK 0x400 /end MEASUREMENT
/begin MEASUREMENT LV_CDN_DIAG_TCO_PLAUS "" UWORD _CNV_S_2_RANGE______77_R_CM 1 100. 0. 255. ECU_ADDRESS 0x3fc522 BIT_MASK 0x800 /end MEASUREMENT
/begin MEASUREMENT ERR_SYM_TCO_PLAUS "" UWORD _CNV_S_5_RANGE_ERR__323_CM 1 100. 0. 8. ECU_ADDRESS 0x3fc522 BIT_MASK 0xF /end MEASUREMENT
/begin MEASUREMENT LV_END_DIAG_TCO_PLAUS "" UWORD _CNV_S_2_RANGE______77_R_CM 1 100. 0. 255. ECU_ADDRESS 0x3fc522 BIT_MASK 0x1000 /end MEASUREMENT
/begin MEASUREMENT CTR_ABC_END_DIAG_TCO_PLAUS "" UBYTE _CNV_A_R_LINEAR_____13_CM 1 100. 0. 255. ECU_ADDRESS 0x3fc524 FORMAT "%3.0" /end MEASUREMENT
/begin MEASUREMENT ERR_DTC_CUS_0 "" UWORD _CNV_A_R_LINEAR_____13_CM 1 100. 0. 65535. ECU_ADDRESS 0x3fc274 FORMAT "%6.0" /end MEASUREMENT
/begin MEASUREMENT CTR_FRC_0 "Frequency counter of failure N" UBYTE _CNV_A_R_LINEAR_____13_CM 1 100. 0. 255. ECU_ADDRESS 0x3fc277 FORMAT "%3.0" /end MEASUREMENT
/begin MEASUREMENT CTR_WUP_CYC_0 "Counter for warm-up cycle" UBYTE _CNV_A_R_LINEAR_____13_CM 1 100. 0. 255. ECU_ADDRESS 0x3fc278 FORMAT "%3.0" /end MEASUREMENT
/begin MEASUREMENT CTR_DC_0 "Counter for driving cycle" UBYTE _CNV_A_R_LINEAR_____13_CM 1 100. 0. 255. ECU_ADDRESS 0x3fc279 FORMAT "%3.0" /end MEASUREMENT
/begin MEASUREMENT ERR_INFO_DYN "" UWORD _CNV_S_2_RANGE______77_R_CM 1 100. 0. 255. ECU_ADDRESS 0x3fc27c /end MEASUREMENT
/begin MEASUREMENT ERR_SYM_MEM_0 "" UWORD _CNV_S_5_RANGE_ERR__323_CM 1 100. 0. 8. ECU_ADDRESS 0x3fc27c BIT_MASK 0xF /end MEASUREMENT
/begin MEASUREMENT LV_ERR_DC_0 "" UWORD _CNV_S_2_RANGE______202_CM 1 100. 0. 1. ECU_ADDRESS 0x3fc27c BIT_MASK 0x10 /end MEASUREMENT
/begin MEASUREMENT LV_ERR_TMP_0 "" UWORD _CNV_S_2_RANGE______77_R_CM 1 100. 0. 255. ECU_ADDRESS 0x3fc27c BIT_MASK 0x20 /end MEASUREMENT
/begin MEASUREMENT LV_ERR_DIS_0 "" UWORD _CNV_S_2_RANGE______77_R_CM 1 100. 0. 255. ECU_ADDRESS 0x3fc27c BIT_MASK 0x40 /end MEASUREMENT
/begin MEASUREMENT LV_DC_MAX_0 "" UWORD _CNV_S_2_RANGE______77_R_CM 1 100. 0. 255. ECU_ADDRESS 0x3fc27c BIT_MASK 0x80 /end MEASUREMENT
/begin MEASUREMENT LV_ERR_CFM_0 "" UWORD _CNV_S_2_RANGE______77_R_CM 1 100. 0. 255. ECU_ADDRESS 0x3fc27c BIT_MASK 0x100 /end MEASUREMENT
/begin MEASUREMENT LV_ERR_SYM_CHG_MEM_0 "" UWORD _CNV_S_2_RANGE______77_R_CM 1 100. 0. 255. ECU_ADDRESS 0x3fc27c BIT_MASK 0x400 /end MEASUREMENT
/begin MEASUREMENT ERR_DTC_CUS_1 "" UWORD _CNV_A_R_LINEAR_____13_CM 1 100. 0. 65535. ECU_ADDRESS 0x3fc27e FORMAT "%6.0" /end MEASUREMENT
/begin MEASUREMENT CTR_FRC_1 "Frequency counter of failure N" UBYTE _CNV_A_R_LINEAR_____13_CM 1 100. 0. 255. ECU_ADDRESS 0x3fc281 FORMAT "%3.0" /end MEASUREMENT
/begin MEASUREMENT CTR_WUP_CYC_1 "Counter for warm-up cycle" UBYTE _CNV_A_R_LINEAR_____13_CM 1 100. 0. 255. ECU_ADDRESS 0x3fc282 FORMAT "%3.0" /end MEASUREMENT
/begin MEASUREMENT CTR_DC_1 "Counter for driving cycle" UBYTE _CNV_A_R_LINEAR_____13_CM 1 100. 0. 255. ECU_ADDRESS 0x3fc283 FORMAT "%3.0" /end MEASUREMENT
/begin MEASUREMENT ERR_SYM_MEM_1 "" UWORD _CNV_S_5_RANGE_ERR__323_CM 1 100. 0. 8. ECU_ADDRESS 0x3fc286 BIT_MASK 0xF /end MEASUREMENT
/begin MEASUREMENT LV_ERR_DC_1 "" UWORD _CNV_S_2_RANGE______202_CM 1 100. 0. 1. ECU_ADDRESS 0x3fc286 BIT_MASK 0x10 /end MEASUREMENT
/begin MEASUREMENT LV_ERR_TMP_1 "" UWORD _CNV_S_2_RANGE______77_R_CM 1 100. 0. 255. ECU_ADDRESS 0x3fc286 BIT_MASK 0x20 /end MEASUREMENT
/begin MEASUREMENT LV_ERR_DIS_1 "" UWORD _CNV_S_2_RANGE______77_R_CM 1 100. 0. 255. ECU_ADDRESS 0x3fc286 BIT_MASK 0x40 /end MEASUREMENT
/begin MEASUREMENT LV_DC_MAX_1 "" UWORD _CNV_S_2_RANGE______77_R_CM 1 100. 0. 255. ECU_ADDRESS 0x3fc286 BIT_MASK 0x80 /end MEASUREMENT
/begin MEASUREMENT LV_ERR_CFM_1 "" UWORD _CNV_S_2_RANGE______77_R_CM 1 100. 0. 255. ECU_ADDRESS 0x3fc286 BIT_MASK 0x100 /end MEASUREMENT
/begin MEASUREMENT LV_ERR_SYM_CHG_MEM_1 "" UWORD _CNV_S_2_RANGE______77_R_CM 1 100. 0. 255. ECU_ADDRESS 0x3fc286 BIT_MASK 0x400 /end MEASUREMENT
/begin MEASUREMENT ERR_DTC_CUS_2 "" UWORD _CNV_A_R_LINEAR_____13_CM 1 100. 0. 65535. ECU_ADDRESS 0x3fc288 FORMAT "%6.0" /end MEASUREMENT
/begin MEASUREMENT CTR_FRC_2 "Frequency counter of failure N" UBYTE _CNV_A_R_LINEAR_____13_CM 1 100. 0. 255. ECU_ADDRESS 0x3fc28b FORMAT "%3.0" /end MEASUREMENT
/begin MEASUREMENT CTR_WUP_CYC_2 "Counter for warm-up cycle" UBYTE _CNV_A_R_LINEAR_____13_CM 1 100. 0. 255. ECU_ADDRESS 0x3fc28c FORMAT "%3.0" /end MEASUREMENT
/begin MEASUREMENT CTR_DC_2 "Counter for driving cycle" UBYTE _CNV_A_R_LINEAR_____13_CM 1 100. 0. 255. ECU_ADDRESS 0x3fc28d FORMAT "%3.0" /end MEASUREMENT
/begin MEASUREMENT ERR_SYM_MEM_2 "" UWORD _CNV_S_5_RANGE_ERR__323_CM 1 100. 0. 8. ECU_ADDRESS 0x3fc290 BIT_MASK 0xF /end MEASUREMENT
/begin MEASUREMENT LV_ERR_DC_2 "" UWORD _CNV_S_2_RANGE______202_CM 1 100. 0. 1. ECU_ADDRESS 0x3fc290 BIT_MASK 0x10 /end MEASUREMENT
/begin MEASUREMENT LV_ERR_TMP_2 "" UWORD _CNV_S_2_RANGE______77_R_CM 1 100. 0. 255. ECU_ADDRESS 0x3fc290 BIT_MASK 0x20 /end MEASUREMENT
/begin MEASUREMENT LV_ERR_DIS_2 "" UWORD _CNV_S_2_RANGE______77_R_CM 1 100. 0. 255. ECU_ADDRESS 0x3fc290 BIT_MASK 0x40 /end MEASUREMENT
/begin MEASUREMENT LV_DC_MAX_2 "" UWORD _CNV_S_2_RANGE______77_R_CM 1 100. 0. 255. ECU_ADDRESS 0x3fc290 BIT_MASK 0x80 /end MEASUREMENT
/begin MEASUREMENT LV_ERR_CFM_2 "" UWORD _CNV_S_2_RANGE______77_R_CM 1 100. 0. 255. ECU_ADDRESS 0x3fc290 BIT_MASK 0x100 /end MEASUREMENT
/begin MEASUREMENT LV_ERR_SYM_CHG_MEM_2 "" UWORD _CNV_S_2_RANGE______77_R_CM 1 100. 0. 255. ECU_ADDRESS 0x3fc290 BIT_MASK 0x400 /end MEASUREMENT
/begin MEASUREMENT ERR_DTC_CUS_3 "" UWORD _CNV_A_R_LINEAR_____13_CM 1 100. 0. 65535. ECU_ADDRESS 0x3fc292 FORMAT "%6.0" /end MEASUREMENT
/begin MEASUREMENT CTR_FRC_3 "Frequency counter of failure N" UBYTE _CNV_A_R_LINEAR_____13_CM 1 100. 0. 255. ECU_ADDRESS 0x3fc295 FORMAT "%3.0" /end MEASUREMENT
/begin MEASUREMENT CTR_WUP_CYC_3 "Counter for warm-up cycle" UBYTE _CNV_A_R_LINEAR_____13_CM 1 100. 0. 255. ECU_ADDRESS 0x3fc296 FORMAT "%3.0" /end MEASUREMENT
/begin MEASUREMENT CTR_DC_3 "Counter for driving cycle" UBYTE _CNV_A_R_LINEAR_____13_CM 1 100. 0. 255. ECU_ADDRESS 0x3fc297 FORMAT "%3.0" /end MEASUREMENT
/begin MEASUREMENT ERR_SYM_MEM_3 "" UWORD _CNV_S_5_RANGE_ERR__323_CM 1 100. 0. 8. ECU_ADDRESS 0x3fc29a BIT_MASK 0xF /end MEASUREMENT
/begin MEASUREMENT LV_ERR_DC_3 "" UWORD _CNV_S_2_RANGE______202_CM 1 100. 0. 1. ECU_ADDRESS 0x3fc29a BIT_MASK 0x10 /end MEASUREMENT
/begin MEASUREMENT LV_ERR_TMP_3 "" UWORD _CNV_S_2_RANGE______77_R_CM 1 100. 0. 255. ECU_ADDRESS 0x3fc29a BIT_MASK 0x20 /end MEASUREMENT
/begin MEASUREMENT LV_ERR_DIS_3 "" UWORD _CNV_S_2_RANGE______77_R_CM 1 100. 0. 255. ECU_ADDRESS 0x3fc29a BIT_MASK 0x40 /end MEASUREMENT
/begin MEASUREMENT LV_DC_MAX_3 "" UWORD _CNV_S_2_RANGE______77_R_CM 1 100. 0. 255. ECU_ADDRESS 0x3fc29a BIT_MASK 0x80 /end MEASUREMENT
/begin MEASUREMENT LV_ERR_CFM_3 "" UWORD _CNV_S_2_RANGE______77_R_CM 1 100. 0. 255. ECU_ADDRESS 0x3fc29a BIT_MASK 0x100 /end MEASUREMENT
/begin MEASUREMENT LV_ERR_SYM_CHG_MEM_3 "" UWORD _CNV_S_2_RANGE______77_R_CM 1 100. 0. 255. ECU_ADDRESS 0x3fc29a BIT_MASK 0x400 /end MEASUREMENT
/begin MEASUREMENT ERR_DTC_CUS_4 "" UWORD _CNV_A_R_LINEAR_____13_CM 1 100. 0. 65535. ECU_ADDRESS 0x3fc29c FORMAT "%6.0" /end MEASUREMENT
/begin MEASUREMENT CTR_FRC_4 "Frequency counter of failure N" UBYTE _CNV_A_R_LINEAR_____13_CM 1 100. 0. 255. ECU_ADDRESS 0x3fc29f FORMAT "%3.0" /end MEASUREMENT
/begin MEASUREMENT CTR_WUP_CYC_4 "Counter for warm-up cycle" UBYTE _CNV_A_R_LINEAR_____13_CM 1 100. 0. 255. ECU_ADDRESS 0x3fc2a0 FORMAT "%3.0" /end MEASUREMENT
/begin MEASUREMENT CTR_DC_4 "Counter for driving cycle" UBYTE _CNV_A_R_LINEAR_____13_CM 1 100. 0. 255. ECU_ADDRESS 0x3fc2a1 FORMAT "%3.0" /end MEASUREMENT
/begin MEASUREMENT ERR_SYM_MEM_4 "" UWORD _CNV_S_5_RANGE_ERR__323_CM 1 100. 0. 8. ECU_ADDRESS 0x3fc2a4 BIT_MASK 0xF /end MEASUREMENT
/begin MEASUREMENT LV_ERR_DC_4 "" UWORD _CNV_S_2_RANGE______202_CM 1 100. 0. 1. ECU_ADDRESS 0x3fc2a4 BIT_MASK 0x10 /end MEASUREMENT
/begin MEASUREMENT LV_ERR_TMP_4 "" UWORD _CNV_S_2_RANGE______77_R_CM 1 100. 0. 255. ECU_ADDRESS 0x3fc2a4 BIT_MASK 0x20 /end MEASUREMENT
/begin MEASUREMENT LV_ERR_DIS_4 "" UWORD _CNV_S_2_RANGE______77_R_CM 1 100. 0. 255. ECU_ADDRESS 0x3fc2a4 BIT_MASK 0x40 /end MEASUREMENT
/begin MEASUREMENT LV_DC_MAX_4 "" UWORD _CNV_S_2_RANGE______77_R_CM 1 100. 0. 255. ECU_ADDRESS 0x3fc2a4 BIT_MASK 0x80 /end MEASUREMENT
/begin MEASUREMENT LV_ERR_CFM_4 "" UWORD _CNV_S_2_RANGE______77_R_CM 1 100. 0. 255. ECU_ADDRESS 0x3fc2a4 BIT_MASK 0x100 /end MEASUREMENT
/begin MEASUREMENT LV_ERR_SYM_CHG_MEM_4 "" UWORD _CNV_S_2_RANGE______77_R_CM 1 100. 0. 255. ECU_ADDRESS 0x3fc2a4 BIT_MASK 0x400 /end MEASUREMENT
/begin MEASUREMENT ERR_DTC_CUS_5 "" UWORD _CNV_A_R_LINEAR_____13_CM 1 100. 0. 65535. ECU_ADDRESS 0x3fc2a6 FORMAT "%6.0" /end MEASUREMENT
/begin MEASUREMENT CTR_FRC_5 "Frequency counter of failure N" UBYTE _CNV_A_R_LINEAR_____13_CM 1 100. 0. 255. ECU_ADDRESS 0x3fc2a9 FORMAT "%3.0" /end MEASUREMENT
/begin MEASUREMENT CTR_WUP_CYC_5 "Counter for warm-up cycle" UBYTE _CNV_A_R_LINEAR_____13_CM 1 100. 0. 255. ECU_ADDRESS 0x3fc2aa FORMAT "%3.0" /end MEASUREMENT
/begin MEASUREMENT CTR_DC_5 "Counter for driving cycle" UBYTE _CNV_A_R_LINEAR_____13_CM 1 100. 0. 255. ECU_ADDRESS 0x3fc2ab FORMAT "%3.0" /end MEASUREMENT
/begin MEASUREMENT ERR_SYM_MEM_5 "" UWORD _CNV_S_5_RANGE_ERR__323_CM 1 100. 0. 8. ECU_ADDRESS 0x3fc2ae BIT_MASK 0xF /end MEASUREMENT
/begin MEASUREMENT LV_ERR_DC_5 "" UWORD _CNV_S_2_RANGE______202_CM 1 100. 0. 1. ECU_ADDRESS 0x3fc2ae BIT_MASK 0x10 /end MEASUREMENT
/begin MEASUREMENT LV_ERR_TMP_5 "" UWORD _CNV_S_2_RANGE______77_R_CM 1 100. 0. 255. ECU_ADDRESS 0x3fc2ae BIT_MASK 0x20 /end MEASUREMENT
/begin MEASUREMENT LV_ERR_DIS_5 "" UWORD _CNV_S_2_RANGE______77_R_CM 1 100. 0. 255. ECU_ADDRESS 0x3fc2ae BIT_MASK 0x40 /end MEASUREMENT
/begin MEASUREMENT LV_DC_MAX_5 "" UWORD _CNV_S_2_RANGE______77_R_CM 1 100. 0. 255. ECU_ADDRESS 0x3fc2ae BIT_MASK 0x80 /end MEASUREMENT
/begin MEASUREMENT LV_ERR_CFM_5 "" UWORD _CNV_S_2_RANGE______77_R_CM 1 100. 0. 255. ECU_ADDRESS 0x3fc2ae BIT_MASK 0x100 /end MEASUREMENT
/begin MEASUREMENT LV_ERR_SYM_CHG_MEM_5 "" UWORD _CNV_S_2_RANGE______77_R_CM 1 100. 0. 255. ECU_ADDRESS 0x3fc2ae BIT_MASK 0x400 /end MEASUREMENT
/begin MEASUREMENT ERR_DTC_CUS_6 "" UWORD _CNV_A_R_LINEAR_____13_CM 1 100. 0. 65535. ECU_ADDRESS 0x3fc2b0 FORMAT "%6.0" /end MEASUREMENT
/begin MEASUREMENT CTR_FRC_6 "Frequency counter of failure N" UBYTE _CNV_A_R_LINEAR_____13_CM 1 100. 0. 255. ECU_ADDRESS 0x3fc2b3 FORMAT "%3.0" /end MEASUREMENT
/begin MEASUREMENT CTR_WUP_CYC_6 "Counter for warm-up cycle" UBYTE _CNV_A_R_LINEAR_____13_CM 1 100. 0. 255. ECU_ADDRESS 0x3fc2b4 FORMAT "%3.0" /end MEASUREMENT
/begin MEASUREMENT CTR_DC_6 "Counter for driving cycle" UBYTE _CNV_A_R_LINEAR_____13_CM 1 100. 0. 255. ECU_ADDRESS 0x3fc2b5 FORMAT "%3.0" /end MEASUREMENT
/begin MEASUREMENT ERR_SYM_MEM_6 "" UWORD _CNV_S_5_RANGE_ERR__323_CM 1 100. 0. 8. ECU_ADDRESS 0x3fc2b8 BIT_MASK 0xF /end MEASUREMENT
/begin MEASUREMENT LV_ERR_DC_6 "" UWORD _CNV_S_2_RANGE______202_CM 1 100. 0. 1. ECU_ADDRESS 0x3fc2b8 BIT_MASK 0x10 /end MEASUREMENT
/begin MEASUREMENT LV_ERR_TMP_6 "" UWORD _CNV_S_2_RANGE______77_R_CM 1 100. 0. 255. ECU_ADDRESS 0x3fc2b8 BIT_MASK 0x20 /end MEASUREMENT
/begin MEASUREMENT LV_ERR_DIS_6 "" UWORD _CNV_S_2_RANGE______77_R_CM 1 100. 0. 255. ECU_ADDRESS 0x3fc2b8 BIT_MASK 0x40 /end MEASUREMENT
/begin MEASUREMENT LV_DC_MAX_6 "" UWORD _CNV_S_2_RANGE______77_R_CM 1 100. 0. 255. ECU_ADDRESS 0x3fc2b8 BIT_MASK 0x80 /end MEASUREMENT
/begin MEASUREMENT LV_ERR_CFM_6 "" UWORD _CNV_S_2_RANGE______77_R_CM 1 100. 0. 255. ECU_ADDRESS 0x3fc2b8 BIT_MASK 0x100 /end MEASUREMENT
/begin MEASUREMENT LV_ERR_SYM_CHG_MEM_6 "" UWORD _CNV_S_2_RANGE______77_R_CM 1 100. 0. 255. ECU_ADDRESS 0x3fc2b8 BIT_MASK 0x400 /end MEASUREMENT
/begin MEASUREMENT ERR_DTC_CUS_7 "" UWORD _CNV_A_R_LINEAR_____13_CM 1 100. 0. 65535. ECU_ADDRESS 0x3fc2ba FORMAT "%6.0" /end MEASUREMENT
/begin MEASUREMENT CTR_FRC_7 "Frequency counter of failure N" UBYTE _CNV_A_R_LINEAR_____13_CM 1 100. 0. 255. ECU_ADDRESS 0x3fc2bd FORMAT "%3.0" /end MEASUREMENT
/begin MEASUREMENT CTR_WUP_CYC_7 "Counter for warm-up cycle" UBYTE _CNV_A_R_LINEAR_____13_CM 1 100. 0. 255. ECU_ADDRESS 0x3fc2be FORMAT "%3.0" /end MEASUREMENT
/begin MEASUREMENT CTR_DC_7 "Counter for driving cycle" UBYTE _CNV_A_R_LINEAR_____13_CM 1 100. 0. 255. ECU_ADDRESS 0x3fc2bf FORMAT "%3.0" /end MEASUREMENT
/begin MEASUREMENT ERR_SYM_MEM_7 "" UWORD _CNV_S_5_RANGE_ERR__323_CM 1 100. 0. 8. ECU_ADDRESS 0x3fc2c2 BIT_MASK 0xF /end MEASUREMENT
/begin MEASUREMENT LV_ERR_DC_7 "" UWORD _CNV_S_2_RANGE______202_CM 1 100. 0. 1. ECU_ADDRESS 0x3fc2c2 BIT_MASK 0x10 /end MEASUREMENT
/begin MEASUREMENT LV_ERR_TMP_7 "" UWORD _CNV_S_2_RANGE______77_R_CM 1 100. 0. 255. ECU_ADDRESS 0x3fc2c2 BIT_MASK 0x20 /end MEASUREMENT
/begin MEASUREMENT LV_ERR_DIS_7 "" UWORD _CNV_S_2_RANGE______77_R_CM 1 100. 0. 255. ECU_ADDRESS 0x3fc2c2 BIT_MASK 0x40 /end MEASUREMENT
/begin MEASUREMENT LV_DC_MAX_7 "" UWORD _CNV_S_2_RANGE______77_R_CM 1 100. 0. 255. ECU_ADDRESS 0x3fc2c2 BIT_MASK 0x80 /end MEASUREMENT
/begin MEASUREMENT LV_ERR_CFM_7 "" UWORD _CNV_S_2_RANGE______77_R_CM 1 100. 0. 255. ECU_ADDRESS 0x3fc2c2 BIT_MASK 0x100 /end MEASUREMENT
/begin MEASUREMENT LV_ERR_SYM_CHG_MEM_7 "" UWORD _CNV_S_2_RANGE______77_R_CM 1 100. 0. 255. ECU_ADDRESS 0x3fc2c2 BIT_MASK 0x400 /end MEASUREMENT
/begin MEASUREMENT ERR_DTC_CUS_8 "" UWORD _CNV_A_R_LINEAR_____13_CM 1 100. 0. 65535. ECU_ADDRESS 0x3fc2c4 FORMAT "%6.0" /end MEASUREMENT
/begin MEASUREMENT CTR_FRC_8 "Frequency counter of failure N" UBYTE _CNV_A_R_LINEAR_____13_CM 1 100. 0. 255. ECU_ADDRESS 0x3fc2c7 FORMAT "%3.0" /end MEASUREMENT
/begin MEASUREMENT CTR_WUP_CYC_8 "Counter for warm-up cycle" UBYTE _CNV_A_R_LINEAR_____13_CM 1 100. 0. 255. ECU_ADDRESS 0x3fc2c8 FORMAT "%3.0" /end MEASUREMENT
/begin MEASUREMENT CTR_DC_8 "Counter for driving cycle" UBYTE _CNV_A_R_LINEAR_____13_CM 1 100. 0. 255. ECU_ADDRESS 0x3fc2c9 FORMAT "%3.0" /end MEASUREMENT
/begin MEASUREMENT ERR_SYM_MEM_8 "" UWORD _CNV_S_5_RANGE_ERR__323_CM 1 100. 0. 8. ECU_ADDRESS 0x3fc2cc BIT_MASK 0xF /end MEASUREMENT
/begin MEASUREMENT LV_ERR_DC_8 "" UWORD _CNV_S_2_RANGE______202_CM 1 100. 0. 1. ECU_ADDRESS 0x3fc2cc BIT_MASK 0x10 /end MEASUREMENT
/begin MEASUREMENT LV_ERR_TMP_8 "" UWORD _CNV_S_2_RANGE______77_R_CM 1 100. 0. 255. ECU_ADDRESS 0x3fc2cc BIT_MASK 0x20 /end MEASUREMENT
/begin MEASUREMENT LV_ERR_DIS_8 "" UWORD _CNV_S_2_RANGE______77_R_CM 1 100. 0. 255. ECU_ADDRESS 0x3fc2cc BIT_MASK 0x40 /end MEASUREMENT
/begin MEASUREMENT LV_DC_MAX_8 "" UWORD _CNV_S_2_RANGE______77_R_CM 1 100. 0. 255. ECU_ADDRESS 0x3fc2cc BIT_MASK 0x80 /end MEASUREMENT
/begin MEASUREMENT LV_ERR_CFM_8 "" UWORD _CNV_S_2_RANGE______77_R_CM 1 100. 0. 255. ECU_ADDRESS 0x3fc2cc BIT_MASK 0x100 /end MEASUREMENT
/begin MEASUREMENT LV_ERR_SYM_CHG_MEM_8 "" UWORD _CNV_S_2_RANGE______77_R_CM 1 100. 0. 255. ECU_ADDRESS 0x3fc2cc BIT_MASK 0x400 /end MEASUREMENT
/begin MEASUREMENT ERR_DTC_CUS_9 "" UWORD _CNV_A_R_LINEAR_____13_CM 1 100. 0. 65535. ECU_ADDRESS 0x3fc2ce FORMAT "%6.0" /end MEASUREMENT
/begin MEASUREMENT CTR_FRC_9 "Frequency counter of failure N" UBYTE _CNV_A_R_LINEAR_____13_CM 1 100. 0. 255. ECU_ADDRESS 0x3fc2d1 FORMAT "%3.0" /end MEASUREMENT
/begin MEASUREMENT CTR_WUP_CYC_9 "Counter for warm-up cycle" UBYTE _CNV_A_R_LINEAR_____13_CM 1 100. 0. 255. ECU_ADDRESS 0x3fc2d2 FORMAT "%3.0" /end MEASUREMENT
/begin MEASUREMENT CTR_DC_9 "Counter for driving cycle" UBYTE _CNV_A_R_LINEAR_____13_CM 1 100. 0. 255. ECU_ADDRESS 0x3fc2d3 FORMAT "%3.0" /end MEASUREMENT
/begin MEASUREMENT ERR_SYM_MEM_9 "" UWORD _CNV_S_5_RANGE_ERR__323_CM 1 100. 0. 8. ECU_ADDRESS 0x3fc2d6 BIT_MASK 0xF /end MEASUREMENT
/begin MEASUREMENT LV_ERR_DC_9 "" UWORD _CNV_S_2_RANGE______202_CM 1 100. 0. 1. ECU_ADDRESS 0x3fc2d6 BIT_MASK 0x10 /end MEASUREMENT
/begin MEASUREMENT LV_ERR_TMP_9 "" UWORD _CNV_S_2_RANGE______77_R_CM 1 100. 0. 255. ECU_ADDRESS 0x3fc2d6 BIT_MASK 0x20 /end MEASUREMENT
/begin MEASUREMENT LV_ERR_DIS_9 "" UWORD _CNV_S_2_RANGE______77_R_CM 1 100. 0. 255. ECU_ADDRESS 0x3fc2d6 BIT_MASK 0x40 /end MEASUREMENT
/begin MEASUREMENT LV_DC_MAX_9 "" UWORD _CNV_S_2_RANGE______77_R_CM 1 100. 0. 255. ECU_ADDRESS 0x3fc2d6 BIT_MASK 0x80 /end MEASUREMENT
/begin MEASUREMENT LV_ERR_CFM_9 "" UWORD _CNV_S_2_RANGE______77_R_CM 1 100. 0. 255. ECU_ADDRESS 0x3fc2d6 BIT_MASK 0x100 /end MEASUREMENT
/begin MEASUREMENT LV_ERR_SYM_CHG_MEM_9 "" UWORD _CNV_S_2_RANGE______77_R_CM 1 100. 0. 255. ECU_ADDRESS 0x3fc2d6 BIT_MASK 0x400 /end MEASUREMENT
/begin MEASUREMENT CTR_ABC_ISC_H "" UBYTE _CNV_A_R_LINEAR_____13_CM 1 100. 0. 255. ECU_ADDRESS 0x3fc526 FORMAT "%3.0" /end MEASUREMENT
/begin MEASUREMENT LV_ERR_DET_ISC_H "" UWORD _CNV_S_2_RANGE______77_R_CM 1 100. 0. 255. ECU_ADDRESS 0x3fc528 BIT_MASK 0x100 /end MEASUREMENT
/begin MEASUREMENT LV_ERR_SYM_CHG_ISC_H "" UWORD _CNV_S_2_RANGE______77_R_CM 1 100. 0. 255. ECU_ADDRESS 0x3fc528 BIT_MASK 0x400 /end MEASUREMENT
/begin MEASUREMENT LV_CDN_DIAG_ISC_H "" UWORD _CNV_S_2_RANGE______77_R_CM 1 100. 0. 255. ECU_ADDRESS 0x3fc528 BIT_MASK 0x800 /end MEASUREMENT
/begin MEASUREMENT ERR_SYM_ISC_H "" UWORD _CNV_S_5_RANGE_ERR__323_CM 1 100. 0. 8. ECU_ADDRESS 0x3fc528 BIT_MASK 0xF /end MEASUREMENT
/begin MEASUREMENT LV_END_DIAG_ISC_H "" UWORD _CNV_S_2_RANGE______77_R_CM 1 100. 0. 255. ECU_ADDRESS 0x3fc528 BIT_MASK 0x1000 /end MEASUREMENT
/begin MEASUREMENT CTR_ABC_END_DIAG_ISC_H "" UBYTE _CNV_A_R_LINEAR_____13_CM 1 100. 0. 255. ECU_ADDRESS 0x3fc52a FORMAT "%3.0" /end MEASUREMENT
/begin MEASUREMENT CTR_ABC_ISC_L "" UBYTE _CNV_A_R_LINEAR_____13_CM 1 100. 0. 255. ECU_ADDRESS 0x3fc52c FORMAT "%3.0" /end MEASUREMENT
/begin MEASUREMENT LV_ERR_DET_ISC_L "" UWORD _CNV_S_2_RANGE______77_R_CM 1 100. 0. 255. ECU_ADDRESS 0x3fc52e BIT_MASK 0x100 /end MEASUREMENT
/begin MEASUREMENT LV_ERR_SYM_CHG_ISC_L "" UWORD _CNV_S_2_RANGE______77_R_CM 1 100. 0. 255. ECU_ADDRESS 0x3fc52e BIT_MASK 0x400 /end MEASUREMENT
/begin MEASUREMENT LV_CDN_DIAG_ISC_L "" UWORD _CNV_S_2_RANGE______77_R_CM 1 100. 0. 255. ECU_ADDRESS 0x3fc52e BIT_MASK 0x800 /end MEASUREMENT
/begin MEASUREMENT ERR_SYM_ISC_L "" UWORD _CNV_S_5_RANGE_ERR__323_CM 1 100. 0. 8. ECU_ADDRESS 0x3fc52e BIT_MASK 0xF /end MEASUREMENT
/begin MEASUREMENT LV_END_DIAG_ISC_L "" UWORD _CNV_S_2_RANGE______77_R_CM 1 100. 0. 255. ECU_ADDRESS 0x3fc52e BIT_MASK 0x1000 /end MEASUREMENT
/begin MEASUREMENT CTR_ABC_END_DIAG_ISC_l "" UBYTE _CNV_A_R_LINEAR_____13_CM 1 100. 0. 255. ECU_ADDRESS 0x3fc530 FORMAT "%3.0" /end MEASUREMENT
/begin AXIS_PTS ldp_fmy_envd "" 0x69b8d ENVD _REC_AXS_20_u1 3. _CNV_S_4_RANGE_FMY__322_CM 4 0. 3. /end AXIS_PTS
/begin MEASUREMENT CTR_ABC_TOIL "" UBYTE _CNV_A_R_LINEAR_____13_CM 1 100. 0. 255. ECU_ADDRESS 0x3fc2e6 FORMAT "%3.0" /end MEASUREMENT
/begin MEASUREMENT LV_ERR_DET_TOIL "" UWORD _CNV_S_2_RANGE______77_R_CM 1 100. 0. 255. ECU_ADDRESS 0x3fc2e8 BIT_MASK 0x100 /end MEASUREMENT
/begin MEASUREMENT LV_ERR_SYM_CHG_TOIL "" UWORD _CNV_S_2_RANGE______77_R_CM 1 100. 0. 255. ECU_ADDRESS 0x3fc2e8 BIT_MASK 0x400 /end MEASUREMENT
/begin MEASUREMENT LV_CDN_DIAG_TOIL "" UWORD _CNV_S_2_RANGE______77_R_CM 1 100. 0. 255. ECU_ADDRESS 0x3fc2e8 BIT_MASK 0x800 /end MEASUREMENT
/begin MEASUREMENT ERR_SYM_TOIL "" UWORD _CNV_S_5_RANGE_ERR__323_CM 1 100. 0. 8. ECU_ADDRESS 0x3fc2e8 BIT_MASK 0xF /end MEASUREMENT
/begin MEASUREMENT LV_END_DIAG_TOIL "" UWORD _CNV_S_2_RANGE______77_R_CM 1 100. 0. 255. ECU_ADDRESS 0x3fc2e8 BIT_MASK 0x1000 /end MEASUREMENT
/begin MEASUREMENT CTR_ABC_END_DIAG_TOIL "" UBYTE _CNV_A_R_LINEAR_____13_CM 1 100. 0. 255. ECU_ADDRESS 0x3fc2ea FORMAT "%3.0" /end MEASUREMENT
/begin MEASUREMENT CTR_ABC_MIS_MPL "" UBYTE _CNV_A_R_LINEAR_____13_CM 1 100. 0. 255. ECU_ADDRESS 0x3fc5b0 FORMAT "%3.0" /end MEASUREMENT
/begin MEASUREMENT LV_ERR_DET_MIS_MPL "" UWORD _CNV_S_2_RANGE______77_R_CM 1 100. 0. 255. ECU_ADDRESS 0x3fc5b2 BIT_MASK 0x100 /end MEASUREMENT
/begin MEASUREMENT LV_ERR_SYM_CHG_MIS_MPL "" UWORD _CNV_S_2_RANGE______77_R_CM 1 100. 0. 255. ECU_ADDRESS 0x3fc5b2 BIT_MASK 0x400 /end MEASUREMENT
/begin MEASUREMENT LV_CDN_DIAG_MIS_MPL "" UWORD _CNV_S_2_RANGE______77_R_CM 1 100. 0. 255. ECU_ADDRESS 0x3fc5b2 BIT_MASK 0x800 /end MEASUREMENT
/begin MEASUREMENT ERR_SYM_MIS_MPL "" UWORD _CNV_S_5_RANGE_ERR__323_CM 1 100. 0. 8. ECU_ADDRESS 0x3fc5b2 BIT_MASK 0xF /end MEASUREMENT
/begin MEASUREMENT LV_END_DIAG_MIS_MPL "" UWORD _CNV_S_2_RANGE______77_R_CM 1 100. 0. 255. ECU_ADDRESS 0x3fc5b2 BIT_MASK 0x1000 /end MEASUREMENT
/begin MEASUREMENT CTR_ABC_END_DIAG_MIS_MPL "" UBYTE _CNV_A_R_LINEAR_____13_CM 1 100. 0. 255. ECU_ADDRESS 0x3fc5b4 FORMAT "%3.0" /end MEASUREMENT
/begin MEASUREMENT CTR_ABC_MIS_A_0 "" UBYTE _CNV_A_R_LINEAR_____13_CM 1 100. 0. 255. ECU_ADDRESS 0x3fc568 FORMAT "%3.0" /end MEASUREMENT
/begin MEASUREMENT LV_ERR_DET_MIS_A_0 "" UWORD _CNV_S_2_RANGE______77_R_CM 1 100. 0. 255. ECU_ADDRESS 0x3fc56a BIT_MASK 0x100 /end MEASUREMENT
/begin MEASUREMENT LV_ERR_SYM_CHG_MIS_A_0 "" UWORD _CNV_S_2_RANGE______77_R_CM 1 100. 0. 255. ECU_ADDRESS 0x3fc56a BIT_MASK 0x400 /end MEASUREMENT
/begin MEASUREMENT LV_CDN_DIAG_MIS_A_0 "" UWORD _CNV_S_2_RANGE______77_R_CM 1 100. 0. 255. ECU_ADDRESS 0x3fc56a BIT_MASK 0x800 /end MEASUREMENT
/begin MEASUREMENT ERR_SYM_MIS_A_0 "" UWORD _CNV_S_5_RANGE_ERR__323_CM 1 100. 0. 8. ECU_ADDRESS 0x3fc56a BIT_MASK 0xF /end MEASUREMENT
/begin MEASUREMENT LV_END_DIAG_MIS_A_0 "" UWORD _CNV_S_2_RANGE______77_R_CM 1 100. 0. 255. ECU_ADDRESS 0x3fc56a BIT_MASK 0x1000 /end MEASUREMENT
/begin MEASUREMENT CTR_ABC_END_DIAG_MIS_A_0 "" UBYTE _CNV_A_R_LINEAR_____13_CM 1 100. 0. 255. ECU_ADDRESS 0x3fc56c FORMAT "%3.0" /end MEASUREMENT
/begin MEASUREMENT CTR_ABC_MIS_A_1 "" UBYTE _CNV_A_R_LINEAR_____13_CM 1 100. 0. 255. ECU_ADDRESS 0x3fc56e FORMAT "%3.0" /end MEASUREMENT
/begin MEASUREMENT LV_ERR_DET_MIS_A_1 "" UWORD _CNV_S_2_RANGE______77_R_CM 1 100. 0. 255. ECU_ADDRESS 0x3fc570 BIT_MASK 0x100 /end MEASUREMENT
/begin MEASUREMENT LV_ERR_SYM_CHG_MIS_A_1 "" UWORD _CNV_S_2_RANGE______77_R_CM 1 100. 0. 255. ECU_ADDRESS 0x3fc570 BIT_MASK 0x400 /end MEASUREMENT
/begin MEASUREMENT LV_CDN_DIAG_MIS_A_1 "" UWORD _CNV_S_2_RANGE______77_R_CM 1 100. 0. 255. ECU_ADDRESS 0x3fc570 BIT_MASK 0x800 /end MEASUREMENT
/begin MEASUREMENT ERR_SYM_MIS_A_1 "" UWORD _CNV_S_5_RANGE_ERR__323_CM 1 100. 0. 8. ECU_ADDRESS 0x3fc570 BIT_MASK 0xF /end MEASUREMENT
/begin MEASUREMENT LV_END_DIAG_MIS_A_1 "" UWORD _CNV_S_2_RANGE______77_R_CM 1 100. 0. 255. ECU_ADDRESS 0x3fc570 BIT_MASK 0x1000 /end MEASUREMENT
/begin MEASUREMENT CTR_ABC_END_DIAG_MIS_A_1 "" UBYTE _CNV_A_R_LINEAR_____13_CM 1 100. 0. 255. ECU_ADDRESS 0x3fc572 FORMAT "%3.0" /end MEASUREMENT
/begin MEASUREMENT CTR_ABC_MIS_A_2 "" UBYTE _CNV_A_R_LINEAR_____13_CM 1 100. 0. 255. ECU_ADDRESS 0x3fc574 FORMAT "%3.0" /end MEASUREMENT
/begin MEASUREMENT LV_ERR_DET_MIS_A_2 "" UWORD _CNV_S_2_RANGE______77_R_CM 1 100. 0. 255. ECU_ADDRESS 0x3fc576 BIT_MASK 0x100 /end MEASUREMENT
/begin MEASUREMENT LV_ERR_SYM_CHG_MIS_A_2 "" UWORD _CNV_S_2_RANGE______77_R_CM 1 100. 0. 255. ECU_ADDRESS 0x3fc576 BIT_MASK 0x400 /end MEASUREMENT
/begin MEASUREMENT LV_CDN_DIAG_MIS_A_2 "" UWORD _CNV_S_2_RANGE______77_R_CM 1 100. 0. 255. ECU_ADDRESS 0x3fc576 BIT_MASK 0x800 /end MEASUREMENT
/begin MEASUREMENT ERR_SYM_MIS_A_2 "" UWORD _CNV_S_5_RANGE_ERR__323_CM 1 100. 0. 8. ECU_ADDRESS 0x3fc576 BIT_MASK 0xF /end MEASUREMENT
/begin MEASUREMENT LV_END_DIAG_MIS_A_2 "" UWORD _CNV_S_2_RANGE______77_R_CM 1 100. 0. 255. ECU_ADDRESS 0x3fc576 BIT_MASK 0x1000 /end MEASUREMENT
/begin MEASUREMENT CTR_ABC_END_DIAG_MIS_A_2 "" UBYTE _CNV_A_R_LINEAR_____13_CM 1 100. 0. 255. ECU_ADDRESS 0x3fc578 FORMAT "%3.0" /end MEASUREMENT
/begin MEASUREMENT CTR_ABC_MIS_A_3 "" UBYTE _CNV_A_R_LINEAR_____13_CM 1 100. 0. 255. ECU_ADDRESS 0x3fc57a FORMAT "%3.0" /end MEASUREMENT
/begin MEASUREMENT LV_ERR_DET_MIS_A_3 "" UWORD _CNV_S_2_RANGE______77_R_CM 1 100. 0. 255. ECU_ADDRESS 0x3fc57c BIT_MASK 0x100 /end MEASUREMENT
/begin MEASUREMENT LV_ERR_SYM_CHG_MIS_A_3 "" UWORD _CNV_S_2_RANGE______77_R_CM 1 100. 0. 255. ECU_ADDRESS 0x3fc57c BIT_MASK 0x400 /end MEASUREMENT
/begin MEASUREMENT LV_CDN_DIAG_MIS_A_3 "" UWORD _CNV_S_2_RANGE______77_R_CM 1 100. 0. 255. ECU_ADDRESS 0x3fc57c BIT_MASK 0x800 /end MEASUREMENT
/begin MEASUREMENT ERR_SYM_MIS_A_3 "" UWORD _CNV_S_5_RANGE_ERR__323_CM 1 100. 0. 8. ECU_ADDRESS 0x3fc57c BIT_MASK 0xF /end MEASUREMENT
/begin MEASUREMENT LV_END_DIAG_MIS_A_3 "" UWORD _CNV_S_2_RANGE______77_R_CM 1 100. 0. 255. ECU_ADDRESS 0x3fc57c BIT_MASK 0x1000 /end MEASUREMENT
/begin MEASUREMENT CTR_ABC_END_DIAG_MIS_A_3 "" UBYTE _CNV_A_R_LINEAR_____13_CM 1 100. 0. 255. ECU_ADDRESS 0x3fc57e FORMAT "%3.0" /end MEASUREMENT
/begin MEASUREMENT CTR_ABC_MIS_A_4 "" UBYTE _CNV_A_R_LINEAR_____13_CM 1 100. 0. 255. ECU_ADDRESS 0x3fc580 FORMAT "%3.0" /end MEASUREMENT
/begin MEASUREMENT LV_ERR_DET_MIS_A_4 "" UWORD _CNV_S_2_RANGE______77_R_CM 1 100. 0. 255. ECU_ADDRESS 0x3fc582 BIT_MASK 0x100 /end MEASUREMENT
/begin MEASUREMENT LV_ERR_SYM_CHG_MIS_A_4 "" UWORD _CNV_S_2_RANGE______77_R_CM 1 100. 0. 255. ECU_ADDRESS 0x3fc582 BIT_MASK 0x400 /end MEASUREMENT
/begin MEASUREMENT LV_CDN_DIAG_MIS_A_4 "" UWORD _CNV_S_2_RANGE______77_R_CM 1 100. 0. 255. ECU_ADDRESS 0x3fc582 BIT_MASK 0x800 /end MEASUREMENT
/begin MEASUREMENT ERR_SYM_MIS_A_4 "" UWORD _CNV_S_5_RANGE_ERR__323_CM 1 100. 0. 8. ECU_ADDRESS 0x3fc582 BIT_MASK 0xF /end MEASUREMENT
/begin MEASUREMENT LV_END_DIAG_MIS_A_4 "" UWORD _CNV_S_2_RANGE______77_R_CM 1 100. 0. 255. ECU_ADDRESS 0x3fc582 BIT_MASK 0x1000 /end MEASUREMENT
/begin MEASUREMENT CTR_ABC_END_DIAG_MIS_A_4 "" UBYTE _CNV_A_R_LINEAR_____13_CM 1 100. 0. 255. ECU_ADDRESS 0x3fc584 FORMAT "%3.0" /end MEASUREMENT
/begin MEASUREMENT CTR_ABC_MIS_A_5 "" UBYTE _CNV_A_R_LINEAR_____13_CM 1 100. 0. 255. ECU_ADDRESS 0x3fc586 FORMAT "%3.0" /end MEASUREMENT
/begin MEASUREMENT LV_ERR_DET_MIS_A_5 "" UWORD _CNV_S_2_RANGE______77_R_CM 1 100. 0. 255. ECU_ADDRESS 0x3fc588 BIT_MASK 0x100 /end MEASUREMENT
/begin MEASUREMENT LV_ERR_SYM_CHG_MIS_A_5 "" UWORD _CNV_S_2_RANGE______77_R_CM 1 100. 0. 255. ECU_ADDRESS 0x3fc588 BIT_MASK 0x400 /end MEASUREMENT
/begin MEASUREMENT LV_CDN_DIAG_MIS_A_5 "" UWORD _CNV_S_2_RANGE______77_R_CM 1 100. 0. 255. ECU_ADDRESS 0x3fc588 BIT_MASK 0x800 /end MEASUREMENT
/begin MEASUREMENT ERR_SYM_MIS_A_5 "" UWORD _CNV_S_5_RANGE_ERR__323_CM 1 100. 0. 8. ECU_ADDRESS 0x3fc588 BIT_MASK 0xF /end MEASUREMENT
/begin MEASUREMENT LV_END_DIAG_MIS_A_5 "" UWORD _CNV_S_2_RANGE______77_R_CM 1 100. 0. 255. ECU_ADDRESS 0x3fc588 BIT_MASK 0x1000 /end MEASUREMENT
/begin MEASUREMENT CTR_ABC_END_DIAG_MIS_A_5 "" UBYTE _CNV_A_R_LINEAR_____13_CM 1 100. 0. 255. ECU_ADDRESS 0x3fc58a FORMAT "%3.0" /end MEASUREMENT
/begin MEASUREMENT CTR_ABC_MIS_B_0 "" UBYTE _CNV_A_R_LINEAR_____13_CM 1 100. 0. 255. ECU_ADDRESS 0x3fc58c FORMAT "%3.0" /end MEASUREMENT
/begin MEASUREMENT LV_ERR_DET_MIS_B_0 "" UWORD _CNV_S_2_RANGE______77_R_CM 1 100. 0. 255. ECU_ADDRESS 0x3fc58e BIT_MASK 0x100 /end MEASUREMENT
/begin MEASUREMENT LV_ERR_SYM_CHG_MIS_B_0 "" UWORD _CNV_S_2_RANGE______77_R_CM 1 100. 0. 255. ECU_ADDRESS 0x3fc58e BIT_MASK 0x400 /end MEASUREMENT
/begin MEASUREMENT LV_CDN_DIAG_MIS_B_0 "" UWORD _CNV_S_2_RANGE______77_R_CM 1 100. 0. 255. ECU_ADDRESS 0x3fc58e BIT_MASK 0x800 /end MEASUREMENT
/begin MEASUREMENT ERR_SYM_MIS_B_0 "" UWORD _CNV_S_5_RANGE_ERR__323_CM 1 100. 0. 8. ECU_ADDRESS 0x3fc58e BIT_MASK 0xF /end MEASUREMENT
/begin MEASUREMENT LV_END_DIAG_MIS_B_0 "" UWORD _CNV_S_2_RANGE______77_R_CM 1 100. 0. 255. ECU_ADDRESS 0x3fc58e BIT_MASK 0x1000 /end MEASUREMENT
/begin MEASUREMENT CTR_ABC_END_DIAG_MIS_B_0 "" UBYTE _CNV_A_R_LINEAR_____13_CM 1 100. 0. 255. ECU_ADDRESS 0x3fc590 FORMAT "%3.0" /end MEASUREMENT
/begin MEASUREMENT CTR_ABC_MIS_B_1 "" UBYTE _CNV_A_R_LINEAR_____13_CM 1 100. 0. 255. ECU_ADDRESS 0x3fc592 FORMAT "%3.0" /end MEASUREMENT
/begin MEASUREMENT LV_ERR_DET_MIS_B_1 "" UWORD _CNV_S_2_RANGE______77_R_CM 1 100. 0. 255. ECU_ADDRESS 0x3fc594 BIT_MASK 0x100 /end MEASUREMENT
/begin MEASUREMENT LV_ERR_SYM_CHG_MIS_B_1 "" UWORD _CNV_S_2_RANGE______77_R_CM 1 100. 0. 255. ECU_ADDRESS 0x3fc594 BIT_MASK 0x400 /end MEASUREMENT
/begin MEASUREMENT LV_CDN_DIAG_MIS_B_1 "" UWORD _CNV_S_2_RANGE______77_R_CM 1 100. 0. 255. ECU_ADDRESS 0x3fc594 BIT_MASK 0x800 /end MEASUREMENT
/begin MEASUREMENT ERR_SYM_MIS_B_1 "" UWORD _CNV_S_5_RANGE_ERR__323_CM 1 100. 0. 8. ECU_ADDRESS 0x3fc594 BIT_MASK 0xF /end MEASUREMENT
/begin MEASUREMENT LV_END_DIAG_MIS_B_1 "" UWORD _CNV_S_2_RANGE______77_R_CM 1 100. 0. 255. ECU_ADDRESS 0x3fc594 BIT_MASK 0x1000 /end MEASUREMENT
/begin MEASUREMENT CTR_ABC_END_DIAG_MIS_B_1 "" UBYTE _CNV_A_R_LINEAR_____13_CM 1 100. 0. 255. ECU_ADDRESS 0x3fc596 FORMAT "%3.0" /end MEASUREMENT
/begin MEASUREMENT CTR_ABC_MIS_B_2 "" UBYTE _CNV_A_R_LINEAR_____13_CM 1 100. 0. 255. ECU_ADDRESS 0x3fc598 FORMAT "%3.0" /end MEASUREMENT
/begin MEASUREMENT LV_ERR_DET_MIS_B_2 "" UWORD _CNV_S_2_RANGE______77_R_CM 1 100. 0. 255. ECU_ADDRESS 0x3fc59a BIT_MASK 0x100 /end MEASUREMENT
/begin MEASUREMENT LV_ERR_SYM_CHG_MIS_B_2 "" UWORD _CNV_S_2_RANGE______77_R_CM 1 100. 0. 255. ECU_ADDRESS 0x3fc59a BIT_MASK 0x400 /end MEASUREMENT
/begin MEASUREMENT LV_CDN_DIAG_MIS_B_2 "" UWORD _CNV_S_2_RANGE______77_R_CM 1 100. 0. 255. ECU_ADDRESS 0x3fc59a BIT_MASK 0x800 /end MEASUREMENT
/begin MEASUREMENT ERR_SYM_MIS_B_2 "" UWORD _CNV_S_5_RANGE_ERR__323_CM 1 100. 0. 8. ECU_ADDRESS 0x3fc59a BIT_MASK 0xF /end MEASUREMENT
/begin MEASUREMENT LV_END_DIAG_MIS_B_2 "" UWORD _CNV_S_2_RANGE______77_R_CM 1 100. 0. 255. ECU_ADDRESS 0x3fc59a BIT_MASK 0x1000 /end MEASUREMENT
/begin MEASUREMENT CTR_ABC_END_DIAG_MIS_B_2 "" UBYTE _CNV_A_R_LINEAR_____13_CM 1 100. 0. 255. ECU_ADDRESS 0x3fc59c FORMAT "%3.0" /end MEASUREMENT
/begin MEASUREMENT CTR_ABC_MIS_B_3 "" UBYTE _CNV_A_R_LINEAR_____13_CM 1 100. 0. 255. ECU_ADDRESS 0x3fc59e FORMAT "%3.0" /end MEASUREMENT
/begin MEASUREMENT LV_ERR_DET_MIS_B_3 "" UWORD _CNV_S_2_RANGE______77_R_CM 1 100. 0. 255. ECU_ADDRESS 0x3fc5a0 BIT_MASK 0x100 /end MEASUREMENT
/begin MEASUREMENT LV_ERR_SYM_CHG_MIS_B_3 "" UWORD _CNV_S_2_RANGE______77_R_CM 1 100. 0. 255. ECU_ADDRESS 0x3fc5a0 BIT_MASK 0x400 /end MEASUREMENT
/begin MEASUREMENT LV_CDN_DIAG_MIS_B_3 "" UWORD _CNV_S_2_RANGE______77_R_CM 1 100. 0. 255. ECU_ADDRESS 0x3fc5a0 BIT_MASK 0x800 /end MEASUREMENT
/begin MEASUREMENT ERR_SYM_MIS_B_3 "" UWORD _CNV_S_5_RANGE_ERR__323_CM 1 100. 0. 8. ECU_ADDRESS 0x3fc5a0 BIT_MASK 0xF /end MEASUREMENT
/begin MEASUREMENT LV_END_DIAG_MIS_B_3 "" UWORD _CNV_S_2_RANGE______77_R_CM 1 100. 0. 255. ECU_ADDRESS 0x3fc5a0 BIT_MASK 0x1000 /end MEASUREMENT
/begin MEASUREMENT CTR_ABC_END_DIAG_MIS_B_3 "" UBYTE _CNV_A_R_LINEAR_____13_CM 1 100. 0. 255. ECU_ADDRESS 0x3fc5a2 FORMAT "%3.0" /end MEASUREMENT
/begin MEASUREMENT CTR_ABC_MIS_B_4 "" UBYTE _CNV_A_R_LINEAR_____13_CM 1 100. 0. 255. ECU_ADDRESS 0x3fc5a4 FORMAT "%3.0" /end MEASUREMENT
/begin MEASUREMENT LV_ERR_DET_MIS_B_4 "" UWORD _CNV_S_2_RANGE______77_R_CM 1 100. 0. 255. ECU_ADDRESS 0x3fc5a6 BIT_MASK 0x100 /end MEASUREMENT
/begin MEASUREMENT LV_ERR_SYM_CHG_MIS_B_4 "" UWORD _CNV_S_2_RANGE______77_R_CM 1 100. 0. 255. ECU_ADDRESS 0x3fc5a6 BIT_MASK 0x400 /end MEASUREMENT
/begin MEASUREMENT LV_CDN_DIAG_MIS_B_4 "" UWORD _CNV_S_2_RANGE______77_R_CM 1 100. 0. 255. ECU_ADDRESS 0x3fc5a6 BIT_MASK 0x800 /end MEASUREMENT
/begin MEASUREMENT ERR_SYM_MIS_B_4 "" UWORD _CNV_S_5_RANGE_ERR__323_CM 1 100. 0. 8. ECU_ADDRESS 0x3fc5a6 BIT_MASK 0xF /end MEASUREMENT
/begin MEASUREMENT LV_END_DIAG_MIS_B_4 "" UWORD _CNV_S_2_RANGE______77_R_CM 1 100. 0. 255. ECU_ADDRESS 0x3fc5a6 BIT_MASK 0x1000 /end MEASUREMENT
/begin MEASUREMENT CTR_ABC_END_DIAG_MIS_B_4 "" UBYTE _CNV_A_R_LINEAR_____13_CM 1 100. 0. 255. ECU_ADDRESS 0x3fc5a8 FORMAT "%3.0" /end MEASUREMENT
/begin MEASUREMENT CTR_ABC_MIS_B_5 "" UBYTE _CNV_A_R_LINEAR_____13_CM 1 100. 0. 255. ECU_ADDRESS 0x3fc5aa FORMAT "%3.0" /end MEASUREMENT
/begin MEASUREMENT LV_ERR_DET_MIS_B_5 "" UWORD _CNV_S_2_RANGE______77_R_CM 1 100. 0. 255. ECU_ADDRESS 0x3fc5ac BIT_MASK 0x100 /end MEASUREMENT
/begin MEASUREMENT LV_ERR_SYM_CHG_MIS_B_5 "" UWORD _CNV_S_2_RANGE______77_R_CM 1 100. 0. 255. ECU_ADDRESS 0x3fc5ac BIT_MASK 0x400 /end MEASUREMENT
/begin MEASUREMENT LV_CDN_DIAG_MIS_B_5 "" UWORD _CNV_S_2_RANGE______77_R_CM 1 100. 0. 255. ECU_ADDRESS 0x3fc5ac BIT_MASK 0x800 /end MEASUREMENT
/begin MEASUREMENT ERR_SYM_MIS_B_5 "" UWORD _CNV_S_5_RANGE_ERR__323_CM 1 100. 0. 8. ECU_ADDRESS 0x3fc5ac BIT_MASK 0xF /end MEASUREMENT
/begin MEASUREMENT LV_END_DIAG_MIS_B_5 "" UWORD _CNV_S_2_RANGE______77_R_CM 1 100. 0. 255. ECU_ADDRESS 0x3fc5ac BIT_MASK 0x1000 /end MEASUREMENT
/begin MEASUREMENT CTR_ABC_END_DIAG_MIS_B_5 "" UBYTE _CNV_A_R_LINEAR_____13_CM 1 100. 0. 255. ECU_ADDRESS 0x3fc5ae FORMAT "%3.0" /end MEASUREMENT
/begin MEASUREMENT CTR_ABC_SEG_T_AD "" UBYTE _CNV_A_R_LINEAR_____13_CM 1 100. 0. 255. ECU_ADDRESS 0x3fc562 FORMAT "%3.0" /end MEASUREMENT
/begin MEASUREMENT LV_ERR_DET_SEG_T_AD "" UWORD _CNV_S_2_RANGE______77_R_CM 1 100. 0. 255. ECU_ADDRESS 0x3fc564 BIT_MASK 0x100 /end MEASUREMENT
/begin MEASUREMENT LV_ERR_SYM_CHG_SEG_T_AD "" UWORD _CNV_S_2_RANGE______77_R_CM 1 100. 0. 255. ECU_ADDRESS 0x3fc564 BIT_MASK 0x400 /end MEASUREMENT
/begin MEASUREMENT LV_CDN_DIAG_SEG_T_AD "" UWORD _CNV_S_2_RANGE______77_R_CM 1 100. 0. 255. ECU_ADDRESS 0x3fc564 BIT_MASK 0x800 /end MEASUREMENT
/begin MEASUREMENT ERR_SYM_SEG_T_AD "" UWORD _CNV_S_5_RANGE_ERR__323_CM 1 100. 0. 8. ECU_ADDRESS 0x3fc564 BIT_MASK 0xF /end MEASUREMENT
/begin MEASUREMENT LV_END_DIAG_SEG_T_AD "" UWORD _CNV_S_2_RANGE______77_R_CM 1 100. 0. 255. ECU_ADDRESS 0x3fc564 BIT_MASK 0x1000 /end MEASUREMENT
/begin MEASUREMENT CTR_ABC_END_DIAG_SEG_T_AD "" UBYTE _CNV_A_R_LINEAR_____13_CM 1 100. 0. 255. ECU_ADDRESS 0x3fc566 FORMAT "%3.0" /end MEASUREMENT
/begin MEASUREMENT CTR_ABC_ISA_1 "" UBYTE _CNV_A_R_LINEAR_____13_CM 1 100. 0. 255. ECU_ADDRESS 0x3fc556 FORMAT "%3.0" /end MEASUREMENT
/begin MEASUREMENT LV_ERR_DET_ISA_1 "" UWORD _CNV_S_2_RANGE______77_R_CM 1 100. 0. 255. ECU_ADDRESS 0x3fc558 BIT_MASK 0x100 /end MEASUREMENT
/begin MEASUREMENT LV_ERR_SYM_CHG_ISA_1 "" UWORD _CNV_S_2_RANGE______77_R_CM 1 100. 0. 255. ECU_ADDRESS 0x3fc558 BIT_MASK 0x400 /end MEASUREMENT
/begin MEASUREMENT LV_CDN_DIAG_ISA_1 "" UWORD _CNV_S_2_RANGE______77_R_CM 1 100. 0. 255. ECU_ADDRESS 0x3fc558 BIT_MASK 0x800 /end MEASUREMENT
/begin MEASUREMENT ERR_SYM_ISA_1 "" UWORD _CNV_S_5_RANGE_ERR__323_CM 1 100. 0. 8. ECU_ADDRESS 0x3fc558 BIT_MASK 0xF /end MEASUREMENT
/begin MEASUREMENT LV_END_DIAG_ISA_1 "" UWORD _CNV_S_2_RANGE______77_R_CM 1 100. 0. 255. ECU_ADDRESS 0x3fc558 BIT_MASK 0x1000 /end MEASUREMENT
/begin MEASUREMENT CTR_ABC_END_DIAG_ISA_1 "" UBYTE _CNV_A_R_LINEAR_____13_CM 1 100. 0. 255. ECU_ADDRESS 0x3fc55a FORMAT "%3.0" /end MEASUREMENT
/begin MEASUREMENT CTR_ABC_ISA_2 "" UBYTE _CNV_A_R_LINEAR_____13_CM 1 100. 0. 255. ECU_ADDRESS 0x3fc55c FORMAT "%3.0" /end MEASUREMENT
/begin MEASUREMENT LV_ERR_DET_ISA_2 "" UWORD _CNV_S_2_RANGE______77_R_CM 1 100. 0. 255. ECU_ADDRESS 0x3fc55e BIT_MASK 0x100 /end MEASUREMENT
/begin MEASUREMENT LV_ERR_SYM_CHG_ISA_2 "" UWORD _CNV_S_2_RANGE______77_R_CM 1 100. 0. 255. ECU_ADDRESS 0x3fc55e BIT_MASK 0x400 /end MEASUREMENT
/begin MEASUREMENT LV_CDN_DIAG_ISA_2 "" UWORD _CNV_S_2_RANGE______77_R_CM 1 100. 0. 255. ECU_ADDRESS 0x3fc55e BIT_MASK 0x800 /end MEASUREMENT
/begin MEASUREMENT ERR_SYM_ISA_2 "" UWORD _CNV_S_5_RANGE_ERR__323_CM 1 100. 0. 8. ECU_ADDRESS 0x3fc55e BIT_MASK 0xF /end MEASUREMENT
/begin MEASUREMENT LV_END_DIAG_ISA_2 "" UWORD _CNV_S_2_RANGE______77_R_CM 1 100. 0. 255. ECU_ADDRESS 0x3fc55e BIT_MASK 0x1000 /end MEASUREMENT
/begin MEASUREMENT CTR_ABC_END_DIAG_ISA_2 "" UBYTE _CNV_A_R_LINEAR_____13_CM 1 100. 0. 255. ECU_ADDRESS 0x3fc560 FORMAT "%3.0" /end MEASUREMENT
/begin MEASUREMENT CTR_ABC_MEC_ISA "" UBYTE _CNV_A_R_LINEAR_____13_CM 1 100. 0. 255. ECU_ADDRESS 0x3fc550 FORMAT "%3.0" /end MEASUREMENT
/begin MEASUREMENT LV_ERR_DET_MEC_ISA "" UWORD _CNV_S_2_RANGE______77_R_CM 1 100. 0. 255. ECU_ADDRESS 0x3fc552 BIT_MASK 0x100 /end MEASUREMENT
/begin MEASUREMENT LV_ERR_SYM_CHG_MEC_ISA "" UWORD _CNV_S_2_RANGE______77_R_CM 1 100. 0. 255. ECU_ADDRESS 0x3fc552 BIT_MASK 0x400 /end MEASUREMENT
/begin MEASUREMENT LV_CDN_DIAG_MEC_ISA "" UWORD _CNV_S_2_RANGE______77_R_CM 1 100. 0. 255. ECU_ADDRESS 0x3fc552 BIT_MASK 0x800 /end MEASUREMENT
/begin MEASUREMENT ERR_SYM_MEC_ISA "" UWORD _CNV_S_5_RANGE_ERR__323_CM 1 100. 0. 8. ECU_ADDRESS 0x3fc552 BIT_MASK 0xF /end MEASUREMENT
/begin MEASUREMENT LV_END_DIAG_MEC_ISA "" UWORD _CNV_S_2_RANGE______77_R_CM 1 100. 0. 255. ECU_ADDRESS 0x3fc552 BIT_MASK 0x1000 /end MEASUREMENT
/begin MEASUREMENT CTR_ABC_END_DIAG_MEC_ISA "" UBYTE _CNV_A_R_LINEAR_____13_CM 1 100. 0. 255. ECU_ADDRESS 0x3fc554 FORMAT "%3.0" /end MEASUREMENT
/begin MEASUREMENT CTR_ABC_MSW_3 "" UBYTE _CNV_A_R_LINEAR_____13_CM 1 100. 0. 255. ECU_ADDRESS 0x3fc54a FORMAT "%3.0" /end MEASUREMENT
/begin MEASUREMENT LV_ERR_DET_MSW_3 "" UWORD _CNV_S_2_RANGE______77_R_CM 1 100. 0. 255. ECU_ADDRESS 0x3fc54c BIT_MASK 0x100 /end MEASUREMENT
/begin MEASUREMENT LV_ERR_SYM_CHG_MSW_3 "" UWORD _CNV_S_2_RANGE______77_R_CM 1 100. 0. 255. ECU_ADDRESS 0x3fc54c BIT_MASK 0x400 /end MEASUREMENT
/begin MEASUREMENT LV_CDN_DIAG_MSW_3 "" UWORD _CNV_S_2_RANGE______77_R_CM 1 100. 0. 255. ECU_ADDRESS 0x3fc54c BIT_MASK 0x800 /end MEASUREMENT
/begin MEASUREMENT ERR_SYM_MSW_3 "" UWORD _CNV_S_5_RANGE_ERR__323_CM 1 100. 0. 8. ECU_ADDRESS 0x3fc54c BIT_MASK 0xF /end MEASUREMENT
/begin MEASUREMENT LV_END_DIAG_MSW_3 "" UWORD _CNV_S_2_RANGE______77_R_CM 1 100. 0. 255. ECU_ADDRESS 0x3fc54c BIT_MASK 0x1000 /end MEASUREMENT
/begin MEASUREMENT CTR_ABC_END_DIAG_MSW_3 "" UBYTE _CNV_A_R_LINEAR_____13_CM 1 100. 0. 255. ECU_ADDRESS 0x3fc54e FORMAT "%3.0" /end MEASUREMENT
/begin MEASUREMENT CTR_ABC_MSW_2 "" UBYTE _CNV_A_R_LINEAR_____13_CM 1 100. 0. 255. ECU_ADDRESS 0x3fc544 FORMAT "%3.0" /end MEASUREMENT
/begin MEASUREMENT LV_ERR_DET_MSW_2 "" UWORD _CNV_S_2_RANGE______77_R_CM 1 100. 0. 255. ECU_ADDRESS 0x3fc546 BIT_MASK 0x100 /end MEASUREMENT
/begin MEASUREMENT LV_ERR_SYM_CHG_MSW_2 "" UWORD _CNV_S_2_RANGE______77_R_CM 1 100. 0. 255. ECU_ADDRESS 0x3fc546 BIT_MASK 0x400 /end MEASUREMENT
/begin MEASUREMENT LV_CDN_DIAG_MSW_2 "" UWORD _CNV_S_2_RANGE______77_R_CM 1 100. 0. 255. ECU_ADDRESS 0x3fc546 BIT_MASK 0x800 /end MEASUREMENT
/begin MEASUREMENT ERR_SYM_MSW_2 "" UWORD _CNV_S_5_RANGE_ERR__323_CM 1 100. 0. 8. ECU_ADDRESS 0x3fc546 BIT_MASK 0xF /end MEASUREMENT
/begin MEASUREMENT LV_END_DIAG_MSW_2 "" UWORD _CNV_S_2_RANGE______77_R_CM 1 100. 0. 255. ECU_ADDRESS 0x3fc546 BIT_MASK 0x1000 /end MEASUREMENT
/begin MEASUREMENT CTR_ABC_END_DIAG_MSW_2 "" UBYTE _CNV_A_R_LINEAR_____13_CM 1 100. 0. 255. ECU_ADDRESS 0x3fc548 FORMAT "%3.0" /end MEASUREMENT
/begin MEASUREMENT CTR_ABC_MSW_TOG "" UBYTE _CNV_A_R_LINEAR_____13_CM 1 100. 0. 255. ECU_ADDRESS 0x3fc53e FORMAT "%3.0" /end MEASUREMENT
/begin MEASUREMENT LV_ERR_DET_MSW_TOG "" UWORD _CNV_S_2_RANGE______77_R_CM 1 100. 0. 255. ECU_ADDRESS 0x3fc540 BIT_MASK 0x100 /end MEASUREMENT
/begin MEASUREMENT LV_ERR_SYM_CHG_MSW_TOG "" UWORD _CNV_S_2_RANGE______77_R_CM 1 100. 0. 255. ECU_ADDRESS 0x3fc540 BIT_MASK 0x400 /end MEASUREMENT
/begin MEASUREMENT LV_CDN_DIAG_MSW_TOG "" UWORD _CNV_S_2_RANGE______77_R_CM 1 100. 0. 255. ECU_ADDRESS 0x3fc540 BIT_MASK 0x800 /end MEASUREMENT
/begin MEASUREMENT ERR_SYM_MSW_TOG "" UWORD _CNV_S_5_RANGE_ERR__323_CM 1 100. 0. 8. ECU_ADDRESS 0x3fc540 BIT_MASK 0xF /end MEASUREMENT
/begin MEASUREMENT LV_END_DIAG_MSW_TOG "" UWORD _CNV_S_2_RANGE______77_R_CM 1 100. 0. 255. ECU_ADDRESS 0x3fc540 BIT_MASK 0x1000 /end MEASUREMENT
/begin MEASUREMENT CTR_ABC_END_DIAG_MSW_TOG "" UBYTE _CNV_A_R_LINEAR_____13_CM 1 100. 0. 255. ECU_ADDRESS 0x3fc542 FORMAT "%3.0" /end MEASUREMENT
/begin MEASUREMENT CTR_ABC_IM_BTS_PLAUS "" UBYTE _CNV_A_R_LINEAR_____13_CM 1 100. 0. 255. ECU_ADDRESS 0x3fc538 FORMAT "%3.0" /end MEASUREMENT
/begin MEASUREMENT LV_ERR_DET_IM_BTS_PLAUS "" UWORD _CNV_S_2_RANGE______77_R_CM 1 100. 0. 255. ECU_ADDRESS 0x3fc53a BIT_MASK 0x100 /end MEASUREMENT
/begin MEASUREMENT LV_ERR_SYM_CHG_IM_BTS_PLAUS "" UWORD _CNV_S_2_RANGE______77_R_CM 1 100. 0. 255. ECU_ADDRESS 0x3fc53a BIT_MASK 0x400 /end MEASUREMENT
/begin MEASUREMENT LV_CDN_DIAG_IM_BTS_PLAUS "" UWORD _CNV_S_2_RANGE______77_R_CM 1 100. 0. 255. ECU_ADDRESS 0x3fc53a BIT_MASK 0x800 /end MEASUREMENT
/begin MEASUREMENT ERR_SYM_IM_BTS_PLAUS "" UWORD _CNV_S_5_RANGE_ERR__323_CM 1 100. 0. 8. ECU_ADDRESS 0x3fc53a BIT_MASK 0xF /end MEASUREMENT
/begin MEASUREMENT LV_END_DIAG_IM_BTS_PLAUS "" UWORD _CNV_S_2_RANGE______77_R_CM 1 100. 0. 255. ECU_ADDRESS 0x3fc53a BIT_MASK 0x1000 /end MEASUREMENT
/begin MEASUREMENT CTR_ABC_END_DIAG_IM_BTS_PLAUS "" UBYTE _CNV_A_R_LINEAR_____13_CM 1 100. 0. 255. ECU_ADDRESS 0x3fc53c FORMAT "%3.0" /end MEASUREMENT
/begin MEASUREMENT CTR_ABC_IM_BLS_PLAUS "" UBYTE _CNV_A_R_LINEAR_____13_CM 1 100. 0. 255. ECU_ADDRESS 0x3fc532 FORMAT "%3.0" /end MEASUREMENT
/begin MEASUREMENT LV_ERR_DET_IM_BLS_PLAUS "" UWORD _CNV_S_2_RANGE______77_R_CM 1 100. 0. 255. ECU_ADDRESS 0x3fc534 BIT_MASK 0x100 /end MEASUREMENT
/begin MEASUREMENT LV_ERR_SYM_CHG_IM_BLS_PLAUS "" UWORD _CNV_S_2_RANGE______77_R_CM 1 100. 0. 255. ECU_ADDRESS 0x3fc534 BIT_MASK 0x400 /end MEASUREMENT
/begin MEASUREMENT LV_CDN_DIAG_IM_BLS_PLAUS "" UWORD _CNV_S_2_RANGE______77_R_CM 1 100. 0. 255. ECU_ADDRESS 0x3fc534 BIT_MASK 0x800 /end MEASUREMENT
/begin MEASUREMENT ERR_SYM_IM_BLS_PLAUS "" UWORD _CNV_S_5_RANGE_ERR__323_CM 1 100. 0. 8. ECU_ADDRESS 0x3fc534 BIT_MASK 0xF /end MEASUREMENT
/begin MEASUREMENT LV_END_DIAG_IM_BLS_PLAUS "" UWORD _CNV_S_2_RANGE______77_R_CM 1 100. 0. 255. ECU_ADDRESS 0x3fc534 BIT_MASK 0x1000 /end MEASUREMENT
/begin MEASUREMENT CTR_ABC_END_DIAG_IM_BLS_PLAUS "" UBYTE _CNV_A_R_LINEAR_____13_CM 1 100. 0. 255. ECU_ADDRESS 0x3fc536 FORMAT "%3.0" /end MEASUREMENT
/begin COMPU_METHOD _CNV_A_R_LINEAR_____13_CM "" RAT_FUNC "%6.3" "[-]" COEFFS 0 1. 0. 0 0 1 /end COMPU_METHOD
/begin COMPU_METHOD _CNV_A_R_LINEAR_____17_CM "" RAT_FUNC "%6.3" "-" COEFFS 0 1. 0. 0 0 1 /end COMPU_METHOD
/begin COMPU_METHOD _CNV_S_2_RANGE______77_R_CM "" TAB_VERB "%6.3" "[-]" COMPU_TAB_REF _CNV_S_2_RANGE______77_R /end COMPU_METHOD
/begin COMPU_VTAB_RANGE _CNV_S_2_RANGE______77_R "" 2 0 0 "0" 1 255 "1" /end COMPU_VTAB_RANGE
/begin COMPU_METHOD _CNV_S_2_RANGE______202_CM "" TAB_VERB "%6.3" "[-]" COMPU_TAB_REF _CNV_S_2_RANGE______202 /end COMPU_METHOD
/begin COMPU_VTAB _CNV_S_2_RANGE______202 "" TAB_VERB 2 0 "PASSIVE" 1 "ACTIVE" /end COMPU_VTAB
/begin COMPU_METHOD _CNV_S_6_RANGE_FMY__320_CM "" TAB_VERB "%6.3" "[-]" COMPU_TAB_REF _CNV_S_6_RANGE_FMY__320 /end COMPU_METHOD
/begin COMPU_VTAB _CNV_S_6_RANGE_FMY__320 "" TAB_VERB 6 0 "0" 1 "1" 2 "2" 3 "3" 4 "global" 5 "cus" /end COMPU_VTAB
/begin COMPU_METHOD _CNV_S_6_RANGE_DIAG_321_CM "" TAB_VERB "%6.3" "[-]" COMPU_TAB_REF _CNV_S_6_RANGE_DIAG_321 /end COMPU_METHOD
/begin COMPU_VTAB _CNV_S_6_RANGE_DIAG_321 "" TAB_VERB 6 4 "tco" 10 "n" 11 "vs" 19 "tia" 20 "vb" 21 "tps_av" /end COMPU_VTAB
/begin COMPU_METHOD _CNV_S_4_RANGE_FMY__322_CM "" TAB_VERB "%6.3" "[-]" COMPU_TAB_REF _CNV_S_4_RANGE_FMY__322 /end COMPU_METHOD
/begin COMPU_VTAB _CNV_S_4_RANGE_FMY__322 "" TAB_VERB 4 0 "0" 1 "1" 2 "2" 3 "3" /end COMPU_VTAB
/begin COMPU_METHOD _CNV_S_5_RANGE_ERR__323_CM "" TAB_VERB "%6.3" "[-]" COMPU_TAB_REF _CNV_S_5_RANGE_ERR__323 /end COMPU_METHOD
/begin COMPU_VTAB _CNV_S_5_RANGE_ERR__323 "" TAB_VERB 5 0 "NO_SYM" 1 "SYM_0" 2 "SYM_1" 4 "SYM_2" 8 "SYM_3" /end COMPU_VTAB
/begin RECORD_LAYOUT _REC_VAL_20_u1 FNC_VALUES 1 UBYTE COLUMN_DIR DIRECT /end RECORD_LAYOUT
/begin RECORD_LAYOUT _REC_AXS_20_u2 NO_AXIS_PTS_X 1 UWORD AXIS_PTS_X 2 UWORD INDEX_INCR DIRECT /end RECORD_LAYOUT
/begin RECORD_LAYOUT _REC_AXS_20_u1 NO_AXIS_PTS_X 1 UBYTE AXIS_PTS_X 2 UBYTE INDEX_INCR DIRECT /end RECORD_LAYOUT
/begin RECORD_LAYOUT _REC_CUR_20_u2_u2 FNC_VALUES 1 UWORD COLUMN_DIR DIRECT /end RECORD_LAYOUT
/begin RECORD_LAYOUT _REC_CUR_20_u1_u1 FNC_VALUES 1 UBYTE COLUMN_DIR DIRECT /end RECORD_LAYOUT
/begin FUNCTION DIA_Error_memory_interface "_Error-memory interface"
 /begin DEF_CHARACTERISTIC ID_ERR_DTC_TEG_PCAT_DOWN_1 ID_ERR_ENVD_TEG_PCAT_DOWN_1 C_DIAG_CONF_TEG_PCAT_DOWN_1 C_DC_INC_TEG_PCAT_DOWN_1 C_DC_MAX_TEG_PCAT_DOWN_1 C_DC_DEC_TEG_PCAT_DOWN_1 ID_ERR_DTC_TEG_PCAT_DOWN_2 ID_ERR_ENVD_TEG_PCAT_DOWN_2 C_DIAG_CONF_TEG_PCAT_DOWN_2 C_DC_INC_TEG_PCAT_DOWN_2 C_DC_MAX_TEG_PCAT_DOWN_2 C_DC_DEC_TEG_PCAT_DOWN_2 ID_ERR_DTC_TOIL ID_ERR_ENVD_TOIL C_DIAG_CONF_TOIL C_DC_INC_TOIL C_DC_MAX_TOIL C_DC_DEC_TOIL ID_ERR_DTC_TCO_EX ID_ERR_ENVD_TCO_EX C_DIAG_CONF_TCO_EX C_DC_INC_TCO_EX C_DC_MAX_TCO_EX C_DC_DEC_TCO_EX ID_ERR_DTC_TIA ID_ERR_ENVD_TIA C_DIAG_CONF_TIA C_DC_INC_TIA C_DC_MAX_TIA C_DC_DEC_TIA ID_ERR_DTC_AMP ID_ERR_ENVD_AMP C_DIAG_CONF_AMP C_DC_INC_AMP C_DC_MAX_AMP C_DC_DEC_AMP ID_ERR_DTC_MAF ID_ERR_ENVD_MAF C_DIAG_CONF_MAF C_DC_INC_MAF C_DC_MAX_MAF C_DC_DEC_MAF ID_ERR_DTC_VLS_UP_SCB_1 ID_ERR_ENVD_VLS_UP_SCB_1 C_DIAG_CONF_VLS_UP_SCB_1 C_DC_INC_VLS_UP_SCB_1 C_DC_MAX_VLS_UP_SCB_1 C_DC_DEC_VLS_UP_SCB_1 ID_ERR_DTC_VLS_UP_SCB_2 ID_ERR_ENVD_VLS_UP_SCB_2 C_DIAG_CONF_VLS_UP_SCB_2 C_DC_INC_VLS_UP_SCB_2 C_DC_MAX_VLS_UP_SCB_2 C_DC_DEC_VLS_UP_SCB_2 ID_ERR_DTC_VLS_UP_SCG_1 ID_ERR_ENVD_VLS_UP_SCG_1 C_DIAG_CONF_VLS_UP_SCG_1 C_DC_INC_VLS_UP_SCG_1 C_DC_MAX_VLS_UP_SCG_1 C_DC_DEC_VLS_UP_SCG_1 ID_ERR_DTC_VLS_UP_SCG_2 ID_ERR_ENVD_VLS_UP_SCG_2 C_DIAG_CONF_VLS_UP_SCG_2 C_DC_INC_VLS_UP_SCG_2 C_DC_MAX_VLS_UP_SCG_2 C_DC_DEC_VLS_UP_SCG_2 ID_ERR_DTC_VLS_UP_OL_1 ID_ERR_ENVD_VLS_UP_OL_1 C_DIAG_CONF_VLS_UP_OL_1 C_DC_INC_VLS_UP_OL_1 C_DC_MAX_VLS_UP_OL_1 C_DC_DEC_VLS_UP_OL_1 ID_ERR_DTC_VLS_UP_OL_2 ID_ERR_ENVD_VLS_UP_OL_2 C_DIAG_CONF_VLS_UP_OL_2 C_DC_INC_VLS_UP_OL_2 C_DC_MAX_VLS_UP_OL_2 C_DC_DEC_VLS_UP_OL_2 ID_ERR_DTC_VLS_DOWN_SCB_1 ID_ERR_ENVD_VLS_DOWN_SCB_1 C_DIAG_CONF_VLS_DOWN_SCB_1 C_DC_INC_VLS_DOWN_SCB_1 C_DC_MAX_VLS_DOWN_SCB_1 C_DC_DEC_VLS_DOWN_SCB_1 ID_ERR_DTC_VLS_DOWN_SCB_2 ID_ERR_ENVD_VLS_DOWN_SCB_2 C_DIAG_CONF_VLS_DOWN_SCB_2 C_DC_INC_VLS_DOWN_SCB_2 C_DC_MAX_VLS_DOWN_SCB_2 C_DC_DEC_VLS_DOWN_SCB_2 ID_ERR_DTC_VLS_DOWN_SCG_1 ID_ERR_ENVD_VLS_DOWN_SCG_1 C_DIAG_CONF_VLS_DOWN_SCG_1 C_DC_INC_VLS_DOWN_SCG_1 C_DC_MAX_VLS_DOWN_SCG_1 C_DC_DEC_VLS_DOWN_SCG_1 ID_ERR_DTC_VLS_DOWN_SCG_2 ID_ERR_ENVD_VLS_DOWN_SCG_2 C_DIAG_CONF_VLS_DOWN_SCG_2 C_DC_INC_VLS_DOWN_SCG_2 C_DC_MAX_VLS_DOWN_SCG_2 C_DC_DEC_VLS_DOWN_SCG_2 ID_ERR_DTC_VLS_DOWN_OL_1 ID_ERR_ENVD_VLS_DOWN_OL_1 C_DIAG_CONF_VLS_DOWN_OL_1 C_DC_INC_VLS_DOWN_OL_1 C_DC_MAX_VLS_DOWN_OL_1 C_DC_DEC_VLS_DOWN_OL_1 ID_ERR_DTC_VLS_DOWN_OL_2 ID_ERR_ENVD_VLS_DOWN_OL_2 C_DIAG_CONF_VLS_DOWN_OL_2 C_DC_INC_VLS_DOWN_OL_2 C_DC_MAX_VLS_DOWN_OL_2 C_DC_DEC_VLS_DOWN_OL_2 ID_ERR_DTC_VLS_STK_1 ID_ERR_ENVD_VLS_STK_1 C_DIAG_CONF_VLS_STK_1 C_DC_INC_VLS_STK_1 C_DC_MAX_VLS_STK_1 C_DC_DEC_VLS_STK_1 ID_ERR_DTC_VLS_STK_2 ID_ERR_ENVD_VLS_STK_2 C_DIAG_CONF_VLS_STK_2 C_DC_INC_VLS_STK_2 C_DC_MAX_VLS_STK_2 C_DC_DEC_VLS_STK_2 ID_ERR_DTC_LAM_LIM_1 ID_ERR_ENVD_LAM_LIM_1 C_DIAG_CONF_LAM_LIM_1 C_DC_INC_LAM_LIM_1 C_DC_MAX_LAM_LIM_1 C_DC_DEC_LAM_LIM_1 ID_ERR_DTC_LAM_LIM_2 ID_ERR_ENVD_LAM_LIM_2 C_DIAG_CONF_LAM_LIM_2 C_DC_INC_LAM_LIM_2 C_DC_MAX_LAM_LIM_2 C_DC_DEC_LAM_LIM_2 ID_ERR_DTC_IV_0 ID_ERR_ENVD_IV_0 C_DIAG_CONF_IV_0 C_DC_INC_IV_0 C_DC_MAX_IV_0 C_DC_DEC_IV_0 ID_ERR_DTC_IV_1 ID_ERR_ENVD_IV_1 C_DIAG_CONF_IV_1 C_DC_INC_IV_1 C_DC_MAX_IV_1 C_DC_DEC_IV_1 ID_ERR_DTC_IV_2 ID_ERR_ENVD_IV_2 C_DIAG_CONF_IV_2 C_DC_INC_IV_2 C_DC_MAX_IV_2 C_DC_DEC_IV_2 ID_ERR_DTC_IV_3 ID_ERR_ENVD_IV_3 C_DIAG_CONF_IV_3 C_DC_INC_IV_3 C_DC_MAX_IV_3 C_DC_DEC_IV_3 ID_ERR_DTC_IV_4 ID_ERR_ENVD_IV_4 C_DIAG_CONF_IV_4 C_DC_INC_IV_4 C_DC_MAX_IV_4 C_DC_DEC_IV_4 ID_ERR_DTC_IV_5 ID_ERR_ENVD_IV_5 C_DIAG_CONF_IV_5 C_DC_INC_IV_5 C_DC_MAX_IV_5 C_DC_DEC_IV_5 ID_ERR_DTC_LSH_UP_1 ID_ERR_ENVD_LSH_UP_1 C_DIAG_CONF_LSH_UP_1 C_DC_INC_LSH_UP_1 C_DC_MAX_LSH_UP_1 C_DC_DEC_LSH_UP_1 ID_ERR_DTC_LSH_UP_2 ID_ERR_ENVD_LSH_UP_2 C_DIAG_CONF_LSH_UP_2 C_DC_INC_LSH_UP_2 C_DC_MAX_LSH_UP_2 C_DC_DEC_LSH_UP_2 ID_ERR_DTC_LSH_DOWN_1 ID_ERR_ENVD_LSH_DOWN_1 C_DIAG_CONF_LSH_DOWN_1 C_DC_INC_LSH_DOWN_1 C_DC_MAX_LSH_DOWN_1 C_DC_DEC_LSH_DOWN_1 ID_ERR_DTC_LSH_DOWN_2 ID_ERR_ENVD_LSH_DOWN_2 C_DIAG_CONF_LSH_DOWN_2 C_DC_INC_LSH_DOWN_2 C_DC_MAX_LSH_DOWN_2 C_DC_DEC_LSH_DOWN_2 ID_ERR_DTC_RLY_EFP ID_ERR_ENVD_RLY_EFP C_DIAG_CONF_RLY_EFP C_DC_INC_RLY_EFP C_DC_MAX_RLY_EFP C_DC_DEC_RLY_EFP ID_ERR_DTC_CPS ID_ERR_ENVD_CPS C_DIAG_CONF_CPS C_DC_INC_CPS C_DC_MAX_CPS C_DC_DEC_CPS ID_ERR_DTC_IVVT_0 ID_ERR_ENVD_IVVT_0 C_DIAG_CONF_IVVT_0 C_DC_INC_IVVT_0 C_DC_MAX_IVVT_0 C_DC_DEC_IVVT_0 ID_ERR_DTC_IVVT_1 ID_ERR_ENVD_IVVT_1 C_DIAG_CONF_IVVT_1 C_DC_INC_IVVT_1 C_DC_MAX_IVVT_1 C_DC_DEC_IVVT_1 ID_ERR_DTC_CKS_ECU_SW ID_ERR_ENVD_CKS_ECU_SW C_DIAG_CONF_CKS_ECU_SW C_DC_INC_CKS_ECU_SW C_DC_MAX_CKS_ECU_SW C_DC_DEC_CKS_ECU_SW ID_ERR_DTC_TOUT_ECTU_1 ID_ERR_ENVD_TOUT_ECTU_1 C_DIAG_CONF_TOUT_ECTU_1 C_DC_INC_TOUT_ECTU_1 C_DC_MAX_TOUT_ECTU_1 C_DC_DEC_TOUT_ECTU_1 ID_ERR_DTC_TOUT_ICL_2 ID_ERR_ENVD_TOUT_ICL_2 C_DIAG_CONF_TOUT_ICL_2 C_DC_INC_TOUT_ICL_2 C_DC_MAX_TOUT_ICL_2 C_DC_DEC_TOUT_ICL_2 ID_ERR_DTC_TOUT_ICL_3 ID_ERR_ENVD_TOUT_ICL_3 C_DIAG_CONF_TOUT_ICL_3 C_DC_INC_TOUT_ICL_3 C_DC_MAX_TOUT_ICL_3 C_DC_DEC_TOUT_ICL_3 ID_ERR_DTC_TOUT_ASR_1 ID_ERR_ENVD_TOUT_ASR_1 C_DIAG_CONF_TOUT_ASR_1 C_DC_INC_TOUT_ASR_1 C_DC_MAX_TOUT_ASR_1 C_DC_DEC_TOUT_ASR_1 ID_ERR_DTC_TOUT_ASR_3 ID_ERR_ENVD_TOUT_ASR_3 C_DIAG_CONF_TOUT_ASR_3 C_DC_INC_TOUT_ASR_3 C_DC_MAX_TOUT_ASR_3 C_DC_DEC_TOUT_ASR_3 ID_ERR_DTC_VS ID_ERR_ENVD_VS C_DIAG_CONF_VS C_DC_INC_VS C_DC_MAX_VS C_DC_DEC_VS ID_ERR_DTC_KNKS_1 ID_ERR_ENVD_KNKS_1 C_DIAG_CONF_KNKS_1 C_DC_INC_KNKS_1 C_DC_MAX_KNKS_1 C_DC_DEC_KNKS_1 ID_ERR_DTC_KNKS_2 ID_ERR_ENVD_KNKS_2 C_DIAG_CONF_KNKS_2 C_DC_INC_KNKS_2 C_DC_MAX_KNKS_2 C_DC_DEC_KNKS_2 ID_ERR_DTC_TD_IGC_CUT_0 ID_ERR_ENVD_TD_IGC_CUT_0 C_DIAG_CONF_TD_IGC_CUT_0 C_DC_INC_TD_IGC_CUT_0 /end DEF_CHARACTERISTIC
 /begin OUT_MEASUREMENT LV_ERR_SYM_CHG_CPS LV_CDN_DIAG_CPS ERR_SYM_CPS LV_END_DIAG_CPS CTR_ABC_END_DIAG_CPS CTR_ABC_IVVT_0 ERR_INFO_STAT LV_ERR_DET_IVVT_0 LV_ERR_SYM_CHG_IVVT_0 LV_CDN_DIAG_IVVT_0 ERR_SYM_IVVT_0 LV_END_DIAG_IVVT_0 CTR_ABC_END_DIAG_IVVT_0 CTR_ABC_IVVT_1 ERR_INFO_STAT LV_ERR_DET_IVVT_1 LV_ERR_SYM_CHG_IVVT_1 LV_CDN_DIAG_IVVT_1 ERR_SYM_IVVT_1 LV_END_DIAG_IVVT_1 CTR_ABC_END_DIAG_IVVT_1 CTR_ABC_CKS_ECU_SW ERR_INFO_STAT LV_ERR_DET_CKS_ECU_SW LV_ERR_SYM_CHG_CKS_ECU_SW LV_CDN_DIAG_CKS_ECU_SW ERR_SYM_CKS_ECU_SW LV_END_DIAG_CKS_ECU_SW CTR_ABC_END_DIAG_CKS_ECU_SW CTR_ABC_TOUT_ETCU_1 ERR_INFO_STAT LV_ERR_DET_TOUT_ETCU_1 LV_ERR_SYM_CHG_TOUT_ETCU_1 LV_CDN_DIAG_TOUT_ETCU_1 ERR_SYM_TOUT_ETCU_1 LV_END_DIAG_TOUT_ETCU_1 CTR_ABC_END_DIAG_TOUT_ETCU_1 CTR_ABC_TOUT_ICL_2 ERR_INFO_STAT LV_ERR_DET_TOUT_ICL_2 LV_ERR_SYM_CHG_TOUT_ICL_2 LV_CDN_DIAG_TOUT_ICL_2 ERR_SYM_TOUT_ICL_2 LV_END_DIAG_TOUT_ICL_2 CTR_ABC_END_DIAG_TOUT_ICL__ CTR_ABC_TOUT_ICL_3 ERR_INFO_STAT LV_ERR_DET_TOUT_ICL_3 LV_ERR_SYM_CHG_TOUT_ICL_3 LV_CDN_DIAG_TOUT_ICL_3 ERR_SYM_TOUT_ICL_3 LV_END_DIAG_TOUT_ICL_3 CTR_ABC_END_DIAG_TOUT_ICL_3 CTR_ABC_TOUT_ASR_1 ERR_INFO_STAT LV_ERR_DET_TOUT_ASR_1 LV_ERR_SYM_CHG_TOUT_ASR_1 LV_CDN_DIAG_TOUT_ASR_1 ERR_SYM_TOUT_ASR_1 LV_END_DIAG_TOUT_ASR_1 CTR_ABC_END_DIAG_TOUT_ASR_1 CTR_ABC_TOUT_ASR_3 ERR_INFO_STAT LV_ERR_DET_TOUT_ASR_3 LV_ERR_SYM_CHG_TOUT_ASR_3 LV_CDN_DIAG_TOUT_ASR_3 ERR_SYM_TOUT_ASR_3 LV_END_DIAG_TOUT_ASR_3 CTR_ABC_END_DIAG_TOUT_ASR_3 CTR_ABC_VS ERR_INFO_STAT LV_ERR_DET_VS LV_ERR_SYM_CHG_VS LV_CDN_DIAG_VS ERR_SYM_VS LV_END_DIAG_VS CTR_ABC_END_DIAG_VS CTR_ABC_KNKS_1 ERR_INFO_STAT LV_ERR_DET_KNKS_1 LV_ERR_SYM_CHG_KNKS_1 LV_CDN_DIAG_KNKS_1 ERR_SYM_KNKS_1 LV_END_DIAG_KNKS_1 CTR_ABC_END_DIAG_KNKS_1 CTR_ABC_KNKS_2 ERR_INFO_STAT LV_ERR_DET_KNKS_2 LV_ERR_SYM_CHG_KNKS_2 LV_CDN_DIAG_KNKS_2 ERR_SYM_KNKS_2 LV_END_DIAG_KNKS_2 CTR_ABC_END_DIAG_KNKS_2 CTR_ABC_TD_IGC_CUT_0 ERR_INFO_STAT LV_ERR_DET_TD_IGC_CUT_0 LV_ERR_SYM_CHG_TD_IGC_CUT_0 LV_CDN_DIAG_TD_IGC_CUT_0 ERR_SYM_TD_IGC_CUT_0 LV_END_DIAG_TD_IGC_CUT_0 CTR_ABC_END_DIAG_TD_IGC_CUT_0 CTR_ABC_TD_IGC_CUT_1 ERR_INFO_STAT LV_ERR_DET_TD_IGC_CUT_1 LV_ERR_SYM_CHG_TD_IGC_CUT_1 LV_CDN_DIAG_TD_IGC_CUT_1 ERR_SYM_TD_IGC_CUT_1 LV_END_DIAG_TD_IGC_CUT_1 CTR_ABC_END_DIAG_TD_IGC_CUT_1 CTR_ABC_TD_IGC_CUT_2 ERR_INFO_STAT LV_ERR_DET_TD_IGC_CUT_2 LV_ERR_SYM_CHG_TD_IGC_CUT_2 LV_CDN_DIAG_TD_IGC_CUT_2 ERR_SYM_TD_IGC_CUT_2 LV_END_DIAG_TD_IGC_CUT_2 CTR_ABC_END_DIAG_TD_IGC_CUT_2 CTR_ABC_TD_IGC_CUT_3 ERR_INFO_STAT LV_ERR_DET_TD_IGC_CUT_3 LV_ERR_SYM_CHG_TD_IGC_CUT_3 LV_CDN_DIAG_TD_IGC_CUT_3 ERR_SYM_TD_IGC_CUT_3 LV_END_DIAG_TD_IGC_CUT_3 CTR_ABC_END_DIAG_TD_IGC_CUT_3 CTR_ABC_TD_IGC_CUT_4 ERR_INFO_STAT LV_ERR_DET_TD_IGC_CUT_4 LV_ERR_SYM_CHG_TD_IGC_CUT_4 LV_CDN_DIAG_TD_IGC_CUT_4 ERR_SYM_TD_IGC_CUT_4 LV_END_DIAG_TD_IGC_CUT_4 CTR_ABC_END_DIAG_TD_IGC_CUT_4 CTR_ABC_TD_IGC_CUT_5 ERR_INFO_STAT LV_ERR_DET_TD_IGC_CUT_5 LV_ERR_SYM_CHG_TD_IGC_CUT_5 LV_CDN_DIAG_TD_IGC_CUT_5 ERR_SYM_TD_IGC_CUT_5 LV_END_DIAG_TD_IGC_CUT_5 CTR_ABC_END_DIAG_TD_IGC_CUT_5 CTR_ABC_DUR_IGC_0 ERR_INFO_STAT LV_ERR_DET_DUR_IGC_0 LV_ERR_SYM_CHG_DUR_IGC_0 LV_CDN_DIAG_DUR_IGC_0 ERR_SYM_DUR_IGC_0 LV_END_DIAG_DUR_IGC_0 CTR_ABC_END_DIAG_DUR_IGC_0 CTR_ABC_DUR_IGC_1 ERR_INFO_STAT LV_ERR_DET_DUR_IGC_1 LV_ERR_SYM_CHG_DUR_IGC_1 LV_CDN_DIAG_DUR_IGC_1 ERR_SYM_DUR_IGC_1 LV_END_DIAG_DUR_IGC_1 CTR_ABC_END_DIAG_DUR_IGC_1 CTR_ABC_DUR_IGC_2 ERR_INFO_STAT LV_ERR_DET_DUR_IGC_2 LV_ERR_SYM_CHG_DUR_IGC_2 LV_CDN_DIAG_DUR_IGC_2 ERR_SYM_DUR_IGC_2 LV_END_DIAG_DUR_IGC_2 CTR_ABC_END_DIAG_DUR_IGC_2 CTR_ABC_DUR_IGC_3 ERR_INFO_STAT LV_ERR_DET_DUR_IGC_3 LV_ERR_SYM_CHG_DUR_IGC_3 LV_CDN_DIAG_DUR_IGC_3 ERR_SYM_DUR_IGC_3 LV_END_DIAG_DUR_IGC_3 CTR_END CTR_ABC_DUR_IGC_4 ERR_INFO_STAT LV_ERR_DET_DUR_IGC_4 LV_ERR_SYM_CHG_DUR_IGC_4 LV_CDN_DIAG_DUR_IGC_4 ERR_SYM_DUR_IGC_4 LV_END_DIAG_DUR_IGC_4 CTR_ABC_END_DIAG_DUR_IGC_4 CTR_ABC_DUR_IGC_5 ERR_INFO_STAT LV_ERR_DET_DUR_IGC_5 LV_ERR_SYM_CHG_DUR_IGC_5 LV_CDN_DIAG_DUR_IGC_5 ERR_SYM_DUR_IGC_5 LV_END_DIAG_DUR_IGC_5 CTR_ABC_END_DIAG_DUR_IGC_5 CTR_ABC_TPS_1 ERR_INFO_STAT LV_ERR_DET_TPS_1 LV_ERR_SYM_CHG_TPS_1 LV_CDN_DIAG_TPS_1 ERR_SYM_TPS_1 LV_END_DIAG_TPS_1 CTR_ABC_END_DIAG_TPS_1 CTR_ABC_TPS_2 ERR_INFO_STAT LV_ERR_DET_TPS_2 LV_ERR_SYM_CHG_TPS_2 LV_CDN_DIAG_TPS_2 ERR_SYM_TPS_2 LV_END_DIAG_TPS_2 CTR_ABC_END_DIAG_TPS_2 CTR_ABC_TPS_MAF_1 ERR_INFO_STAT LV_ERR_DET_TPS_MAF_1 LV_ERR_SYM_CHG_TPS_MAF_1 LV_CDN_DIAG_TPS_MAF_1 ERR_SYM_TPS_MAF_1 LV_END_DIAG_TPS_MAF_1 CTR_ABC_END_DIAG_TPS_MAF_1 CTR_ABC_TPS_MAF_2 ERR_INFO_STAT LV_ERR_DET_TPS_MAF_2 LV_ERR_SYM_CHG_TPS_MAF_2 LV_CDN_DIAG_TPS_MAF_2 ERR_SYM_TPS_MAF_2 LV_END_DIAG_TPS_MAF_2 CTR_ABC_END_DIAG_TPS_MAF_2 CTR_ABC_TD ERR_INFO_STAT LV_ERR_DET_TD LV_ERR_SYM_CHG_TD LV_CDN_DIAG_TD ERR_SYM_TD LV_END_DIAG_TD CTR_ABC_END_DIAG_TD CTR_ABC_V_REF_1 ERR_INFO_STAT LV_ERR_DET_V_REF_1 LV_ERR_SYM_CHG_V_REF_1 LV_CDN_DIAG_V_REF_1 ERR_SYM_V_REF_1 LV_END_DIAG_V_REF_1 CTR_ABC_END_DIAG_V_REF_1 CTR_ABC_V_REF_2 ERR_INFO_STAT LV_ERR_DET_V_REF_2 LV_ERR_SYM_CHG_V_REF_2 LV_CDN_DIAG_V_REF_2 ERR_SYM_V_REF_2 LV_END_DIAG_V_REF_2 CTR_ABC_END_DIAG_V_REF_2 CTR_ABC_PVS_1 ERR_INFO_STAT LV_ERR_DET_PVS_1 LV_ERR_SYM_CHG_PVS_1 LV_CDN_DIAG_PVS_1 ERR_SYM_PVS_1 LV_END_DIAG_PVS_1 CTR_ABC_END_DIAG_PVS_1 CTR_ABC_PVS_2 ERR_INFO_STAT LV_ERR_DET_PVS_2 LV_ERR_SYM_CHG_PVS_2 LV_CDN_DIAG_PVS_2 ERR_SYM_PVS_2 LV_END_DIAG_PVS_2 CTR_ABC_END_DIAG_PVS_2 CTR_ABC_PVS_RATIO ERR_INFO_STAT LV_ERR_DET_PVS_RATIO LV_ERR_SYM_CHG_PVS_RATIO LV_CDN_DIAG_PVS_RATIO ERR_SYM_PVS_RATIO LV_END_DIAG_PVS_RATIO CTR_ABC_END_DIAG_PVS_RATIO CTR_ABC_PVS_DOUBLE ERR_INFO_STAT LV_ERR_DET_PVS_DOUBLE LV_ERR_SYM_CHG_PVS_DOUBLE LV_CDN_DIAG_PVS_DOUBLE ERR_SYM_PVS_DOUBLE LV_END_DIAG_PVS_DOUBLE CTR_ABC_END_DIAG_PVS_DOUBLE CTR_ABC_MTC_DR ERR_INFO_STAT LV_ERR_DET_MTC_DR LV_ERR_SYM_CHG_MTC_DR LV_CDN_DIAG_MTC_DR ERR_SYM_MTC_DR LV_END_DIAG_MTC_DR CTR_ABC_END_DIAG_MTC_DR CTR_ABC_MTC_CTL_1 ERR_INFO_STAT LV_ERR_DET_MTC_CTL_1 LV_ERR_SYM_CHG_MTC_CTL_1 LV_CDN_DIAG_MTC_CTL_1 ERR_SYM_MTC_CTL_1 LV_END_DIAG_MTC_CTL_1 CTR_ABC_END_DIAG_MTC_CTL_1 CTR_ABC_MTC_CTL_2 ERR_INFO_STAT LV_ERR_DET_MTC_CTL_2 LV_ERR_SYM_CHG_MTC_CTL_2 LV_CDN_DIAG_MTC_CTL_2 ERR_SYM_MTC_CTL_2 LV_END_DIAG_MTC_CTL_2 CTR_ABC_END_DIAG_MTC_CTL_2 CTR_ABC_MTC_CTL_3 ERR_INFO_STAT LV_ERR_DET_MTC_CTL_3 LV_ERR_SYM_CHG_MTC_CTL_3 LV_CDN_DIAG_MTC_CTL_3 ERR_SYM_MTC_CTL_3 LV_END_DIAG_MTC_CTL_3 CTR_ABC_END_DIAG_MTC_CTL_3 CTR_ABC_TPS_AD ERR_INFO_STAT LV_ERR_DET_TPS_AD LV_ERR_SYM_CHG_TPS_AD LV_CDN_DIAG_TPS_AD ERR_SYM_TPS_AD LV_END_DIAG_TPS_AD CTR_ABC_END_DIAG_TPS_AD CTR_ABC_TPS_ST_CHK_1 ERR_INFO_STAT LV_ERR_DET_TPS_ST_CHK_1 LV_ERR_SYM_CHG_TPS_ST_CHK_1 LV_CDN_DIAG_TPS_ST_CHK_1 ERR_SYM_TPS_ST_CHK_1 LV_END_DIAG_TPS_ST_CHK_1 CTR_ABC_END_DIAG_TPS_ST_CHK_1 CTR_ABC_TPS_ST_CHK_2 ERR_INFO_STAT LV_ERR_DET_TPS_ST_CHK_2 LV_ERR_SYM_CHG_TPS_ST_CHK_2 LV_CDN_DIAG_TPS_ST_CHK_2 ERR_SYM_TPS_ST_CHK_2 LV_END_DIAG_TPS_ST_CHK_2 CTR_ABC_END_DIAG_TPS_ST_CHK_2 CTR_ABC_GEN ERR_INFO_STAT LV_ERR_DET_GEN LV_ERR_SYM_CHG_GEN LV_CDN_DIAG_GEN ERR_SYM_GEN LV_END_DIAG_GEN CTR_ABC_END_DIAG_GEN CTR_ABC_VIM ERR_INFO_STAT LV_ERR_DET_VIM LV_ERR_SYM_CHG_VIM LV_CDN_DIAG_VIM ERR_SYM_VIM LV_END_DIAG_VIM CTR_ABC_END_DIAG_VIM CTR_ABC_ENG_PSN ERR_INFO_STAT LV_ERR_DET_ENG_PSN LV_ERR_SYM_CHG_ENG_PSN LV_CDN_DIAG_ENG_PSN ERR_SYM_ENG_PSN LV_END_DIAG_ENG_PSN CTR_ABC_END_DIAG_ENG_PSN CTR_ABC_TOOTH_PER ERR_INFO_STAT LV_ERR_DET_TOOTH_PER LV_ERR_SYM_CHG_TOOTH_PER LV_CDN_DIAG_TOOTH_PER ERR_SYM_TOOTH_PER LV_END_DIAG_TOOTH_PER CTR_ABC_END_DIAG_TOOTH_PER CTR_ABC_TPU_SYN ERR_INFO_STAT LV_ERR_DET_TPU_SYN LV_ERR_SYM_CHG_TPU_SYN LV_CDN_DIAG_TPU_SYN ERR_SYM_TPU_SYN LV_END_DIAG_TPU_SYN CTR_ABC_END_DIAG_TPU_SYN CTR_ABC_CAM_PER_0 ERR_INFO_STAT LV_ERR_DET_CAM_PER_0 LV_ERR_SYM_CHG_CAM_PER_0 LV_CDN_DIAG_CAM_PER_0 ERR_SYM_CAM_PER_0 LV_END_DIAG_CAM_PER_0 CTR_ABC_END_DIAG_CAM_PER_0 CTR_ABC_CAM_PER_1 ERR_INFO_STAT LV_ERR_DET_CAM_PER_1 LV_ERR_SYM_CHG_CAM_PER_1 LV_CDN_DIAG_CAM_PER_1 ERR_SYM_CAM_PER_1 LV_END_DIAG_CAM_PER_1 CTR_ABC_END_DIAG_CAM_PER_1 CTR_ABC_CAM_PSN_0 ERR_INFO_STAT LV_ERR_DET_CAM_PSN_0 LV_ERR_SYM_CHG_CAM_PSN_0 LV_CDN_DIAG_CAM_PSN_0 ERR_SYM_CAM_PSN_0 LV_END_DIAG_CAM_PSN_0 CTR_ABC_END_DIAG_CAM_PSN_0 CTR_ABC_CAM_PSN_1 ERR_INFO_STAT LV_ERR_DET_CAM_PSN_1 LV_ERR_SYM_CHG_CAM_PSN_1 LV_CDN_DIAG_CAM_PSN_1 ERR_SYM_CAM_PSN_1 LV_END_DIAG_CAM_PSN_1 CTR_ABC_END_DIAG_CAMPSN_1 CTR_ABC_TOUT_TXU_1 ERR_INFO_STAT LV_ERR_DET_TOUT_TXU_1 LV_ERR_SYM_CHG_TOUT_TXU_1 LV_CDN_DIAG_TOUT_TXU_1 ERR_SYM_TOUT_TXU_1 CTR_ABC_END_DIAG_TOUT_TXU_1 CTR_ABC_CAN_BOFF ERR_INFO_STAT LV_ERR_DET_CAN_BOFF LV_ERR_SYM_CHG_CAN_BOFF LV_CDN_DIAG_CAN_BOFF ERR_SYM_CAN_BOFF LV_END_DIAG_CAN_BOFF CTR_ABC_END_DIAG_CAN_BOFF CTR_ABC_RLY_MAIN ERR_INFO_STAT LV_ERR_DET_RLY_MAIN LV_ERR_SYM_CHG_RLY_MAIN LV_CDN_DIAG_RLY_MAIN ERR_SYM_RLY_MAIN LV_END_DIAG_RLY_MAIN CTR_ABC_END_DIAG_RLY_MAIN CTR_ABC_RLY_ACCOUT ERR_INFO_STAT LV_ERR_DET_RLY_ACCOUT LV_ERR_SYM_CHG_RLY_ACCOUT LV_CDN_DIAG_RLY_ACCOUT ERR_SYM_RLY_ACCOUT LV_END_DIAG_RLY_ACCOUT CTR_ABC_END_DIAG_RLY_ACCOUT CTR_ABC_SAP ERR_INFO_STAT LV_ERR_DET_SAP LV_ERR_SYM_CHG_SAP LV_CDN_DIAG_SAP ERR_SYM_SAP LV_END_DIAG_SAP CTR_ABC_END_DIAG_SAP CTR_ABC_SAV ERR_INFO_STAT LV_ERR_DET_SAV LV_ERR_SYM_CHG_SAV LV_CDN_DIAG_SAV ERR_SYM_SAV LV_END_DIAG_SAV CTR_ABC_END_DIAG_SAV CTR_ABC_ECF ERR_INFO_STAT LV_ERR_DET_ECF LV_ERR_SYM_CHG_ECF LV_CDN_DIAG_ECF ERR_SYM_ECF LV_END_DIAG_ECF CTR_ABC_END_DIAG_ECF CTR_ABC_TCO_EL ERR_INFO_STAT LV_ERR_DET_TCO_EL LV_ERR_SYM_CHG_TCO_EL LV_CDN_DIAG_TCO_EL ERR_SYM_TCO_EL LV_END_DIAG_TCO_EL CTR_ABC_END_DIAG_TCO_EL CTR_ABC_TCO_STUCK ERR_INFO_STAT LV_ERR_DET_TCO_STUCK LV_ERR_SYM_CHG_TCO_STUCK LV_CDN_DIAG_TCO_STUCK ERR_SYM_TCO_STUCK LV_END_DIAG_TCO_STUCK CTR_ABC_END_DIAG_TCO_STUCK CTR_ABC_TCO_GRD ERR_INFO_STAT LV_ERR_DET_TCO_GRD LV_ERR_SYM_CHG_TCO_GRD LV_CDN_DIAG_TCO_GRD ERR_SYM_TCO_GRD LV_END_DIAG_TCO_GRD CTR_ABC_END_DIAG_TCO_GRD CTR_ABC_ECT_MEC ERR_INFO_STAT LV_ERR_DET_ECT_MEC LV_ERR_SYM_CHG_ECT_MEC LV_CDN_DIAG_ECT_MEC ERR_SYM_ECT_MEC LV_END_DIAG_ECT_MEC CTR_ABC_END_DIAG_ECT_MEC CTR_ABC_ECT_EL ERR_INFO_STAT LV_ERR_DET_ECT_EL LV_ERR_SYM_CHG_ECT_EL LV_CDN_DIAG_ECT_EL ERR_SYM_ECT_EL LV_END_DIAG_ECT_EL CTR_ABC_END_DIAG_ECT_EL CTR_ABC_TCO_PLAUS ERR_INFO_STAT LV_ERR_DET_TCO_PLAUS LV_ERR_SYM_CHG_TCO_PLAUS LV_CDN_DIAG_TCO_PLAUS ERR_SYM_TCO_PLAUS LV_END_DIAG_TCO_PLAUS CTR_ABC_END_DIAG_TCO_PLAUS ERR_DTC_CUS_0 CTR_FRC_0 CTR_WUP_CYC_0 CTR_DC_0 ERR_INFO_DYN ERR_SYM_MEM_0 LV_ERR_DC_0 LV_ERR_TMP_0 LV_ERR_DIS_0 LV_DC_MAX_0 LV_ERR_CFM_0 LV_ERR_SYM_CHG_MEM_0 ERR_DTC_CUS_1 CTR_FRC_1 CTR_WUP_CYC_1 CTR_DC_1 ERR_INFO_DYN ERR_SYM_MEM_1 LV_ERR_DC_1 LV_ERR_TMP_1 LV_ERR_DIS_1 LV_DC_MAX_1 LV_ERR_CFM_1 LV_ERR_SYM_CHG_MEM_1 ERR_DTC_CUS_2 CTR_FRC_2 CTR_WUP_CYC_2 CTR_DC_2 ERR_INFO_DYN ERR_SYM_MEM_2 LV_ERR_DC_2 LV_ERR_TMP_2 LV_ERR_DIS_2 LV_DC_MAX_2 LV_ERR_CFM_2 LV_ERR_SYM_CHG_MEM_2 ERR_DTC_CUS_3 CTR_FRC_3 CTR_WUP_CYC_3 CTR_DC_3 ERR_INFO_DYN ERR_SYM_MEM_3 LV_ERR_DC_3 LV_ERR_TMP_3 LV_ERR_DIS_3 LV_DC_MAX_3 LV_ERR_CFM_3 LV_ERR_SYM_CHG_MEM_3 ERR_DTC_CUS_4 CTR_FRC_4 CTR_WUP_CYC_4 CTR_DC_4 ERR_INFO_DYN ERR_SYM_MEM_4 LV_ERR_DC_4 LV_ERR_TMP_4 LV_ERR_DIS_4 LV_DC_MAX_4 LV_ERR_CFM_4 LV_ERR_SYM_CHG_MEM_4 ERR_DTC_CUS_5 CTR_FRC_5 CTR_WUP_CYC_5 CTR_DC_5 ERR_INFO_DYN ERR_SYM_MEM_5 LV_ERR_DC_5 LV_ERR_TMP_5 LV_ERR_DIS_5 LV_DC_MAX_5 LV_ERR_CFM_5 LV_ERR_SYM_CHG_MEM_5 ERR_DTC_CUS_6 CTR_FRC_6 CTR_WUP_CYC_6 CTR_DC_6 ERR_INFO_DYN ERR_SYM_MEM_6 LV_ERR_DC_6 LV_ERR_TMP_6 LV_ERR_DIS_6 LV_DC_MAX_6 LV_ERR_CFM_6 LV_ERR_SYM_CHG_MEM_6 ERR_DTC_CUS_7 CTR_FRC_7 CTR_WUP_CYC_7 CTR_DC_7 ERR_INFO_DYN ERR_SYM_MEM_7 LV_ERR_DC_7 LV_ERR_TMP_7 LV_ERR_DIS_7 LV_DC_MAX_7 LV_ERR_CFM_7 LV_ERR_SYM_CHG_MEM_7 ERR_DTC_CUS_8 CTR_FRC_8 CTR_WUP_CYC_8 CTR_DC_8 ERR_INFO_DYN ERR_SYM_MEM_8 LV_ERR_DC_8 LV_ERR_TMP_8 LV_ERR_DIS_8 LV_DC_MAX_8 LV_ERR_CFM_8 LV_ERR_SYM_CHG_MEM_8 ERR_DTC_CUS_9 CTR_FRC_9 CTR_WUP_CYC_9 CTR_DC_9 ERR_INFO_DYN ERR_SYM_MEM_9 LV_ERR_DC_9 LV_ERR_TMP_9 LV_ERR_DIS_9 LV_DC_MAX_9 LV_ERR_CFM_9 LV_ERR_SYM_CHG_MEM_9 CTR_ABC_ISC_H ERR_INFO_STAT LV_ERR_DET_ISC_H LV_ERR_SYM_CHG_ISC_H LV_CDN_DIAG_ISC_H ERR_SYM_ISC_H LV_END_DIAG_ISC_H CTR_ABC_END_DIAG_ISC_H CTR_ABC_ISC_L ERR_INFO_STAT LV_ERR_DET_ISC_L LV_ERR_SYM_CHG_ISC_L LV_CDN_DIAG_ISC_L ERR_SYM_ISC_L LV_END_DIAG_ISC_L CTR_ABC_END_DIAG_ISC_l CTR_ABC_TOIL ERR_INFO_STAT LV_ERR_DET_TOIL LV_ERR_SYM_CHG_TOIL LV_CDN_DIAG_TOIL ERR_SYM_TOIL LV_END_DIAG_TOIL CTR_ABC_END_DIAG_TOIL CTR_ABC_MIS_MPL ERR_INFO_STAT LV_ERR_DET_MIS_MPL LV_ERR_SYM_CHG_MIS_MPL LV_CDN_DIAG_MIS_MPL ERR_SYM_MIS_MPL LV_END_DIAG_MIS_MPL CTR_ABC_END_DIAG_MIS_MPL CTR_ABC_MIS_A_0 ERR_INFO_STAT LV_ERR_DET_MIS_A_0 LV_ERR_SYM_CHG_MIS_A_0 LV_CDN_DIAG_MIS_A_0 ERR_SYM_MIS_A_0 LV_END_DIAG_MIS_A_0 CTR_ABC_END_DIAG_MIS_A_0 CTR_ABC_MIS_A_1 ERR_INFO_STAT LV_ERR_DET_MIS_A_1 LV_ERR_SYM_CHG_MIS_A_1 LV_CDN_DIAG_MIS_A_1 ERR_SYM_MIS_A_1 LV_END_DIAG_MIS_A_1 CTR_ABC_END_DIAG_MIS_A_1 CTR_ABC_MIS_A_2 ERR_INFO_STAT LV_ERR_DET_MIS_A_2 LV_ERR_SYM_CHG_MIS_A_2 LV_CDN_DIAG_MIS_A_2 ERR_SYM_MIS_A_2 LV_END_DIAG_MIS_A_2 CTR_ABC_END_DIAG_MIS_A_2 CTR_ABC_MIS_A_3 ERR_INFO_STAT LV_ERR_DET_MIS_A_3 LV_ERR_SYM_CHG_MIS_A_3 LV_CDN_DIAG_MIS_A_3 ERR_SYM_MIS_A_3 LV_END_DIAG_MIS_A_3 CTR_ABC_END_DIAG_MIS_A_3 CTR_ABC_MIS_A_4 ERR_INFO_STAT LV_ERR_DET_MIS_A_4 LV_ERR_SYM_CHG_MIS_A_4 LV_CDN_DIAG_MIS_A_4 ERR_SYM_MIS_A_4 LV_END_DIAG_MIS_A_4 CTR_ABC_END_DIAG_MIS_A_4 CTR_ABC_MIS_A_5 ERR_INFO_STAT LV_ERR_DET_MIS_A_5 LV_ERR_SYM_CHG_MIS_A_5 LV_CDN_DIAG_MIS_A_5 ERR_SYM_MIS_A_5 LV_END_DIAG_MIS_A_5 CTR_ABC_END_DIAG_MIS_A_5 CTR_ABC_MIS_B_0 ERR_INFO_STAT LV_ERR_DET_MIS_B_0 LV_ERR_SYM_CHG_MIS_B_0 LV_CDN_DIAG_MIS_B_0 ERR_SYM_MIS_B_0 LV_END_DIAG_MIS_B_0 CTR_ABC_END_DIAG_MIS_B_0 CTR_ABC_MIS_B_1 ERR_INFO_STAT LV_ERR_DET_MIS_B_1 LV_ERR_SYM_CHG_MIS_B_1 LV_CDN_DIAG_MIS_B_1 ERR_SYM_MIS_B_1 LV_END_DIAG_MIS_B_1 CTR_ABC_END_DIAG_MIS_B_1 CTR_ABC_MIS_B_2 ERR_INFO_STAT LV_ERR_DET_MIS_B_2 LV_ERR_SYM_CHG_MIS_B_2 LV_CDN_DIAG_MIS_B_2 ERR_SYM_MIS_B_2 LV_END_DIAG_MIS_B_2 CTR_ABC_END_DIAG_MIS_B_2 CTR_ABC_MIS_B_3 ERR_INFO_STAT LV_ERR_DET_MIS_B_3 LV_ERR_SYM_CHG_MIS_B_3 LV_CDN_DIAG_MIS_B_3 ERR_SYM_MIS_B_3 LV_END_DIAG_MIS_B_3 CTR_ABC_END_DIAG_MIS_B_3 CTR_ABC_MIS_B_4 ERR_INFO_STAT LV_ERR_DET_MIS_B_4 LV_ERR_SYM_CHG_MIS_B_4 LV_CDN_DIAG_MIS_B_4 ERR_SYM_MIS_B_4 LV_END_DIAG_MIS_B_4 CTR_ABC_END_DIAG_MIS_B_4 CTR_ABC_MIS_B_5 ERR_INFO_STAT LV_ERR_DET_MIS_B_5 LV_ERR_SYM_CHG_MIS_B_5 LV_CDN_DIAG_MIS_B_5 ERR_SYM_MIS_B_5 LV_END_DIAG_MIS_B_5 CTR_ABC_END_DIAG_MIS_B_5 CTR_ABC_SEG_T_AD ERR_INFO_STAT LV_ERR_DET_SEG_T_AD LV_ERR_SYM_CHG_SEG_T_AD LV_CDN_DIAG_SEG_T_AD ERR_SYM_SEG_T_AD LV_END_DIAG_SEG_T_AD CTR_ABC_END_DIAG_SEG_T_AD CTR_ABC_ISA_1 ERR_INFO_STAT LV_ERR_DET_ISA_1 LV_ERR_SYM_CHG_ISA_1 LV_CDN_DIAG_ISA_1 ERR_SYM_ISA_1 LV_END_DIAG_ISA_1 CTR_ABC_END_DIAG_ISA_1 CTR_ABC_ISA_2 ERR_INFO_STAT LV_ERR_DET_ISA_2 LV_ERR_SYM_CHG_ISA_2 LV_CDN_DIAG_ISA_2 ERR_SYM_ISA_2 LV_END_DIAG_ISA_2 CTR_ABC_END_DIAG_ISA_2 CTR_ABC_MEC_ISA ERR_INFO_STAT LV_ERR_DET_MEC_ISA LV_ERR_SYM_CHG_MEC_ISA LV_CDN_DIAG_MEC_ISA ERR_SYM_MEC_ISA LV_END_DIAG_MEC_ISA CTR_ABC_END_DIAG_MEC_ISA CTR_ABC_MSW_3 ERR_INFO_STAT LV_ERR_DET_MSW_3 LV_ERR_SYM_CHG_MSW_3 LV_CDN_DIAG_MSW_3 ERR_SYM_MSW_3 LV_END_DIAG_MSW_3 CTR_ABC_END_DIAG_MSW_3 CTR_ABC_MSW_2 ERR_INFO_STAT LV_ERR_DET_MSW_2 LV_ERR_SYM_CHG_MSW_2 LV_CDN_DIAG_MSW_2 ERR_SYM_MSW_2 LV_END_DIAG_MSW_2 CTR_ABC_END_DIAG_MSW_2 CTR_ABC_MSW_TOG ERR_INFO_STAT LV_ERR_DET_MSW_TOG LV_ERR_SYM_CHG_MSW_TOG LV_CDN_DIAG_MSW_TOG ERR_SYM_MSW_TOG LV_END_DIAG_MSW_TOG CTR_ABC_END_DIAG_MSW_TOG CTR_ABC_IM_BTS_PLAUS ERR_INFO_STAT LV_ERR_DET_IM_BTS_PLAUS LV_ERR_SYM_CHG_IM_BTS_PLAUS LV_CDN_DIAG_IM_BTS_PLAUS ERR_SYM_IM_BTS_PLAUS LV_END_DIAG_IM_BTS_PLAUS CTR_ABC_END_DIAG_IM_BTS_PLAUS CTR_ABC_IM_BLS_PLAUS ERR_INFO_STAT LV_ERR_DET_IM_BLS_PLAUS LV_ERR_SYM_CHG_IM_BLS_PLAUS LV_CDN_DIAG_IM_BLS_PLAUS ERR_SYM_IM_BLS_PLAUS LV_END_DIAG_IM_BLS_PLAUS CTR_ABC_END_DIAG_IM_BLS_PLAUS /end OUT_MEASUREMENT
/end FUNCTION
/end MODULE
/end PROJECT
