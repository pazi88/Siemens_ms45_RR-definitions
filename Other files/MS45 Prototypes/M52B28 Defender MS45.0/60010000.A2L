/* -------------------------------------------------------------------------
S I E M E N S Automotive
Data Declaration System (DDS)
- ASAP2 export -
DDS-Version 2.27.1BETA
Component-Version Build<000018.01> (March 06, 2000)
CreationDate 29 Mar 2000, 08:17:03
Project MS45
Number 450
Structure 600
Serial Nr. 00
Option Project (DataBase) g:\p_450\dds21sim\user\MIFO\DB
Option Verbose true
Option ASAP2File g:\p_450\dds21sim\user\MIFO\DB\Datas\45060000.a2l
Option IgnoreAddressCheck false
Option ASAP2Version 1.31
Option ExportSoftwareGrouping false
Option ExportComponentGrouping false
Option SuppressFunctionGrouping false
Option SuppressAxisFunctionGrouping false
Option ExportDisplayIdentifier <1>
Option ExportLongIdentifier <0>
Option ExportAnnotation false
Option MemoryRegionAutoAssignment <0>
Option ExportReference2MemorySegment false
Option AddressOffset <0>
Option SuppressEcuAddress false
Option IfDataSetList 'ETK_P1'
Option IfDataOutputFormat <0>
Option CalibrationMethodList
Option SuppressFloat false
Option OnlineOnly false
Option ExportHiddenData false
Option Map2PointLinearConv2RatFunc true
Option NonLinearConvMode <0>
Option MapVTabRange2VTab false
Option MaxCompuTabValuePairs <255>
Option DefaultFormat4VerbalConvers...
Option WriteEscapeCharacters false
Option AllowASAP1_3IdentsAlso4NonI... false
Option IgnorePartialIdentLengthCheck false
------------------------------------------------------------------------- */
ASAP2_VERSION 1 31
/begin PROJECT MS45 "Rover Motorsteuerung V6"
/begin HEADER "_default_HeaderComment" PROJECT_NO _50 /end HEADER
/begin MODULE _default_ModuleName "_default_ModuleLongIdentifier"
/begin MOD_PAR "_default_ModParComment"
 /begin MEMORY_SEGMENT _RAM "" VARIABLES RAM EXTERN 0x400000 0x10000 -1 -1 -1 -1 -1 /begin IF_DATA ETK DP_BLOB 0x400000 0x10000 /end IF_DATA /end MEMORY_SEGMENT
 /begin MEMORY_SEGMENT _ROM "" DATA FLASH EXTERN 0x60000 0xee40 -1 -1 -1 -1 -1 /begin IF_DATA ETK DP_BLOB 0x60000 0xee40 /end IF_DATA /end MEMORY_SEGMENT
 /begin MEMORY_SEGMENT _INT_RAM "" VARIABLES RAM INTERN 0x3f9800 0x6800 -1 -1 -1 -1 -1 /begin IF_DATA ETK DP_BLOB 0x3f9800 0x6800 /end IF_DATA /end MEMORY_SEGMENT
 /begin MEMORY_SEGMENT _INT_RAM_BIT "" VARIABLES RAM INTERN 0xfd00 0x100 -1 -1 -1 -1 -1 /begin IF_DATA ETK DP_BLOB 0xfd00 0x100 /end IF_DATA /end MEMORY_SEGMENT
/end MOD_PAR
/begin MOD_COMMON "_default_ModCommonComment" DEPOSIT ABSOLUTE BYTE_ORDER MSB_FIRST ALIGNMENT_BYTE 1 ALIGNMENT_WORD 2 ALIGNMENT_LONG 4 ALIGNMENT_FLOAT32_IEEE 4 ALIGNMENT_FLOAT64_IEEE 8 /end MOD_COMMON
/begin IF_DATA ETK
 /begin SOURCE "Segment Synchronous" 103 1 QP_BLOB 1 0x3a 0x6ea00 0x401000 0x400080 0 0x0 0x0 /end SOURCE
 /begin SOURCE "Time Synchronous Cylinder 10ms" 4 1 QP_BLOB 2 0x5a 0x6eaf0 0x40103a 0x400084 10 0x0 0x0 /end SOURCE
 /begin SOURCE "Time Synchronous Cylinder 100ms" 5 1 QP_BLOB 3 0x5a 0x6ec60 0x401094 0x400088 100 0x0 0x0 /end SOURCE
 /begin TP_BLOB 0x01000001 0x0 0x00000800
  /begin DISTAB_CFG 0xD 0x1222 0x1 0x400000 0x1020100 TRG_MOD 0x0 0x27 0x0 0x0 0x0 /end DISTAB_CFG
  CODE_CHK 0x0 0x0 0x0 0x0 ETK_CFG 0x02 0xE2 0x4E 0xDF 0xEF 0x4E 0xDF 0xEF 0x4E 0xCF 0xFB 0xFE 0xFF 0xFF 0xFB 0xFF 0xFF 0xFF 0xFF 0xFF 0x03 0xFF 0x01 0xFF RESERVED 0x6ea00 0x1600 EXTERN -1 -1 -1 -1 -1 /end TP_BLOB
/end IF_DATA
/include if_kwp4.a2l
/include if_ccp2.a2l
/begin CHARACTERISTIC C_ADD_N_MAX_FCUT "Additive threshold to maximum engine speed for activation fuel cut-off all cylinders" VALUE 0x67b56 _REC_VAL_20_u2 8160. _CNV_A_R_LINEAR_____0_CM 0. 8160. FORMAT "%4.0" /end CHARACTERISTIC
/begin CHARACTERISTIC C_N_GRD_HYS "Hysteresis for N_GRD Filtering" VALUE 0x67c0e _REC_VAL_20_s1 8160. _CNV_A_R_LINEAR_____14_CM -4096. 4064. FORMAT "%5.0" /end CHARACTERISTIC
/begin CHARACTERISTIC C_TCO_BOL_ECT "TCO setpoint for LV_REQ_TCO_L = 1" VALUE 0x67c9c _REC_VAL_20_u1 190.5 _CNV_A_R_LINEAR_____22_CM -48. 142.5 FORMAT "%5.1" /end CHARACTERISTIC
/begin CHARACTERISTIC C_TCO_EX_HYS_ECT "Hysteresis for end of the special case" VALUE 0x67ca0 _REC_VAL_20_u1 28.575 _CNV_A_R_LINEAR_____23_CM 0. 190.5 FORMAT "%4.1" /end CHARACTERISTIC
/begin CHARACTERISTIC C_TCO_EX_MAX_ECT "TCO_EX threshold" VALUE 0x67ca1 _REC_VAL_20_u1 28.575 _CNV_A_R_LINEAR_____22_CM -48. 142.5 FORMAT "%5.1" /end CHARACTERISTIC
/begin CHARACTERISTIC C_TCO_MIN_ECT "Min. TCO threshold for full energization of the thermostat" VALUE 0x67caa _REC_VAL_20_u1 190.5 _CNV_A_R_LINEAR_____22_CM -48. 142.5 FORMAT "%5.1" /end CHARACTERISTIC
/begin CHARACTERISTIC C_TCO_SP_TCO_EX_MAX "TCO target temperature if TCO_EX threshold exceeded" VALUE 0x67cae _REC_VAL_20_u1 28.575 _CNV_A_R_LINEAR_____22_CM -48. 142.5 FORMAT "%5.1" /end CHARACTERISTIC
/begin CHARACTERISTIC C_TCO_SP_TIA_MAX "TCO target temperature if TIA threshold exceeded" VALUE 0x67caf _REC_VAL_20_u1 28.575 _CNV_A_R_LINEAR_____22_CM -48. 142.5 FORMAT "%5.1" /end CHARACTERISTIC
/begin CHARACTERISTIC C_TCO_SP_TOIL_MIN "Set value for TCO_SP" VALUE 0x67cb0 _REC_VAL_20_u1 190.5 _CNV_A_R_LINEAR_____22_CM -48. 142.5 FORMAT "%5.1" /end CHARACTERISTIC
/begin CHARACTERISTIC C_TIA_HYS_ECT "Hysteresis for end of the special case" VALUE 0x67cdc _REC_VAL_20_u1 28.575 _CNV_A_R_LINEAR_____23_CM 0. 190.5 FORMAT "%4.1" /end CHARACTERISTIC
/begin CHARACTERISTIC C_TIA_MAX_ECT "TIA threshold" VALUE 0x67cde _REC_VAL_20_u1 28.575 _CNV_A_R_LINEAR_____22_CM -48. 142.5 FORMAT "%5.1" /end CHARACTERISTIC
/begin CHARACTERISTIC C_TOIL_HYS_ECT "TOIL hystheresis for hot operation" VALUE 0x67ce6 _REC_VAL_20_u1 255. _CNV_A_R_LINEAR_____31_CM 0. 255. FORMAT "%3.0" /end CHARACTERISTIC
/begin CHARACTERISTIC C_TOIL_MIN_ECT "Lower TOIL threshold" VALUE 0x67cea _REC_VAL_20_u1 200. _CNV_A_R_LINEAR_____32_CM -40. 160. FORMAT "%3.0" /end CHARACTERISTIC
/begin CHARACTERISTIC C_TQI_MAX_PAS "Passive value indicated engine torque when engine speed limitation is inactive" VALUE 0x67d44 _REC_VAL_20_u2 1023.96875 _CNV_A_R_LINEAR_____37_CM 0. 1023.96875 FORMAT "%7.2" /end CHARACTERISTIC
/begin MEASUREMENT TCO_SP "TCO target temperature" UBYTE _CNV_A_R_LINEAR_____22_CM 1 100. -48. 142.5 ECU_ADDRESS 0x3fd9a6 FORMAT "%4.1" /end MEASUREMENT
/begin AXIS_PTS ldp_n_32__ectpwm_add "" 0x61617 N_32 _REC_AXS_20_u1 8160. _CNV_A_R_LINEAR_____15_CM 8 0. 8160. FORMAT "%4.0" /end AXIS_PTS
/begin AXIS_PTS ldp_tco_dif__ectpwm_i "" 0x618c1 TCO_DIF _REC_AXS_20_u1 191.25 _CNV_A_R_LINEAR_____55_CM 8 -96. 95.25 FORMAT "%6.2" /end AXIS_PTS
/begin AXIS_PTS ldp_tco_dif__ectpwm_p "" 0x618ca TCO_DIF _REC_AXS_20_u1 191.25 _CNV_A_R_LINEAR_____55_CM 8 -96. 95.25 FORMAT "%6.2" /end AXIS_PTS
/begin AXIS_PTS ldp_tco_sp__ectpwm_add "" 0x618dc TCO_SP _REC_AXS_20_u1 190.5 _CNV_A_R_LINEAR_____22_CM 8 -48. 142.5 FORMAT "%5.1" /end AXIS_PTS
/begin AXIS_PTS ldp_tco_st__dist "" 0x618e5 TCO_ST _REC_AXS_20_u1 190.5 _CNV_A_R_LINEAR_____22_CM 8 -48. 142.5 FORMAT "%5.1" /end AXIS_PTS
/begin CHARACTERISTIC ID_ECTPWM_ADD "Precontrol pulse width modulation" MAP 0x64ff0 _REC_MAP_20_u1_u1_u1 99.609375 _CNV_A_R_LINEAR_____16_CM 0. 99.609375 FORMAT "%5.2"
 /begin AXIS_DESCR COM_AXIS N_32 _CNV_A_R_LINEAR_____15_CM 8 0. 8160. FORMAT "%4.0" AXIS_PTS_REF ldp_n_32__ectpwm_add /end AXIS_DESCR
 /begin AXIS_DESCR COM_AXIS TCO_SP _CNV_A_R_LINEAR_____22_CM 8 -48. 142.5 FORMAT "%5.1" AXIS_PTS_REF ldp_tco_sp__ectpwm_add /end AXIS_DESCR
/end CHARACTERISTIC
/begin CHARACTERISTIC IP_DIST_MIN "Distance limit" CURVE 0x65a14 _REC_CUR_20_u2_u1 65535. _CNV_A_R_LINEAR_____17_CM 0. 65535. FORMAT "%5.0"
 /begin AXIS_DESCR COM_AXIS TCO_ST _CNV_A_R_LINEAR_____22_CM 8 -48. 142.5 FORMAT "%5.1" AXIS_PTS_REF ldp_tco_st__dist /end AXIS_DESCR
/end CHARACTERISTIC
/begin CHARACTERISTIC IP_ECTPWM_I "Controller I component" CURVE 0x65a3c _REC_CUR_20_u1_u1 12.45 _CNV_A_R_LINEAR_____59_CM -6.25 6.2 FORMAT "%5.2"
 /begin AXIS_DESCR COM_AXIS TCO_DIF _CNV_A_R_LINEAR_____55_CM 8 -96. 95.25 FORMAT "%6.2" AXIS_PTS_REF ldp_tco_dif__ectpwm_i /end AXIS_DESCR
/end CHARACTERISTIC
/begin CHARACTERISTIC IP_ECTPWM_P "Controller P component" CURVE 0x65a44 _REC_CUR_20_u1_u1 99.60939999999999 _CNV_A_R_LINEAR_____60_CM -50. 49.6094 FORMAT "%5.1"
 /begin AXIS_DESCR COM_AXIS TCO_DIF _CNV_A_R_LINEAR_____55_CM 8 -96. 95.25 FORMAT "%6.2" AXIS_PTS_REF ldp_tco_dif__ectpwm_p /end AXIS_DESCR
/end CHARACTERISTIC
/begin MEASUREMENT ECTPWM "Actuation pulse width modulation for thermostat" UBYTE _CNV_A_R_LINEAR_____16_CM 1 100. 0. 99.609375 ECU_ADDRESS 0x3fd9a7 FORMAT "%5.1" /end MEASUREMENT
/begin MEASUREMENT LV_N_MAX_REQ_FCUT "Logical variable fuel cut-off of all cylinder requested for engine speed limitation" UBYTE _CNV_S_2_RANGE______76_CM 1 100. 0. 1. ECU_ADDRESS 0x3fd50b BIT_MASK 0x1 /end MEASUREMENT
/begin MEASUREMENT N_DIF_MAX_LIM "Engine speed difference as an input for PI-controller" SWORD _CNV_A_R_LINEAR_____0_CM 1 100. -8160. 8160. ECU_ADDRESS 0x3fce32 FORMAT "%4.0" /end MEASUREMENT
/begin MEASUREMENT N_PRED_MAX_LIM "Predicted engine speed " UWORD _CNV_A_R_LINEAR_____0_CM 1 100. 0. 8160. ECU_ADDRESS 0x3fce30 FORMAT "%4.0" /end MEASUREMENT
/begin MEASUREMENT TQ_N_MAX_DIF "Torque output of N_MAX-PI-Controller" SWORD _CNV_A_R_LINEAR_____37_CM 1 100. -1024. 1023.96875 ECU_ADDRESS 0x3fce38 FORMAT "%6.2" /end MEASUREMENT
/begin MEASUREMENT TQ_N_MAX_DIF_I "Torque output of N_MAX-I-Controller" SLONG _CNV_A_R_LINEAR_____82_CM 1 100. -1024. 1023.99999952 ECU_ADDRESS 0x3fc1a0 FORMAT "%11.7" /end MEASUREMENT
/begin MEASUREMENT TQ_N_MAX_DIF_P "Torque output of N_MAX-P-Controller" SWORD _CNV_A_R_LINEAR_____37_CM 1 100. -1024. 1023.96875 ECU_ADDRESS 0x3fce3a FORMAT "%6.2" /end MEASUREMENT
/begin MEASUREMENT TQ_N_MAX_INP_I "Torque input for N_MAX I-controller" SWORD _CNV_A_R_LINEAR_____83_CM 1 100. -4. 3.99987793 ECU_ADDRESS 0x3fce34 FORMAT "%5.4" /end MEASUREMENT
/begin MEASUREMENT TQI_N_MAX "Indicated engine torque setpoint  for N_MAX-limitation" UWORD _CNV_A_R_LINEAR_____37_CM 1 100. 0. 1023.96875 ECU_ADDRESS 0x3fce2e FORMAT "%7.2" /end MEASUREMENT
/begin MEASUREMENT TQI_N_MAX_REF "Reference indicated engine  torque on which controller output is applied" UWORD _CNV_A_R_LINEAR_____37_CM 1 100. 0. 1023.96875 ECU_ADDRESS 0x3fce36 FORMAT "%7.2" /end MEASUREMENT
/begin MEASUREMENT LV_ACCOUT_RLY "LV to activate the ACC-relay" UBYTE _CNV_S_2_RANGE______74_CM 1 100. 0. 1. ECU_ADDRESS 0x3fd420 BIT_MASK 0x1 /end MEASUREMENT
/begin CHARACTERISTIC C_ACCIN_DLY_1_LOCK_FL "Blocking time for renewed triggering of the ACC suppression at high load" VALUE 0x67b50 _REC_VAL_20_u2 655.35 _CNV_A_R_LINEAR_____21_CM 0. 655.35 FORMAT "%6.2" /end CHARACTERISTIC
/begin CHARACTERISTIC C_ACCIN_DLY_1 "Delay for ACC suppression in transition after full load" VALUE 0x67b4e _REC_VAL_20_u2 655.35 _CNV_A_R_LINEAR_____21_CM 0. 655.35 FORMAT "%6.2" /end CHARACTERISTIC
/begin CHARACTERISTIC C_ACCIN_DLY_4 "Delay in transition from start" VALUE 0x67b52 _REC_VAL_20_u2 6553.5 _CNV_A_R_LINEAR_____18_CM 0. 6553.5 FORMAT "%6.1" /end CHARACTERISTIC
/begin CHARACTERISTIC C_ACCIN_DLY_5 "Delay before renewed reactivation of the ACC" VALUE 0x67b54 _REC_VAL_20_u2 655.35 _CNV_A_R_LINEAR_____21_CM 0. 655.35 FORMAT "%6.2" /end CHARACTERISTIC
/begin CHARACTERISTIC C_PVS_FL_ACCIN "PV-threshold for ACC suppression" VALUE 0x67c2f _REC_VAL_20_u1 99.609375 _CNV_A_R_LINEAR_____16_CM 0. 99.609375 FORMAT "%4.1" /end CHARACTERISTIC
/begin MEASUREMENT LV_EFP "Logical variable for electrical fuel pump active" UBYTE _CNV_S_2_RANGE______76_CM 1 100. 0. 1. ECU_ADDRESS 0x3fd47b BIT_MASK 0x1 /end MEASUREMENT
/begin CHARACTERISTIC C_T_EFP_PREV "On-time for elctrical fuel pump after reset with engine stopped" VALUE 0x67c50 _REC_VAL_20_u2 655.35 _CNV_A_R_LINEAR_____21_CM 0. 655.35 FORMAT "%6.2" /end CHARACTERISTIC
/begin MEASUREMENT T_DLY_EFP "Timer for delays in EFP" UWORD _CNV_A_R_LINEAR_____21_CM 1 100. 0. 655.35 ECU_ADDRESS 0x3fc7ee FORMAT "%6.2" /end MEASUREMENT
/begin MEASUREMENT FPAPWM_BAS "Basic fuel pressure regulation term" UBYTE _CNV_A_R_LINEAR_____16_CM 1 100. 0. 99.609375 ECU_ADDRESS 0x3fd863 FORMAT "%5.1" /end MEASUREMENT
/begin MEASUREMENT FPAPWM_P "Proportional fuel pressure regulation term" SWORD _CNV_A_R_LINEAR_____12_CM 1 100. -100. 99.99694824 ECU_ADDRESS 0x3fc8ba FORMAT "%8.3" /end MEASUREMENT
/begin MEASUREMENT FPAPWM_I "Integral fuel pressure regulation term" SWORD _CNV_A_R_LINEAR_____12_CM 1 100. -100. 99.99694824 ECU_ADDRESS 0x3fc8bc FORMAT "%8.3" /end MEASUREMENT
/begin MEASUREMENT FUP_SP "Fuel pressure setpoint" UWORD _CNV_A_R_LINEAR_____114_CM 1 100. 0. 173888. ECU_ADDRESS 0x3fc8b6 FORMAT "%6.0" /end MEASUREMENT
/begin MEASUREMENT FUP_DIF "Fuel pressure regulation error" SWORD _CNV_A_R_LINEAR_____138_CM 1 100. -86945.33 86942.67 ECU_ADDRESS 0x3fc8be FORMAT "%9.2" /end MEASUREMENT
/begin MEASUREMENT FPAPWM "Global fuel pressure regulation" UBYTE _CNV_A_R_LINEAR_____16_CM 1 100. 0. 99.609375 ECU_ADDRESS 0x3fd860 FORMAT "%5.1" /end MEASUREMENT
/begin MEASUREMENT FPA_MFF "Fuel pressure actuator fuel flow" UWORD _CNV_A_R_LINEAR_____139_CM 1 100. 0. 1511.232 ECU_ADDRESS 0x3fc8b8 FORMAT "%7.2" /end MEASUREMENT
/begin MEASUREMENT STATE_FUP "Status of the fuel pressure controller operation" UBYTE _CNV_S_3_RANGE_STAT_140_CM 1 100. 0. 2. ECU_ADDRESS 0x3fd861 /end MEASUREMENT
/begin AXIS_PTS ldpm_n_32__fup_sp "" 0x61c5f N_32 _REC_AXS_20_u1 8160. _CNV_A_R_LINEAR_____15_CM 8 0. 8160. FORMAT "%4.0" /end AXIS_PTS
/begin AXIS_PTS ldpm_n_32__fup_sp_s "" 0x61c68 N_32 _REC_AXS_20_u1 8160. _CNV_A_R_LINEAR_____15_CM 8 0. 8160. FORMAT "%4.0" /end AXIS_PTS
/begin AXIS_PTS ldp_fup_sp__fpapwm_bas "" 0x6151a FUP_SP _REC_AXS_20_u2 173888. _CNV_A_R_LINEAR_____114_CM 8 0. 173888. FORMAT "%6.0" /end AXIS_PTS
/begin AXIS_PTS ldpm_fup_dif__fpapwm "" 0x61ae4 FUP_DIF _REC_AXS_20_u2 173888. _CNV_A_R_LINEAR_____141_CM 8 -86945.33 86942.67 FORMAT "%9.2" /end AXIS_PTS
/begin CHARACTERISTIC IP_FUP_SP_HOM "Fuel pressure setpoint for homogenous engine operation" MAP 0x65da0 _REC_MAP_20_u2_u2_u1 173888. _CNV_A_R_LINEAR_____114_CM 0. 173888. FORMAT "%6.0"
 /begin AXIS_DESCR COM_AXIS TQI_SP _CNV_A_R_LINEAR_____37_CM 8 0. 1023.96875 FORMAT "%7.2" AXIS_PTS_REF ldpm_tqi_sp__fup_sp /end AXIS_DESCR
 /begin AXIS_DESCR COM_AXIS N_32 _CNV_A_R_LINEAR_____15_CM 8 0. 8160. FORMAT "%4.0" AXIS_PTS_REF ldpm_n_32__fup_sp /end AXIS_DESCR
/end CHARACTERISTIC
/begin CHARACTERISTIC IP_FUP_SP_S "Fuel pressure setpoint for stratified engine operation" MAP 0x65e20 _REC_MAP_20_u2_u2_u1 173888. _CNV_A_R_LINEAR_____114_CM 0. 173888. FORMAT "%6.0"
 /begin AXIS_DESCR COM_AXIS TQI_SP _CNV_A_R_LINEAR_____37_CM 8 0. 1023.96875 FORMAT "%7.2" AXIS_PTS_REF ldpm_tqi_sp__fup_sp /end AXIS_DESCR
 /begin AXIS_DESCR COM_AXIS N_32 _CNV_A_R_LINEAR_____15_CM 8 0. 8160. FORMAT "%4.0" AXIS_PTS_REF ldpm_n_32__fup_sp_s /end AXIS_DESCR
/end CHARACTERISTIC
/begin CHARACTERISTIC IP_FPAPWM_BAS "Duty cycle basic value" CURVE 0x65d48 _REC_CUR_20_u1_u2 99.609375 _CNV_A_R_LINEAR_____16_CM 0. 99.609375 FORMAT "%5.1"
 /begin AXIS_DESCR COM_AXIS FUP_SP _CNV_A_R_LINEAR_____114_CM 8 0. 173888. FORMAT "%6.0" AXIS_PTS_REF ldp_fup_sp__fpapwm_bas /end AXIS_DESCR
/end CHARACTERISTIC
/begin CHARACTERISTIC IP_FPAPWM_FAC "Battery voltage correction" CURVE 0x65d50 _REC_CUR_20_u1_u1 1.9921875 _CNV_A_R_LINEAR_____67_CM 0. 1.9921875 FORMAT "%5.3"
 /begin AXIS_DESCR COM_AXIS VB _CNV_A_R_LINEAR_____42_CM 8 0. 25.8984 FORMAT "%3.1" AXIS_PTS_REF ldp_vb__fpapwm_fac /end AXIS_DESCR
/end CHARACTERISTIC
/begin CHARACTERISTIC IP_FPAPWM_P_FAC "Prportional parameter correction" CURVE 0x65d80 _REC_CUR_20_u1_u2 3.984375 _CNV_A_R_LINEAR_____113_CM 0. 3.984375 FORMAT "%4.2"
 /begin AXIS_DESCR COM_AXIS FPA_MFF _CNV_A_R_LINEAR_____139_CM 8 0. 1511.232 FORMAT "%7.2" AXIS_PTS_REF ldpm_fpa_mff__fpapwm /end AXIS_DESCR
/end CHARACTERISTIC
/begin CHARACTERISTIC IP_FPAPWM_I_FAC "Integral parameter correction" CURVE 0x65d68 _REC_CUR_20_u1_u2 3.984375 _CNV_A_R_LINEAR_____113_CM 0. 3.984375 FORMAT "%4.2"
 /begin AXIS_DESCR COM_AXIS FPA_MFF _CNV_A_R_LINEAR_____139_CM 8 0. 1511.232 FORMAT "%7.2" AXIS_PTS_REF ldpm_fpa_mff__fpapwm /end AXIS_DESCR
/end CHARACTERISTIC
/begin CHARACTERISTIC IP_FPAPWM_P "Proportional parameter" CURVE 0x65d70 _REC_CUR_20_u2_u2 199.99694824 _CNV_A_R_LINEAR_____63_CM -100. 99.99694824 FORMAT "%8.3"
 /begin AXIS_DESCR COM_AXIS FUP_DIF _CNV_A_R_LINEAR_____141_CM 8 -86945.33 86942.67 FORMAT "%9.2" AXIS_PTS_REF ldpm_fup_dif__fpapwm /end AXIS_DESCR
/end CHARACTERISTIC
/begin CHARACTERISTIC IP_FPAPWM_I "Integral parameter" CURVE 0x65d58 _REC_CUR_20_u2_u2 199.99694824 _CNV_A_R_LINEAR_____63_CM -100. 99.99694824 FORMAT "%8.3"
 /begin AXIS_DESCR COM_AXIS FUP_DIF _CNV_A_R_LINEAR_____141_CM 8 -86945.33 86942.67 FORMAT "%9.2" AXIS_PTS_REF ldpm_fup_dif__fpapwm /end AXIS_DESCR
/end CHARACTERISTIC
/begin CHARACTERISTIC C_FPAPWM_MAX "Duty cycle maximum value" VALUE 0x67ba6 _REC_VAL_20_u1 99.609375 _CNV_A_R_LINEAR_____16_CM 0. 99.609375 FORMAT "%5.1" /end CHARACTERISTIC
/begin CHARACTERISTIC C_FUP_MIN "Fuel pressure minimum threshold, for jumping in the control mode" VALUE 0x67bae _REC_VAL_20_u2 173888. _CNV_A_R_LINEAR_____114_CM 0. 173888. FORMAT "%6.0" /end CHARACTERISTIC
/begin CHARACTERISTIC C_FUP_BOL "Fuel pressure bottom limit threshold, for jumping back in the init mode" VALUE 0x67ba8 _REC_VAL_20_u2 173888. _CNV_A_R_LINEAR_____114_CM 0. 173888. FORMAT "%6.0" /end CHARACTERISTIC
/begin CHARACTERISTIC C_FUP_MAX "Fuel pressure maximum threshold" VALUE 0x67baa _REC_VAL_20_u2 173888. _CNV_A_R_LINEAR_____114_CM 0. 173888. FORMAT "%6.0" /end CHARACTERISTIC
/begin CHARACTERISTIC C_T_DLY_FUP_MAX "Time delay for overpressure detection" VALUE 0x67c48 _REC_VAL_20_u1 2550. _CNV_A_R_LINEAR_____3_CM 0. 2550. FORMAT "%4.0" /end CHARACTERISTIC
/begin CHARACTERISTIC C_FPA_MFF_INI "Fuel flow_initialisation" VALUE 0x67ba2 _REC_VAL_20_u2 1511.232 _CNV_A_R_LINEAR_____139_CM 0. 1511.232 FORMAT "%7.2" /end CHARACTERISTIC
/begin CHARACTERISTIC C_MFP "mass flow of the mechanical pump" VALUE 0x67bee _REC_VAL_20_u2 11112. _CNV_A_R_LINEAR_____142_CM 0. 11112. FORMAT "%7.1" /end CHARACTERISTIC
/begin CHARACTERISTIC C_FPAPWM_MIN "Duty cycle minimum value" VALUE 0x67ba7 _REC_VAL_20_u1 99.609375 _CNV_A_R_LINEAR_____16_CM 0. 99.609375 FORMAT "%5.1" /end CHARACTERISTIC
/begin CHARACTERISTIC C_FPAPWM_I_MIN "I-part limitation minimum threshold" VALUE 0x67ba5 _REC_VAL_20_s1 199.21875 _CNV_A_R_LINEAR_____143_CM -100. 99.21875 FORMAT "%6.1" /end CHARACTERISTIC
/begin CHARACTERISTIC C_FPAPWM_I_MAX "I-part limitation maximum threshold" VALUE 0x67ba4 _REC_VAL_20_s1 199.21875 _CNV_A_R_LINEAR_____143_CM -100. 99.21875 FORMAT "%6.1" /end CHARACTERISTIC
/begin MEASUREMENT LV_N_MAX "Logical variable engine speed limitation active" UBYTE _CNV_S_2_RANGE______76_CM 1 100. 0. 1. ECU_ADDRESS 0x3fd50a BIT_MASK 0x1 /end MEASUREMENT
/begin CHARACTERISTIC C_TOIL_MAX_ECT "TOIL threshold for hot operation" VALUE 0x67ce8 _REC_VAL_20_u1 200. _CNV_A_R_LINEAR_____32_CM -40. 160. FORMAT "%3.0" /end CHARACTERISTIC
/begin AXIS_PTS ldpm_tqi_sp__fup_sp "" 0x61d66 TQI_SP _REC_AXS_20_u2 1023.96875 _CNV_A_R_LINEAR_____37_CM 8 0. 1023.96875 FORMAT "%7.2" /end AXIS_PTS
/begin AXIS_PTS ldpm_fpa_mff__fpapwm "" 0x61ad2 FPA_MFF _REC_AXS_20_u2 1511.232 _CNV_A_R_LINEAR_____139_CM 8 0. 1511.232 FORMAT "%7.2" /end AXIS_PTS
/begin MEASUREMENT STATE_EFP "States of electrical fuel pump function" UBYTE _CNV_S_6_RANGE_STAT_151_CM 1 100. 0. 5. ECU_ADDRESS 0x3fd846 /end MEASUREMENT
/begin AXIS_PTS ldpm_n_32_28 "" 0x61c52 N_32 _REC_AXS_20_u1 8160. _CNV_A_R_LINEAR_____15_CM 12 0. 8160. FORMAT "%4.0" /end AXIS_PTS
/begin MEASUREMENT TEMP_MMV_SUB_CAT_ECF "Calculated cat. temperature substitute value" UBYTE _CNV_A_R_LINEAR_____26_CM 1 100. -33. 987. ECU_ADDRESS 0x3fd837 FORMAT "%3.0" /end MEASUREMENT
/begin MEASUREMENT TEMP_MMV_SUB_CAT_ECF_STOP "Calculated cat. temperature substitute value at engine stop" UBYTE _CNV_A_R_LINEAR_____26_CM 1 100. -33. 987. ECU_ADDRESS 0x3fd839 FORMAT "%3.0" /end MEASUREMENT
/begin MEASUREMENT ECFPWM_ECF "Electric fan control pulse width modulation" UBYTE _CNV_A_R_LINEAR_____16_CM 1 100. 0. 99.609375 ECU_ADDRESS 0x3fd838 FORMAT "%5.1" /end MEASUREMENT
/begin MEASUREMENT N_ECF_MIN_HYS "Hysteresis of set point Electric fan seed stage" UBYTE _CNV_A_R_LINEAR_____87_CM 1 100. 0. 15.9375 ECU_ADDRESS 0x3fd83c /end MEASUREMENT
/begin MEASUREMENT N_ECF_COR "Set point Electric fan seed stage" UBYTE _CNV_A_R_LINEAR_____87_CM 1 100. 0. 15.9375 ECU_ADDRESS 0x3fd83a /end MEASUREMENT
/begin MEASUREMENT N_ECF_COR_FIL "Filter value of set point Electric fan seed stage" UBYTE _CNV_A_R_LINEAR_____87_CM 1 100. 0. 15.9375 ECU_ADDRESS 0x3fd83d /end MEASUREMENT
/begin MEASUREMENT N_PERC "Percentage filtered value of set point Electric fan seed stage" UBYTE _CNV_A_R_LINEAR_____16_CM 1 100. 0. 99.609375 ECU_ADDRESS 0x3fd83b FORMAT "%5.1" /end MEASUREMENT
/begin MEASUREMENT ECFPWM_IGK_OFF "Electric fan pulse width modulation in the self-holding phase" UBYTE _CNV_A_R_LINEAR_____16_CM 1 100. 0. 99.609375 ECU_ADDRESS 0x3fd83e FORMAT "%5.1" /end MEASUREMENT
/begin AXIS_PTS ldp_n_ecf__n_ecf_min_accin "" 0x61e91 N_ECF _REC_AXS_20_u1 15. _CNV_A_R_LINEAR_____17_CM 16 0. 15. FORMAT "%2.0" /end AXIS_PTS
/begin AXIS_PTS ldp_vs__n_ecf_vs_cor "" 0x61ea2 VS _REC_AXS_20_u1 255. _CNV_A_R_LINEAR_____43_CM 5 0. 255. FORMAT "%3.0" /end AXIS_PTS
/begin AXIS_PTS ldp_tco__temp_sub_ecf_ini "" 0x61eaf TCO _REC_AXS_20_u1 190.5 _CNV_A_R_LINEAR_____22_CM 6 -48. 142.5 FORMAT "%5.1" /end AXIS_PTS
/begin AXIS_PTS ldp_n_ecf_cor_fil__n_perc_ecf "" 0x61eb6 N_ECF_COR_FIL _REC_AXS_20_u1 15.9375 _CNV_A_R_LINEAR_____87_CM 6 0. 15.9375 FORMAT "%5.2" /end AXIS_PTS
/begin AXIS_PTS ldp_tco_ex__n_ecf "" 0x61e8a TCO_EX _REC_AXS_20_u1 190.5 _CNV_A_R_LINEAR_____22_CM 6 -48. 142.5 FORMAT "%5.1" /end AXIS_PTS
/begin CHARACTERISTIC ID_ECFPWM_IGK_OFF__TEMP_CAT_ "Map of Electric fan pulse width modulation in the self-holding phase" CURVE 0x688b7 _REC_CUR_20_u1_u1 99.609375 _CNV_A_R_LINEAR_____16_CM 0. 99.609375 FORMAT "%5.1"
 /begin AXIS_DESCR COM_AXIS TEMP_MMV_SUB_CAT_ECF _CNV_A_R_LINEAR_____26_CM 6 -33. 987. FORMAT "%3.0" AXIS_PTS_REF ldpm_temp_mmv_sub_cat_ecf_1 /end AXIS_DESCR
/end CHARACTERISTIC
/begin CHARACTERISTIC IP_N_ECF_TEMP_CAT_ "Electric fan minimum speed stage cat temperature" CURVE 0x688c3 _REC_CUR_20_u1_u1 15.9375 _CNV_A_R_LINEAR_____87_CM 0. 15.9375 FORMAT "%5.2"
 /begin AXIS_DESCR COM_AXIS TEMP_MMV_SUB_CAT_ECF _CNV_A_R_LINEAR_____26_CM 6 -33. 987. FORMAT "%3.0" AXIS_PTS_REF ldpm_temp_mmv_sub_cat_ecf_1 /end AXIS_DESCR
/end CHARACTERISTIC
/begin CHARACTERISTIC ID_N_ECF_MIN_ACCIN_ "Electric fan minimum speed stage CAN" CURVE 0x688c9 _REC_CUR_20_u1_u1 15.9375 _CNV_A_R_LINEAR_____87_CM 0. 15.9375 FORMAT "%5.2"
 /begin AXIS_DESCR COM_AXIS N_ECF _CNV_A_R_LINEAR_____17_CM 16 0. 15. FORMAT "%2.0" AXIS_PTS_REF ldp_n_ecf__n_ecf_min_accin /end AXIS_DESCR
/end CHARACTERISTIC
/begin CHARACTERISTIC IP_N_ECF_VS_COR_ "Speed correction of electric fan speed" CURVE 0x688d9 _REC_CUR_20_u1_u1 0.9960940000000002 _CNV_A_R_LINEAR_____8_CM 0. 0.996094 FORMAT "%5.3"
 /begin AXIS_DESCR COM_AXIS VS _CNV_A_R_LINEAR_____43_CM 5 0. 255. FORMAT "%3.0" AXIS_PTS_REF ldp_vs__n_ecf_vs_cor /end AXIS_DESCR
/end CHARACTERISTIC
/begin CHARACTERISTIC IP_TEMP_SUB_ECF_INI_ "Cat substitute temperature initialization map" MAP 0x688de _REC_MAP_20_u1_u1_u1 1020. _CNV_A_R_LINEAR_____26_CM -33. 987. FORMAT "%3.0"
 /begin AXIS_DESCR COM_AXIS TAM _CNV_A_R_LINEAR_____22_CM 6 -48. 142.5 FORMAT "%5.1" AXIS_PTS_REF ldp_tam__temp_sub_ecf_ini /end AXIS_DESCR
 /begin AXIS_DESCR COM_AXIS TCO _CNV_A_R_LINEAR_____22_CM 6 -48. 142.5 FORMAT "%5.1" AXIS_PTS_REF ldp_tco__temp_sub_ecf_ini /end AXIS_DESCR
/end CHARACTERISTIC
/begin CHARACTERISTIC IP_N_PERC_ECF_ "Electric fan control pulse width modulation" CURVE 0x68902 _REC_CUR_20_u1_u1 99.609375 _CNV_A_R_LINEAR_____16_CM 0. 99.609375 FORMAT "%4.1"
 /begin AXIS_DESCR COM_AXIS N_ECF_COR_FIL _CNV_A_R_LINEAR_____87_CM 6 0. 15.9375 FORMAT "%5.2" AXIS_PTS_REF ldp_n_ecf_cor_fil__n_perc_ecf /end AXIS_DESCR
/end CHARACTERISTIC
/begin CHARACTERISTIC C_TCO_HYS_CAT "TCO hysteresis" VALUE 0x68908 _REC_VAL_20_u1 60. _CNV_A_R_LINEAR_____23_CM 0. 60. FORMAT "%4.1" /end CHARACTERISTIC
/begin CHARACTERISTIC C_TOIL_HYS_CAT "TOIL hysteresis" VALUE 0x68909 _REC_VAL_20_u1 60. _CNV_A_R_LINEAR_____23_CM 0. 60. FORMAT "%4.1" /end CHARACTERISTIC
/begin CHARACTERISTIC C_CRLC_INC_CAT_ECF_ "CRLC for substitute temperature on cat warming up" VALUE 0x6890a _REC_VAL_20_u2 0.99998474 _CNV_A_R_LINEAR_____2_CM 0. 0.99998474 FORMAT "%7.5" /end CHARACTERISTIC
/begin CHARACTERISTIC C_CRLC_DEC_CAT_ECF_ "CRLC for substitute temperature on cat cooling down" VALUE 0x6890c _REC_VAL_20_u2 0.99998474 _CNV_A_R_LINEAR_____2_CM 0. 0.99998474 FORMAT "%7.5" /end CHARACTERISTIC
/begin CHARACTERISTIC C_N_ECF_HYS "Electric fan speed hysteresis" VALUE 0x6890e _REC_VAL_20_u1 15.9375 _CNV_A_R_LINEAR_____87_CM 0. 15.9375 FORMAT "%5.2" /end CHARACTERISTIC
/begin CHARACTERISTIC C_N_PERC_ECF_LGRD "Limitation gradient of C_N_PERC_ECF_LGRD" VALUE 0x6890f _REC_VAL_20_u1 25. _CNV_A_R_LINEAR_____175_CM 0. 25. FORMAT "%5.2" /end CHARACTERISTIC
/begin CHARACTERISTIC C_T_N_PERC_ECF_AS "Application correction" VALUE 0x68910 _REC_VAL_20_u1 99.60939999999999 _CNV_A_R_LINEAR_____60_CM -50. 49.6094 FORMAT "%5.1" /end CHARACTERISTIC
/begin CHARACTERISTIC C_T_N_PERC_ECF_ACT "Time condition for electric fan during self diagnostic" VALUE 0x68912 _REC_VAL_20_u1 50.8 _CNV_A_R_LINEAR_____176_CM 0.2 51. FORMAT "%4.1" /end CHARACTERISTIC
/begin CHARACTERISTIC C_T_N_ECF_AST "Time condition after start for electric fan active" VALUE 0x68911 _REC_VAL_20_u1 50.8 _CNV_A_R_LINEAR_____176_CM 0.2 51. FORMAT "%4.1" /end CHARACTERISTIC
/begin CHARACTERISTIC C_ECFPWM_MIN "Lower ECFPWM_ECF limitation" VALUE 0x68913 _REC_VAL_20_u1 99.609375 _CNV_A_R_LINEAR_____16_CM 0. 99.609375 FORMAT "%4.1" /end CHARACTERISTIC
/begin CHARACTERISTIC C_ECFPWM_MAX "Upper ECFPWM_ECF limitation" VALUE 0x68914 _REC_VAL_20_u1 99.609375 _CNV_A_R_LINEAR_____16_CM 0. 99.609375 FORMAT "%4.1" /end CHARACTERISTIC
/begin CHARACTERISTIC C_N_PERC_ACT_ECF "Set value for N_PERC_ECF" VALUE 0x68915 _REC_VAL_20_u1 99.609375 _CNV_A_R_LINEAR_____16_CM 0. 99.609375 FORMAT "%4.1" /end CHARACTERISTIC
/begin CHARACTERISTIC C_ECFPWM_ACT_ECF "Min limitation ECFPWM_ECF from speed stage C_N_PERC_ACT_ECF" VALUE 0x68916 _REC_VAL_20_u1 99.609375 _CNV_A_R_LINEAR_____16_CM 0. 99.609375 FORMAT "%4.1" /end CHARACTERISTIC
/begin CHARACTERISTIC C_TCO_EX_MAX_VS_HYS "hysteresis of temperature threshold" VALUE 0x68918 _REC_VAL_20_u1 190.5 _CNV_A_R_LINEAR_____22_CM -48. 142.5 FORMAT "%5.1" /end CHARACTERISTIC
/begin CHARACTERISTIC C_TCO_EX_MAX_VS "threshold for coolant temperature" VALUE 0x68919 _REC_VAL_20_u1 190.5 _CNV_A_R_LINEAR_____22_CM -48. 142.5 FORMAT "%5.1" /end CHARACTERISTIC
/begin CHARACTERISTIC C_VS_MAX_ACCIN "Speed condition for ACC suppression at high load" VALUE 0x67d74 _REC_VAL_20_u1 255. _CNV_A_R_LINEAR_____43_CM 0. 255. FORMAT "%3.0" /end CHARACTERISTIC
/begin AXIS_PTS ldp_vb__fpapwm_fac "" 0x61aaa VB _REC_AXS_20_u1 25.8984 _CNV_A_R_LINEAR_____42_CM 8 0. 25.8984 FORMAT "%3.1" /end AXIS_PTS
/begin MEASUREMENT N_GRD_FIL "Filtered engine speed gradient for predicted engine speed" SBYTE _CNV_A_R_LINEAR_____171_CM 1 100. -4096. 4064. ECU_ADDRESS 0x3fd94d FORMAT "%4.0" /end MEASUREMENT
/begin CHARACTERISTIC C_CRLC_N_GRD_FIL_1 "N_GRD_FIL low pass filter constant if LV_N_MAX = 0" VALUE 0x6892a _REC_VAL_20_u2 0.99998474 _CNV_A_R_LINEAR_____2_CM 0. 0.99998474 FORMAT "%7.5" /end CHARACTERISTIC
/begin CHARACTERISTIC C_CRLC_N_GRD_FIL_2 "N_GRD_FIL low pass filter constant if LV_N_MAX = 1" VALUE 0x6892c _REC_VAL_20_u2 0.99998474 _CNV_A_R_LINEAR_____2_CM 0. 0.99998474 FORMAT "%7.5" /end CHARACTERISTIC
/begin CHARACTERISTIC C_TQI_N_MAX_INC "Maximum increment for the output when limiting increasing rate" VALUE 0x6892e _REC_VAL_20_u2 1023.96875 _CNV_A_R_LINEAR_____37_CM 0. 1023.96875 FORMAT "%7.2" /end CHARACTERISTIC
/begin AXIS_PTS ldpm_gear "" 0x61ec7 GEAR _REC_AXS_20_u1 255. _CNV_A_R_LINEAR_____13_CM 9 0. 255. FORMAT "%3.0" /end AXIS_PTS
/begin CHARACTERISTIC ID_FAC_N_MAX_I_AT__GEAR "I-control parameter for N_MAX-controller automatic transmission" CURVE 0x68942 _REC_CUR_20_u2_u1 7.99987793 _CNV_A_R_LINEAR_____58_CM 0. 7.99987793 FORMAT "%6.4"
 /begin AXIS_DESCR COM_AXIS GEAR _CNV_A_R_LINEAR_____13_CM 9 0. 255. FORMAT "%3.0" AXIS_PTS_REF ldpm_gear /end AXIS_DESCR
/end CHARACTERISTIC
/begin CHARACTERISTIC ID_FAC_N_MAX_P_MT__GEAR "P-control parameter for N_MAX-controller manual transmission" CURVE 0x68939 _REC_CUR_20_u1_u1 7.96875 _CNV_A_R_LINEAR_____179_CM 0. 7.96875 FORMAT "%4.2"
 /begin AXIS_DESCR COM_AXIS GEAR _CNV_A_R_LINEAR_____13_CM 9 0. 255. FORMAT "%3.0" AXIS_PTS_REF ldpm_gear /end AXIS_DESCR
/end CHARACTERISTIC
/begin CHARACTERISTIC ID_FAC_N_MAX_I_MT__GEAR "I-control parameter for N_MAX-controller manual transmission" CURVE 0x68954 _REC_CUR_20_u2_u1 7.99987793 _CNV_A_R_LINEAR_____58_CM 0. 7.99987793 FORMAT "%6.4"
 /begin AXIS_DESCR COM_AXIS GEAR _CNV_A_R_LINEAR_____13_CM 9 0. 255. FORMAT "%3.0" AXIS_PTS_REF ldpm_gear /end AXIS_DESCR
/end CHARACTERISTIC
/begin CHARACTERISTIC ID_FAC_N_MAX_P_AT__GEAR "P-control parameter for N_MAX-controller automatic transmission" CURVE 0x68930 _REC_CUR_20_u1_u1 7.96875 _CNV_A_R_LINEAR_____179_CM 0. 7.96875 FORMAT "%4.2"
 /begin AXIS_DESCR COM_AXIS GEAR _CNV_A_R_LINEAR_____13_CM 9 0. 255. FORMAT "%3.0" AXIS_PTS_REF ldpm_gear /end AXIS_DESCR
/end CHARACTERISTIC
/begin CHARACTERISTIC ID_T_N_MAX_PRED_AT__GEAR "Prediction time for predicted engine speed for automatic transmission" CURVE 0x68966 _REC_CUR_20_u1_u1 7.96875 _CNV_A_R_LINEAR_____80_CM 0. 7.96875 FORMAT "%4.2"
 /begin AXIS_DESCR COM_AXIS GEAR _CNV_A_R_LINEAR_____13_CM 9 0. 255. FORMAT "%3.0" AXIS_PTS_REF ldpm_gear /end AXIS_DESCR
/end CHARACTERISTIC
/begin CHARACTERISTIC ID_T_N_MAX_PRED_MT__GEAR "Prediction time for predicted engine speed for manual transmission" CURVE 0x6896f _REC_CUR_20_u1_u1 7.96875 _CNV_A_R_LINEAR_____80_CM 0. 7.96875 FORMAT "%4.2"
 /begin AXIS_DESCR COM_AXIS GEAR _CNV_A_R_LINEAR_____13_CM 9 0. 255. FORMAT "%3.0" AXIS_PTS_REF ldpm_gear /end AXIS_DESCR
/end CHARACTERISTIC
/begin CHARACTERISTIC IP_N_GRD_THD__N_32 "Engine speed gradient threshold for filtering of basic engine speed gradient" CURVE 0x68978 _REC_CUR_20_u1_u1 8160. _CNV_A_R_LINEAR_____180_CM -4096. 4064. FORMAT "%5.0"
 /begin AXIS_DESCR COM_AXIS N_32 _CNV_A_R_LINEAR_____15_CM 8 0. 8160. FORMAT "%4.0" AXIS_PTS_REF ldp_n_32_n_grd_thd /end AXIS_DESCR
/end CHARACTERISTIC
/begin AXIS_PTS ldp_n_32_n_grd_thd "" 0x61ed1 N_32 _REC_AXS_20_u1 8160. _CNV_A_R_LINEAR_____15_CM 8 0. 8160. FORMAT "%4.0" /end AXIS_PTS
/begin MEASUREMENT N_GRD_FIL_FIL "Low pass filtered engine speed gradient for predicted engine speed" SBYTE _CNV_A_R_LINEAR_____171_CM 1 100. -4096. 4064. ECU_ADDRESS 0x3fd94e FORMAT "%4.0" /end MEASUREMENT
/begin MEASUREMENT LV_VS_MAX "Boolean for vehicle speed limitation active" UBYTE _CNV_S_2_RANGE______74_CM 1 100. 0. 1. ECU_ADDRESS 0x3fd50c /end MEASUREMENT
/begin MEASUREMENT N_MAX_VS_MAX "Engine speed limit in case of vehicle speed limitation" UWORD _CNV_A_R_LINEAR_____0_CM 1 100. 0. 8160. ECU_ADDRESS 0x3fce42 FORMAT "%4.0" /end MEASUREMENT
/begin MEASUREMENT VS_RATIO "Ratio between vehicle speed limit and actual vehicle speed" UWORD _CNV_A_R_LINEAR_____181_CM 1 100. 0. 31.99951171875 ECU_ADDRESS 0x3fce44 FORMAT "%7.4" /end MEASUREMENT
/begin CHARACTERISTIC IP_N_ECF "Electric fan speed stage" CURVE 0x688bd _REC_CUR_20_u1_u1 15.9375 _CNV_A_R_LINEAR_____87_CM 0. 15.9375 FORMAT "%5.2"
 /begin AXIS_DESCR COM_AXIS TCO_EX _CNV_A_R_LINEAR_____22_CM 6 -48. 142.5 FORMAT "%5.1" AXIS_PTS_REF ldp_tco_ex__n_ecf /end AXIS_DESCR
/end CHARACTERISTIC
/begin AXIS_PTS ldpm_tco_1 "" 0x61ced TCO _REC_AXS_20_u1 190.5 _CNV_A_R_LINEAR_____22_CM 6 -48. 142.5 FORMAT "%5.1" /end AXIS_PTS
/begin AXIS_PTS ldp_tam__temp_sub_ecf_ini "" 0x61ea8 TAM _REC_AXS_20_u1 190.5 _CNV_A_R_LINEAR_____22_CM 6 -48. 142.5 FORMAT "%5.1" /end AXIS_PTS
/begin CHARACTERISTIC C_VB_ECF_GRD_MAX "VB gradient for VB filtering" VALUE 0x68917 _REC_VAL_20_u1 26. _CNV_A_R_LINEAR_____188_CM 0. 26. FORMAT "%4.1" /end CHARACTERISTIC
/begin CHARACTERISTIC C_VB_ECF "Refernce VB (1.2* nominal voltage)" VALUE 0x690e0 _REC_VAL_20_u1 26. _CNV_A_R_LINEAR_____188_CM 0. 26. FORMAT "%4.1" /end CHARACTERISTIC
/begin MEASUREMENT TQI_N_MAX_1 "Intermitted indicated engine torque after considering PI-controller output" SWORD _CNV_A_R_LINEAR_____37_CM 1 100. -1024. 1023.96875 ECU_ADDRESS 0x3fce3c FORMAT "%7.1" /end MEASUREMENT
/begin MEASUREMENT TQI_N_MAX_2 "Intermitted indicated engine torque after considering PI-controller output" SWORD _CNV_A_R_LINEAR_____37_CM 1 100. -1024. 1023.96875 ECU_ADDRESS 0x3fce3e FORMAT "%7.1" /end MEASUREMENT
/begin CHARACTERISTIC C_T_EFP "Time delay to shut off the electrical fuel pump relay after ignition key off" VALUE 0x67c4e _REC_VAL_20_u2 655.35 _CNV_A_R_LINEAR_____21_CM 0. 655.35 FORMAT "%6.2" /end CHARACTERISTIC
/begin AXIS_PTS ldpm_temp_mmv_sub_cat_ecf_1 "" 0x61e83 TEMP_MMV_SUB_CAT_ECF _REC_AXS_20_u1 1020. _CNV_A_R_LINEAR_____26_CM 6 -33. 987. FORMAT "%3.0" /end AXIS_PTS
/begin CHARACTERISTIC ID_TCO_SP_ECT__N__PV_MAX "Target coolant temperature for vehicles without air conditioner" MAP 0x658f6 _REC_MAP_20_u1_u1_u1 190.5 _CNV_A_R_LINEAR_____22_CM -48. 142.5 FORMAT "%5.1"
 /begin AXIS_DESCR COM_AXIS N_32 _CNV_A_R_LINEAR_____15_CM 12 0. 8160. FORMAT "%4.0" AXIS_PTS_REF ldpm_n_32_28 /end AXIS_DESCR
 /begin AXIS_DESCR COM_AXIS PV_MAX _CNV_A_R_LINEAR_____16_CM 6 0. 99.609375 FORMAT "%5.1" AXIS_PTS_REF ldpm_pv_max_1 /end AXIS_DESCR
/end CHARACTERISTIC
/begin AXIS_PTS ldpm_pv_max_1 "" 0x6204f PV_MAX _REC_AXS_20_u1 99.609375 _CNV_A_R_LINEAR_____16_CM 6 0. 99.609375 FORMAT "%5.1" /end AXIS_PTS
/begin CHARACTERISTIC ID_TCO_SP_ECT_ACIN__N__PV_MAX "Target coolant temperature for vehicles with air conditioner" MAP 0x6593e _REC_MAP_20_u1_u1_u1 190.5 _CNV_A_R_LINEAR_____22_CM -48. 142.5 FORMAT "%5.1"
 /begin AXIS_DESCR COM_AXIS N_32 _CNV_A_R_LINEAR_____15_CM 12 0. 8160. FORMAT "%4.0" AXIS_PTS_REF ldpm_n_32_28 /end AXIS_DESCR
 /begin AXIS_DESCR COM_AXIS PV_MAX _CNV_A_R_LINEAR_____16_CM 6 0. 99.609375 FORMAT "%5.1" AXIS_PTS_REF ldpm_pv_max_1 /end AXIS_DESCR
/end CHARACTERISTIC
/begin MEASUREMENT Vnsfaktvub "" UBYTE _CNV_A_R_fak_ub_b2_224_CM 1 100. 0. 1.99219 ECU_ADDRESS 0x3fac25 FORMAT "%6.4" /end MEASUREMENT
/begin MEASUREMENT Vsa2adp "" UWORD _CNV_A_R_sprzi_q0p1_225_CM 1 100. 0. 6553.5 ECU_ADDRESS 0x3fac8c FORMAT "%3.2" /end MEASUREMENT
/begin MEASUREMENT Vsa2dwnw "" SWORD _CNV_A_R_sprzi_q0p1_225_CM 1 100. -3276.8 3276.7 ECU_ADDRESS 0x3fac32 FORMAT "%3.2" /end MEASUREMENT
/begin MEASUREMENT Vsa2dwnwkl "" UWORD _CNV_A_R_sprzi_q0p1_226_CM 1 100. -3276.8 3276.7 ECU_ADDRESS 0x3fac34 FORMAT "%7.1" /end MEASUREMENT
/begin MEASUREMENT Vsa2spri "Actual valve spread angle exhaust cam 1" UWORD _CNV_A_R_sprzi_q0p1_225_CM 1 100. 0. 6553.5 ECU_ADDRESS 0x3fac36 FORMAT "%3.2" /end MEASUREMENT
/begin MEASUREMENT Vsa2spris "" UWORD _CNV_A_R_sprzi_q0p1_225_CM 1 100. 0. 6553.5 ECU_ADDRESS 0x3fac38 FORMAT "%3.2" /end MEASUREMENT
/begin MEASUREMENT Vsa2sprs "" UWORD _CNV_A_R_sprzi_q0p1_225_CM 1 100. 0. 6553.5 ECU_ADDRESS 0x3fac3a FORMAT "%3.2" /end MEASUREMENT
/begin MEASUREMENT Vsa2tv "" UWORD _CNV_A_R_vnstv_q0p0_227_CM 1 100. 0. 655.35 ECU_ADDRESS 0x3fac3c FORMAT "%7.5" /end MEASUREMENT
/begin MEASUREMENT Vsa2tv_i "" UWORD _CNV_A_R_vnstv_q0p0_228_CM 1 100. -100. 99.9969 ECU_ADDRESS 0x3fac3e FORMAT "%7.3" /end MEASUREMENT
/begin MEASUREMENT Vsa2tv_p "" UWORD _CNV_A_R_vnstv_q0p0_228_CM 1 100. -100. 99.9969 ECU_ADDRESS 0x3fac40 FORMAT "%7.3" /end MEASUREMENT
/begin MEASUREMENT Vsa2vg "" SWORD _CNV_A_R_sprzivg_q0_229_CM 1 100. -25600. 25599.2 ECU_ADDRESS 0x3fac42 /end MEASUREMENT
/begin MEASUREMENT Vsadwnwkl "" UWORD _CNV_A_R_sprzi_q0p1_226_CM 1 100. -3276.8 3276.7 ECU_ADDRESS 0x3fac44 FORMAT "%7.1" /end MEASUREMENT
/begin MEASUREMENT Vsaspris "" UWORD _CNV_A_R_sprzi_q0p1_225_CM 1 100. 0. 6553.5 ECU_ADDRESS 0x3fac46 FORMAT "%3.2" /end MEASUREMENT
/begin MEASUREMENT Vsa_adp "" UWORD _CNV_A_R_sprzi_q0p1_225_CM 1 100. 0. 6553.5 ECU_ADDRESS 0x3fac8e FORMAT "%3.2" /end MEASUREMENT
/begin MEASUREMENT Vsa_dwnw "" SWORD _CNV_A_R_sprzi_q0p1_225_CM 1 100. -3276.8 3276.7 ECU_ADDRESS 0x3fac48 FORMAT "%3.2" /end MEASUREMENT
/begin MEASUREMENT Vsa_spri "Actual valve spread angle exhaust cam 0" UWORD _CNV_A_R_sprzi_q0p1_225_CM 1 100. 0. 6553.5 ECU_ADDRESS 0x3fac4a FORMAT "%3.2" /end MEASUREMENT
/begin MEASUREMENT Vsa_sprs "" UWORD _CNV_A_R_sprzi_q0p1_225_CM 1 100. 0. 6553.5 ECU_ADDRESS 0x3fac4c FORMAT "%3.2" /end MEASUREMENT
/begin MEASUREMENT Vsa_tv "" UWORD _CNV_A_R_vnstv_q0p0_227_CM 1 100. 0. 655.35 ECU_ADDRESS 0x3fac4e FORMAT "%7.5" /end MEASUREMENT
/begin MEASUREMENT Vsa_tv_i "" UWORD _CNV_A_R_vnstv_q0p0_228_CM 1 100. -100. 99.9969 ECU_ADDRESS 0x3fac50 FORMAT "%7.3" /end MEASUREMENT
/begin MEASUREMENT Vsa_tv_p "" UWORD _CNV_A_R_vnstv_q0p0_228_CM 1 100. -100. 99.9969 ECU_ADDRESS 0x3fac52 FORMAT "%7.3" /end MEASUREMENT
/begin MEASUREMENT Vsa_vg "" SWORD _CNV_A_R_sprzivg_q0_229_CM 1 100. -25600. 25599.2 ECU_ADDRESS 0x3fac54 /end MEASUREMENT
/begin MEASUREMENT Vse2adp "" UWORD _CNV_A_R_sprzi_q0p1_225_CM 1 100. 0. 6553.5 ECU_ADDRESS 0x3fac90 FORMAT "%3.2" /end MEASUREMENT
/begin MEASUREMENT Vse2dwnw "" SWORD _CNV_A_R_sprzi_q0p1_225_CM 1 100. -3276.8 3276.7 ECU_ADDRESS 0x3fac56 FORMAT "%3.2" /end MEASUREMENT
/begin MEASUREMENT Vse2dwnwkl "" UWORD _CNV_A_R_sprzi_q0p1_226_CM 1 100. -3276.8 3276.7 ECU_ADDRESS 0x3fac58 FORMAT "%7.1" /end MEASUREMENT
/begin MEASUREMENT Vse2spri "Actual valve spread angle inlet cam 1" UWORD _CNV_A_R_sprzi_q0p1_225_CM 1 100. 0. 6553.5 ECU_ADDRESS 0x3fac5a FORMAT "%3.2" /end MEASUREMENT
/begin MEASUREMENT Vse2spris "" UWORD _CNV_A_R_sprzi_q0p1_225_CM 1 100. 0. 6553.5 ECU_ADDRESS 0x3fac5c FORMAT "%3.2" /end MEASUREMENT
/begin MEASUREMENT Vse2sprs "" UWORD _CNV_A_R_sprzi_q0p1_225_CM 1 100. 0. 6553.5 ECU_ADDRESS 0x3fac5e FORMAT "%3.2" /end MEASUREMENT
/begin MEASUREMENT Vse2tv "" UWORD _CNV_A_R_vnstv_q0p0_227_CM 1 100. 0. 655.35 ECU_ADDRESS 0x3fac60 FORMAT "%7.5" /end MEASUREMENT
/begin MEASUREMENT Vse2tv_i "" UWORD _CNV_A_R_vnstv_q0p0_228_CM 1 100. -100. 99.9969 ECU_ADDRESS 0x3fac62 FORMAT "%7.3" /end MEASUREMENT
/begin MEASUREMENT Vse2vg "" SWORD _CNV_A_R_sprzivg_q0_229_CM 1 100. -25600. 25599.2 ECU_ADDRESS 0x3fac66 /end MEASUREMENT
/begin MEASUREMENT Vsedwnwkl "" UWORD _CNV_A_R_sprzi_q0p1_226_CM 1 100. -3276.8 3276.7 ECU_ADDRESS 0x3fac68 FORMAT "%7.1" /end MEASUREMENT
/begin MEASUREMENT Vsespris "" UWORD _CNV_A_R_sprzi_q0p1_225_CM 1 100. 0. 6553.5 ECU_ADDRESS 0x3fac6a FORMAT "%3.2" /end MEASUREMENT
/begin MEASUREMENT Vse_adp "" UWORD _CNV_A_R_sprzi_q0p1_225_CM 1 100. 0. 6553.5 ECU_ADDRESS 0x3fac92 FORMAT "%3.2" /end MEASUREMENT
/begin MEASUREMENT Vse_dwnw "" SWORD _CNV_A_R_sprzi_q0p1_225_CM 1 100. -3276.8 3276.7 ECU_ADDRESS 0x3fac6c FORMAT "%3.2" /end MEASUREMENT
/begin MEASUREMENT Vse_spri "Actual valve spread angle inlet cam 0" UWORD _CNV_A_R_sprzi_q0p1_225_CM 1 100. 0. 6553.5 ECU_ADDRESS 0x3fac6e FORMAT "%3.2" /end MEASUREMENT
/begin MEASUREMENT Vse_sprs "" UWORD _CNV_A_R_sprzi_q0p1_225_CM 1 100. 0. 6553.5 ECU_ADDRESS 0x3fac70 FORMAT "%3.2" /end MEASUREMENT
/begin MEASUREMENT Vse_tv "" UWORD _CNV_A_R_vnstv_q0p0_227_CM 1 100. 0. 655.35 ECU_ADDRESS 0x3fac72 FORMAT "%7.5" /end MEASUREMENT
/begin MEASUREMENT Vse_tv_i "" UWORD _CNV_A_R_vnstv_q0p0_228_CM 1 100. -100. 99.9969 ECU_ADDRESS 0x3fac74 FORMAT "%7.3" /end MEASUREMENT
/begin MEASUREMENT Vse_tv_p "" UWORD _CNV_A_R_vnstv_q0p0_228_CM 1 100. -100. 99.9969 ECU_ADDRESS 0x3fac76 FORMAT "%7.3" /end MEASUREMENT
/begin MEASUREMENT Vse_vg "" SWORD _CNV_A_R_sprzivg_q0_229_CM 1 100. -25600. 25599.2 ECU_ADDRESS 0x3fac78 /end MEASUREMENT
/begin MEASUREMENT wnwi_w "" SWORD _CNV_A_R_wkw_sw_b12_230_CM 1 100. -128. 127.996 ECU_ADDRESS 0x3faa70 FORMAT "%7.5" /end MEASUREMENT
/begin CHARACTERISTIC ESP_ADPWF "" VALUE 0x6db2a _REC_VAL_20_u2 6554. _CNV_A_R_sprzi_q0p1_225_CM 0. 6554. FORMAT "%3.2" /end CHARACTERISTIC
/begin CHARACTERISTIC ESP_BA "" VALUE 0x6db20 _REC_VAL_20_u1 255. _CNV_A_R_LINEAR_____17_CM 0. 255. FORMAT "%3.0" /end CHARACTERISTIC
/begin CHARACTERISTIC ESP_ADTV "" VALUE 0x6db1f _REC_VAL_20_u1 255. _CNV_A_R_LINEAR_____17_CM 0. 255. FORMAT "%3.0" /end CHARACTERISTIC
/begin CHARACTERISTIC ESP_TVHB "" VALUE 0x6db21 _REC_VAL_20_u1 255. _CNV_A_R_LINEAR_____17_CM 0. 255. FORMAT "%3.0" /end CHARACTERISTIC
/begin CHARACTERISTIC ESP_WNWS "" VALUE 0x6db2c _REC_VAL_20_u2 6554. _CNV_A_R_sprzi_q0p1_225_CM 0. 6554. FORMAT "%3.2" /end CHARACTERISTIC
/begin CHARACTERISTIC VNSRTVMX "" VALUE 0x6db34 _REC_VAL_20_s2 199.9969 _CNV_A_R_LINEAR_____78_CM -100. 99.9969 FORMAT "%7.5" /end CHARACTERISTIC
/begin CHARACTERISTIC VNSRTVMN "" VALUE 0x6db32 _REC_VAL_20_s2 199.9969 _CNV_A_R_LINEAR_____78_CM -100. 99.9969 FORMAT "%7.5" /end CHARACTERISTIC
/begin CHARACTERISTIC VNSRTVIMX "" VALUE 0x6db30 _REC_VAL_20_u2 199.9969 _CNV_A_R_vnstv_q0p0_228_CM -100. 99.9969 FORMAT "%7.3" /end CHARACTERISTIC
/begin CHARACTERISTIC VNSRTVIMN "" VALUE 0x6db2e _REC_VAL_20_u2 199.9969 _CNV_A_R_vnstv_q0p0_228_CM -100. 99.9969 FORMAT "%7.3" /end CHARACTERISTIC
/begin CHARACTERISTIC SPRZG_AN_0_ "" VALUE 0x6db42 _REC_VAL_20_u2 6554. _CNV_A_R_sprzi_q0p1_225_CM 0. 6554. FORMAT "%3.2" /end CHARACTERISTIC
/begin CHARACTERISTIC SPRZG_AN_1_ "" VALUE 0x6db44 _REC_VAL_20_u2 6554. _CNV_A_R_sprzi_q0p1_225_CM 0. 6554. FORMAT "%3.2" /end CHARACTERISTIC
/begin CHARACTERISTIC SPRZG_AN_2_ "" VALUE 0x6db46 _REC_VAL_20_u2 6554. _CNV_A_R_sprzi_q0p1_225_CM 0. 6554. FORMAT "%3.2" /end CHARACTERISTIC
/begin CHARACTERISTIC SPRZG_AN_3_ "" VALUE 0x6db48 _REC_VAL_20_u2 6554. _CNV_A_R_sprzi_q0p1_225_CM 0. 6554. FORMAT "%3.2" /end CHARACTERISTIC
/begin CHARACTERISTIC NW_MIN_0_ "" VALUE 0x6db3a _REC_VAL_20_u2 6554. _CNV_A_R_sprzi_q0p1_225_CM 0. 6554. FORMAT "%3.2" /end CHARACTERISTIC
/begin CHARACTERISTIC NW_MIN_1_ "" VALUE 0x6db3c _REC_VAL_20_u2 6554. _CNV_A_R_sprzi_q0p1_225_CM 0. 6554. FORMAT "%3.2" /end CHARACTERISTIC
/begin CHARACTERISTIC NW_MIN_2_ "" VALUE 0x6db3e _REC_VAL_20_u2 6554. _CNV_A_R_sprzi_q0p1_225_CM 0. 6554. FORMAT "%3.2" /end CHARACTERISTIC
/begin CHARACTERISTIC NW_MIN_3_ "" VALUE 0x6db40 _REC_VAL_20_u2 6554. _CNV_A_R_sprzi_q0p1_225_CM 0. 6554. FORMAT "%3.2" /end CHARACTERISTIC
/begin CHARACTERISTIC VNS_ADT "" VALUE 0x6db38 _REC_VAL_20_u1 255. _CNV_A_R_LINEAR_____20_CM 0. 255. FORMAT "%6.4" /end CHARACTERISTIC
/begin CHARACTERISTIC ASP_ADPWF "" VALUE 0x6db24 _REC_VAL_20_u2 6554. _CNV_A_R_sprzi_q0p1_225_CM 0. 6554. FORMAT "%3.2" /end CHARACTERISTIC
/begin CHARACTERISTIC ASP_BA "" VALUE 0x6db1d _REC_VAL_20_u1 255. _CNV_A_R_LINEAR_____17_CM 0. 255. FORMAT "%3.0" /end CHARACTERISTIC
/begin CHARACTERISTIC ASP_ADTV "" VALUE 0x6db1c _REC_VAL_20_u1 255. _CNV_A_R_LINEAR_____17_CM 0. 255. FORMAT "%3.0" /end CHARACTERISTIC
/begin CHARACTERISTIC ASP_TVHB "" VALUE 0x6db1e _REC_VAL_20_u1 255. _CNV_A_R_LINEAR_____17_CM 0. 255. FORMAT "%3.0" /end CHARACTERISTIC
/begin CHARACTERISTIC ASP_WNWSASP_WNWS "" VALUE 0x6db26 _REC_VAL_20_u2 6554. _CNV_A_R_sprzi_q0p1_225_CM 0. 6554. FORMAT "%3.2" /end CHARACTERISTIC
/begin CHARACTERISTIC ESP2ADPWF "" VALUE 0x6db28 _REC_VAL_20_u2 6554. _CNV_A_R_sprzi_q0p1_225_CM 0. 6554. FORMAT "%3.2" /end CHARACTERISTIC
/begin CHARACTERISTIC ASP2ADPWF "" VALUE 0x6db22 _REC_VAL_20_u2 6554. _CNV_A_R_sprzi_q0p1_225_CM 0. 6554. FORMAT "%3.2" /end CHARACTERISTIC
/begin CHARACTERISTIC KLRANWI "" CURVE 0x6db5a _REC_CUR_32_u2_u2 199.9969482421875 _CNV_A_R_vnstv_q0p0_228_CM -100. 99.9969482421875 FORMAT "%7.3"
 /begin AXIS_DESCR STD_AXIS Vsadwnwkl _CNV_A_R_sprzi_q0p1_226_CM 16 -3276.8 3276.7 FORMAT "%7.1" /end AXIS_DESCR
/end CHARACTERISTIC
/begin CHARACTERISTIC KLRANWP "" CURVE 0x6db9c _REC_CUR_32_u2_u2 199.9969482421875 _CNV_A_R_vnstv_q0p0_228_CM -100. 99.9969482421875 FORMAT "%7.3"
 /begin AXIS_DESCR STD_AXIS Vsadwnwkl _CNV_A_R_sprzi_q0p1_226_CM 16 -3276.8 3276.7 FORMAT "%7.1" /end AXIS_DESCR
/end CHARACTERISTIC
/begin CHARACTERISTIC KLRENWI "" CURVE 0x6dbde _REC_CUR_32_u2_u2 199.9969482421875 _CNV_A_R_vnstv_q0p0_228_CM -100. 99.9969482421875 FORMAT "%7.3"
 /begin AXIS_DESCR STD_AXIS Vsedwnwkl _CNV_A_R_sprzi_q0p1_226_CM 16 -3276.8 3276.7 FORMAT "%7.1" /end AXIS_DESCR
/end CHARACTERISTIC
/begin CHARACTERISTIC KLRENWP "" CURVE 0x6dc20 _REC_CUR_32_u2_u2 199.9969482421875 _CNV_A_R_vnstv_q0p0_228_CM -100. 99.9969482421875 FORMAT "%7.3"
 /begin AXIS_DESCR STD_AXIS Vsedwnwkl _CNV_A_R_sprzi_q0p1_226_CM 16 -3276.8 3276.7 FORMAT "%7.1" /end AXIS_DESCR
/end CHARACTERISTIC
/begin CHARACTERISTIC KLVNSTVUB "" CURVE 0x6db4c _REC_CUR_32_u1_u1 1.9921875 _CNV_A_R_fak_ub_b2_224_CM 0. 1.9921875 FORMAT "%6.4" /begin AXIS_DESCR STD_AXIS ub _CNV_A_R_spg_ubatt_223_CM 6 0. 24.021 /end AXIS_DESCR /end CHARACTERISTIC
/begin MEASUREMENT Vse2tv_p "" UWORD _CNV_A_R_vnstv_q0p0_228_CM 1 100. -100. 99.9969 ECU_ADDRESS 0x3fac64 FORMAT "%7.3" /end MEASUREMENT
/begin MEASUREMENT VSA2ADP_FL_0__A "" SBYTE _CNV_A_R_sprzi_q0p0_231_CM 1 100. -6.4 6.35 ECU_ADDRESS 0x3fac7c FORMAT "%3.2" /end MEASUREMENT
/begin MEASUREMENT VSA2ADP_FL_1__A "" SBYTE _CNV_A_R_sprzi_q0p0_231_CM 1 100. -6.4 6.35 ECU_ADDRESS 0x3fac7d FORMAT "%3.2" /end MEASUREMENT
/begin MEASUREMENT VSA2ADP_FL_2__A "" SBYTE _CNV_A_R_sprzi_q0p0_231_CM 1 100. -6.4 6.35 ECU_ADDRESS 0x3fac7e FORMAT "%3.2" /end MEASUREMENT
/begin MEASUREMENT VSA2ADP_FL_3__A "" SBYTE _CNV_A_R_sprzi_q0p0_231_CM 1 100. -6.4 6.35 ECU_ADDRESS 0x3fac7f FORMAT "%3.2" /end MEASUREMENT
/begin MEASUREMENT NW_POS_0__A "" UWORD _CNV_A_R_sprzi_q0p1_225_CM 1 100. 0. 6553.5 ECU_ADDRESS 0x3fac2a FORMAT "%3.2" /end MEASUREMENT
/begin MEASUREMENT NW_POS_1__A "" UWORD _CNV_A_R_sprzi_q0p1_225_CM 1 100. 0. 6553.5 ECU_ADDRESS 0x3fac2c FORMAT "%3.2" /end MEASUREMENT
/begin MEASUREMENT NW_POS_2__A "" UWORD _CNV_A_R_sprzi_q0p1_225_CM 1 100. 0. 6553.5 ECU_ADDRESS 0x3fac2e FORMAT "%3.2" /end MEASUREMENT
/begin MEASUREMENT NW_POS_3__A "" UWORD _CNV_A_R_sprzi_q0p1_225_CM 1 100. 0. 6553.5 ECU_ADDRESS 0x3fac30 FORMAT "%3.2" /end MEASUREMENT
/begin MEASUREMENT VSE2ADP_FL_0__A "" SBYTE _CNV_A_R_sprzi_q0p0_231_CM 1 100. -6.4 6.35 ECU_ADDRESS 0x3fac84 FORMAT "%3.2" /end MEASUREMENT
/begin MEASUREMENT VSE2ADP_FL_1__A "" SBYTE _CNV_A_R_sprzi_q0p0_231_CM 1 100. -6.4 6.35 ECU_ADDRESS 0x3fac85 FORMAT "%3.2" /end MEASUREMENT
/begin MEASUREMENT VSE2ADP_FL_2__A "" SBYTE _CNV_A_R_sprzi_q0p0_231_CM 1 100. -6.4 6.35 ECU_ADDRESS 0x3fac86 FORMAT "%3.2" /end MEASUREMENT
/begin MEASUREMENT VSE2ADP_FL_3__A "" SBYTE _CNV_A_R_sprzi_q0p0_231_CM 1 100. -6.4 6.35 ECU_ADDRESS 0x3fac87 FORMAT "%3.2" /end MEASUREMENT
/begin MEASUREMENT VSA_ADP_FL_0__A "" SBYTE _CNV_A_R_sprzi_q0p0_231_CM 1 100. -6.4 6.35 ECU_ADDRESS 0x3fac80 FORMAT "%3.2" /end MEASUREMENT
/begin MEASUREMENT VSA_ADP_FL_1__A "" SBYTE _CNV_A_R_sprzi_q0p0_231_CM 1 100. -6.4 6.35 ECU_ADDRESS 0x3fac81 FORMAT "%3.2" /end MEASUREMENT
/begin MEASUREMENT VSA_ADP_FL_2__A "" SBYTE _CNV_A_R_sprzi_q0p0_231_CM 1 100. -6.4 6.35 ECU_ADDRESS 0x3fac82 FORMAT "%3.2" /end MEASUREMENT
/begin MEASUREMENT VSA_ADP_FL_3__A "" SBYTE _CNV_A_R_sprzi_q0p0_231_CM 1 100. -6.4 6.35 ECU_ADDRESS 0x3fac83 FORMAT "%3.2" /end MEASUREMENT
/begin MEASUREMENT VSE_ADP_FL_0__A "" SBYTE _CNV_A_R_sprzi_q0p0_231_CM 1 100. -6.4 6.35 ECU_ADDRESS 0x3fac88 FORMAT "%3.2" /end MEASUREMENT
/begin MEASUREMENT VSE_ADP_FL_1__A "" SBYTE _CNV_A_R_sprzi_q0p0_231_CM 1 100. -6.4 6.35 ECU_ADDRESS 0x3fac89 FORMAT "%3.2" /end MEASUREMENT
/begin MEASUREMENT VSE_ADP_FL_2__A "" SBYTE _CNV_A_R_sprzi_q0p0_231_CM 1 100. -6.4 6.35 ECU_ADDRESS 0x3fac8a FORMAT "%3.2" /end MEASUREMENT
/begin MEASUREMENT VSE_ADP_FL_3__A "" SBYTE _CNV_A_R_sprzi_q0p0_231_CM 1 100. -6.4 6.35 ECU_ADDRESS 0x3fac8b FORMAT "%3.2" /end MEASUREMENT
/begin MEASUREMENT Vsa2stat "" UBYTE _CNV_A_R_LINEAR_____17_CM 1 100. 0. 255. ECU_ADDRESS 0x3fac26 FORMAT "%3.0" /end MEASUREMENT
/begin MEASUREMENT B2VSAADERR "" UBYTE _CNV_S_2_B_TRUE_222_CM 1 100. 0. 1. ECU_ADDRESS 0x3fac26 BIT_MASK 0x1000 /end MEASUREMENT
/begin MEASUREMENT B2VSAADNOK "" UBYTE _CNV_S_2_B_TRUE_222_CM 1 100. 0. 1. ECU_ADDRESS 0x3fac26 BIT_MASK 0x10000 /end MEASUREMENT
/begin MEASUREMENT B2VSAADP "" UBYTE _CNV_S_2_B_TRUE_222_CM 1 100. 0. 1. ECU_ADDRESS 0x3fac26 BIT_MASK 0x1 /end MEASUREMENT
/begin MEASUREMENT VSE2STAT "" UBYTE _CNV_A_R_LINEAR_____17_CM 1 100. 0. 255. ECU_ADDRESS 0x3fac28 FORMAT "%3.0" /end MEASUREMENT
/begin MEASUREMENT B2VSEADERR "" UBYTE _CNV_S_2_B_TRUE_222_CM 1 100. 0. 1. ECU_ADDRESS 0x3fac28 BIT_MASK 0x1000 /end MEASUREMENT
/begin MEASUREMENT B2VSEADNOK "" UBYTE _CNV_S_2_B_TRUE_222_CM 1 100. 0. 1. ECU_ADDRESS 0x3fac28 BIT_MASK 0x10000 /end MEASUREMENT
/begin MEASUREMENT B2VSEADP "" UBYTE _CNV_S_2_B_TRUE_222_CM 1 100. 0. 1. ECU_ADDRESS 0x3fac28 BIT_MASK 0x1 /end MEASUREMENT
/begin MEASUREMENT VSE_STAT "" UBYTE _CNV_A_R_LINEAR_____17_CM 1 100. 0. 255. ECU_ADDRESS 0x3fac29 FORMAT "%3.0" /end MEASUREMENT
/begin MEASUREMENT B_VSEADERR "" UBYTE _CNV_S_2_B_TRUE_222_CM 1 100. 0. 1. ECU_ADDRESS 0x3fac29 BIT_MASK 0x1000 /end MEASUREMENT
/begin MEASUREMENT B_VSEADNOK "" UBYTE _CNV_S_2_B_TRUE_222_CM 1 100. 0. 1. ECU_ADDRESS 0x3fac29 BIT_MASK 0x10000 /end MEASUREMENT
/begin MEASUREMENT B_VSEADP "" UBYTE _CNV_S_2_B_TRUE_222_CM 1 100. 0. 1. ECU_ADDRESS 0x3fac29 BIT_MASK 0x1 /end MEASUREMENT
/begin MEASUREMENT VSA_STAT "" UBYTE _CNV_A_R_LINEAR_____17_CM 1 100. 0. 255. ECU_ADDRESS 0x3fac27 FORMAT "%3.0" /end MEASUREMENT
/begin MEASUREMENT B_VSAADERR "" UBYTE _CNV_S_2_B_TRUE_222_CM 1 100. 0. 1. ECU_ADDRESS 0x3fac27 BIT_MASK 0x1000 /end MEASUREMENT
/begin MEASUREMENT B_VSAADNOK "" UBYTE _CNV_S_2_B_TRUE_222_CM 1 100. 0. 1. ECU_ADDRESS 0x3fac27 BIT_MASK 0x10000 /end MEASUREMENT
/begin MEASUREMENT B_VSAADP "" UBYTE _CNV_S_2_B_TRUE_222_CM 1 100. 0. 1. ECU_ADDRESS 0x3fac27 BIT_MASK 0x1 /end MEASUREMENT
/begin MEASUREMENT TMOT "" UBYTE _CNV_A_R_LINEAR_____232_CM 1 100. -48. 143.25 ECU_ADDRESS 0x3fd9f9 FORMAT "%8.4" /end MEASUREMENT
/begin MEASUREMENT NWPOS_TKOR "" SBYTE _CNV_R_R_sprzi_q0p1_233_CM 1 100. -12.8 12.7 ECU_ADDRESS 0x3fadd9 FORMAT "%3.2" /end MEASUREMENT
/begin MEASUREMENT NWPOS_NKOR "" SBYTE _CNV_R_R_sprzi_q0p1_233_CM 1 100. -12.8 12.7 ECU_ADDRESS 0x3fadd8 FORMAT "%3.2" /end MEASUREMENT
/begin CHARACTERISTIC VNS_ADEND "" VALUE 0x6db36 _REC_VAL_20_u2 655.35 _CNV_A_R_LINEAR_____20_CM 0. 655.35 FORMAT "%8.4" /end CHARACTERISTIC
/begin CHARACTERISTIC NW3FLANKE_0_ "" VALUE 0x6d832 _REC_VAL_20_u2 6554. _CNV_R_R_sprzi_q0p1_233_CM 0. 6554. FORMAT "%3.2" /end CHARACTERISTIC
/begin CHARACTERISTIC NW3FLANKE_1_ "" VALUE 0x6d834 _REC_VAL_20_u2 6554. _CNV_R_R_sprzi_q0p1_233_CM 0. 6554. FORMAT "%3.2" /end CHARACTERISTIC
/begin CHARACTERISTIC NW3FLANKE_2_ "" VALUE 0x6d836 _REC_VAL_20_u2 6554. _CNV_R_R_sprzi_q0p1_233_CM 0. 6554. FORMAT "%3.2" /end CHARACTERISTIC
/begin CHARACTERISTIC NW3FLANKE_3_ "" VALUE 0x6d838 _REC_VAL_20_u2 6554. _CNV_R_R_sprzi_q0p1_233_CM 0. 6554. FORMAT "%3.2" /end CHARACTERISTIC
/begin CHARACTERISTIC NW2FLANKE_0_ "" VALUE 0x6d82a _REC_VAL_20_u2 6554. _CNV_R_R_sprzi_q0p1_233_CM 0. 6554. FORMAT "%3.2" /end CHARACTERISTIC
/begin CHARACTERISTIC NW2FLANKE_1_ "" VALUE 0x6d82c _REC_VAL_20_u2 6554. _CNV_R_R_sprzi_q0p1_233_CM 0. 6554. FORMAT "%3.2" /end CHARACTERISTIC
/begin CHARACTERISTIC NW2FLANKE_2_ "" VALUE 0x6d82e _REC_VAL_20_u2 6554. _CNV_R_R_sprzi_q0p1_233_CM 0. 6554. FORMAT "%3.2" /end CHARACTERISTIC
/begin CHARACTERISTIC NW2FLANKE_3_ "" VALUE 0x6d830 _REC_VAL_20_u2 6554. _CNV_R_R_sprzi_q0p1_233_CM 0. 6554. FORMAT "%3.2" /end CHARACTERISTIC
/begin CHARACTERISTIC NW1FLANKE_0_ "" VALUE 0x6d822 _REC_VAL_20_u2 6554. _CNV_R_R_sprzi_q0p1_233_CM 0. 6554. FORMAT "%3.2" /end CHARACTERISTIC
/begin CHARACTERISTIC NW1FLANKE_1_ "" VALUE 0x6d824 _REC_VAL_20_u2 6554. _CNV_R_R_sprzi_q0p1_233_CM 0. 6554. FORMAT "%3.2" /end CHARACTERISTIC
/begin CHARACTERISTIC NW1FLANKE_2_ "" VALUE 0x6d826 _REC_VAL_20_u2 6554. _CNV_R_R_sprzi_q0p1_233_CM 0. 6554. FORMAT "%3.2" /end CHARACTERISTIC
/begin CHARACTERISTIC NW1FLANKE_3_ "" VALUE 0x6d828 _REC_VAL_20_u2 6554. _CNV_R_R_sprzi_q0p1_233_CM 0. 6554. FORMAT "%3.2" /end CHARACTERISTIC
/begin CHARACTERISTIC NW0FLANKE_0_ "" VALUE 0x6d81a _REC_VAL_20_u2 6554. _CNV_R_R_sprzi_q0p1_233_CM 0. 6554. FORMAT "%3.2" /end CHARACTERISTIC
/begin CHARACTERISTIC NW0FLANKE_1_ "" VALUE 0x6d81c _REC_VAL_20_u2 6554. _CNV_R_R_sprzi_q0p1_233_CM 0. 6554. FORMAT "%3.2" /end CHARACTERISTIC
/begin CHARACTERISTIC NW0FLANKE_2_ "" VALUE 0x6d81e _REC_VAL_20_u2 6554. _CNV_R_R_sprzi_q0p1_233_CM 0. 6554. FORMAT "%3.2" /end CHARACTERISTIC
/begin CHARACTERISTIC NW0FLANKE_3_ "" VALUE 0x6d820 _REC_VAL_20_u2 6554. _CNV_R_R_sprzi_q0p1_233_CM 0. 6554. FORMAT "%3.2" /end CHARACTERISTIC
/begin CHARACTERISTIC NWSEGOFFS_0_ "" VALUE 0x6d83a _REC_VAL_20_u2 180. _CNV_R_R_sprzi_q0p1_233_CM 0. 180. FORMAT "%3.2" /end CHARACTERISTIC
/begin CHARACTERISTIC NWSEGOFFS_1_ "" VALUE 0x6d83c _REC_VAL_20_u2 180. _CNV_R_R_sprzi_q0p1_233_CM 0. 180. FORMAT "%3.2" /end CHARACTERISTIC
/begin CHARACTERISTIC NWSEGOFFS_2_ "" VALUE 0x6d83e _REC_VAL_20_u2 180. _CNV_R_R_sprzi_q0p1_233_CM 0. 180. FORMAT "%3.2" /end CHARACTERISTIC
/begin CHARACTERISTIC NWSEGOFFS_3_ "" VALUE 0x6d840 _REC_VAL_20_u2 180. _CNV_R_R_sprzi_q0p1_233_CM 0. 180. FORMAT "%3.2" /end CHARACTERISTIC
/begin CHARACTERISTIC KLNWPOST "" CURVE 0x6d80d _REC_CUR_32_u1_u1 25.5 _CNV_R_R_sprzi_q0p1_234_CM -12.8 12.7 FORMAT "%6.5"
 /begin AXIS_DESCR STD_AXIS tmot _CNV_A_R_LINEAR_____232_CM 6 -48. 143.25 FORMAT "%8.4" /end AXIS_DESCR
/end CHARACTERISTIC
/begin CHARACTERISTIC KLNWPOSN "" CURVE 0x6d800 _REC_CUR_32_u1_u1 25.5 _CNV_R_R_sprzi_q0p1_234_CM -12.8 12.7 FORMAT "%6.5"
 /begin AXIS_DESCR STD_AXIS nmot _CNV_A_R_nmot_ub_q4_235_CM 6 0. 10200. FORMAT "%5.0" /end AXIS_DESCR
/end CHARACTERISTIC
/begin MEASUREMENT St_di "" UBYTE _CNV_A_R_LINEAR_____17_CM 1 100. 0. 255. ECU_ADDRESS 0x3fdb91 FORMAT "%3.0" /end MEASUREMENT
/begin MEASUREMENT B_disa "" UBYTE _CNV_S_2_B_TRUE_222_CM 1 100. 0. 1. ECU_ADDRESS 0x3fdb91 BIT_MASK 0x1 /end MEASUREMENT
/begin MEASUREMENT B_di_ausschalt "" UBYTE _CNV_S_2_B_TRUE_222_CM 1 100. 0. 1. ECU_ADDRESS 0x3fdb91 BIT_MASK 0x2 /end MEASUREMENT
/begin MEASUREMENT B_di_einschalt "" UBYTE _CNV_S_2_B_TRUE_222_CM 1 100. 0. 1. ECU_ADDRESS 0x3fdb91 BIT_MASK 0x4 /end MEASUREMENT
/begin MEASUREMENT Di "" UBYTE _CNV_A_R_LINEAR_____17_CM 1 100. 0. 255. ECU_ADDRESS 0x3fdb8c FORMAT "%3.0" /end MEASUREMENT
/begin MEASUREMENT Disa_soll "" UBYTE _CNV_A_R_LINEAR_____16_CM 1 100. 0. 99.60939999999999 ECU_ADDRESS 0x3fdb8f FORMAT "%5.2" /end MEASUREMENT
/begin MEASUREMENT Disaaus_i "" UWORD _CNV_A_R_vnstv_q0p0_228_CM 1 100. -100. 99.9969 ECU_ADDRESS 0x3fdb92 FORMAT "%7.3" /end MEASUREMENT
/begin MEASUREMENT Disaaus_p "" UWORD _CNV_A_R_vnstv_q0p0_228_CM 1 100. -100. 99.9969 ECU_ADDRESS 0x3fdb94 FORMAT "%7.3" /end MEASUREMENT
/begin MEASUREMENT D_disa_kl "" UWORD _CNV_A_R_vnstv_q0p0_228_CM 1 100. -100. 99.9969 ECU_ADDRESS 0x3fdba0 FORMAT "%7.3" /end MEASUREMENT
/begin MEASUREMENT Disaaus_w "" SWORD _CNV_A_R_LINEAR_____78_CM 1 100. -100. 99.9969 ECU_ADDRESS 0x3fdba6 FORMAT "%7.3" /end MEASUREMENT
/begin MEASUREMENT D_disa_v "" SWORD _CNV_A_R_LINEAR_____78_CM 1 100. -100. 99.9969 ECU_ADDRESS 0x3fdba2 FORMAT "%7.3" /end MEASUREMENT
/begin MEASUREMENT D_disa_w "" SWORD _CNV_A_R_LINEAR_____78_CM 1 100. -100. 99.9969 ECU_ADDRESS 0x3fdba4 FORMAT "%7.3" /end MEASUREMENT
/begin MEASUREMENT Disa_ist "" UWORD _CNV_A_R_vnstv_q0p0_265_CM 1 100. 0. 199.9969 ECU_ADDRESS 0x3fdb96 FORMAT "%7.3" /end MEASUREMENT
/begin MEASUREMENT Disa_oma "" UWORD _CNV_A_R_vnstv_q0p0_265_CM 1 100. 0. 199.9969 ECU_ADDRESS 0x3fdba8 FORMAT "%7.3" /end MEASUREMENT
/begin MEASUREMENT Disa_roh "" UWORD _CNV_A_R_vnstv_q0p0_265_CM 1 100. 0. 199.9969 ECU_ADDRESS 0x3fdb98 FORMAT "%7.3" /end MEASUREMENT
/begin MEASUREMENT Disa_uma "" UWORD _CNV_A_R_vnstv_q0p0_265_CM 1 100. 0. 199.9969 ECU_ADDRESS 0x3fdbaa FORMAT "%7.3" /end MEASUREMENT
/begin MEASUREMENT Disolakt "" UWORD _CNV_A_R_vnstv_q0p0_265_CM 1 100. 0. 199.9969 ECU_ADDRESS 0x3fdb9a FORMAT "%7.3" /end MEASUREMENT
/begin MEASUREMENT Ditv_aus "" UWORD _CNV_A_R_vnstv_q0p0_227_CM 1 100. 0. 655.35 ECU_ADDRESS 0x3fdb9c FORMAT "%8.4" /end MEASUREMENT
/begin MEASUREMENT Disa_spg "position feed back DISA" UWORD _CNV_A_R_LINEAR_____158_CM 1 100. 0. 319.995 ECU_ADDRESS 0x3fd2b6 FORMAT "%8.4" /end MEASUREMENT
/begin MEASUREMENT Disa_lern "" UBYTE _CNV_A_R_LINEAR_____17_CM 1 100. 0. 255. ECU_ADDRESS 0x3fdb8e FORMAT "%3.0" /end MEASUREMENT
/begin MEASUREMENT Di_alt "" UBYTE _CNV_A_R_dez_266_CM 1 100. 0. 255. ECU_ADDRESS 0x3fdb90 FORMAT "%3.0" /end MEASUREMENT
/begin MEASUREMENT Di_cnt "" UWORD _CNV_A_R_dez_266_CM 1 100. 0. 65535. ECU_ADDRESS 0x3fdb9e FORMAT "%5.0" /end MEASUREMENT
/begin CHARACTERISTIC DISA_BEGR "" VALUE 0x6da8a _REC_VAL_20_u2 199.9969 _CNV_A_R_vnstv_q0p0_265_CM 0. 199.9969 FORMAT "%7.3" /end CHARACTERISTIC
/begin CHARACTERISTIC DISA_U "" VALUE 0x6da96 _REC_VAL_20_u2 199.9969 _CNV_A_R_vnstv_q0p0_265_CM 0. 199.9969 FORMAT "%7.3" /end CHARACTERISTIC
/begin CHARACTERISTIC DISA_O "" VALUE 0x6da8c _REC_VAL_20_u2 199.9969 _CNV_A_R_vnstv_q0p0_265_CM 0. 199.9969 FORMAT "%7.3" /end CHARACTERISTIC
/begin CHARACTERISTIC DISA_RAMP "" VALUE 0x6da90 _REC_VAL_20_u2 199.9969 _CNV_A_R_vnstv_q0p0_265_CM 0. 199.9969 FORMAT "%7.3" /end CHARACTERISTIC
/begin CHARACTERISTIC DISAMN "" VALUE 0x6da86 _REC_VAL_20_s2 199.9969 _CNV_A_R_LINEAR_____78_CM -100. 99.9969 FORMAT "%7.3" /end CHARACTERISTIC
/begin CHARACTERISTIC DISAIMX "" VALUE 0x6da84 _REC_VAL_20_u2 199.9969 _CNV_A_R_vnstv_q0p0_228_CM -100. 99.9969 FORMAT "%7.3" /end CHARACTERISTIC
/begin CHARACTERISTIC DISAIMN "" VALUE 0x6da82 _REC_VAL_20_u2 199.9969 _CNV_A_R_vnstv_q0p0_228_CM -100. 99.9969 FORMAT "%7.3" /end CHARACTERISTIC
/begin CHARACTERISTIC Di_dir "" VALUE 0x6d95a _REC_VAL_20_u1 255. _CNV_A_R_LINEAR_____17_CM 0. 255. FORMAT "%3.0" /end CHARACTERISTIC
/begin CHARACTERISTIC Di_h_res "" VALUE 0x6d95c _REC_VAL_20_u1 255. _CNV_A_R_LINEAR_____17_CM 0. 255. FORMAT "%3.0" /end CHARACTERISTIC
/begin CHARACTERISTIC DISA_KL_P "" CURVE 0x6dada _REC_CUR_32_u2_u2 199.9969482421875 _CNV_A_R_vnstv_q0p0_228_CM -100. 99.9969482421875 FORMAT "%7.3"
 /begin AXIS_DESCR STD_AXIS D_disa_kl _CNV_A_R_vnstv_q0p0_228_CM 16 -100. 99.9969482421875 FORMAT "%7.3" /end AXIS_DESCR
/end CHARACTERISTIC
/begin CHARACTERISTIC DISA_KL_I "" CURVE 0x6da98 _REC_CUR_32_u2_u2 199.9969482421875 _CNV_A_R_vnstv_q0p0_228_CM -100. 99.9969482421875 FORMAT "%7.3"
 /begin AXIS_DESCR STD_AXIS D_disa_kl _CNV_A_R_vnstv_q0p0_228_CM 16 -100. 99.9969482421875 FORMAT "%7.3" /end AXIS_DESCR
/end CHARACTERISTIC
/begin CHARACTERISTIC DITV "" CURVE 0x6d940 _REC_CUR_32_u2_u2 100. _CNV_A_R_vnstv_q0p0_227_CM 0. 100. FORMAT "%8.4"
 /begin AXIS_DESCR STD_AXIS Di_cnt _CNV_A_R_LINEAR_____17_CM 6 0. 255. FORMAT "%5.0" /end AXIS_DESCR
/end CHARACTERISTIC
/begin CHARACTERISTIC WLSU "" MAP 0x6d960 _REC_MAP_32_u1_u1_u1 99.609375 _CNV_A_R_LINEAR_____16_CM 0. 99.609375
 /begin AXIS_DESCR STD_AXIS nmot _CNV_A_R_nmot_ub_q4_235_CM 16 0. 10200. FORMAT "%5.0" /end AXIS_DESCR
 /begin AXIS_DESCR STD_AXIS rl _CNV_A_R_rel_ub_q0p_264_CM 16 0. 191.25 FORMAT "%6.2" /end AXIS_DESCR
/end CHARACTERISTIC
/begin CHARACTERISTIC DI_HYST "" VALUE 0x6d95b _REC_VAL_20_u1 49.61 _CNV_A_R_LINEAR_____16_CM 50. 99.61 FORMAT "%5.2" /end CHARACTERISTIC
/begin CHARACTERISTIC DISAMX "" VALUE 0x6da88 _REC_VAL_20_s2 199.9969 _CNV_A_R_LINEAR_____78_CM -100. 99.9969 FORMAT "%7.3" /end CHARACTERISTIC
/begin CHARACTERISTIC DISA_OFF_THR "" VALUE 0x6da8e _REC_VAL_20_s2 199.9969 _CNV_A_R_LINEAR_____78_CM -100. 99.9969 FORMAT "%7.3" /end CHARACTERISTIC
/begin CHARACTERISTIC DISA_SAVE "" VALUE 0x6da92 _REC_VAL_20_u2 199.9969 _CNV_A_R_vnstv_q0p0_265_CM 0. 199.9969 FORMAT "%7.3" /end CHARACTERISTIC
/begin CHARACTERISTIC DISA_SOL_OFST "" VALUE 0x6da94 _REC_VAL_20_u2 199.9969 _CNV_A_R_vnstv_q0p0_265_CM 0. 199.9969 FORMAT "%7.3" /end CHARACTERISTIC
/begin CHARACTERISTIC DI_SPRUNG "" VALUE 0x6d95e _REC_VAL_20_u1 255. _CNV_A_R_LINEAR_____17_CM 0. 255. FORMAT "%3.0" /end CHARACTERISTIC
/begin CHARACTERISTIC DI_SCHALT "" VALUE 0x6d95d _REC_VAL_20_u1 255. _CNV_A_R_LINEAR_____17_CM 0. 255. FORMAT "%3.0" /end CHARACTERISTIC
/begin MEASUREMENT Disa_dir "" UBYTE _CNV_A_R_LINEAR_____17_CM 1 100. 0. 255. ECU_ADDRESS 0x3fdb8d FORMAT "%3.0" /end MEASUREMENT
/begin MEASUREMENT B_su "" UBYTE _CNV_S_2_B_TRUE_222_CM 1 100. 0. 1. ECU_ADDRESS 0x3fdb8a BIT_MASK 0x1 /end MEASUREMENT
/begin MEASUREMENT Disa_off "" UBYTE _CNV_S_2_B_TRUE_222_CM 1 100. 0. 1. ECU_ADDRESS 0x3fdb8b BIT_MASK 0x1 /end MEASUREMENT
/begin MEASUREMENT LAMB_MMV "Filtered value of Lambda" UWORD _CNV_A_R_LINEAR_____267_CM 1 100. 0.69 3.77 ECU_ADDRESS 0x3fc750 FORMAT "%6.4" /end MEASUREMENT
/begin MEASUREMENT TI_LAM_MMV "Moving mean value of the lambda control injection time correction TI_LAM_COR_1" SWORD _CNV_A_R_LINEAR_____149_CM 1 100. -50. 49.99847412 ECU_ADDRESS 0x3fc752 /end MEASUREMENT
/begin MEASUREMENT LV_CP_ACT "Logical value for EVAP-Control active" UBYTE _CNV_S_2_RANGE______76_CM 1 100. 0. 1. ECU_ADDRESS 0x3fd463 BIT_MASK 0x1 /end MEASUREMENT
/begin MEASUREMENT STATE_T_SDL_CP "State of Evaporative Emission Control Function" UBYTE _CNV_S_5_RANGE_STAT_268_CM 1 100. 0. 4. ECU_ADDRESS 0x3fd82b /end MEASUREMENT
/begin MEASUREMENT T_CP "Time of actual CP time range " UWORD _CNV_A_R_LINEAR_____18_CM 1 100. 0. 6553.5 ECU_ADDRESS 0x3fc7e8 FORMAT "%6.1" /end MEASUREMENT
/begin MEASUREMENT STATE_TRA_CP "State of transitions between partial functions of the Evaporative Emission Control" UBYTE _CNV_S_12_RANGE_STAT_269_CM 1 100. 0. 11. ECU_ADDRESS 0x3fd827 /end MEASUREMENT
/begin MEASUREMENT STATE_NORM_DEAC_CP "Deactivation states of NORMAL_PURGE" UBYTE _CNV_S_3_RANGE_STAT_270_CM 1 100. 0. 2. ECU_ADDRESS 0x3fd829 /end MEASUREMENT
/begin MEASUREMENT REL_FLOW_CPS "Setpoint value for the relative flow (FLOW_CPS/MAF_CYL) through the CPS" UWORD _CNV_A_R_LINEAR_____2_CM 1 100. 0. 0.99998474 ECU_ADDRESS 0x3fc762 FORMAT "%7.5" /end MEASUREMENT
/begin MEASUREMENT REL_FLOW_CPS_AV "Actual value of the relative flow (FLOW_CPS/MAF_CYL) through the CPS" UWORD _CNV_A_R_LINEAR_____2_CM 1 100. 0. 0.99998474 ECU_ADDRESS 0x3fc760 FORMAT "%7.5" /end MEASUREMENT
/begin MEASUREMENT REL_FLOW_CPS_DI "Relative flow (FLOW_CPS/MAF_CYL) through the CPS for disabled NORMAL_PURGE operation" UWORD _CNV_A_R_LINEAR_____2_CM 1 100. 0. 0.99998474 ECU_ADDRESS 0x3fc77c FORMAT "%7.5" /end MEASUREMENT
/begin MEASUREMENT REL_FLOW_CPS_OLD "Relative flow (FLOW_CPS/MAF_CYL) for additive mass fuel correction" UWORD _CNV_A_R_LINEAR_____2_CM 1 100. 0. 0.99998474 ECU_ADDRESS 0x3fc77e FORMAT "%7.5" /end MEASUREMENT
/begin MEASUREMENT REL_FLOW_CPS_OLD_DI "Relative flow (FLOW_CPS/MAF_CYL) for additive mass fuel correction for disabled NORMAL_PURGE operation" UWORD _CNV_A_R_LINEAR_____2_CM 1 100. 0. 0.99998474 ECU_ADDRESS 0x3fc780 FORMAT "%7.5" /end MEASUREMENT
/begin MEASUREMENT REL_FLOW_SP_CPS "Set point value for relative flow during RAMP_OPEN_FAST operation" UWORD _CNV_A_R_LINEAR_____2_CM 1 100. 0. 0.99998474 ECU_ADDRESS 0x3fc77a FORMAT "%7.5" /end MEASUREMENT
/begin MEASUREMENT MAF_CYL_DLY_MMV "Moving mean value of MAF_CYL_DLY" UWORD _CNV_A_R_LINEAR_____52_CM 1 100. 0. 2047.96875 ECU_ADDRESS 0x3fc78c FORMAT "%7.2" /end MEASUREMENT
/begin MEASUREMENT MAF_CYL_DLY "Filtered value of MAF_CYL (Padé Filter)" UWORD _CNV_A_R_LINEAR_____52_CM 1 100. 0. 2047.96875 ECU_ADDRESS 0x3fc78a FORMAT "%7.2" /end MEASUREMENT
/begin MEASUREMENT CL "Canister load						" UWORD _CNV_A_R_LINEAR_____104_CM 1 100. 0. 7.99987793 ECU_ADDRESS 0x3fc7a4 FORMAT "%6.4" /end MEASUREMENT
/begin MEASUREMENT CL_MMV "Moving mean value of the canister load CL" UWORD _CNV_A_R_LINEAR_____104_CM 1 100. 0. 7.99987793 ECU_ADDRESS 0x3fc766 FORMAT "%6.4" /end MEASUREMENT
/begin MEASUREMENT CL_MMV_DI "Moving mean value of the canister load CL for disabled NORMAL_PURGE operation" UWORD _CNV_A_R_LINEAR_____104_CM 1 100. 0. 7.99987793 ECU_ADDRESS 0x3fc7a6 FORMAT "%6.4" /end MEASUREMENT
/begin MEASUREMENT CL_MMV_OLD "Canister load for additive mass fuel correction calculation" UWORD _CNV_A_R_LINEAR_____104_CM 1 100. 0. 7.99987793 ECU_ADDRESS 0x3fc7a8 FORMAT "%6.4" /end MEASUREMENT
/begin MEASUREMENT CL_MMV_OLD_DI "Canister load for additive mass fuel correction calculation for disabled NORMAL_PURGE operation  " UWORD _CNV_A_R_LINEAR_____104_CM 1 100. 0. 7.99987793 ECU_ADDRESS 0x3fc7aa FORMAT "%6.4" /end MEASUREMENT
/begin MEASUREMENT LV_RAMP_CLOSE_END "Logical value for end of  RAMP_CLOSE operation" UBYTE _CNV_S_2_RANGE______76_CM 1 100. 0. 1. ECU_ADDRESS 0x3fd45f BIT_MASK 0x1 /end MEASUREMENT
/begin MEASUREMENT LV_RAMP_OPEN_END "Logical value for end of RAMP_OPEN operation" UBYTE _CNV_S_2_RANGE______76_CM 1 100. 0. 1. ECU_ADDRESS 0x3fd45d BIT_MASK 0x1 /end MEASUREMENT
/begin MEASUREMENT LV_RAMP_OPEN_ACT "Logical value for active RAMP_OPEN operation" UBYTE _CNV_S_2_RANGE______76_CM 1 100. 0. 1. ECU_ADDRESS 0x3fd45a BIT_MASK 0x1 /end MEASUREMENT
/begin MEASUREMENT LV_MAX_PURGE_END "Logical value for end of  MAX_PURGE operation" UBYTE _CNV_S_2_RANGE______76_CM 1 100. 0. 1. ECU_ADDRESS 0x3fd45e BIT_MASK 0x1 /end MEASUREMENT
/begin MEASUREMENT LAM_0_CP_DI "Start value of the additive mass fuel correction TI_LAM_MMV for disabled NORMAL_PURGE operation" SWORD _CNV_A_R_LINEAR_____149_CM 1 100. -50. 49.99847412 ECU_ADDRESS 0x3fc7a0 /end MEASUREMENT
/begin MEASUREMENT LAM_0_CP "Start value of the additive mass fuel correction TI_LAM_MMV before the CPS is opened" SWORD _CNV_A_R_LINEAR_____149_CM 1 100. -50. 49.99847412 ECU_ADDRESS 0x3fc79e /end MEASUREMENT
/begin MEASUREMENT CL_MMV_NORM_PURGE_END "Canister load at the end of NORMAL_PURGE_MAX_PURGE operation" UWORD _CNV_A_R_LINEAR_____104_CM 1 100. 0. 7.99987793 ECU_ADDRESS 0x3fc776 FORMAT "%6.4" /end MEASUREMENT
/begin MEASUREMENT FRQ_REQ_CP "Output frequency" UBYTE _CNV_A_R_LINEAR_____271_CM 1 100. 0. 255. ECU_ADDRESS 0x3fd830 FORMAT "%3.0" /end MEASUREMENT
/begin MEASUREMENT FUEL_FLOW_CP "Fuel flow from the ACF" UWORD _CNV_A_R_LINEAR_____272_CM 1 100. 0. 7.99987793 ECU_ADDRESS 0x3fc7a2 FORMAT "%7.4" /end MEASUREMENT
/begin MEASUREMENT FUEL_FLOW_MAX_CP "Maximum fuel flow coming from the canister" UWORD _CNV_A_R_LINEAR_____272_CM 1 100. 0. 7.99987793 ECU_ADDRESS 0x3fc784 FORMAT "%7.4" /end MEASUREMENT
/begin MEASUREMENT FLOW_COR_CPS "Corrected flow setpoint through the CPS" UWORD _CNV_A_R_LINEAR_____272_CM 1 100. 0. 7.99987793 ECU_ADDRESS 0x3fc764 FORMAT "%7.4" /end MEASUREMENT
/begin MEASUREMENT FLOW_CPS_DLY_MMV "Moving mean value of FLOW_CPS_DLY" UWORD _CNV_A_R_LINEAR_____272_CM 1 100. 0. 7.99987793 ECU_ADDRESS 0x3fc778 FORMAT "%7.4" /end MEASUREMENT
/begin MEASUREMENT CPPWM_SP "Setpoint PWM signal for CPS opening" UBYTE _CNV_A_R_LINEAR_____16_CM 1 100. 0. 99.609375 ECU_ADDRESS 0x3fd82c FORMAT "%3.1" /end MEASUREMENT
/begin MEASUREMENT CPPWM_CPS "Corrected PWM signal for CPS opening" UBYTE _CNV_A_R_LINEAR_____16_CM 1 100. 0. 99.609375 ECU_ADDRESS 0x3fd82f FORMAT "%3.1" /end MEASUREMENT
/begin MEASUREMENT CPPWM_REF "Reference PWM signal for CPS opening" UBYTE _CNV_A_R_LINEAR_____16_CM 1 100. 0. 99.609375 ECU_ADDRESS 0x3fd82d FORMAT "%3.1" /end MEASUREMENT
/begin MEASUREMENT CPPWM "PWM signal for CPS opening" UBYTE _CNV_A_R_LINEAR_____16_CM 1 100. 0. 99.609375 ECU_ADDRESS 0x3fd82e FORMAT "%4.1" /end MEASUREMENT
/begin MEASUREMENT LV_FRQ_CPS "Logical value for CPS PWM frequency" UBYTE _CNV_S_2_RANGE______76_CM 1 100. 0. 1. ECU_ADDRESS 0x3fd469 BIT_MASK 0x1 /end MEASUREMENT
/begin MEASUREMENT LAM_DIF_CP "Lambda deviation with active canister purge" SWORD _CNV_A_R_LINEAR_____149_CM 1 100. -50. 49.99847412 ECU_ADDRESS 0x3fc79c /end MEASUREMENT
/begin MEASUREMENT LAM_ADJ_CP "Correction value for TI_LAM correction during RAMP_OPEN operation" SWORD _CNV_A_R_LINEAR_____149_CM 1 100. -50. 49.99847412 ECU_ADDRESS 0x3fc768 /end MEASUREMENT
/begin MEASUREMENT LV_LAM_ADJ_CP "Logical value for TI_LAM_COR correction during RAMP_OPEN operation" UBYTE _CNV_S_2_RANGE______76_CM 1 100. 0. 1. ECU_ADDRESS 0x3fd45c BIT_MASK 0x1 /end MEASUREMENT
/begin MEASUREMENT T_DLY_MAX_CP "Time counter" UWORD _CNV_A_R_LINEAR_____18_CM 1 100. 0. 6553.5 ECU_ADDRESS 0x3fc7ac FORMAT "%6.1" /end MEASUREMENT
/begin MEASUREMENT MAF_CYL_DLY_OLD "Old value of MAF_CYL_DLY for Padé Filter calculation for MAF_CYL_DLY" UWORD _CNV_A_R_LINEAR_____52_CM 1 100. 0. 2047.96875 ECU_ADDRESS 0x3fc78e FORMAT "%7.2" /end MEASUREMENT
/begin MEASUREMENT MAF_CYL_OLD "Old value of MAF_CYL for Padé Filter calculation for MAF_CYL_DLY" UWORD _CNV_A_R_LINEAR_____52_CM 1 100. 0. 2047.96875 ECU_ADDRESS 0x3fc790 FORMAT "%7.2" /end MEASUREMENT
/begin MEASUREMENT MAF_CYL_OLD2 "Old value of MAF_CYL for Padé Filter calculation for MAF_CYL_DLY" UWORD _CNV_A_R_LINEAR_____52_CM 1 100. 0. 2047.96875 ECU_ADDRESS 0x3fc792 FORMAT "%7.2" /end MEASUREMENT
/begin MEASUREMENT FLOW_CPS_DLY "Filtered value of FLOW_CPS (Padé Filter)" UWORD _CNV_A_R_LINEAR_____272_CM 1 100. 0. 7.99987793 ECU_ADDRESS 0x3fc794 FORMAT "%7.4" /end MEASUREMENT
/begin MEASUREMENT FLOW_CPS_DLY_OLD "Old value of FLOW_CPS_DLY for Padé Filter calculation for FLOW_CPS_DLY" UWORD _CNV_A_R_LINEAR_____272_CM 1 100. 0. 7.99987793 ECU_ADDRESS 0x3fc796 FORMAT "%7.4" /end MEASUREMENT
/begin MEASUREMENT FLOW_CPS "Flow through the CPS" UWORD _CNV_A_R_LINEAR_____272_CM 1 100. 0. 7.99987793 ECU_ADDRESS 0x3fc76c FORMAT "%7.4" /end MEASUREMENT
/begin MEASUREMENT FLOW_CPS_OLD "Old value of FLOW_CPS for Padé Filter calculation for FLOW_CPS_DLY" UWORD _CNV_A_R_LINEAR_____272_CM 1 100. 0. 7.99987793 ECU_ADDRESS 0x3fc798 FORMAT "%7.4" /end MEASUREMENT
/begin MEASUREMENT FLOW_CPS_OLD2 "Old value of FLOW_CPS for Padé Filter calculation for FLOW_CPS_DLY" UWORD _CNV_A_R_LINEAR_____272_CM 1 100. 0. 7.99987793 ECU_ADDRESS 0x3fc79a FORMAT "%7.4" /end MEASUREMENT
/begin MEASUREMENT FUEL_FLOW_ADD_AD_CP "Additive adaptive fuel flow from the ACF for the additive mass fuel correction" UWORD _CNV_A_R_LINEAR_____272_CM 1 100. 0. 7.99987793 ECU_ADDRESS 0x3fc7dc FORMAT "%7.4" /end MEASUREMENT
/begin MEASUREMENT FUEL_CPS "Fuel flow from the CPS to the Cylinder" UWORD _CNV_A_R_LINEAR_____272_CM 1 100. 0. 7.99987793 ECU_ADDRESS 0x3fc76e FORMAT "%7.4" /end MEASUREMENT
/begin MEASUREMENT FLOW_SP_CPS "Flow setpoint through the CPS" UWORD _CNV_A_R_LINEAR_____272_CM 1 100. 0. 7.99987793 ECU_ADDRESS 0x3fc786 FORMAT "%7.4" /end MEASUREMENT
/begin MEASUREMENT FLOW_TOT_CPS "Total of FLOW_CPS during emission cycle" ULONG _CNV_A_R_LINEAR_____273_CM 1 100. 0. 1456. ECU_ADDRESS 0x3fc7e4 FORMAT "%12.7" /end MEASUREMENT
/begin MEASUREMENT MAF_CPS "Air flow from the CPS to the Cylinder" UWORD _CNV_A_R_LINEAR_____272_CM 1 100. 0. 7.99987793 ECU_ADDRESS 0x3fc770 FORMAT "%7.4" /end MEASUREMENT
/begin MEASUREMENT LV_TI_AD_ENA "Logical value for enabled lambda adaptation" UBYTE _CNV_S_2_RANGE______76_CM 1 100. 0. 1. ECU_ADDRESS 0x3fd45b BIT_MASK 0x1 /end MEASUREMENT
/begin CHARACTERISTIC C_TI_T_AD "" VALUE 0x621b2 _REC_VAL_20_u2 6553.5 _CNV_A_R_LINEAR_____18_CM 0. 6553.5 FORMAT "%6.1" /end CHARACTERISTIC
/begin CHARACTERISTIC C_T_2_CP "" VALUE 0x621b4 _REC_VAL_20_u2 6553.5 _CNV_A_R_LINEAR_____18_CM 0. 6553.5 FORMAT "%6.1" /end CHARACTERISTIC
/begin CHARACTERISTIC C_PRS_MAX_CPS "" VALUE 0x621b6 _REC_VAL_20_u2 2400. _CNV_A_R_LINEAR_____274_CM 0. 2400. FORMAT "%7.2" /end CHARACTERISTIC
/begin CHARACTERISTIC C_TIA_MIN_CP "" VALUE 0x621b8 _REC_VAL_20_u1 190.5 _CNV_A_R_LINEAR_____22_CM -48. 142.5 FORMAT "%5.1" /end CHARACTERISTIC
/begin CHARACTERISTIC C_N_CP_TOL "" VALUE 0x621b9 _REC_VAL_20_u1 8160. _CNV_A_R_LINEAR_____15_CM 0. 8160. FORMAT "%4.0" /end CHARACTERISTIC
/begin CHARACTERISTIC C_N_CP_BOL "" VALUE 0x621ba _REC_VAL_20_u1 8160. _CNV_A_R_LINEAR_____15_CM 0. 8160. FORMAT "%4.0" /end CHARACTERISTIC
/begin CHARACTERISTIC C_MAF_CP_BOL "" VALUE 0x621bb _REC_VAL_20_u1 1389. _CNV_A_R_LINEAR_____51_CM 0. 1389. FORMAT "%4.0" /end CHARACTERISTIC
/begin CHARACTERISTIC C_MAF_CP_TOL "" VALUE 0x621bc _REC_VAL_20_u1 1389. _CNV_A_R_LINEAR_____51_CM 0. 1389. FORMAT "%4.0" /end CHARACTERISTIC
/begin CHARACTERISTIC C_T_DI_MAX_CP "" VALUE 0x621be _REC_VAL_20_u2 6553.400000000001 _CNV_A_R_LINEAR_____18_CM 0.1 6553.5 FORMAT "%6.1" /end CHARACTERISTIC
/begin CHARACTERISTIC C_T_DI_RAMP_OPEN_CP "" VALUE 0x621c0 _REC_VAL_20_u2 6553.400000000001 _CNV_A_R_LINEAR_____18_CM 0.1 6553.5 FORMAT "%6.1" /end CHARACTERISTIC
/begin CHARACTERISTIC C_T_DLY_CP "" VALUE 0x621c2 _REC_VAL_20_u2 6553.400000000001 _CNV_A_R_LINEAR_____18_CM 0.1 6553.5 FORMAT "%6.1" /end CHARACTERISTIC
/begin CHARACTERISTIC C_T_DLY_MAX_1_CP "" VALUE 0x621c4 _REC_VAL_20_u2 6553.5 _CNV_A_R_LINEAR_____18_CM 0. 6553.5 FORMAT "%6.1" /end CHARACTERISTIC
/begin CHARACTERISTIC C_T_DLY_MAX_2_CP "" VALUE 0x621c6 _REC_VAL_20_u2 6553.5 _CNV_A_R_LINEAR_____18_CM 0. 6553.5 FORMAT "%6.1" /end CHARACTERISTIC
/begin CHARACTERISTIC C_MAF_CYL_DLY_CRLC "" VALUE 0x621c8 _REC_VAL_20_u2 0.99998474 _CNV_A_R_LINEAR_____2_CM 0. 0.99998474 FORMAT "%7.5" /end CHARACTERISTIC
/begin CHARACTERISTIC C_FLOW_CPS_DLY_CRLC "" VALUE 0x621ca _REC_VAL_20_u2 0.99998474 _CNV_A_R_LINEAR_____2_CM 0. 0.99998474 FORMAT "%7.5" /end CHARACTERISTIC
/begin CHARACTERISTIC C_FUEL_FAC_CP "" VALUE 0x621cc _REC_VAL_20_u2 255.996094 _CNV_A_R_LINEAR_____275_CM 0. 255.996094 FORMAT "%7.3" /end CHARACTERISTIC
/begin CHARACTERISTIC C_CL_ST_CP "" VALUE 0x621ce _REC_VAL_20_u2 7.99987793 _CNV_A_R_LINEAR_____104_CM 0. 7.99987793 FORMAT "%6.4" /end CHARACTERISTIC
/begin CHARACTERISTIC C_CL_MAX_CP "" VALUE 0x621d0 _REC_VAL_20_u2 7.99987793 _CNV_A_R_LINEAR_____104_CM 0. 7.99987793 FORMAT "%6.4" /end CHARACTERISTIC
/begin CHARACTERISTIC C_CL_MMV_THD "" VALUE 0x621d2 _REC_VAL_20_u2 7.99987793 _CNV_A_R_LINEAR_____104_CM 0. 7.99987793 FORMAT "%6.4" /end CHARACTERISTIC
/begin CHARACTERISTIC C_LAM_DIF_MAX_CP "" VALUE 0x621d4 _REC_VAL_20_u2 50. _CNV_A_R_LINEAR_____276_CM 0. 50. /end CHARACTERISTIC
/begin CHARACTERISTIC C_N_FRQ_HYS_CPS "Hysteresis threshold on engine speed to shift CPS frequency output" VALUE 0x621d6 _REC_VAL_20_u1 8160. _CNV_A_R_LINEAR_____15_CM 0. 8160. FORMAT "%4.0" /end CHARACTERISTIC
/begin CHARACTERISTIC C_CPPWM_FRQ_2 "Second CPS output frequency" VALUE 0x621d7 _REC_VAL_20_u1 250. _CNV_A_R_LINEAR_____271_CM 5. 255. FORMAT "%3.0" /end CHARACTERISTIC
/begin CHARACTERISTIC C_N_FRQ_1_CPS "Threshold on engine speed to shift CPS frequency output" VALUE 0x621d8 _REC_VAL_20_u1 8160. _CNV_A_R_LINEAR_____15_CM 0. 8160. FORMAT "%4.0" /end CHARACTERISTIC
/begin CHARACTERISTIC C_N_FRQ_2_CPS "Second threshold on engine speed to shift CPS frequency output" VALUE 0x621d9 _REC_VAL_20_u1 8160. _CNV_A_R_LINEAR_____15_CM 0. 8160. FORMAT "%4.0" /end CHARACTERISTIC
/begin CHARACTERISTIC C_CPPWM_FRQ_1_CPS "Threshold on CPPWM to shift CPS output frequency" VALUE 0x621da _REC_VAL_20_u1 99.609375 _CNV_A_R_LINEAR_____16_CM 0. 99.609375 FORMAT "%5.1" /end CHARACTERISTIC
/begin CHARACTERISTIC C_CPPWM_FRQ_2_CPS "Threshold on CPPWM to shift CPS output frequency" VALUE 0x621db _REC_VAL_20_u1 99.609375 _CNV_A_R_LINEAR_____16_CM 0. 99.609375 FORMAT "%5.1" /end CHARACTERISTIC
/begin CHARACTERISTIC C_LAMB_SP_CP_FAC "LAMB_SP_S moving mean value factor" VALUE 0x621dc _REC_VAL_20_u1 0.9960940000000002 _CNV_A_R_LINEAR_____8_CM 0. 0.996094 FORMAT "%5.3" /end CHARACTERISTIC
/begin CHARACTERISTIC C_LAMB_FAC_CP "Correction factor on TI_LAM_MMV value during stratified mode" VALUE 0x621dd _REC_VAL_20_u1 1.9921875 _CNV_A_R_LINEAR_____67_CM 0. 1.9921875 FORMAT "%5.3" /end CHARACTERISTIC
/begin CHARACTERISTIC C_CPPWM_AS "CPPWM_REF correction of application system" VALUE 0x621de _REC_VAL_20_s1 99.609375 _CNV_A_R_LINEAR_____16_CM -50. 49.609375 FORMAT "%5.1" /end CHARACTERISTIC
/begin CHARACTERISTIC LC_CPPWM_LIM_DIAG "Correction factor on TI_LAM_MMV value during stratified mode" VALUE 0x621e4 _REC_VAL_20_u1 1. _CNV_S_2_RANGE______76_CM 0. 1. /end CHARACTERISTIC
/begin AXIS_PTS ldp_cl_mmv_ip_t_max_cp "" 0x60b08 CL_MMV _REC_AXS_20_u2 7.99987793 _CNV_A_R_LINEAR_____104_CM 6 0. 7.99987793 FORMAT "%6.4" /end AXIS_PTS
/begin AXIS_PTS ldpm_maf_cyl_ip_ti_lam_cor_crlc "" 0x60b16 MAF_CYL _REC_AXS_20_u2 2047.96875 _CNV_A_R_LINEAR_____52_CM 6 0. 2047.96875 FORMAT "%6.2" /end AXIS_PTS
/begin AXIS_PTS ldp_cl_mmv_ip_rel_flow_fac_cp "" 0x60b24 CL_MMV _REC_AXS_20_u2 7.99987793 _CNV_A_R_LINEAR_____104_CM 6 0. 7.99987793 FORMAT "%6.4" /end AXIS_PTS
/begin AXIS_PTS ldpm_maf_cyl_ip_rel_flow_inc_cp "" 0x60b32 MAF_CYL _REC_AXS_20_u2 2047.96875 _CNV_A_R_LINEAR_____52_CM 6 0. 2047.96875 FORMAT "%6.2" /end AXIS_PTS
/begin AXIS_PTS ldpm_maf_cyl_ip_rel_flow_max_cp "" 0x60b40 MAF_CYL _REC_AXS_20_u1 1389. _CNV_A_R_LINEAR_____51_CM 12 0. 1389. FORMAT "%4.0" /end AXIS_PTS
/begin AXIS_PTS ldpm_n_32_ip_rel_flow_max_cps "" 0x60b4d N_32 _REC_AXS_20_u1 8160. _CNV_A_R_LINEAR_____15_CM 12 0. 8160. FORMAT "%4.0" /end AXIS_PTS
/begin AXIS_PTS ldpm_n_32_ip_rel_flow_cps_s "" 0x60b5a N_32 _REC_AXS_20_u1 8160. _CNV_A_R_LINEAR_____15_CM 6 0. 8160. FORMAT "%4.0" /end AXIS_PTS
/begin AXIS_PTS ldpm_maf_ip_rel_flow_max_cps "" 0x60b61 MAF _REC_AXS_20_u1 69.45 _CNV_A_R_LINEAR_____51_CM 12 0. 1389. FORMAT "%4.0" /end AXIS_PTS
/begin AXIS_PTS ldpm_maf_ip_rel_flow_cps_s "" 0x60b6e MAF _REC_AXS_20_u1 69.45 _CNV_A_R_LINEAR_____51_CM 6 0. 1389. FORMAT "%4.0" /end AXIS_PTS
/begin AXIS_PTS ldp_flow_cor_cps_ip_cppwm "" 0x60b76 FLOW_COR_CPS _REC_AXS_20_u2 7.99987793 _CNV_A_R_LINEAR_____272_CM 12 0. 7.99987793 FORMAT "%7.4" /end AXIS_PTS
/begin AXIS_PTS ldpm_prs_cps_ip_cppwm "" 0x60b90 PRS_CPS _REC_AXS_20_u2 1200. _CNV_A_R_LINEAR_____277_CM 12 0. 1200. FORMAT "%7.2" /end AXIS_PTS
/begin AXIS_PTS ldp_tia_ip_fac_tia_cp "" 0x60baa TIA _REC_AXS_20_u1 190.5 _CNV_A_R_LINEAR_____22_CM 6 -48. 142.5 FORMAT "%5.1" /end AXIS_PTS
/begin AXIS_PTS ldpm_vb_ip_cppwm_vb "" 0x60bb1 VB _REC_AXS_20_u1 28.8 _CNV_A_R_LINEAR_____157_CM 8 0. 28.8 FORMAT "%3.1" /end AXIS_PTS
/begin AXIS_PTS ldp_cppwm_ref_ip_cppwm_cor_frq "" 0x60bba CPPWM_REF _REC_AXS_20_u1 99.609375 _CNV_A_R_LINEAR_____16_CM 8 0. 99.609375 FORMAT "%5.1" /end AXIS_PTS
/begin AXIS_PTS ldpm_n_32_ip_fuel_dly_cps "" 0x60bc3 N_32 _REC_AXS_20_u1 8160. _CNV_A_R_LINEAR_____15_CM 6 0. 8160. FORMAT "%4.0" /end AXIS_PTS
/begin CHARACTERISTIC IP_TI_LAM_COR_CRLC__MAF_CYL "Correlation constant for TI_LAM_COR_1 filter" CURVE 0x621e6 _REC_CUR_20_u1_u2 0.9960940000000002 _CNV_A_R_LINEAR_____8_CM 0. 0.996094 FORMAT "%5.3"
 /begin AXIS_DESCR COM_AXIS MAF_CYL _CNV_A_R_LINEAR_____52_CM 6 0. 2047.96875 FORMAT "%6.2" AXIS_PTS_REF ldpm_maf_cyl_ip_ti_lam_cor_crlc /end AXIS_DESCR
/end CHARACTERISTIC
/begin CHARACTERISTIC IP_T_MAX_CP__CL_MMV "Duration of maximum purge versus Canister Load" CURVE 0x621ec _REC_CUR_20_u2_u2 6553.5 _CNV_A_R_LINEAR_____18_CM 0. 6553.5 FORMAT "%6.1"
 /begin AXIS_DESCR COM_AXIS CL_MMV _CNV_A_R_LINEAR_____104_CM 6 0. 7.99987793 FORMAT "%6.4" AXIS_PTS_REF ldp_cl_mmv_ip_t_max_cp /end AXIS_DESCR
/end CHARACTERISTIC
/begin CHARACTERISTIC IP_REL_FLOW_INC_CP__MAF_CYL "Increment value for ramp increase of REL_FLOW_CPS" CURVE 0x621f8 _REC_CUR_20_u2_u2 0.99998474 _CNV_A_R_LINEAR_____2_CM 0. 0.99998474 FORMAT "%7.5"
 /begin AXIS_DESCR COM_AXIS MAF_CYL _CNV_A_R_LINEAR_____52_CM 6 0. 2047.96875 FORMAT "%6.2" AXIS_PTS_REF ldpm_maf_cyl_ip_rel_flow_inc_cp /end AXIS_DESCR
/end CHARACTERISTIC
/begin CHARACTERISTIC IP_REL_FLOW_FAC_CP__CL_MMV "Correction factor for ramp increase of REL_FLOW_CPS" CURVE 0x62204 _REC_CUR_20_u2_u2 1.99996948 _CNV_A_R_LINEAR_____5_CM 0. 1.99996948 FORMAT "%7.5"
 /begin AXIS_DESCR COM_AXIS CL_MMV _CNV_A_R_LINEAR_____104_CM 6 0. 7.99987793 FORMAT "%6.4" AXIS_PTS_REF ldp_cl_mmv_ip_rel_flow_fac_cp /end AXIS_DESCR
/end CHARACTERISTIC
/begin CHARACTERISTIC IP_REL_FLOW_DEC_CP__MAF_CYL "Decrement value for ramp decrease of REL_FLOW_CPS" CURVE 0x62210 _REC_CUR_20_u2_u2 0.99998474 _CNV_A_R_LINEAR_____2_CM 0. 0.99998474 FORMAT "%7.5"
 /begin AXIS_DESCR COM_AXIS MAF_CYL _CNV_A_R_LINEAR_____52_CM 6 0. 2047.96875 FORMAT "%6.2" AXIS_PTS_REF ldpm_maf_cyl_ip_rel_flow_inc_cp /end AXIS_DESCR
/end CHARACTERISTIC
/begin CHARACTERISTIC IP_REL_FLOW_CPS_S__N_32__MAF "REL_FLOW_CPS value during MIN_PURGE operation and stratified mode" MAP 0x6221c _REC_MAP_20_u2_u1_u1 0.99998474 _CNV_A_R_LINEAR_____2_CM 0. 0.99998474 FORMAT "%7.5"
 /begin AXIS_DESCR COM_AXIS N_32 _CNV_A_R_LINEAR_____15_CM 6 0. 8160. FORMAT "%4.0" AXIS_PTS_REF ldpm_n_32_ip_rel_flow_cps_s /end AXIS_DESCR
 /begin AXIS_DESCR COM_AXIS MAF _CNV_A_R_LINEAR_____51_CM 6 0. 1389. FORMAT "%4.0" AXIS_PTS_REF ldpm_maf_ip_rel_flow_cps_s /end AXIS_DESCR
/end CHARACTERISTIC
/begin CHARACTERISTIC IP_REL_FLOW_CPS_HOM__N_32__MAF "REL_FLOW_CPS value during MIN_PURGE operation and homogenous lambda 1 mode" MAP 0x622ac _REC_MAP_20_u2_u1_u1 0.99998474 _CNV_A_R_LINEAR_____2_CM 0. 0.99998474 FORMAT "%7.5"
 /begin AXIS_DESCR COM_AXIS N_32 _CNV_A_R_LINEAR_____15_CM 6 0. 8160. FORMAT "%4.0" AXIS_PTS_REF ldpm_n_32_ip_rel_flow_cps_s /end AXIS_DESCR
 /begin AXIS_DESCR COM_AXIS MAF _CNV_A_R_LINEAR_____51_CM 6 0. 1389. FORMAT "%4.0" AXIS_PTS_REF ldpm_maf_ip_rel_flow_cps_s /end AXIS_DESCR
/end CHARACTERISTIC
/begin CHARACTERISTIC IP_CPPWM__FLOW_COR_CPS__PRS_CPS "CPS duty cycle" MAP 0x622f4 _REC_MAP_20_u1_u2_u2 99.609375 _CNV_A_R_LINEAR_____16_CM 0. 99.609375 FORMAT "%5.2"
 /begin AXIS_DESCR COM_AXIS FLOW_COR_CPS _CNV_A_R_LINEAR_____272_CM 12 0. 7.99987793 FORMAT "%7.4" AXIS_PTS_REF ldp_flow_cor_cps_ip_cppwm /end AXIS_DESCR
 /begin AXIS_DESCR COM_AXIS PRS_CPS _CNV_A_R_LINEAR_____277_CM 12 0. 1200. FORMAT "%7.2" AXIS_PTS_REF ldpm_prs_cps_ip_cppwm /end AXIS_DESCR
/end CHARACTERISTIC
/begin CHARACTERISTIC IP_FAC_AMP_CP__AMP "Correction factor for ambient pressure" CURVE 0x62384 _REC_CUR_20_u1_u2 1.9921875 _CNV_A_R_LINEAR_____67_CM 0. 1.9921875 FORMAT "%5.3"
 /begin AXIS_DESCR COM_AXIS AMP _CNV_A_R_LINEAR_____278_CM 6 -1200. 1200. FORMAT "%8.2" AXIS_PTS_REF ldp_amp_ip_fac_amp_cp /end AXIS_DESCR
/end CHARACTERISTIC
/begin CHARACTERISTIC IP_FAC_TIA_CP__TIA "Correction factor for intake air temperature" CURVE 0x6238a _REC_CUR_20_u1_u1 1.9921875 _CNV_A_R_LINEAR_____67_CM 0. 1.9921875 FORMAT "%5.3"
 /begin AXIS_DESCR COM_AXIS TIA _CNV_A_R_LINEAR_____22_CM 6 -48. 142.5 FORMAT "%5.1" AXIS_PTS_REF ldp_tia_ip_fac_tia_cp /end AXIS_DESCR
/end CHARACTERISTIC
/begin CHARACTERISTIC IP_CPPWM_VB_FAC__VB "Multiplicate VB correction for CPPWM" CURVE 0x62390 _REC_CUR_20_u1_u1 1.9921875 _CNV_A_R_LINEAR_____67_CM 0. 1.9921875 FORMAT "%5.3"
 /begin AXIS_DESCR COM_AXIS VB _CNV_A_R_LINEAR_____157_CM 8 0. 28.8 FORMAT "%3.1" AXIS_PTS_REF ldpm_vb_ip_cppwm_vb /end AXIS_DESCR
/end CHARACTERISTIC
/begin CHARACTERISTIC IP_FLOW_CPS__PRS_CPS "FLOW_CPS for fully opened CPS" CURVE 0x62398 _REC_CUR_20_u2_u2 7.99987793 _CNV_A_R_LINEAR_____272_CM 0. 7.99987793 FORMAT "%7.4"
 /begin AXIS_DESCR COM_AXIS PRS_CPS _CNV_A_R_LINEAR_____277_CM 12 0. 1200. FORMAT "%7.2" AXIS_PTS_REF ldpm_prs_cps_ip_cppwm /end AXIS_DESCR
/end CHARACTERISTIC
/begin CHARACTERISTIC IP_CPPWM_COR_FRQ__CPPWM_REF "PWM correction following frequency output" CURVE 0x623b0 _REC_CUR_20_u1_u1 1.9921875 _CNV_A_R_LINEAR_____67_CM 0. 1.9921875 FORMAT "%6.2"
 /begin AXIS_DESCR COM_AXIS CPPWM_REF _CNV_A_R_LINEAR_____16_CM 8 0. 99.609375 FORMAT "%5.1" AXIS_PTS_REF ldp_cppwm_ref_ip_cppwm_cor_frq /end AXIS_DESCR
/end CHARACTERISTIC
/begin CHARACTERISTIC IP_FUEL_DLY_CPS__N_32 "" CURVE 0x623b8 _REC_CUR_20_u1_u1 19. _CNV_A_R_LINEAR_____17_CM 0. 19. FORMAT "%2.0"
 /begin AXIS_DESCR COM_AXIS N_32 _CNV_A_R_LINEAR_____15_CM 6 0. 8160. FORMAT "%4.0" AXIS_PTS_REF ldpm_n_32_ip_fuel_dly_cps /end AXIS_DESCR
/end CHARACTERISTIC
/begin CHARACTERISTIC IP_FUEL_FAC_CPS__N_32 "Ratio of FUEL_CPS calculation" CURVE 0x623be _REC_CUR_20_u1_u1 0.9960940000000002 _CNV_A_R_LINEAR_____8_CM 0. 0.996094 FORMAT "%5.3"
 /begin AXIS_DESCR COM_AXIS N_32 _CNV_A_R_LINEAR_____15_CM 6 0. 8160. FORMAT "%4.0" AXIS_PTS_REF ldpm_n_32_ip_fuel_dly_cps /end AXIS_DESCR
/end CHARACTERISTIC
/begin CHARACTERISTIC IP_FUEL_FAC_2_CPS__N_32 "Ratio of FUEL_CPS calculationin RAMP_OPEN_FAST" CURVE 0x623c4 _REC_CUR_20_u1_u1 0.9960940000000002 _CNV_A_R_LINEAR_____8_CM 0. 0.996094 FORMAT "%5.3"
 /begin AXIS_DESCR COM_AXIS N_32 _CNV_A_R_LINEAR_____15_CM 6 0. 8160. FORMAT "%4.0" AXIS_PTS_REF ldpm_n_32_ip_fuel_dly_cps /end AXIS_DESCR
/end CHARACTERISTIC
/begin CHARACTERISTIC IP_REL_FLOW_MAX_CPS__N_32__MAF "Maximum limit for REL_FLOW_CPS value" MAP 0x623ca _REC_MAP_20_u2_u1_u1 0.99998474 _CNV_A_R_LINEAR_____2_CM 0. 0.99998474 FORMAT "%7.5"
 /begin AXIS_DESCR COM_AXIS N_32 _CNV_A_R_LINEAR_____15_CM 12 0. 8160. FORMAT "%4.0" AXIS_PTS_REF ldpm_n_32_ip_rel_flow_max_cps /end AXIS_DESCR
 /begin AXIS_DESCR COM_AXIS MAF _CNV_A_R_LINEAR_____51_CM 12 0. 1389. FORMAT "%4.0" AXIS_PTS_REF ldpm_maf_ip_rel_flow_max_cps /end AXIS_DESCR
/end CHARACTERISTIC
/begin AXIS_PTS ldp_amp_ip_fac_amp_cp "" 0x60bea AMP _REC_AXS_20_u2 2400. _CNV_A_R_LINEAR_____278_CM 6 -1200. 1200. FORMAT "%8.2" /end AXIS_PTS
/begin CHARACTERISTIC C_T_1_CP "" VALUE 0x621e0 _REC_VAL_20_u2 6553.5 _CNV_A_R_LINEAR_____18_CM 0. 6553.5 FORMAT "%6.1" /end CHARACTERISTIC
/begin CHARACTERISTIC IP_CL_CRLC__N_32__MAF "correlation constant for CL-filter" MAP 0x62972 _REC_MAP_20_u2_u1_u1 0.99998474 _CNV_A_R_LINEAR_____2_CM 0. 0.99998474 FORMAT "%7.5"
 /begin AXIS_DESCR COM_AXIS N_32 _CNV_A_R_LINEAR_____15_CM 12 0. 8160. FORMAT "%4.0" AXIS_PTS_REF ldpm_n_32_ip_rel_flow_max_cps /end AXIS_DESCR
 /begin AXIS_DESCR COM_AXIS MAF_CYL _CNV_A_R_LINEAR_____51_CM 12 0. 1389. FORMAT "%4.0" AXIS_PTS_REF ldpm_maf_cyl_ip_rel_flow_max_cp /end AXIS_DESCR
/end CHARACTERISTIC
/begin MEASUREMENT LV_OBD_CDN_CLOSE_MOD "Logical value for NO_PURGE authorization by projectspecific conditions " UBYTE _CNV_S_2_RANGE______74_CM 1 100. 0. 1. ECU_ADDRESS 0x3fd457 BIT_MASK 0x1 /end MEASUREMENT
/begin MEASUREMENT MFF_SP_HOM_ENG "mass fuel flow setpoint for canister purge function" UWORD _CNV_A_R_LINEAR_____56_CM 1 100. 0. 1389. ECU_ADDRESS 0x3fc756 FORMAT "%7.2" /end MEASUREMENT
/begin MEASUREMENT CPPWM_CP_DIAGCP "???" UBYTE _CNV_A_R_LINEAR_____16_CM 1 100. 0. 99.609375 ECU_ADDRESS 0x3fd825 FORMAT "%5.1" /end MEASUREMENT
/begin MEASUREMENT CPPWM_EXT_ADJ "???" UBYTE _CNV_A_R_LINEAR_____16_CM 1 100. 0. 99.609375 ECU_ADDRESS 0x3fd824 FORMAT "%5.1" /end MEASUREMENT
/begin CHARACTERISTIC LC_LAM_CTL_CONF "Reference lambda bank for canister purge function" VALUE 0x621e5 _REC_VAL_20_u1 1. _CNV_S_2_RANGE______76_CM 0. 1. /end CHARACTERISTIC
/begin CHARACTERISTIC C_CPPWM_FRQ_1 "First CPS output frequency" VALUE 0x621e2 _REC_VAL_20_u1 250. _CNV_A_R_LINEAR_____271_CM 5. 255. FORMAT "%3.0" /end CHARACTERISTIC
/begin CHARACTERISTIC C_CPPWM_FRQ_HYS_CPS "Hysteresis threshold on engine speed to shift CPS frequency output" VALUE 0x621e3 _REC_VAL_20_u1 99.609375 _CNV_A_R_LINEAR_____16_CM 0. 99.609375 FORMAT "%5.1" /end CHARACTERISTIC
/begin CHARACTERISTIC IP_CPPWM_VB_ADD_1__VB "Additive VB correction for CPPWM" CURVE 0x62a92 _REC_CUR_20_u1_u1 99.609375 _CNV_A_R_LINEAR_____279_CM -50. 49.609375 FORMAT "%6.2"
 /begin AXIS_DESCR COM_AXIS VB _CNV_A_R_LINEAR_____157_CM 8 0. 28.8 FORMAT "%3.1" AXIS_PTS_REF ldpm_vb_ip_cppwm_vb /end AXIS_DESCR
/end CHARACTERISTIC
/begin CHARACTERISTIC IP_CPPWM_VB_ADD_2__VB "Additive VB correction for CPPWM" CURVE 0x62a9a _REC_CUR_20_u1_u1 99.609375 _CNV_A_R_LINEAR_____279_CM -50. 49.609375 FORMAT "%6.2"
 /begin AXIS_DESCR COM_AXIS VB _CNV_A_R_LINEAR_____157_CM 8 0. 28.8 FORMAT "%3.1" AXIS_PTS_REF ldpm_vb_ip_cppwm_vb /end AXIS_DESCR
/end CHARACTERISTIC
/begin MEASUREMENT FUEL_TOT_CPS "Total of FUEL_CPS during emission cycle" ULONG _CNV_A_R_LINEAR_____273_CM 1 100. 0. 1456. ECU_ADDRESS 0x3fc7e0 FORMAT "%12.7" /end MEASUREMENT
/begin MEASUREMENT FUEL_FLOW_ADD_BUF_0_ "Array of FUEL_FLOW_ADD_AD_CP values(20 values) " UWORD _CNV_A_R_LINEAR_____272_CM 1 100. 0. 7.99987793 ECU_ADDRESS 0x3fc7ae FORMAT "%7.4" /end MEASUREMENT
/begin MEASUREMENT FUEL_FLOW_ADD_BUF_1_ "Array of FUEL_FLOW_ADD_AD_CP values(20 values) " UWORD _CNV_A_R_LINEAR_____272_CM 1 100. 0. 7.99987793 ECU_ADDRESS 0x3fc7b0 FORMAT "%7.4" /end MEASUREMENT
/begin MEASUREMENT FUEL_FLOW_ADD_BUF_2_ "Array of FUEL_FLOW_ADD_AD_CP values(20 values) " UWORD _CNV_A_R_LINEAR_____272_CM 1 100. 0. 7.99987793 ECU_ADDRESS 0x3fc7b2 FORMAT "%7.4" /end MEASUREMENT
/begin MEASUREMENT FUEL_FLOW_ADD_BUF_3_ "Array of FUEL_FLOW_ADD_AD_CP values(20 values) " UWORD _CNV_A_R_LINEAR_____272_CM 1 100. 0. 7.99987793 ECU_ADDRESS 0x3fc7b4 FORMAT "%7.4" /end MEASUREMENT
/begin MEASUREMENT FUEL_FLOW_ADD_BUF_4_ "Array of FUEL_FLOW_ADD_AD_CP values(20 values) " UWORD _CNV_A_R_LINEAR_____272_CM 1 100. 0. 7.99987793 ECU_ADDRESS 0x3fc7b6 FORMAT "%7.4" /end MEASUREMENT
/begin MEASUREMENT FUEL_FLOW_ADD_BUF_5_ "Array of FUEL_FLOW_ADD_AD_CP values(20 values) " UWORD _CNV_A_R_LINEAR_____272_CM 1 100. 0. 7.99987793 ECU_ADDRESS 0x3fc7b8 FORMAT "%7.4" /end MEASUREMENT
/begin MEASUREMENT FUEL_FLOW_ADD_BUF_6_ "Array of FUEL_FLOW_ADD_AD_CP values(20 values) " UWORD _CNV_A_R_LINEAR_____272_CM 1 100. 0. 7.99987793 ECU_ADDRESS 0x3fc7ba FORMAT "%7.4" /end MEASUREMENT
/begin MEASUREMENT FUEL_FLOW_ADD_BUF_7_ "Array of FUEL_FLOW_ADD_AD_CP values(20 values) " UWORD _CNV_A_R_LINEAR_____272_CM 1 100. 0. 7.99987793 ECU_ADDRESS 0x3fc7bc FORMAT "%7.4" /end MEASUREMENT
/begin MEASUREMENT FUEL_FLOW_ADD_BUF_8_ "Array of FUEL_FLOW_ADD_AD_CP values(20 values) " UWORD _CNV_A_R_LINEAR_____272_CM 1 100. 0. 7.99987793 ECU_ADDRESS 0x3fc7be FORMAT "%7.4" /end MEASUREMENT
/begin MEASUREMENT FUEL_FLOW_ADD_BUF_9_ "Array of FUEL_FLOW_ADD_AD_CP values(20 values) " UWORD _CNV_A_R_LINEAR_____272_CM 1 100. 0. 7.99987793 ECU_ADDRESS 0x3fc7c0 FORMAT "%7.4" /end MEASUREMENT
/begin MEASUREMENT FUEL_FLOW_ADD_BUF_10_ "Array of FUEL_FLOW_ADD_AD_CP values(20 values) " UWORD _CNV_A_R_LINEAR_____272_CM 1 100. 0. 7.99987793 ECU_ADDRESS 0x3fc7c2 FORMAT "%7.4" /end MEASUREMENT
/begin MEASUREMENT FUEL_FLOW_ADD_BUF_11_ "Array of FUEL_FLOW_ADD_AD_CP values(20 values) " UWORD _CNV_A_R_LINEAR_____272_CM 1 100. 0. 7.99987793 ECU_ADDRESS 0x3fc7c4 FORMAT "%7.4" /end MEASUREMENT
/begin MEASUREMENT FUEL_FLOW_ADD_BUF_12_ "Array of FUEL_FLOW_ADD_AD_CP values(20 values) " UWORD _CNV_A_R_LINEAR_____272_CM 1 100. 0. 7.99987793 ECU_ADDRESS 0x3fc7c6 FORMAT "%7.4" /end MEASUREMENT
/begin MEASUREMENT FUEL_FLOW_ADD_BUF_13_ "Array of FUEL_FLOW_ADD_AD_CP values(20 values) " UWORD _CNV_A_R_LINEAR_____272_CM 1 100. 0. 7.99987793 ECU_ADDRESS 0x3fc7c8 FORMAT "%7.4" /end MEASUREMENT
/begin MEASUREMENT FUEL_FLOW_ADD_BUF_14_ "Array of FUEL_FLOW_ADD_AD_CP values(20 values) " UWORD _CNV_A_R_LINEAR_____272_CM 1 100. 0. 7.99987793 ECU_ADDRESS 0x3fc7ca FORMAT "%7.4" /end MEASUREMENT
/begin MEASUREMENT FUEL_FLOW_ADD_BUF_15_ "Array of FUEL_FLOW_ADD_AD_CP values(20 values) " UWORD _CNV_A_R_LINEAR_____272_CM 1 100. 0. 7.99987793 ECU_ADDRESS 0x3fc7cc FORMAT "%7.4" /end MEASUREMENT
/begin MEASUREMENT FUEL_FLOW_ADD_BUF_16_ "Array of FUEL_FLOW_ADD_AD_CP values(20 values) " UWORD _CNV_A_R_LINEAR_____272_CM 1 100. 0. 7.99987793 ECU_ADDRESS 0x3fc7ce FORMAT "%7.4" /end MEASUREMENT
/begin MEASUREMENT FUEL_FLOW_ADD_BUF_17_ "Array of FUEL_FLOW_ADD_AD_CP values(20 values) " UWORD _CNV_A_R_LINEAR_____272_CM 1 100. 0. 7.99987793 ECU_ADDRESS 0x3fc7d0 FORMAT "%7.4" /end MEASUREMENT
/begin MEASUREMENT FUEL_FLOW_ADD_BUF_18_ "Array of FUEL_FLOW_ADD_AD_CP values(20 values) " UWORD _CNV_A_R_LINEAR_____272_CM 1 100. 0. 7.99987793 ECU_ADDRESS 0x3fc7d2 FORMAT "%7.4" /end MEASUREMENT
/begin MEASUREMENT FUEL_FLOW_ADD_BUF_19_ "Array of FUEL_FLOW_ADD_AD_CP values(20 values) " UWORD _CNV_A_R_LINEAR_____272_CM 1 100. 0. 7.99987793 ECU_ADDRESS 0x3fc7d4 FORMAT "%7.4" /end MEASUREMENT
/begin CHARACTERISTIC IP_T_DLY_CP__MAF_CYL "Time delay for MAF_CYL" CURVE 0x62aa2 _REC_CUR_20_u2_u2 63.99902344 _CNV_A_R_LINEAR_____280_CM 0. 63.99902344 FORMAT "%7.4"
 /begin AXIS_DESCR COM_AXIS MAF_CYL _CNV_A_R_LINEAR_____52_CM 6 0. 2047.96875 FORMAT "%6.2" AXIS_PTS_REF ldpm_maf_cyl_ip_rel_flow_inc_cp /end AXIS_DESCR
/end CHARACTERISTIC
/begin MEASUREMENT PRS_CPS "Pressure difference at CPS" SWORD _CNV_A_R_LINEAR_____281_CM 1 100. -2717.04 2716.96 ECU_ADDRESS 0x3fc754 FORMAT "%8.2" /end MEASUREMENT
/begin CHARACTERISTIC C_CRLC_LAMB_MMV "Correlation constants for lambda" VALUE 0x621af _REC_VAL_20_u1 0.9960940000000002 _CNV_A_R_LINEAR_____8_CM 0. 0.996094 FORMAT "%5.3" /end CHARACTERISTIC
/begin MEASUREMENT LV_LAM_LIM "Limit indicator" UBYTE _CNV_S_2_RANGE______76_CM 1 100. 0. 1. ECU_ADDRESS 0x3fd454 BIT_MASK 0x1 /end MEASUREMENT
/begin MEASUREMENT LV_OBD_CDN_MIN_MOD "Logical value for MIN_PURGE authorization by projectspecific conditions " UBYTE _CNV_S_2_RANGE______74_CM 1 100. 0. 1. ECU_ADDRESS 0x3fd458 BIT_MASK 0x1 /end MEASUREMENT
/begin MEASUREMENT LV_TI_LAM_COR_CP "LV for TI_LAM correction during RAMP_OPEN" UBYTE _CNV_S_2_RANGE______74_CM 1 100. 0. 1. ECU_ADDRESS 0x3fd459 BIT_MASK 0x1 /end MEASUREMENT
/begin MEASUREMENT TI_LAM_CP "value for TI_LAM correction when LV_TI_LAM_COR_CP = 1" SWORD _CNV_A_R_LINEAR_____149_CM 1 100. -50. 49.99847412 ECU_ADDRESS 0x3fc75a FORMAT "%7.3" /end MEASUREMENT
/begin CHARACTERISTIC IP_REL_FLOW_CPS_AFL__N_32__MAF "REL_FLOW_CPS value during MIN_PURGE operation and homogenous lean burn mode" MAP 0x62264 _REC_MAP_20_u2_u1_u1 0.99998474 _CNV_A_R_LINEAR_____2_CM 0. 0.99998474 FORMAT "%7.5"
 /begin AXIS_DESCR COM_AXIS N_32 _CNV_A_R_LINEAR_____15_CM 6 0. 8160. FORMAT "%4.0" AXIS_PTS_REF ldpm_n_32_ip_rel_flow_cps_s /end AXIS_DESCR
 /begin AXIS_DESCR COM_AXIS MAF _CNV_A_R_LINEAR_____51_CM 6 0. 1389. FORMAT "%4.0" AXIS_PTS_REF ldpm_maf_ip_rel_flow_cps_s /end AXIS_DESCR
/end CHARACTERISTIC
/begin CHARACTERISTIC IP_FUEL_MAX_CP_S__N_32__TQI_SP "Relative fuel flow max value during stratified mode" MAP 0x6272a _REC_MAP_20_u2_u1_u2 0.99998474 _CNV_A_R_LINEAR_____2_CM 0. 0.99998474 FORMAT "%7.5"
 /begin AXIS_DESCR COM_AXIS N_32 _CNV_A_R_LINEAR_____15_CM 12 0. 8160. FORMAT "%4.0" AXIS_PTS_REF ldpm_n_32_ip_rel_flow_max_cps /end AXIS_DESCR
 /begin AXIS_DESCR COM_AXIS TQI_SP _CNV_A_R_LINEAR_____37_CM 12 0. 1023.96875 FORMAT "%7.2" AXIS_PTS_REF ldpm_tqi_sp_s_cp /end AXIS_DESCR
/end CHARACTERISTIC
/begin AXIS_PTS ldpm_tqi_sp_s_cp "" 0x60bca TQI_SP _REC_AXS_20_u2 1023.96875 _CNV_A_R_LINEAR_____37_CM 12 0. 1023.96875 FORMAT "%7.2" /end AXIS_PTS
/begin CHARACTERISTIC IP_FUEL_MAX_CP_AFL__N_32__MAF "Relative fuel flow max value during homogenous lean burn" MAP 0x624ea _REC_MAP_20_u2_u1_u1 0.99998474 _CNV_A_R_LINEAR_____2_CM 0. 0.99998474 FORMAT "%7.5"
 /begin AXIS_DESCR COM_AXIS N_32 _CNV_A_R_LINEAR_____15_CM 12 0. 8160. FORMAT "%4.0" AXIS_PTS_REF ldpm_n_32_ip_rel_flow_max_cps /end AXIS_DESCR
 /begin AXIS_DESCR COM_AXIS MAF _CNV_A_R_LINEAR_____51_CM 12 0. 1389. FORMAT "%4.0" AXIS_PTS_REF ldpm_maf_ip_rel_flow_max_cps /end AXIS_DESCR
/end CHARACTERISTIC
/begin CHARACTERISTIC IP_FUEL_MAX_CP_HOM__N_32__MAF "Relative fuel flow max value during homogenous lambda 1" MAP 0x6260a _REC_MAP_20_u2_u1_u1 0.99998474 _CNV_A_R_LINEAR_____2_CM 0. 0.99998474 FORMAT "%7.5"
 /begin AXIS_DESCR COM_AXIS N_32 _CNV_A_R_LINEAR_____15_CM 12 0. 8160. FORMAT "%4.0" AXIS_PTS_REF ldpm_n_32_ip_rel_flow_max_cps /end AXIS_DESCR
 /begin AXIS_DESCR COM_AXIS MAF _CNV_A_R_LINEAR_____51_CM 12 0. 1389. FORMAT "%4.0" AXIS_PTS_REF ldpm_maf_ip_rel_flow_max_cps /end AXIS_DESCR
/end CHARACTERISTIC
/begin CHARACTERISTIC IP_MFF_FAC_CP__N_32__TQI_SP_S "Fuel flow correction in case of stratified mode" MAP 0x6284a _REC_MAP_20_u2_u1_u2 0.99998474 _CNV_A_R_LINEAR_____2_CM 0. 0.99998474 FORMAT "%7.5"
 /begin AXIS_DESCR COM_AXIS N_32 _CNV_A_R_LINEAR_____15_CM 12 0. 8160. FORMAT "%4.0" AXIS_PTS_REF ldpm_n_32_ip_rel_flow_max_cps /end AXIS_DESCR
 /begin AXIS_DESCR COM_AXIS TQI_SP _CNV_A_R_LINEAR_____37_CM 12 0. 1023.96875 FORMAT "%7.2" AXIS_PTS_REF ldpm_tqi_sp_s_cp /end AXIS_DESCR
/end CHARACTERISTIC
/begin CHARACTERISTIC IP_CPPWM_MIN_DIAG__FRQ_REQ_CP "CPPWM_CPS minimum limit to assure the diagnosis" CURVE 0x6296e _REC_CUR_20_u1_u1 99.609375 _CNV_A_R_LINEAR_____16_CM 0. 99.609375 FORMAT "%5.1"
 /begin AXIS_DESCR COM_AXIS FRQ_REQ_CP _CNV_A_R_LINEAR_____271_CM 4 0. 255. FORMAT "%3.0" AXIS_PTS_REF ldpm_frq_req_cp /end AXIS_DESCR
/end CHARACTERISTIC
/begin AXIS_PTS ldpm_frq_req_cp "" 0x60be4 FRQ_REQ_CP _REC_AXS_20_u1 255. _CNV_A_R_LINEAR_____271_CM 4 0. 255. FORMAT "%3.0" /end AXIS_PTS
/begin CHARACTERISTIC IP_CPPWM_MAX_DIAG__FRQ_REQ_CP "CPPWM_CPS maximum limit to assure the diagnosis" CURVE 0x6296a _REC_CUR_20_u1_u1 99.609375 _CNV_A_R_LINEAR_____16_CM 0. 99.609375 FORMAT "%5.1"
 /begin AXIS_DESCR COM_AXIS FRQ_REQ_CP _CNV_A_R_LINEAR_____271_CM 4 0. 255. FORMAT "%3.0" AXIS_PTS_REF ldpm_frq_req_cp /end AXIS_DESCR
/end CHARACTERISTIC
/begin MEASUREMENT STATE_CP "State of Evaporative Emission Control Function" UBYTE _CNV_S_8_RANGE_STAT_282_CM 1 100. 0. 7. ECU_ADDRESS 0x3fd826 /end MEASUREMENT
/begin MEASUREMENT LAMB "lambda value" UWORD _CNV_A_R_LINEAR_____50_CM 1 100. 0. 31.99902344 ECU_ADDRESS 0x3fc75c FORMAT "%7.4" /end MEASUREMENT
/begin CHARACTERISTIC C_TCO_MIN_CP "" VALUE 0x621b0 _REC_VAL_20_u1 28.575 _CNV_A_R_LINEAR_____22_CM -48. 142.5 FORMAT "%5.1" /end CHARACTERISTIC
/begin AXIS_PTS ldpm_mff_mmv "" 0x60f54 MFF_MMV _REC_AXS_20_u2 1389. _CNV_A_R_LINEAR_____56_CM 6 0. 1389. FORMAT "%7.2" /end AXIS_PTS
/begin MEASUREMENT GENSTATROH "Status Generator" UBYTE _CNV_A_R_LINEAR_____13_CM 1 100. 0. 255. ECU_ADDRESS 0x3fdb86 FORMAT "%3.0" /end MEASUREMENT
/begin MEASUREMENT GENTIMERPD "predrive-timer" UBYTE _CNV_A_R_LINEAR_____313_CM 1 100. 0. 25500. ECU_ADDRESS 0x3fdb87 FORMAT "%5.0" /end MEASUREMENT
/begin MEASUREMENT ST_GEN "Generatorstatus" UBYTE _CNV_A_R_LINEAR_____17_CM 1 100. 0. 3. ECU_ADDRESS 0x3fdb88 FORMAT "%2.0" /end MEASUREMENT
/begin MEASUREMENT B_KL61 "Bedingung KL61" UBYTE _CNV_S_2_RANGE______74_CM 1 100. 0. 1. ECU_ADDRESS 0x3fdb85 /end MEASUREMENT
/begin MEASUREMENT B_GENHFTAK "Bedingung Generatortemperaturabregelung aktiv" UBYTE _CNV_S_2_RANGE______74_CM 1 100. 0. 1. ECU_ADDRESS 0x3fdb84 /end MEASUREMENT
/begin CHARACTERISTIC GEN_DNMIN "" VALUE 0x6d93c _REC_VAL_20_u2 16383.75 _CNV_A_R_LINEAR_____173_CM 0. 16383.75 FORMAT "%8.2" /end CHARACTERISTIC
/begin CHARACTERISTIC GENPDTIME "" VALUE 0x6d93e _REC_VAL_20_u1 25500. _CNV_A_R_LINEAR_____313_CM 0. 25500. FORMAT "%5.0" /end CHARACTERISTIC
/begin MEASUREMENT DFFGEN "DF-signal from alternator" UBYTE _CNV_A_R_LINEAR_____16_CM 1 100. 0. 99.609375 ECU_ADDRESS 0x3fd9e0 FORMAT "%5.1" /end MEASUREMENT
/begin MEASUREMENT TLRFGEN "received load response time from alternator" UBYTE _CNV_A_R_LINEAR_____18_CM 1 100. 0. 25.5 ECU_ADDRESS 0x3fd9e1 FORMAT "%4.1" /end MEASUREMENT
/begin MEASUREMENT UFGEN "received alternator voltage" UBYTE _CNV_A_R_LINEAR_____314_CM 1 100. 10.6 16.9 ECU_ADDRESS 0x3fd9e2 FORMAT "%4.1" /end MEASUREMENT
/begin MEASUREMENT B_GENFEL "alternator failure: electrical" UBYTE _CNV_S_2_RANGE______74_CM 1 100. 0. 1. ECU_ADDRESS 0x3fd9e3 /end MEASUREMENT
/begin MEASUREMENT B_GENFHT "alternator failure: high temperature" UBYTE _CNV_S_2_RANGE______74_CM 1 100. 0. 1. ECU_ADDRESS 0x3fd9e4 /end MEASUREMENT
/begin MEASUREMENT B_GENFME "alternator failure: mechanical" UBYTE _CNV_S_2_RANGE______74_CM 1 100. 0. 1. ECU_ADDRESS 0x3fd9e5 /end MEASUREMENT
/begin MEASUREMENT B_GENFBSD "alternator failure: BSD interface" UBYTE _CNV_S_2_RANGE______74_CM 1 100. 0. 1. ECU_ADDRESS 0x3fd9e6 /end MEASUREMENT
/begin MEASUREMENT NMOT_W "" UWORD _CNV_A_R_LINEAR_____173_CM 1 100. 0. 16383.75 ECU_ADDRESS 0x3fd2b4 FORMAT "%8.2" /end MEASUREMENT
/begin MEASUREMENT LV_EGR_ACT "Logical value for EGR-control active" UBYTE _CNV_S_2_RANGE______76_CM 1 100. 0. 1. ECU_ADDRESS 0x3fd489 BIT_MASK 0x1 /end MEASUREMENT
/begin MEASUREMENT ER_STND_DIF_0 "Difference of normalized and filtered normalized engine roughness value" SWORD _CNV_A_R_LINEAR_____315_CM 1 100. -325.78 325.77 ECU_ADDRESS 0x3fc814 FORMAT "%8.3" /end MEASUREMENT
/begin MEASUREMENT ER_STND_DIF_1 "Difference of normalized and filtered normalized engine roughness value" SWORD _CNV_A_R_LINEAR_____315_CM 1 100. -325.78 325.77 ECU_ADDRESS 0x3fc816 FORMAT "%8.3" /end MEASUREMENT
/begin MEASUREMENT ER_STND_DIF_2 "Difference of normalized and filtered normalized engine roughness value" SWORD _CNV_A_R_LINEAR_____315_CM 1 100. -325.78 325.77 ECU_ADDRESS 0x3fc818 FORMAT "%8.3" /end MEASUREMENT
/begin MEASUREMENT ER_STND_DIF_3 "Difference of normalized and filtered normalized engine roughness value" SWORD _CNV_A_R_LINEAR_____315_CM 1 100. -325.78 325.77 ECU_ADDRESS 0x3fc81a FORMAT "%8.3" /end MEASUREMENT
/begin MEASUREMENT ER_STND_DIF_4 "Difference of normalized and filtered normalized engine roughness value" SWORD _CNV_A_R_LINEAR_____315_CM 1 100. -325.78 325.77 ECU_ADDRESS 0x3fc81c FORMAT "%8.3" /end MEASUREMENT
/begin MEASUREMENT ER_STND_DIF_5 "Difference of normalized and filtered normalized engine roughness value" SWORD _CNV_A_R_LINEAR_____315_CM 1 100. -325.78 325.77 ECU_ADDRESS 0x3fc81e FORMAT "%8.3" /end MEASUREMENT
/begin MEASUREMENT ER_STND_MMV_0 "Filtered normalized engine roughness value" SWORD _CNV_A_R_LINEAR_____315_CM 1 100. -325.78 325.77 ECU_ADDRESS 0x3fc820 FORMAT "%8.3" /end MEASUREMENT
/begin MEASUREMENT ER_STND_MMV_1 "Filtered normalized engine roughness value" SWORD _CNV_A_R_LINEAR_____315_CM 1 100. -325.78 325.77 ECU_ADDRESS 0x3fc822 FORMAT "%8.3" /end MEASUREMENT
/begin MEASUREMENT ER_STND_MMV_2 "Filtered normalized engine roughness value" SWORD _CNV_A_R_LINEAR_____315_CM 1 100. -325.78 325.77 ECU_ADDRESS 0x3fc824 FORMAT "%8.3" /end MEASUREMENT
/begin MEASUREMENT ER_STND_MMV_3 "Filtered normalized engine roughness value" SWORD _CNV_A_R_LINEAR_____315_CM 1 100. -325.78 325.77 ECU_ADDRESS 0x3fc826 FORMAT "%8.3" /end MEASUREMENT
/begin MEASUREMENT ER_STND_MMV_4 "Filtered normalized engine roughness value" SWORD _CNV_A_R_LINEAR_____315_CM 1 100. -325.78 325.77 ECU_ADDRESS 0x3fc828 FORMAT "%8.3" /end MEASUREMENT
/begin MEASUREMENT ER_STND_MMV_5 "Filtered normalized engine roughness value" SWORD _CNV_A_R_LINEAR_____315_CM 1 100. -325.78 325.77 ECU_ADDRESS 0x3fc82a FORMAT "%8.3" /end MEASUREMENT
/begin MEASUREMENT ER_STND_0 "Normalized engine roughness value" SWORD _CNV_A_R_LINEAR_____315_CM 1 100. -325.78 325.77 ECU_ADDRESS 0x3fc808 FORMAT "%8.3" /end MEASUREMENT
/begin MEASUREMENT ER_STND_1 "Normalized engine roughness value" SWORD _CNV_A_R_LINEAR_____315_CM 1 100. -325.78 325.77 ECU_ADDRESS 0x3fc80a FORMAT "%8.3" /end MEASUREMENT
/begin MEASUREMENT ER_STND_2 "Normalized engine roughness value" SWORD _CNV_A_R_LINEAR_____315_CM 1 100. -325.78 325.77 ECU_ADDRESS 0x3fc80c FORMAT "%8.3" /end MEASUREMENT
/begin MEASUREMENT ER_STND_3 "Normalized engine roughness value" SWORD _CNV_A_R_LINEAR_____315_CM 1 100. -325.78 325.77 ECU_ADDRESS 0x3fc80e FORMAT "%8.3" /end MEASUREMENT
/begin MEASUREMENT ER_STND_4 "Normalized engine roughness value" SWORD _CNV_A_R_LINEAR_____315_CM 1 100. -325.78 325.77 ECU_ADDRESS 0x3fc810 FORMAT "%8.3" /end MEASUREMENT
/begin MEASUREMENT ER_STND_5 "Normalized engine roughness value" SWORD _CNV_A_R_LINEAR_____315_CM 1 100. -325.78 325.77 ECU_ADDRESS 0x3fc812 FORMAT "%8.3" /end MEASUREMENT
/begin MEASUREMENT ER_STD_0 "Standard deviation of engine roughness" SWORD _CNV_A_R_LINEAR_____315_CM 1 100. -325.78 325.77 ECU_ADDRESS 0x3fc82c FORMAT "%8.3" /end MEASUREMENT
/begin MEASUREMENT ER_STD_1 "Standard deviation of engine roughness" SWORD _CNV_A_R_LINEAR_____315_CM 1 100. -325.78 325.77 ECU_ADDRESS 0x3fc82e FORMAT "%8.3" /end MEASUREMENT
/begin MEASUREMENT ER_STD_2 "Standard deviation of engine roughness" SWORD _CNV_A_R_LINEAR_____315_CM 1 100. -325.78 325.77 ECU_ADDRESS 0x3fc830 FORMAT "%8.3" /end MEASUREMENT
/begin MEASUREMENT ER_STD_3 "Standard deviation of engine roughness" SWORD _CNV_A_R_LINEAR_____315_CM 1 100. -325.78 325.77 ECU_ADDRESS 0x3fc832 FORMAT "%8.3" /end MEASUREMENT
/begin MEASUREMENT ER_STD_4 "Standard deviation of engine roughness" SWORD _CNV_A_R_LINEAR_____315_CM 1 100. -325.78 325.77 ECU_ADDRESS 0x3fc834 FORMAT "%8.3" /end MEASUREMENT
/begin MEASUREMENT ER_STD_5 "Standard deviation of engine roughness" SWORD _CNV_A_R_LINEAR_____315_CM 1 100. -325.78 325.77 ECU_ADDRESS 0x3fc836 FORMAT "%8.3" /end MEASUREMENT
/begin MEASUREMENT EGR_RATIO_SP "EGR-Ratio Setpoint" UWORD _CNV_A_R_LINEAR_____144_CM 1 100. 0. 99.99847412 ECU_ADDRESS 0x3fc802 /end MEASUREMENT
/begin MEASUREMENT ER_STD_MAX "Maximum standard deviation of engine roughness of all cylinders " SWORD _CNV_A_R_LINEAR_____315_CM 1 100. -325.78 325.77 ECU_ADDRESS 0x3fc838 FORMAT "%8.3" /end MEASUREMENT
/begin MEASUREMENT ER_DIF_MAX "Maximum difference of standard deviation of engine roughness and threshold value of all cylinders" SWORD _CNV_A_R_LINEAR_____315_CM 1 100. -325.78 325.77 ECU_ADDRESS 0x3fc83a FORMAT "%8.3" /end MEASUREMENT
/begin MEASUREMENT ER_EGR "Filtered engine roughness value with EGR" SWORD _CNV_A_R_LINEAR_____315_CM 1 100. -325.78 325.77 ECU_ADDRESS 0x3fc83c FORMAT "%8.3" /end MEASUREMENT
/begin MEASUREMENT FAC_EGR_RATIO "Increment factor for EGR-ratio adaptation" UBYTE _CNV_A_R_LINEAR_____316_CM 1 100. 1. 1.996 ECU_ADDRESS 0x3fd850 FORMAT "%5.3" /end MEASUREMENT
/begin MEASUREMENT EGR_RATIO_AD_MEM "Stored EGR-ratio adaptation value" SBYTE _CNV_A_R_LINEAR_____16_CM 1 100. -50. 49.609375 ECU_ADDRESS 0x3fd84c FORMAT "%5.1" /end MEASUREMENT
/begin MEASUREMENT EGR_RATIO_ADD_AD "Additive EGR-ratio adaptation value" SBYTE _CNV_A_R_LINEAR_____16_CM 1 100. -50. 49.609375 ECU_ADDRESS 0x3fd851 FORMAT "%5.1" /end MEASUREMENT
/begin MEASUREMENT ER_EGR_CTR "Counter for ER_EGR>0" UBYTE _CNV_A_R_LINEAR_____13_CM 1 100. 0. 255. ECU_ADDRESS 0x3fd84d FORMAT "%3.0" /end MEASUREMENT
/begin MEASUREMENT T_EGR_RATIO_AD_POS "Time counter with constant FAC_EGR_RATIO" UWORD _CNV_A_R_LINEAR_____150_CM 1 100. 0. 1310.7 ECU_ADDRESS 0x3fc83e FORMAT "%7.2" /end MEASUREMENT
/begin MEASUREMENT MAF_SP_EGR "EGR-flow setpoint" UWORD _CNV_A_R_LINEAR_____52_CM 1 100. 0. 2047.96875 ECU_ADDRESS 0x3fc840 FORMAT "%7.2" /end MEASUREMENT
/begin MEASUREMENT PSI_SP_EGR "EGR-flow rate setpoint" UWORD _CNV_A_R_LINEAR_____285_CM 1 100. 0. 8.880330000000001 ECU_ADDRESS 0x3fc842 FORMAT "%6.4" /end MEASUREMENT
/begin MEASUREMENT AR_RED_SP_EGR "EGR-valve opening area setpoint" UWORD _CNV_A_R_LINEAR_____286_CM 1 100. 0. 58.592855 ECU_ADDRESS 0x3fc844 FORMAT "%7.4" /end MEASUREMENT
/begin MEASUREMENT EGRPWM_PREV "Pre-control duty-cycle of EGR-valve" UWORD _CNV_A_R_LINEAR_____159_CM 1 100. 0. 99.99694824 ECU_ADDRESS 0x3fc846 /end MEASUREMENT
/begin MEASUREMENT STK_DIF_EGR "Difference between nominal and actual value of the EGR valve stroke" UBYTE _CNV_A_R_LINEAR_____60_CM 1 100. -50. 49.6094 ECU_ADDRESS 0x3fd84f FORMAT "%5.1" /end MEASUREMENT
/begin MEASUREMENT EGRPWM_I "Integral term of PI controller" SWORD _CNV_A_R_LINEAR_____12_CM 1 100. -100. 99.99694824 ECU_ADDRESS 0x3fc848 FORMAT "%8.3" /end MEASUREMENT
/begin MEASUREMENT EGRPWM_P "Proportional term of PI controller" SWORD _CNV_A_R_LINEAR_____12_CM 1 100. -100. 99.99694824 ECU_ADDRESS 0x3fc84a FORMAT "%8.3" /end MEASUREMENT
/begin MEASUREMENT EGRPWM_TMP "Duty cycle for EGR valve control" SWORD _CNV_A_R_LINEAR_____12_CM 1 100. -100. 99.99694824 ECU_ADDRESS 0x3fc804 FORMAT "%8.3" /end MEASUREMENT
/begin MEASUREMENT EGRPWM "Duty cycle for EGR valve control" SWORD _CNV_A_R_LINEAR_____12_CM 1 100. -100. 99.99694824 ECU_ADDRESS 0x3fc806 FORMAT "%8.3" /end MEASUREMENT
/begin MEASUREMENT STATE_OVL_EGR "Overload state" UBYTE _CNV_A_R_LINEAR_____13_CM 1 100. 0. 255. ECU_ADDRESS 0x3fd857 FORMAT "%3.0" /end MEASUREMENT
/begin MEASUREMENT V_AD_BOL_EGR "lower adaptation value EGR-POTI" UWORD _CNV_A_R_LINEAR_____38_CM 1 100. 0. 4.99511719 ECU_ADDRESS 0x3fc7f4 FORMAT "%5.3" /end MEASUREMENT
/begin MEASUREMENT AD_BOL_EGR "measured lower value for EGR-POTI adaptation" UWORD _CNV_A_R_LINEAR_____38_CM 1 100. 0. 4.99511719 ECU_ADDRESS 0x3fc7fc FORMAT "%5.3" /end MEASUREMENT
/begin CHARACTERISTIC C_TCO_MIN_EGR "Minimum temperature for EGR-control active" VALUE 0x6433c _REC_VAL_20_u1 190.5 _CNV_A_R_LINEAR_____22_CM -48. 142.5 FORMAT "%5.1" /end CHARACTERISTIC
/begin CHARACTERISTIC C_T_AST_EGR "time delay for EGR active after start" VALUE 0x6433e _REC_VAL_20_u2 6553.5 _CNV_A_R_LINEAR_____18_CM 0. 6553.5 FORMAT "%6.1" /end CHARACTERISTIC
/begin CHARACTERISTIC C_FAC_VVT_THD "Constant for measured camshaft position " VALUE 0x64340 _REC_VAL_20_u1 0.9960940000000002 _CNV_A_R_LINEAR_____8_CM 0. 0.996094 FORMAT "%5.3" /end CHARACTERISTIC
/begin CHARACTERISTIC C_ER_STND_CRLC "Correlation constant for ER_STND filter" VALUE 0x64341 _REC_VAL_20_u1 0.9960940000000002 _CNV_A_R_LINEAR_____8_CM 0. 0.996094 FORMAT "%5.3" /end CHARACTERISTIC
/begin CHARACTERISTIC C_ER_DIF_MAX_CRLC "Correlation constant for ER_DIF_MAX filter" VALUE 0x64342 _REC_VAL_20_u1 0.9960940000000002 _CNV_A_R_LINEAR_____8_CM 0. 0.996094 FORMAT "%5.3" /end CHARACTERISTIC
/begin CHARACTERISTIC C_FAC_ER_POS "Weighting factor for positive ER_STND_DIF values" VALUE 0x64343 _REC_VAL_20_u1 0.9960940000000002 _CNV_A_R_LINEAR_____8_CM 0. 0.996094 FORMAT "%5.3" /end CHARACTERISTIC
/begin CHARACTERISTIC C_FAC_ER_NEG "Weighting factor for negative ER_STND_DIF values" VALUE 0x64344 _REC_VAL_20_u1 0.9960940000000002 _CNV_A_R_LINEAR_____8_CM 0. 0.996094 FORMAT "%5.3" /end CHARACTERISTIC
/begin CHARACTERISTIC C_MAF_EGR_AD_POS_BOL "Minimum mass air flow for EGR-adaptation active (max. flow)" VALUE 0x64346 _REC_VAL_20_u2 1389. _CNV_A_R_LINEAR_____56_CM 0. 1389. FORMAT "%7.2" /end CHARACTERISTIC
/begin CHARACTERISTIC C_MAF_EGR_AD_POS_TOL "Maximum mass air flow for EGR-adaptation active (max. flow)" VALUE 0x64348 _REC_VAL_20_u2 1389. _CNV_A_R_LINEAR_____56_CM 0. 1389. FORMAT "%7.2" /end CHARACTERISTIC
/begin CHARACTERISTIC C_N_EGR_AD_POS_TOL "Maximum engine speed for EGR-adaptation active (max. flow)" VALUE 0x6434b _REC_VAL_20_u1 8160. _CNV_A_R_LINEAR_____15_CM 0. 8160. FORMAT "%4.0" /end CHARACTERISTIC
/begin CHARACTERISTIC C_MAF_EGR_AD_BOL "Minimum mass air flow for EGR-adaptation active" VALUE 0x6434c _REC_VAL_20_u2 1389. _CNV_A_R_LINEAR_____56_CM 0. 1389. FORMAT "%7.2" /end CHARACTERISTIC
/begin CHARACTERISTIC C_MAF_EGR_AD_TOL "Maximum mass air flow for EGR-adaptation active" VALUE 0x6434e _REC_VAL_20_u2 1389. _CNV_A_R_LINEAR_____56_CM 0. 1389. FORMAT "%7.2" /end CHARACTERISTIC
/begin CHARACTERISTIC C_N_EGR_AD_POS_BOL "Minimum engine speed for EGR-adaptation active (max. flow)" VALUE 0x6434a _REC_VAL_20_u1 8160. _CNV_A_R_LINEAR_____15_CM 0. 8160. FORMAT "%4.0" /end CHARACTERISTIC
/begin CHARACTERISTIC C_N_EGR_AD_BOL "Minimum engine speed for EGR-adaptation active" VALUE 0x64350 _REC_VAL_20_u1 8160. _CNV_A_R_LINEAR_____15_CM 0. 8160. FORMAT "%4.0" /end CHARACTERISTIC
/begin CHARACTERISTIC C_N_EGR_AD_TOL "Maximum engine speed for EGR-adaptation active" VALUE 0x64351 _REC_VAL_20_u1 8160. _CNV_A_R_LINEAR_____15_CM 0. 8160. FORMAT "%4.0" /end CHARACTERISTIC
/begin CHARACTERISTIC C_T_EGR_RATIO_AD_POS "Time limit for max. EGR-Ratio adaptation" VALUE 0x64352 _REC_VAL_20_u2 1310.7 _CNV_A_R_LINEAR_____150_CM 0. 1310.7 FORMAT "%7.2" /end CHARACTERISTIC
/begin CHARACTERISTIC C_EGR_RATIO_AD_CRLC "Correlation constant for EGR_RATIO_AD_MEM filter" VALUE 0x64354 _REC_VAL_20_u1 0.9960940000000002 _CNV_A_R_LINEAR_____8_CM 0. 0.996094 FORMAT "%5.3" /end CHARACTERISTIC
/begin CHARACTERISTIC C_ER_EGR_CTR_TOL "Maximum ER_EGR_CTR-value" VALUE 0x64355 _REC_VAL_20_u1 255. _CNV_A_R_LINEAR_____13_CM 0. 255. FORMAT "%3.0" /end CHARACTERISTIC
/begin CHARACTERISTIC C_EGR_RATIO_SP_AD_MIN "Minimum EGR-Ratio Setpoint value for EGR-adaptation active" VALUE 0x64356 _REC_VAL_20_u2 99.99694824000001 _CNV_A_R_LINEAR_____159_CM 0. 99.99694824 /end CHARACTERISTIC
/begin MEASUREMENT STK_SP_EGR_TMP "EGR-valve lift setpoint" UBYTE _CNV_A_R_LINEAR_____16_CM 1 100. 0. 99.609375 ECU_ADDRESS 0x3fd852 FORMAT "%4.1" /end MEASUREMENT
/begin MEASUREMENT STK_SP_EGR "EGR throttle position setpoint after limitation with absolute limits" UBYTE _CNV_A_R_LINEAR_____16_CM 1 100. 0. 99.609375 ECU_ADDRESS 0x3fd853 FORMAT "%4.1" /end MEASUREMENT
/begin CHARACTERISTIC C_PSI_SP_MIN_EGR "Minimum limit for EGR-flow rate" VALUE 0x64358 _REC_VAL_20_u2 8.880330000000001 _CNV_A_R_LINEAR_____285_CM 0. 8.880330000000001 FORMAT "%6.4" /end CHARACTERISTIC
/begin CHARACTERISTIC C_EGR_THR_TOL "Above this limit, the opening velocity of the throttle position setpoint is limited%" VALUE 0x6435a _REC_VAL_20_u1 99.609375 _CNV_A_R_LINEAR_____16_CM 0. 99.609375 FORMAT "%4.1" /end CHARACTERISTIC
/begin CHARACTERISTIC C_EGR_THR_BOL "Below this limit, the closing velocity of the throttle position setpoint is limited" VALUE 0x6435b _REC_VAL_20_u1 99.609375 _CNV_A_R_LINEAR_____16_CM 0. 99.609375 FORMAT "%4.1" /end CHARACTERISTIC
/begin CHARACTERISTIC C_EGR_THR_LGRD_STOP "Max. permitted gradient of throttle position setpoint near upper and lower stop position" VALUE 0x6435c _REC_VAL_20_u1 99.609375 _CNV_A_R_LINEAR_____16_CM 0. 99.609375 FORMAT "%4.1" /end CHARACTERISTIC
/begin CHARACTERISTIC C_V_AD_SLOP_EGR "Slope value of the EGR-POTI" VALUE 0x6435e _REC_VAL_20_u2 79.998779 _CNV_A_R_LINEAR_____317_CM 0. 79.998779 /end CHARACTERISTIC
/begin CHARACTERISTIC C_EGRPWM_MAX_POS "maximum PWM-value for opening direction" VALUE 0x64360 _REC_VAL_20_s2 199.99694824 _CNV_A_R_LINEAR_____12_CM -100. 99.99694824 FORMAT "%8.3" /end CHARACTERISTIC
/begin CHARACTERISTIC C_EGRPWM_MAX_NEG "maximum PWM-value for closing direction" VALUE 0x64362 _REC_VAL_20_s2 199.99694824 _CNV_A_R_LINEAR_____12_CM -100. 99.99694824 FORMAT "%8.3" /end CHARACTERISTIC
/begin CHARACTERISTIC C_EGRPWM_I_MAX_NEG "maximum PWM-value for I-part (closing direction)" VALUE 0x64364 _REC_VAL_20_s2 199.99694824 _CNV_A_R_LINEAR_____12_CM -100. 99.99694824 FORMAT "%8.3" /end CHARACTERISTIC
/begin CHARACTERISTIC C_EGRPWM_I_MAX_POS "maximum PWM-value for I-part (opening direction)" VALUE 0x64366 _REC_VAL_20_s2 199.99694824 _CNV_A_R_LINEAR_____12_CM -100. 99.99694824 FORMAT "%8.3" /end CHARACTERISTIC
/begin CHARACTERISTIC C_T_EGR_DLY1 "Limitation timer for EGR motor overload" VALUE 0x64368 _REC_VAL_20_u2 655.35 _CNV_A_R_LINEAR_____21_CM 0. 655.35 FORMAT "%6.2" /end CHARACTERISTIC
/begin CHARACTERISTIC C_T_EGR_DLY2 "Limitation timer for EGR motor overload" VALUE 0x6436a _REC_VAL_20_u2 655.35 _CNV_A_R_LINEAR_____21_CM 0. 655.35 FORMAT "%6.2" /end CHARACTERISTIC
/begin CHARACTERISTIC C_EGRPWM_DFT "Limitation for EGR motor overload" VALUE 0x6436c _REC_VAL_20_u2 99.99694824000001 _CNV_A_R_LINEAR_____159_CM 0. 99.99694824 /end CHARACTERISTIC
/begin CHARACTERISTIC C_EGRPWM_OVL_LIM "Threshold for EGR motor overload" VALUE 0x6436e _REC_VAL_20_u2 99.99694824000001 _CNV_A_R_LINEAR_____159_CM 0. 99.99694824 /end CHARACTERISTIC
/begin CHARACTERISTIC C_V_AD_DYW_EGR "Relative threshold for EGR POTI adaptation" VALUE 0x64370 _REC_VAL_20_u1 1.24511719 _CNV_A_R_LINEAR_____39_CM 0. 1.24511719 FORMAT "%5.3" /end CHARACTERISTIC
/begin CHARACTERISTIC C_DLY_AD_BOL_EGR "Delay time corresponding to the response time of EGR-Valve  (for appl. values see chapter 1)" VALUE 0x64371 _REC_VAL_20_u1 25.5 _CNV_A_R_LINEAR_____18_CM 0. 25.5 FORMAT "%4.1" /end CHARACTERISTIC
/begin CHARACTERISTIC C_V_AD_MIN_BOL_EGR "Minimum permissible voltage for EGR-poti in lower limit stop (for appl. values see chapter 1)" VALUE 0x64372 _REC_VAL_20_u2 4.99511719 _CNV_A_R_LINEAR_____38_CM 0. 4.99511719 FORMAT "%5.3" /end CHARACTERISTIC
/begin CHARACTERISTIC C_V_AD_MAX_BOL_EGR "Maximum permissible voltage for EGR-poti in lower limit stop (for appl. values see chapter 1)" VALUE 0x64374 _REC_VAL_20_u2 4.99511719 _CNV_A_R_LINEAR_____38_CM 0. 4.99511719 FORMAT "%5.3" /end CHARACTERISTIC
/begin CHARACTERISTIC C_V_AD_INI_BOL_EGR "Init-value for EGR-poti in lower limit stop  (for appl. values see chapter 1)" VALUE 0x64376 _REC_VAL_20_u2 4.99511719 _CNV_A_R_LINEAR_____38_CM 0. 4.99511719 FORMAT "%5.3" /end CHARACTERISTIC
/begin AXIS_PTS ldpm_n_32__egr_ratio_s "" 0x611d1 N_32 _REC_AXS_20_u1 8160. _CNV_A_R_LINEAR_____15_CM 12 0. 8160. FORMAT "%4.0" /end AXIS_PTS
/begin AXIS_PTS ldpm_mff_sp_s__egr_ratio_s "" 0x611de MFF_SP_S _REC_AXS_20_u2 1389. _CNV_A_R_LINEAR_____56_CM 12 0. 1389. FORMAT "%7.2" /end AXIS_PTS
/begin AXIS_PTS ldpm_maf__egr_ratio_hom "" 0x611aa MAF _REC_AXS_20_u2 1389. _CNV_A_R_LINEAR_____56_CM 12 0. 1389. FORMAT "%7.2" /end AXIS_PTS
/begin AXIS_PTS ldp_maf_ip_egr_ratio_min "" 0x611f8 MAF _REC_AXS_20_u2 1389. _CNV_A_R_LINEAR_____56_CM 4 0. 1389. FORMAT "%7.2" /end AXIS_PTS
/begin AXIS_PTS ldpm_n_32__egr_ratio_hom "" 0x611c4 N_32 _REC_AXS_20_u1 8160. _CNV_A_R_LINEAR_____15_CM 12 0. 8160. FORMAT "%4.0" /end AXIS_PTS
/begin AXIS_PTS ldp_maf_ip_er_std_thd "" 0x6121c MAF _REC_AXS_20_u2 1389. _CNV_A_R_LINEAR_____56_CM 2 0. 1389. FORMAT "%7.2" /end AXIS_PTS
/begin AXIS_PTS ldp_n_32_ip_egr_ratio_min "" 0x61202 N_32 _REC_AXS_20_u1 8160. _CNV_A_R_LINEAR_____15_CM 4 0. 8160. FORMAT "%4.0" /end AXIS_PTS
/begin AXIS_PTS ldp_n_32_ip_er_std_thd "" 0x61222 N_32 _REC_AXS_20_u1 8160. _CNV_A_R_LINEAR_____15_CM 2 0. 8160. FORMAT "%4.0" /end AXIS_PTS
/begin AXIS_PTS ldp_maf_cyl__egr_ratio_inc "" 0x6120e MAF_CYL _REC_AXS_20_u2 2047.96875 _CNV_A_R_LINEAR_____52_CM 6 0. 2047.96875 FORMAT "%7.2" /end AXIS_PTS
/begin AXIS_PTS ldp_ar_red_sp_egr_stk_sp_egr "" 0x61234 AR_RED_SP_EGR _REC_AXS_20_u2 58.592855 _CNV_A_R_LINEAR_____286_CM 12 0. 58.592855 FORMAT "%7.4" /end AXIS_PTS
/begin CHARACTERISTIC IP_EGR_RATIO_HOM__MAF__N_32 "Basic map for EGR-Ratio Setpoint LV_S_ACT=0 (homomgenous engine operation)" MAP 0x64378 _REC_MAP_20_u1_u2_u1 99.609375 _CNV_A_R_LINEAR_____16_CM 0. 99.609375 FORMAT "%4.1"
 /begin AXIS_DESCR COM_AXIS MAF _CNV_A_R_LINEAR_____56_CM 12 0. 1389. FORMAT "%7.2" AXIS_PTS_REF ldpm_maf__egr_ratio_hom /end AXIS_DESCR
 /begin AXIS_DESCR COM_AXIS N_32 _CNV_A_R_LINEAR_____15_CM 12 0. 8160. FORMAT "%4.0" AXIS_PTS_REF ldpm_n_32__egr_ratio_hom /end AXIS_DESCR
/end CHARACTERISTIC
/begin CHARACTERISTIC IP_EGR_RATIO_S "Basic map for EGR-Ratio Setpoint LV_S_ACT=1 (stratified engine operation)" MAP 0x64408 _REC_MAP_20_u1_u2_u1 99.609375 _CNV_A_R_LINEAR_____16_CM 0. 99.609375 FORMAT "%4.1"
 /begin AXIS_DESCR COM_AXIS MFF_SP_S _CNV_A_R_LINEAR_____56_CM 12 0. 1389. FORMAT "%7.2" AXIS_PTS_REF ldpm_mff_sp_s__egr_ratio_s /end AXIS_DESCR
 /begin AXIS_DESCR COM_AXIS N_32 _CNV_A_R_LINEAR_____15_CM 12 0. 8160. FORMAT "%4.0" AXIS_PTS_REF ldpm_n_32__egr_ratio_s /end AXIS_DESCR
/end CHARACTERISTIC
/begin CHARACTERISTIC IP_EGR_RATIO_MIN__MAF__N_32 "Basic map for minimum EGR-Ratio Setpoint" MAP 0x64498 _REC_MAP_20_u1_u2_u1 99.609375 _CNV_A_R_LINEAR_____16_CM 0. 99.609375 FORMAT "%4.1"
 /begin AXIS_DESCR COM_AXIS MAF _CNV_A_R_LINEAR_____56_CM 4 0. 1389. FORMAT "%7.2" AXIS_PTS_REF ldp_maf_ip_egr_ratio_min /end AXIS_DESCR
 /begin AXIS_DESCR COM_AXIS N_32 _CNV_A_R_LINEAR_____15_CM 4 0. 8160. FORMAT "%4.0" AXIS_PTS_REF ldp_n_32_ip_egr_ratio_min /end AXIS_DESCR
/end CHARACTERISTIC
/begin CHARACTERISTIC IP_FAC_TCO_EGR__TCO "TCO-correction factor for EGR-Ratio Setpoint" CURVE 0x644a8 _REC_CUR_20_u1_u1 1.99220002 _CNV_A_R_LINEAR_____64_CM 0. 1.99220002 FORMAT "%5.3"
 /begin AXIS_DESCR COM_AXIS TCO _CNV_A_R_LINEAR_____22_CM 6 -48. 142.5 FORMAT "%5.1" AXIS_PTS_REF ldp_tco__fac_tco_egr /end AXIS_DESCR
/end CHARACTERISTIC
/begin CHARACTERISTIC IP_EGR_RATIO_LGRD__MAF_CYL "Limited gradient for increasing EGR_RATIO_SP" CURVE 0x644ae _REC_CUR_20_u2_u2 99.99694824000001 _CNV_A_R_LINEAR_____159_CM 0. 99.99694824
 /begin AXIS_DESCR COM_AXIS MAF_CYL _CNV_A_R_LINEAR_____52_CM 6 0. 2047.96875 FORMAT "%7.2" AXIS_PTS_REF ldp_maf_cyl__egr_ratio_inc /end AXIS_DESCR
/end CHARACTERISTIC
/begin CHARACTERISTIC IP_ER_STD_THD__MAF__N_32 "Map of  engine roughness standard deviation  threshold" MAP 0x644ba _REC_MAP_20_u2_u2_u1 651.55 _CNV_A_R_LINEAR_____318_CM -325.78 325.77 FORMAT "%8.3"
 /begin AXIS_DESCR COM_AXIS MAF _CNV_A_R_LINEAR_____56_CM 2 0. 1389. FORMAT "%7.2" AXIS_PTS_REF ldp_maf_ip_er_std_thd /end AXIS_DESCR
 /begin AXIS_DESCR COM_AXIS N_32 _CNV_A_R_LINEAR_____15_CM 2 0. 8160. FORMAT "%4.0" AXIS_PTS_REF ldp_n_32_ip_er_std_thd /end AXIS_DESCR
/end CHARACTERISTIC
/begin CHARACTERISTIC IP_EGR_RATIO_INC__MAF_CYL "Increment  value to increase FAC_EGR_RATIO" CURVE 0x644c2 _REC_CUR_20_u1_u2 0.996 _CNV_A_R_LINEAR_____316_CM 1. 1.996 FORMAT "%5.3"
 /begin AXIS_DESCR COM_AXIS MAF_CYL _CNV_A_R_LINEAR_____52_CM 6 0. 2047.96875 FORMAT "%7.2" AXIS_PTS_REF ldp_maf_cyl__egr_ratio_inc /end AXIS_DESCR
/end CHARACTERISTIC
/begin CHARACTERISTIC IP_EGR_ADD_NEG__ER_EGR "Additive value to decrease EGR-Ratio Setpoint" CURVE 0x644c8 _REC_CUR_20_u1_u2 99.609375 _CNV_A_R_LINEAR_____16_CM 0. 99.609375 FORMAT "%4.1"
 /begin AXIS_DESCR COM_AXIS ER_EGR _CNV_A_R_LINEAR_____318_CM 6 -325.78 325.77 FORMAT "%8.3" AXIS_PTS_REF ldpm_er_egr /end AXIS_DESCR
/end CHARACTERISTIC
/begin CHARACTERISTIC IP_ER_EGR_CTR_INC__ER_EGR "Value to increase ER_EGR_CTR" CURVE 0x644ce _REC_CUR_20_u1_u2 255. _CNV_A_R_LINEAR_____13_CM 0. 255. FORMAT "%3.0"
 /begin AXIS_DESCR COM_AXIS ER_EGR _CNV_A_R_LINEAR_____318_CM 6 -325.78 325.77 FORMAT "%8.3" AXIS_PTS_REF ldpm_er_egr /end AXIS_DESCR
/end CHARACTERISTIC
/begin AXIS_PTS ldpm_stk_dif_egr "" 0x6124e STK_DIF_EGR _REC_AXS_20_u1 99.609375 _CNV_A_R_LINEAR_____279_CM 9 -50. 49.609375 FORMAT "%6.2" /end AXIS_PTS
/begin AXIS_PTS ldp_stk_sp_egr__egrpwm_prev "" 0x61258 STK_SP_EGR _REC_AXS_20_u1 99.609375 _CNV_A_R_LINEAR_____16_CM 12 0. 99.609375 FORMAT "%4.1" /end AXIS_PTS
/begin CHARACTERISTIC IP_STK_SP_EGR__AR_RED_SP_EGR "EGR-valve lift setpoint table (inverse table of IP_AR_RED_EGR)" CURVE 0x644d4 _REC_CUR_20_u1_u2 99.609375 _CNV_A_R_LINEAR_____16_CM 0. 99.609375 FORMAT "%4.1"
 /begin AXIS_DESCR COM_AXIS AR_RED_SP_EGR _CNV_A_R_LINEAR_____286_CM 12 0. 58.592855 FORMAT "%7.4" AXIS_PTS_REF ldp_ar_red_sp_egr_stk_sp_egr /end AXIS_DESCR
/end CHARACTERISTIC
/begin CHARACTERISTIC IP_EGRPWM_PREV__STK_SP_EGR "Pre-control duty cycle of the EGR valve" CURVE 0x644e0 _REC_CUR_20_u2_u1 99.99847412 _CNV_A_R_LINEAR_____144_CM 0. 99.99847412
 /begin AXIS_DESCR COM_AXIS STK_SP_EGR _CNV_A_R_LINEAR_____16_CM 12 0. 99.609375 FORMAT "%4.1" AXIS_PTS_REF ldp_stk_sp_egr__egrpwm_prev /end AXIS_DESCR
/end CHARACTERISTIC
/begin CHARACTERISTIC IP_EGRPWM_P__STK_DIF_EGR "Index table for P - term of EGR valve lift position-control" CURVE 0x644f8 _REC_CUR_20_u2_u1 199.99694824 _CNV_A_R_LINEAR_____63_CM -100. 99.99694824 FORMAT "%8.3"
 /begin AXIS_DESCR COM_AXIS STK_DIF_EGR _CNV_A_R_LINEAR_____279_CM 9 -50. 49.609375 FORMAT "%6.2" AXIS_PTS_REF ldpm_stk_dif_egr /end AXIS_DESCR
/end CHARACTERISTIC
/begin CHARACTERISTIC IP_EGRPWM_I__STK_DIF_EGR "Index table for I - term of EGR valve lift position-control" CURVE 0x6450a _REC_CUR_20_u2_u1 199.99694824 _CNV_A_R_LINEAR_____63_CM -100. 99.99694824 FORMAT "%8.3"
 /begin AXIS_DESCR COM_AXIS STK_DIF_EGR _CNV_A_R_LINEAR_____279_CM 9 -50. 49.609375 FORMAT "%6.2" AXIS_PTS_REF ldpm_stk_dif_egr /end AXIS_DESCR
/end CHARACTERISTIC
/begin AXIS_PTS ldpm_er_egr "" 0x61226 ER_EGR _REC_AXS_20_u2 651.55 _CNV_A_R_LINEAR_____318_CM 6 -325.78 325.77 FORMAT "%8.3" /end AXIS_PTS
/begin AXIS_PTS ldp_tco__fac_tco_egr "" 0x61207 TCO _REC_AXS_20_u1 190.5 _CNV_A_R_LINEAR_____22_CM 6 -48. 142.5 FORMAT "%5.1" /end AXIS_PTS
/begin MEASUREMENT LV_SAP "Flag for secondary air pump activation" UBYTE _CNV_S_2_RANGE______76_CM 1 100. 0. 1. ECU_ADDRESS 0x3fd52d BIT_MASK 0x1 /end MEASUREMENT
/begin MEASUREMENT LV_SA "Calculations for SA functions are currently active" UBYTE _CNV_S_2_RANGE______76_CM 1 100. 0. 1. ECU_ADDRESS 0x3fd52e BIT_MASK 0x1 /end MEASUREMENT
/begin MEASUREMENT LV_SA_END "secondary air function ended for this cycle" UBYTE _CNV_S_2_RANGE______76_CM 1 100. 0. 1. ECU_ADDRESS 0x3fd52f BIT_MASK 0x1 /end MEASUREMENT
/begin MEASUREMENT T_SAP_DLY "Time delay for SAP activation" UWORD _CNV_A_R_LINEAR_____21_CM 1 100. 0. 655.35 ECU_ADDRESS 0x3fce88 FORMAT "%6.2" /end MEASUREMENT
/begin MEASUREMENT T_SAV_DLY "Time delay for SAV activation" UWORD _CNV_A_R_LINEAR_____21_CM 1 100. 0. 655.35 ECU_ADDRESS 0x3fce8a FORMAT "%6.2" /end MEASUREMENT
/begin MEASUREMENT T_STATE_SA_ACT "Time counter which is incremented when SA function is active" UWORD _CNV_A_R_LINEAR_____21_CM 1 100. 0. 655.35 ECU_ADDRESS 0x3fce8c FORMAT "%6.2" /end MEASUREMENT
/begin MEASUREMENT STATE_SA "State of Secondary Air Function" UBYTE _CNV_S_9_RANGE_STAT_319_CM 1 100. 0. 8. ECU_ADDRESS 0x3fd96d /end MEASUREMENT
/begin MEASUREMENT LV_SAWUP "secondary air injection time correction active" UBYTE _CNV_S_2_RANGE______76_CM 1 100. 0. 1. ECU_ADDRESS 0x3fd530 BIT_MASK 0x1 /end MEASUREMENT
/begin CHARACTERISTIC C_N_MAX_SA_DEAC "Engine speed threshold to interupt SA function" VALUE 0x645d0 _REC_VAL_20_u1 8160. _CNV_A_R_LINEAR_____15_CM 0. 8160. FORMAT "%4.0" /end CHARACTERISTIC
/begin CHARACTERISTIC C_N_MAX_SA_ACT "Engine speed threshold to reactivate SA function" VALUE 0x645d1 _REC_VAL_20_u1 8160. _CNV_A_R_LINEAR_____15_CM 0. 8160. FORMAT "%4.0" /end CHARACTERISTIC
/begin CHARACTERISTIC C_T_DLY_SAP "Time delay for start of SAP " VALUE 0x645d2 _REC_VAL_20_u2 655.35 _CNV_A_R_LINEAR_____21_CM 0. 655.35 FORMAT "%6.2" /end CHARACTERISTIC
/begin CHARACTERISTIC C_T_DLY_SAV "Time delay for start of SAV" VALUE 0x645d4 _REC_VAL_20_u2 655.35 _CNV_A_R_LINEAR_____21_CM 0. 655.35 FORMAT "%6.2" /end CHARACTERISTIC
/begin CHARACTERISTIC C_T_DLY_SAV_OFF "Time delay for closing of SAV after SAP shut down" VALUE 0x645d6 _REC_VAL_20_u2 655.35 _CNV_A_R_LINEAR_____21_CM 0. 655.35 FORMAT "%6.2" /end CHARACTERISTIC
/begin CHARACTERISTIC C_T_ON_SAWUP "Time delay before injection time correction after STATE_SA = active" VALUE 0x645d8 _REC_VAL_20_u2 655.35 _CNV_A_R_LINEAR_____21_CM 0. 655.35 FORMAT "%6.2" /end CHARACTERISTIC
/begin CHARACTERISTIC C_T_ON_SAWUP_IS "Time delay before injection time correction after STATE_SA = active in idle" VALUE 0x645da _REC_VAL_20_u2 655.35 _CNV_A_R_LINEAR_____21_CM 0. 655.35 FORMAT "%6.2" /end CHARACTERISTIC
/begin AXIS_PTS ldpm_n_32_maf_sa_deac "" 0x612aa N_32 _REC_AXS_20_u1 8160. _CNV_A_R_LINEAR_____15_CM 8 0. 8160. FORMAT "%4.0" /end AXIS_PTS
/begin AXIS_PTS ldpm_n_32_maf_sa_act "" 0x612b3 N_32 _REC_AXS_20_u1 8160. _CNV_A_R_LINEAR_____15_CM 8 0. 8160. FORMAT "%4.0" /end AXIS_PTS
/begin CHARACTERISTIC ID_T_SA_OFF_1 "Time delay to terminate SA function" CURVE 0x645ea _REC_CUR_20_u2_u1 655.35 _CNV_A_R_LINEAR_____21_CM 0. 655.35 FORMAT "%6.2"
 /begin AXIS_DESCR COM_AXIS TCO _CNV_A_R_LINEAR_____22_CM 6 -48. 142.5 FORMAT "%5.1" AXIS_PTS_REF ldpm_tco_1 /end AXIS_DESCR
/end CHARACTERISTIC
/begin CHARACTERISTIC IP_MAF_SA_DEAC__N_32 "MAF threshold to interupt SA function" CURVE 0x645f6 _REC_CUR_20_u2_u1 1389. _CNV_A_R_LINEAR_____56_CM 0. 1389. FORMAT "%7.2"
 /begin AXIS_DESCR COM_AXIS N_32 _CNV_A_R_LINEAR_____15_CM 8 0. 8160. FORMAT "%4.0" AXIS_PTS_REF ldpm_n_32_maf_sa_deac /end AXIS_DESCR
/end CHARACTERISTIC
/begin CHARACTERISTIC IP_MAF_SA_ACT__N_32 "MAF threshold to reactivate SA function" CURVE 0x64606 _REC_CUR_20_u2_u1 1389. _CNV_A_R_LINEAR_____56_CM 0. 1389. FORMAT "%7.2"
 /begin AXIS_DESCR COM_AXIS N_32 _CNV_A_R_LINEAR_____15_CM 8 0. 8160. FORMAT "%4.0" AXIS_PTS_REF ldpm_n_32_maf_sa_act /end AXIS_DESCR
/end CHARACTERISTIC
/begin MEASUREMENT LV_SAV "Flag for secondary air valve activation" UBYTE _CNV_S_2_RANGE______76_CM 1 100. 0. 1. ECU_ADDRESS 0x3fd52c BIT_MASK 0x1 /end MEASUREMENT
/begin MEASUREMENT CTR_REST_SA "Restart-counter for SA activation" UBYTE _CNV_A_R_LINEAR_____13_CM 1 100. 0. 255. ECU_ADDRESS 0x3fd96e FORMAT "%3.0" BIT_MASK 0x1 /end MEASUREMENT
/begin CHARACTERISTIC C_TCO_DIF_MIN_SA "TCO threshold for incrementation the SA restart counter" VALUE 0x6464a _REC_VAL_20_u1 190.5 _CNV_A_R_LINEAR_____23_CM 0. 190.5 FORMAT "%5.1" /end CHARACTERISTIC
/begin CHARACTERISTIC C_VB_MIN_SA "Battery voltage minimum threshold to authorize the secondary air function" VALUE 0x645cf _REC_VAL_20_u1 26. _CNV_A_R_LINEAR_____188_CM 0. 26. FORMAT "%4.1" /end CHARACTERISTIC
/begin CHARACTERISTIC C_CTR_MAX_REST_SA "Number of permissible restarts before aborting SA normal operation" VALUE 0x6464b _REC_VAL_20_u1 255. _CNV_A_R_LINEAR_____13_CM 0. 255. FORMAT "%3.0" /end CHARACTERISTIC
/begin MEASUREMENT LV_PUC_SA_INH "inhibition of PUC during SA active for the first time" UBYTE _CNV_S_2_RANGE______76_CM 1 100. 0. 1. ECU_ADDRESS 0x3fd531 BIT_MASK 0x1 /end MEASUREMENT
/begin CHARACTERISTIC ID_T_SA_OFF_0 "Time delay to terminate SA function" CURVE 0x645de _REC_CUR_20_u2_u1 655.35 _CNV_A_R_LINEAR_____21_CM 0. 655.35 FORMAT "%6.2"
 /begin AXIS_DESCR COM_AXIS TCO _CNV_A_R_LINEAR_____22_CM 6 -48. 142.5 FORMAT "%5.1" AXIS_PTS_REF ldpm_tco_1 /end AXIS_DESCR
/end CHARACTERISTIC
/begin CHARACTERISTIC LC_ACR_CHK_SA_ "Logical value for activation external actuator test (active=1)" VALUE 0x645dc _REC_VAL_20_u1 1. _CNV_S_2_RANGE______74_CM 0. 1. /end CHARACTERISTIC
/begin AXIS_PTS ldpm_n_13 "" 0x613ea N _REC_AXS_20_u2 8160. _CNV_A_R_LINEAR_____0_CM 6 0. 8160. FORMAT "%4.0" /end AXIS_PTS
/begin AXIS_PTS ldpm_maf_ivvt_1 "" 0x613f8 MAF _REC_AXS_20_u2 1389. _CNV_A_R_LINEAR_____56_CM 6 0. 1389. FORMAT "%7.2" /end AXIS_PTS
/begin CHARACTERISTIC IP_CAM_SP_2_EX_IS__N__MAF_IVVT "Target spread for thermal condition 2, idle,exhaust camschaft" MAP 0x64978 _REC_MAP_20_u1_u2_u2 -95.625 _CNV_A_R_LINEAR_____374_CM -40. -135.625 FORMAT "%5.1"
 /begin AXIS_DESCR COM_AXIS N _CNV_A_R_LINEAR_____0_CM 6 0. 8160. FORMAT "%4.0" AXIS_PTS_REF ldpm_n_13 /end AXIS_DESCR
 /begin AXIS_DESCR COM_AXIS MAF _CNV_A_R_LINEAR_____56_CM 6 0. 1389. FORMAT "%7.2" AXIS_PTS_REF ldpm_maf_ivvt_1 /end AXIS_DESCR
/end CHARACTERISTIC
/begin MEASUREMENT CAM_SP_AV_EX_HOM "Exhaust camshaft target spread for homogeneous stochiometric combustion" SWORD _CNV_A_R_LINEAR_____117_CM 1 100. -768. 767.9765625 ECU_ADDRESS 0x3fc958 FORMAT "%7.2" /end MEASUREMENT
/begin MEASUREMENT CAM_SP_AV_IN_HOM "Intake camshaft target spread for homogeneous stochiometric combustion" SWORD _CNV_A_R_LINEAR_____117_CM 1 100. -768. 767.9765625 ECU_ADDRESS 0x3fc94e FORMAT "%7.2" /end MEASUREMENT
/begin MEASUREMENT CAM_SP_AV_LGRD_EX "Exhaust camshaft target spread with limiting gradient during transition function (\"passive\" Þ \"active\")" SWORD _CNV_A_R_LINEAR_____117_CM 1 100. -768. 767.9765625 ECU_ADDRESS 0x3fc95a FORMAT "%7.2" /end MEASUREMENT
/begin MEASUREMENT CAM_SP_IN_LIM "Intake camshaft target spread - after limitation" SWORD _CNV_A_R_LINEAR_____117_CM 1 100. -768. 767.9765625 ECU_ADDRESS 0x3fc948 FORMAT "%7.2" /end MEASUREMENT
/begin MEASUREMENT LV_TRAN_IVVT_EX "Logical variable for active transition function exhaust cam (1 = active)" UBYTE _CNV_S_2_RANGE______74_CM 1 100. 0. 1. ECU_ADDRESS 0x3fd4d1 /end MEASUREMENT
/begin MEASUREMENT CAM_SP_AV_LGRD_IN "Intake camshaft target spread with limiting gradient during transition function (\"passive\" Þ \"active\")" SWORD _CNV_A_R_LINEAR_____117_CM 1 100. -768. 767.9765625 ECU_ADDRESS 0x3fc950 FORMAT "%7.2" /end MEASUREMENT
/begin MEASUREMENT CAM_SP_IN_HYS "Intake camshaft target spread  - after hysteresis" SWORD _CNV_A_R_LINEAR_____117_CM 1 100. -768. 767.9765625 ECU_ADDRESS 0x3fc94a FORMAT "%7.2" /end MEASUREMENT
/begin MEASUREMENT LV_TRAN_IVVT_IN "Logical variable for active transition function inlet cam (1 = active)" UBYTE _CNV_S_2_RANGE______74_CM 1 100. 0. 1. ECU_ADDRESS 0x3fd4d0 /end MEASUREMENT
/begin MEASUREMENT CAM_SP_EX "Exhaust camshaft target spread to be currently controlled" SWORD _CNV_A_R_LINEAR_____117_CM 1 100. -768. 767.9765625 ECU_ADDRESS 0x3fc942 FORMAT "%7.2" /end MEASUREMENT
/begin MEASUREMENT CAM_SP_EX_LIM "exhaust camshaft target spread after limitation" SWORD _CNV_A_R_LINEAR_____117_CM 1 100. -768. 767.9765625 ECU_ADDRESS 0x3fc952 FORMAT "%7.2" /end MEASUREMENT
/begin MEASUREMENT LV_PVS_FL_IVVT "Logical variable for camshaft spread calculation at  high engine load demand (1 = active)" UBYTE _CNV_S_2_RANGE______76_CM 1 100. 0. 1. ECU_ADDRESS 0x3fd4cf /end MEASUREMENT
/begin MEASUREMENT CAM_SP_IN "Intake camshaft target spread to be currently controlled" SWORD _CNV_A_R_LINEAR_____117_CM 1 100. -768. 767.9765625 ECU_ADDRESS 0x3fc940 FORMAT "%7.2" /end MEASUREMENT
/begin MEASUREMENT CAM_SP_EX_HYS "exhaust camshaft target spread after hysteresis" SWORD _CNV_A_R_LINEAR_____117_CM 1 100. -768. 767.9765625 ECU_ADDRESS 0x3fc954 FORMAT "%7.2" /end MEASUREMENT
/begin MEASUREMENT FAC_CAM_IN_IS "Temperature weighting factor intake camshaft  - idle speed " SBYTE _CNV_A_R_LINEAR_____118_CM 1 100. -4. 3.96875 ECU_ADDRESS 0x3fd8c7 FORMAT "%5.2" /end MEASUREMENT
/begin MEASUREMENT FAC_CAM_EX_IS "Temperature weighting factor exhaust camshaft  - idle speed " SBYTE _CNV_A_R_LINEAR_____118_CM 1 100. -4. 3.96875 ECU_ADDRESS 0x3fd8c9 FORMAT "%5.2" /end MEASUREMENT
/begin MEASUREMENT FAC_CAM_EX_PL "Temperature weighting factor exhaust camshaft  - part load " SBYTE _CNV_A_R_LINEAR_____118_CM 1 100. -4. 3.96875 ECU_ADDRESS 0x3fd8ca FORMAT "%5.2" /end MEASUREMENT
/begin MEASUREMENT LV_IVVT_AD_REQ "Logical variable for adaptation of mechanical stop requested (1 = request active)" UBYTE _CNV_S_2_RANGE______74_CM 1 100. 0. 1. ECU_ADDRESS 0x3fd4d2 BIT_MASK 0x1 /end MEASUREMENT
/begin MEASUREMENT FAC_CAM_IN_PL "Temperature weighting factor intake camshaft  - part load " SBYTE _CNV_A_R_LINEAR_____118_CM 1 100. -4. 3.96875 ECU_ADDRESS 0x3fd8c8 FORMAT "%5.2" /end MEASUREMENT
/begin MEASUREMENT T_CAM_SP_ACT "Time after transition of STATE_IVVT  0 Þ 1 (passive Þ active)" UBYTE _CNV_A_R_LINEAR_____3_CM 1 100. 0. 2550. ECU_ADDRESS 0x3fd8cb FORMAT "%4.0" /end MEASUREMENT
/begin CHARACTERISTIC C_CAM_SP_AS_EX "Additive share target spread exhaust camshaft" VALUE 0x6499c _REC_VAL_20_s2 1535.9765625 _CNV_A_R_LINEAR_____117_CM -768. 767.9765625 FORMAT "%7.2" /end CHARACTERISTIC
/begin CHARACTERISTIC C_CAM_SP_AS_IN "Additive share target spread intake camshaft" VALUE 0x6499e _REC_VAL_20_s2 1535.9765625 _CNV_A_R_LINEAR_____117_CM -768. 767.9765625 FORMAT "%7.2" /end CHARACTERISTIC
/begin CHARACTERISTIC C_CAM_SP_DIF_MAX "CAM_Setpoint hysteresis" VALUE 0x649a0 _REC_VAL_20_s2 1535.9765625 _CNV_A_R_LINEAR_____117_CM -768. 767.9765625 FORMAT "%7.2" /end CHARACTERISTIC
/begin CHARACTERISTIC C_LGRD_CAM_SP_TRA "Limiting gradient for camshaft setpoint during active IVVT transition function" VALUE 0x649a2 _REC_VAL_20_s2 1535.9765625 _CNV_A_R_LINEAR_____375_CM -768. 767.9765625 FORMAT "%7.2" /end CHARACTERISTIC
/begin CHARACTERISTIC C_CAM_SP_AS_HYS_NEUT_EX "Hysteresis to close end position without target spread changes in the exhaust camshaft" VALUE 0x649a4 _REC_VAL_20_s2 1535.9765625 _CNV_A_R_LINEAR_____117_CM -768. 767.9765625 FORMAT "%7.2" /end CHARACTERISTIC
/begin CHARACTERISTIC C_CAM_SP_AS_HYS_NEUT_IN "Hysteresis to close end position without target spread changes in the intake camshaft" VALUE 0x649a6 _REC_VAL_20_s2 1535.9765625 _CNV_A_R_LINEAR_____117_CM -768. 767.9765625 FORMAT "%7.2" /end CHARACTERISTIC
/begin CHARACTERISTIC C_T_AST_IVVT "" VALUE 0x649a8 _REC_VAL_20_u2 6553.400000000001 _CNV_A_R_LINEAR_____18_CM 0.1 6553.5 FORMAT "%6.1" /end CHARACTERISTIC
/begin CHARACTERISTIC C_CAM_SP_IN_AD "Target spread for adaption of mechanical stop - intake camshaft" VALUE 0x649aa _REC_VAL_20_s2 1535.9765625 _CNV_A_R_LINEAR_____117_CM -768. 767.9765625 FORMAT "%7.2" /end CHARACTERISTIC
/begin CHARACTERISTIC C_T_CAM_SP_LGRD "Adjusting time for 0.375 °CRK in active transition function" VALUE 0x649ac _REC_VAL_20_u1 2540. _CNV_A_R_LINEAR_____3_CM 10. 2550. FORMAT "%4.0" /end CHARACTERISTIC
/begin CHARACTERISTIC C_CAM_SP_EX_AD "Target spread for adaption of mechanical stop - exhaust camshaft" VALUE 0x649ae _REC_VAL_20_s2 1535.9765625 _CNV_A_R_LINEAR_____117_CM -768. 767.9765625 FORMAT "%7.2" /end CHARACTERISTIC
/begin CHARACTERISTIC IP_FAC_CAM_IN_IS__TCO_TCO_ST "Weighting factor for target spread calculation, idle, intake camschaft" MAP 0x649b0 _REC_MAP_20_u1_u1_u1 7.96875 _CNV_A_R_LINEAR_____376_CM -4. 3.96875
 /begin AXIS_DESCR COM_AXIS TCO _CNV_A_R_LINEAR_____22_CM 8 -48. 142.5 FORMAT "%5.1" AXIS_PTS_REF ldpm_tco_17 /end AXIS_DESCR
 /begin AXIS_DESCR COM_AXIS TCO_ST _CNV_A_R_LINEAR_____22_CM 8 -48. 142.5 FORMAT "%5.1" AXIS_PTS_REF ldpm_tco_st_4 /end AXIS_DESCR
/end CHARACTERISTIC
/begin CHARACTERISTIC IP_CAM_SP_2_EX_FL__N "Target spread for thermal condition 2, high load, exhaust camschaft" CURVE 0x649f0 _REC_CUR_20_u1_u2 -95.625 _CNV_A_R_LINEAR_____374_CM -40. -135.625 FORMAT "%5.1"
 /begin AXIS_DESCR COM_AXIS N _CNV_A_R_LINEAR_____0_CM 16 0. 8160. FORMAT "%4.0" AXIS_PTS_REF ldpm_n_5 /end AXIS_DESCR
/end CHARACTERISTIC
/begin CHARACTERISTIC IP_FAC_CAM_IN_PL__TCO_TCO_ST "Weighting factor for target spread calculation, part load, intake camschaft" MAP 0x64a00 _REC_MAP_20_u1_u1_u1 7.96875 _CNV_A_R_LINEAR_____376_CM -4. 3.96875
 /begin AXIS_DESCR COM_AXIS TCO _CNV_A_R_LINEAR_____22_CM 8 -48. 142.5 FORMAT "%5.1" AXIS_PTS_REF ldpm_tco_17 /end AXIS_DESCR
 /begin AXIS_DESCR COM_AXIS TCO_ST _CNV_A_R_LINEAR_____22_CM 8 -48. 142.5 FORMAT "%5.1" AXIS_PTS_REF ldpm_tco_st_4 /end AXIS_DESCR
/end CHARACTERISTIC
/begin CHARACTERISTIC ID_PV_MAX_FL_IVVT__N "PV-threshold for control IVVT at high load" CURVE 0x64a40 _REC_CUR_20_u1_u2 99.609375 _CNV_A_R_LINEAR_____16_CM 0. 99.609375 FORMAT "%5.1"
 /begin AXIS_DESCR COM_AXIS N _CNV_A_R_LINEAR_____0_CM 16 0. 8160. FORMAT "%4.0" AXIS_PTS_REF ldpm_n_11 /end AXIS_DESCR
/end CHARACTERISTIC
/begin CHARACTERISTIC IP_CAM_SP_2_EX_PL__N__MAF_IVVT "Target spread for thermal condition 2, part load, exhaust camschaft" MAP 0x64a50 _REC_MAP_20_u1_u2_u2 -95.625 _CNV_A_R_LINEAR_____374_CM -40. -135.625 FORMAT "%5.1"
 /begin AXIS_DESCR COM_AXIS N _CNV_A_R_LINEAR_____0_CM 16 0. 8160. FORMAT "%4.0" AXIS_PTS_REF ldpm_n_5 /end AXIS_DESCR
 /begin AXIS_DESCR COM_AXIS MAF _CNV_A_R_LINEAR_____56_CM 12 0. 1389. FORMAT "%7.2" AXIS_PTS_REF ldpm_maf_ivvt_2 /end AXIS_DESCR
/end CHARACTERISTIC
/begin CHARACTERISTIC IP_CAM_SP_2_IN_FL__N "Target spread for thermal condition 2, high load, intake camschaft" CURVE 0x64b10 _REC_CUR_20_u1_u2 95.625 _CNV_A_R_LINEAR_____377_CM 40. 135.625 FORMAT "%5.1"
 /begin AXIS_DESCR COM_AXIS N _CNV_A_R_LINEAR_____0_CM 16 0. 8160. FORMAT "%4.0" AXIS_PTS_REF ldpm_n_5 /end AXIS_DESCR
/end CHARACTERISTIC
/begin CHARACTERISTIC IP_CAM_SP_1_EX_FL__N "Target spread for thermal condition 1, high load, exhaust camschaft" CURVE 0x64b20 _REC_CUR_20_u1_u2 -95.625 _CNV_A_R_LINEAR_____374_CM -40. -135.625 FORMAT "%5.1"
 /begin AXIS_DESCR COM_AXIS N _CNV_A_R_LINEAR_____0_CM 16 0. 8160. FORMAT "%4.0" AXIS_PTS_REF ldpm_n_5 /end AXIS_DESCR
/end CHARACTERISTIC
/begin CHARACTERISTIC IP_CAM_SP_2_IN_IS__N__MAF_IVVT "Target spread for thermal condition 1, idle, intake camschaft" MAP 0x64b30 _REC_MAP_20_u1_u2_u2 95.625 _CNV_A_R_LINEAR_____377_CM 40. 135.625 FORMAT "%5.1"
 /begin AXIS_DESCR COM_AXIS N _CNV_A_R_LINEAR_____0_CM 6 0. 8160. FORMAT "%4.0" AXIS_PTS_REF ldpm_n_13 /end AXIS_DESCR
 /begin AXIS_DESCR COM_AXIS MAF _CNV_A_R_LINEAR_____56_CM 6 0. 1389. FORMAT "%7.2" AXIS_PTS_REF ldpm_maf_ivvt_1 /end AXIS_DESCR
/end CHARACTERISTIC
/begin CHARACTERISTIC IP_CAM_SP_1_EX_IS__N__MAF_IVVT "Target spread for thermal condition 1, idle,exhaust camschaft" MAP 0x64b54 _REC_MAP_20_u1_u2_u2 -95.625 _CNV_A_R_LINEAR_____374_CM -40. -135.625 FORMAT "%5.1"
 /begin AXIS_DESCR COM_AXIS N _CNV_A_R_LINEAR_____0_CM 6 0. 8160. FORMAT "%4.0" AXIS_PTS_REF ldpm_n_13 /end AXIS_DESCR
 /begin AXIS_DESCR COM_AXIS MAF _CNV_A_R_LINEAR_____56_CM 6 0. 1389. FORMAT "%7.2" AXIS_PTS_REF ldpm_maf_ivvt_1 /end AXIS_DESCR
/end CHARACTERISTIC
/begin CHARACTERISTIC IP_CAM_SP_2_IN_PL__N__MAF_IVVT "Target spread for thermal condition 2, part load, intake camschaft" MAP 0x64b78 _REC_MAP_20_u1_u2_u2 95.625 _CNV_A_R_LINEAR_____377_CM 40. 135.625 FORMAT "%5.1"
 /begin AXIS_DESCR COM_AXIS N _CNV_A_R_LINEAR_____0_CM 16 0. 8160. FORMAT "%4.0" AXIS_PTS_REF ldpm_n_5 /end AXIS_DESCR
 /begin AXIS_DESCR COM_AXIS MAF _CNV_A_R_LINEAR_____56_CM 12 0. 1389. FORMAT "%7.2" AXIS_PTS_REF ldpm_maf_ivvt_2 /end AXIS_DESCR
/end CHARACTERISTIC
/begin CHARACTERISTIC IP_CAM_SP_1_EX_PL__N__MAF_IVVT "Target spread for thermal condition 1, part load, exhaust camschaft" MAP 0x64c38 _REC_MAP_20_u1_u2_u2 -95.625 _CNV_A_R_LINEAR_____374_CM -40. -135.625 FORMAT "%5.1"
 /begin AXIS_DESCR COM_AXIS N _CNV_A_R_LINEAR_____0_CM 16 0. 8160. FORMAT "%4.0" AXIS_PTS_REF ldpm_n_5 /end AXIS_DESCR
 /begin AXIS_DESCR COM_AXIS MAF _CNV_A_R_LINEAR_____56_CM 12 0. 1389. FORMAT "%7.2" AXIS_PTS_REF ldpm_maf_ivvt_2 /end AXIS_DESCR
/end CHARACTERISTIC
/begin CHARACTERISTIC IP_CAM_SP_ADD_EX_CH_IS__TCO_ST "CAT-heating target spread offset for CAM_EX" CURVE 0x64cf8 _REC_CUR_20_u2_u1 1535.9765625 _CNV_A_R_LINEAR_____187_CM -768. 767.9765625 FORMAT "%7.2"
 /begin AXIS_DESCR COM_AXIS TCO_ST _CNV_A_R_LINEAR_____22_CM 8 -48. 142.5 FORMAT "%6.2" AXIS_PTS_REF ldpm_tco_st_6 /end AXIS_DESCR
/end CHARACTERISTIC
/begin CHARACTERISTIC IP_CAM_SP_1_IN_FL__N "Target spread for thermal condition 1, high load, intake camschaft" CURVE 0x64d08 _REC_CUR_20_u1_u2 95.625 _CNV_A_R_LINEAR_____377_CM 40. 135.625 FORMAT "%5.1"
 /begin AXIS_DESCR COM_AXIS N _CNV_A_R_LINEAR_____0_CM 16 0. 8160. FORMAT "%4.0" AXIS_PTS_REF ldpm_n_5 /end AXIS_DESCR
/end CHARACTERISTIC
/begin CHARACTERISTIC IP_FAC_CAM_EX_IS__TCO_TCO_ST "Weighting factor for target spread calculation, idle, exhaust camschaft" MAP 0x64d18 _REC_MAP_20_u1_u1_u1 7.96875 _CNV_A_R_LINEAR_____376_CM -4. 3.96875
 /begin AXIS_DESCR COM_AXIS TCO _CNV_A_R_LINEAR_____22_CM 8 -48. 142.5 FORMAT "%5.1" AXIS_PTS_REF ldpm_tco_17 /end AXIS_DESCR
 /begin AXIS_DESCR COM_AXIS TCO_ST _CNV_A_R_LINEAR_____22_CM 8 -48. 142.5 FORMAT "%5.1" AXIS_PTS_REF ldpm_tco_st_4 /end AXIS_DESCR
/end CHARACTERISTIC
/begin CHARACTERISTIC IP_CAM_SP_1_IN_IS__N__MAF_IVVT "Target spread for thermal condition 1, idle, intake camschaft" MAP 0x64d58 _REC_MAP_20_u1_u2_u2 95.625 _CNV_A_R_LINEAR_____377_CM 40. 135.625 FORMAT "%5.1"
 /begin AXIS_DESCR COM_AXIS N _CNV_A_R_LINEAR_____0_CM 6 0. 8160. FORMAT "%4.0" AXIS_PTS_REF ldpm_n_13 /end AXIS_DESCR
 /begin AXIS_DESCR COM_AXIS MAF _CNV_A_R_LINEAR_____56_CM 6 0. 1389. FORMAT "%7.2" AXIS_PTS_REF ldpm_maf_ivvt_1 /end AXIS_DESCR
/end CHARACTERISTIC
/begin CHARACTERISTIC IP_CAM_SP_ADD_IN_CH_IS__TCO_ST "CAT-heating target spread offset for CAM_IN" CURVE 0x64d7c _REC_CUR_20_u2_u1 1535.9765625 _CNV_A_R_LINEAR_____187_CM -768. 767.9765625 FORMAT "%7.2"
 /begin AXIS_DESCR COM_AXIS TCO_ST _CNV_A_R_LINEAR_____22_CM 8 -48. 142.5 FORMAT "%6.2" AXIS_PTS_REF ldpm_tco_st_6 /end AXIS_DESCR
/end CHARACTERISTIC
/begin CHARACTERISTIC IP_FAC_CAM_EX_PL__TCO_TCO_ST "Weighting factor for target spread calculation, part load, exhaust camschaft" MAP 0x64d8c _REC_MAP_20_u1_u1_u1 7.96875 _CNV_A_R_LINEAR_____376_CM -4. 3.96875
 /begin AXIS_DESCR COM_AXIS TCO _CNV_A_R_LINEAR_____22_CM 8 -48. 142.5 FORMAT "%5.1" AXIS_PTS_REF ldpm_tco_17 /end AXIS_DESCR
 /begin AXIS_DESCR COM_AXIS TCO_ST _CNV_A_R_LINEAR_____22_CM 8 -48. 142.5 FORMAT "%5.1" AXIS_PTS_REF ldpm_tco_st_4 /end AXIS_DESCR
/end CHARACTERISTIC
/begin CHARACTERISTIC IP_CAM_SP_1_IN_PL__N__MAF_IVVT "Target spread for thermal condition 1, part load, intake camschaft" MAP 0x64dcc _REC_MAP_20_u1_u2_u2 95.625 _CNV_A_R_LINEAR_____377_CM 40. 135.625 FORMAT "%5.1"
 /begin AXIS_DESCR COM_AXIS N _CNV_A_R_LINEAR_____0_CM 16 0. 8160. FORMAT "%4.0" AXIS_PTS_REF ldpm_n_5 /end AXIS_DESCR
 /begin AXIS_DESCR COM_AXIS MAF _CNV_A_R_LINEAR_____56_CM 12 0. 1389. FORMAT "%7.2" AXIS_PTS_REF ldpm_maf_ivvt_2 /end AXIS_DESCR
/end CHARACTERISTIC
/begin AXIS_PTS ldpm_n_5 "" 0x61406 N _REC_AXS_20_u2 8160. _CNV_A_R_LINEAR_____0_CM 16 0. 8160. FORMAT "%4.0" /end AXIS_PTS
/begin AXIS_PTS ldpm_maf_ivvt_2 "" 0x61428 MAF _REC_AXS_20_u2 1389. _CNV_A_R_LINEAR_____56_CM 12 0. 1389. FORMAT "%7.2" /end AXIS_PTS
/begin AXIS_PTS ldpm_tco_17 "" 0x61442 TCO _REC_AXS_20_u1 190.5 _CNV_A_R_LINEAR_____22_CM 8 -48. 142.5 FORMAT "%5.1" /end AXIS_PTS
/begin AXIS_PTS ldpm_tco_st_4 "" 0x6144b TCO_ST _REC_AXS_20_u1 190.5 _CNV_A_R_LINEAR_____22_CM 8 -48. 142.5 FORMAT "%5.1" /end AXIS_PTS
/begin AXIS_PTS ldpm_tco_st_6 "" 0x61454 TCO_ST _REC_AXS_20_u1 190.5 _CNV_A_R_LINEAR_____22_CM 8 -48. 142.5 FORMAT "%6.2" /end AXIS_PTS
/begin AXIS_PTS ldpm_n_11 "ldpm 6 points N for IGA" 0x6145e N _REC_AXS_20_u2 8160. _CNV_A_R_LINEAR_____0_CM 16 0. 8160. FORMAT "%4.0" /end AXIS_PTS
/begin MEASUREMENT CAM_SP_AV_IN_S "Intake camshaft target spread for stratified combustion" SWORD _CNV_A_R_LINEAR_____117_CM 1 100. -768. 767.9765625 ECU_ADDRESS 0x3fc95c FORMAT "%7.2" /end MEASUREMENT
/begin MEASUREMENT CAM_SP_AV_EX_S "Exhaust camshaft target spread for stratified combustion " SWORD _CNV_A_R_LINEAR_____117_CM 1 100. -768. 767.9765625 ECU_ADDRESS 0x3fc95e FORMAT "%7.2" /end MEASUREMENT
/begin MEASUREMENT MFF_MMV "Low pass filtered value for fuel mass flow" UWORD _CNV_A_R_LINEAR_____56_CM 1 100. 0. 1389. ECU_ADDRESS 0x3fc960 FORMAT "%7.2" /end MEASUREMENT
/begin CHARACTERISTIC C_CRLC_MFF_SP_S "Correlation constants for low pass filtered mass fuel flow stratified" VALUE 0x64e98 _REC_VAL_20_u2 0.999755 _CNV_A_R_LINEAR_____379_CM 0. 0.999755 FORMAT "%7.5" /end CHARACTERISTIC
/begin CHARACTERISTIC IP_CAM_SP_2_EX_PL_S__N__MFF_MMV "Stratified target overlap for TCO_2,PL, exhaust camshaft" MAP 0x64e9a _REC_MAP_20_u1_u2_u2 -95.625 _CNV_A_R_LINEAR_____374_CM -40. -135.625 FORMAT "%5.1"
 /begin AXIS_DESCR COM_AXIS N _CNV_A_R_LINEAR_____0_CM 6 0. 8160. FORMAT "%4.0" AXIS_PTS_REF ldpm_n_13 /end AXIS_DESCR
 /begin AXIS_DESCR COM_AXIS MFF_MMV _CNV_A_R_LINEAR_____56_CM 6 0. 1389. FORMAT "%7.2" AXIS_PTS_REF ldpm_mff_mmv /end AXIS_DESCR
/end CHARACTERISTIC
/begin CHARACTERISTIC IP_CAM_SP_1_EX_PL_S__N__MFF_MMV "Stratified target overlap for TCO_1,PL, exhaust camshaft" MAP 0x64ebe _REC_MAP_20_u1_u2_u2 -95.625 _CNV_A_R_LINEAR_____374_CM -40. -135.625 FORMAT "%5.1"
 /begin AXIS_DESCR COM_AXIS N _CNV_A_R_LINEAR_____0_CM 6 0. 8160. FORMAT "%4.0" AXIS_PTS_REF ldpm_n_13 /end AXIS_DESCR
 /begin AXIS_DESCR COM_AXIS MFF_MMV _CNV_A_R_LINEAR_____56_CM 6 0. 1389. FORMAT "%7.2" AXIS_PTS_REF ldpm_mff_mmv /end AXIS_DESCR
/end CHARACTERISTIC
/begin CHARACTERISTIC IP_CAM_SP_1_IN_IS_S__N__MFF_MMV "Stratified target overlap for TCO_1, IS, intake camshaft" MAP 0x64ee2 _REC_MAP_20_u1_u2_u2 95.625 _CNV_A_R_LINEAR_____377_CM 40. 135.625 FORMAT "%5.1"
 /begin AXIS_DESCR COM_AXIS N _CNV_A_R_LINEAR_____0_CM 6 0. 8160. FORMAT "%4.0" AXIS_PTS_REF ldpm_n_13 /end AXIS_DESCR
 /begin AXIS_DESCR COM_AXIS MFF_MMV _CNV_A_R_LINEAR_____56_CM 6 0. 1389. FORMAT "%7.2" AXIS_PTS_REF ldpm_mff_mmv /end AXIS_DESCR
/end CHARACTERISTIC
/begin CHARACTERISTIC IP_CAM_SP_2_IN_IS_S__N__MFF_MMV "Stratified target overlap for TCO_2, IS, intake camshaft" MAP 0x64f06 _REC_MAP_20_u1_u2_u2 95.625 _CNV_A_R_LINEAR_____377_CM 40. 135.625 FORMAT "%5.1"
 /begin AXIS_DESCR COM_AXIS N _CNV_A_R_LINEAR_____0_CM 6 0. 8160. FORMAT "%4.0" AXIS_PTS_REF ldpm_n_13 /end AXIS_DESCR
 /begin AXIS_DESCR COM_AXIS MFF_MMV _CNV_A_R_LINEAR_____56_CM 6 0. 1389. FORMAT "%7.2" AXIS_PTS_REF ldpm_mff_mmv /end AXIS_DESCR
/end CHARACTERISTIC
/begin CHARACTERISTIC IP_CAM_SP_1_EX_IS_S__N__MFF_MMV "Stratified target overlap for TCO_1, IS, exhaust camshaft" MAP 0x64f2a _REC_MAP_20_u1_u2_u2 -95.625 _CNV_A_R_LINEAR_____374_CM -40. -135.625 FORMAT "%5.1"
 /begin AXIS_DESCR COM_AXIS N _CNV_A_R_LINEAR_____0_CM 6 0. 8160. FORMAT "%4.0" AXIS_PTS_REF ldpm_n_13 /end AXIS_DESCR
 /begin AXIS_DESCR COM_AXIS MFF_MMV _CNV_A_R_LINEAR_____56_CM 6 0. 1389. FORMAT "%7.2" AXIS_PTS_REF ldpm_mff_mmv /end AXIS_DESCR
/end CHARACTERISTIC
/begin CHARACTERISTIC IP_CAM_SP_2_EX_IS_S__N__MFF_MMV "Stratified target overlap for TCO_2, IS, exhaust camshaft" MAP 0x64f4e _REC_MAP_20_u1_u2_u2 -95.625 _CNV_A_R_LINEAR_____374_CM -40. -135.625 FORMAT "%5.1"
 /begin AXIS_DESCR COM_AXIS N _CNV_A_R_LINEAR_____0_CM 6 0. 8160. FORMAT "%4.0" AXIS_PTS_REF ldpm_n_13 /end AXIS_DESCR
 /begin AXIS_DESCR COM_AXIS MFF_MMV _CNV_A_R_LINEAR_____56_CM 6 0. 1389. FORMAT "%7.2" AXIS_PTS_REF ldpm_mff_mmv /end AXIS_DESCR
/end CHARACTERISTIC
/begin CHARACTERISTIC IP_CAM_SP_1_IN_PL_S__N__MFF_MMV "Stratified target overlap for TCO_1,PL, intake camshaft" MAP 0x64f72 _REC_MAP_20_u1_u2_u2 95.625 _CNV_A_R_LINEAR_____377_CM 40. 135.625 FORMAT "%5.1"
 /begin AXIS_DESCR COM_AXIS N _CNV_A_R_LINEAR_____0_CM 6 0. 8160. FORMAT "%4.0" AXIS_PTS_REF ldpm_n_13 /end AXIS_DESCR
 /begin AXIS_DESCR COM_AXIS MFF_MMV _CNV_A_R_LINEAR_____56_CM 6 0. 1389. FORMAT "%7.2" AXIS_PTS_REF ldpm_mff_mmv /end AXIS_DESCR
/end CHARACTERISTIC
/begin CHARACTERISTIC IP_CAM_SP_2_IN_PL_S__N__MFF_MMV "Stratified target overlap for TCO_2,PL, intake camshaft" MAP 0x64f96 _REC_MAP_20_u1_u2_u2 95.625 _CNV_A_R_LINEAR_____377_CM 40. 135.625 FORMAT "%5.1"
 /begin AXIS_DESCR COM_AXIS N _CNV_A_R_LINEAR_____0_CM 6 0. 8160. FORMAT "%4.0" AXIS_PTS_REF ldpm_n_13 /end AXIS_DESCR
 /begin AXIS_DESCR COM_AXIS MFF_MMV _CNV_A_R_LINEAR_____56_CM 6 0. 1389. FORMAT "%7.2" AXIS_PTS_REF ldpm_mff_mmv /end AXIS_DESCR
/end CHARACTERISTIC
/begin MEASUREMENT CAM_SP_AV_IN "Intake camshaft target spread calculated from the maps" SWORD _CNV_A_R_LINEAR_____117_CM 1 100. -768. 767.9765625 ECU_ADDRESS 0x3fc94c FORMAT "%7.2" /end MEASUREMENT
/begin MEASUREMENT CAM_SP_REF_IN "Intake camshaft target spread at reference conditions (warm engine)" SWORD _CNV_A_R_LINEAR_____117_CM 1 100. -768. 767.9765625 ECU_ADDRESS 0x3fc944 FORMAT "%7.2" /end MEASUREMENT
/begin MEASUREMENT CAM_SP_AV_EX "Exhaust camshaft target spread calculated from the maps" SWORD _CNV_A_R_LINEAR_____117_CM 1 100. -768. 767.9765625 ECU_ADDRESS 0x3fc956 FORMAT "%7.2" /end MEASUREMENT
/begin MEASUREMENT CAM_SP_REF_EX "Exhaust camshaft target spread at reference conditions (warm engine)" SWORD _CNV_A_R_LINEAR_____117_CM 1 100. -768. 767.9765625 ECU_ADDRESS 0x3fc946 FORMAT "%7.2" /end MEASUREMENT
/begin COMPU_METHOD _CNV_A_R_LINEAR_____0_CM "" RAT_FUNC "%6.3" "rpm" COEFFS 0 1. 0. 0 0 1 /end COMPU_METHOD
/begin COMPU_METHOD _CNV_A_R_LINEAR_____2_CM "" RAT_FUNC "%6.3" "-" COEFFS 0 65536.00007936121 0. 0 0 1 /end COMPU_METHOD
/begin COMPU_METHOD _CNV_A_R_LINEAR_____3_CM "" RAT_FUNC "%6.3" "ms" COEFFS 0 0.1 0. 0 0 1 /end COMPU_METHOD
/begin COMPU_METHOD _CNV_A_R_LINEAR_____5_CM "" RAT_FUNC "%6.3" "-" COEFFS 0 32768.00003968061 0. 0 0 1 /end COMPU_METHOD
/begin COMPU_METHOD _CNV_A_R_LINEAR_____8_CM "" RAT_FUNC "%6.3" "[-]" COEFFS 0 255.9999357490357 0. 0 0 1 /end COMPU_METHOD
/begin COMPU_METHOD _CNV_A_R_LINEAR_____12_CM "" RAT_FUNC "%6.3" "%" COEFFS 0 327.680000003584 3.584063961170614e-007 0 0 1 /end COMPU_METHOD
/begin COMPU_METHOD _CNV_A_R_LINEAR_____13_CM "" RAT_FUNC "%6.3" "[-]" COEFFS 0 1. 0. 0 0 1 /end COMPU_METHOD
/begin COMPU_METHOD _CNV_A_R_LINEAR_____14_CM "" RAT_FUNC "%6.3" "rpm/s" COEFFS 0 3.125e-002 0. 0 0 1 /end COMPU_METHOD
/begin COMPU_METHOD _CNV_A_R_LINEAR_____15_CM "" RAT_FUNC "%6.3" "rpm" COEFFS 0 3.125e-002 0. 0 0 1 /end COMPU_METHOD
/begin COMPU_METHOD _CNV_A_R_LINEAR_____16_CM "" RAT_FUNC "%6.3" "%" COEFFS 0 2.56 0. 0 0 1 /end COMPU_METHOD
/begin COMPU_METHOD _CNV_A_R_LINEAR_____17_CM "" RAT_FUNC "%6.3" "-" COEFFS 0 1. 0. 0 0 1 /end COMPU_METHOD
/begin COMPU_METHOD _CNV_A_R_LINEAR_____18_CM "" RAT_FUNC "%6.3" "s" COEFFS 0 10. 0. 0 0 1 /end COMPU_METHOD
/begin COMPU_METHOD _CNV_A_R_LINEAR_____20_CM "" RAT_FUNC "%6.3" "s" COEFFS 0 1. 0. 0 0 1 /end COMPU_METHOD
/begin COMPU_METHOD _CNV_A_R_LINEAR_____21_CM "" RAT_FUNC "%6.3" "s" COEFFS 0 100. 0. 0 0 1 /end COMPU_METHOD
/begin COMPU_METHOD _CNV_A_R_LINEAR_____22_CM "" RAT_FUNC "%6.3" "°C" COEFFS 0 1.333333333333333 64. 0 0 1 /end COMPU_METHOD
/begin COMPU_METHOD _CNV_A_R_LINEAR_____23_CM "" RAT_FUNC "%6.3" "°C" COEFFS 0 1.333333333333333 0. 0 0 1 /end COMPU_METHOD
/begin COMPU_METHOD _CNV_A_R_LINEAR_____26_CM "" RAT_FUNC "%6.3" "°C" COEFFS 0 0.25 8.25 0 0 1 /end COMPU_METHOD
/begin COMPU_METHOD _CNV_A_R_LINEAR_____31_CM "" RAT_FUNC "%6.3" "°C" COEFFS 0 1. 0. 0 0 1 /end COMPU_METHOD
/begin COMPU_METHOD _CNV_A_R_LINEAR_____32_CM "" RAT_FUNC "%6.3" "°C" COEFFS 0 1. 40. 0 0 1 /end COMPU_METHOD
/begin COMPU_METHOD _CNV_A_R_LINEAR_____37_CM "" RAT_FUNC "%6.3" "Nm" COEFFS 0 32. 0. 0 0 1 /end COMPU_METHOD
/begin COMPU_METHOD _CNV_A_R_LINEAR_____38_CM "" RAT_FUNC "%6.3" "V" COEFFS 0 204.7999998974999 0. 0 0 1 /end COMPU_METHOD
/begin COMPU_METHOD _CNV_A_R_LINEAR_____39_CM "" RAT_FUNC "%6.3" "V" COEFFS 0 204.7999995887937 0. 0 0 1 /end COMPU_METHOD
/begin COMPU_METHOD _CNV_A_R_LINEAR_____42_CM "" RAT_FUNC "%6.3" "V" COEFFS 0 9.846168103048838 0. 0 0 1 /end COMPU_METHOD
/begin COMPU_METHOD _CNV_A_R_LINEAR_____43_CM "" RAT_FUNC "%6.3" "km/h" COEFFS 0 1. 0. 0 0 1 /end COMPU_METHOD
/begin COMPU_METHOD _CNV_A_R_LINEAR_____50_CM "" RAT_FUNC "%6.3" "-" COEFFS 0 1023.999999919998 0. 0 0 1 /end COMPU_METHOD
/begin COMPU_METHOD _CNV_A_R_LINEAR_____51_CM "" RAT_FUNC "%6.3" "mg/stk" COEFFS 0 0.183585313174946 0. 0 0 1 /end COMPU_METHOD
/begin COMPU_METHOD _CNV_A_R_LINEAR_____52_CM "" RAT_FUNC "%6.3" "kg/h" COEFFS 0 32. 0. 0 0 1 /end COMPU_METHOD
/begin COMPU_METHOD _CNV_A_R_LINEAR_____55_CM "" RAT_FUNC "%6.3" "-" COEFFS 0 1.333333333333333 128. 0 0 1 /end COMPU_METHOD
/begin COMPU_METHOD _CNV_A_R_LINEAR_____56_CM "" RAT_FUNC "%6.3" "mg/stk" COEFFS 0 47.18142548596112 0. 0 0 1 /end COMPU_METHOD
/begin COMPU_METHOD _CNV_A_R_LINEAR_____58_CM "" RAT_FUNC "%6.3" "Nm/rpm" COEFFS 0 8191.999999679995 0. 0 0 1 /end COMPU_METHOD
/begin COMPU_METHOD _CNV_A_R_LINEAR_____59_CM "" RAT_FUNC "%6.3" "%" COEFFS 0 20.48192771084338 128.0120481927711 0 0 1 /end COMPU_METHOD
/begin COMPU_METHOD _CNV_A_R_LINEAR_____60_CM "" RAT_FUNC "%6.3" "%" COEFFS 0 2.559999357490358 127.9999678745179 0 0 1 /end COMPU_METHOD
/begin COMPU_METHOD _CNV_A_R_LINEAR_____63_CM "" RAT_FUNC "%6.3" "%" COEFFS 0 327.680000003584 32768.00000035841 0 0 1 /end COMPU_METHOD
/begin COMPU_METHOD _CNV_A_R_LINEAR_____64_CM "" RAT_FUNC "%6.3" "-" COEFFS 0 127.9991955827809 0. 0 0 1 /end COMPU_METHOD
/begin COMPU_METHOD _CNV_A_R_LINEAR_____67_CM "" RAT_FUNC "%6.3" "[-]" COEFFS 0 128. 0. 0 0 1 /end COMPU_METHOD
/begin COMPU_METHOD _CNV_S_2_RANGE______74_CM "" TAB_VERB "%6.3" "[-]" COMPU_TAB_REF _CNV_S_2_RANGE______74 /end COMPU_METHOD
/begin COMPU_VTAB _CNV_S_2_RANGE______74 "" TAB_VERB 2 0 "0" 1 "1" /end COMPU_VTAB
/begin COMPU_METHOD _CNV_S_2_RANGE______76_CM "" TAB_VERB "%6.3" "-" COMPU_TAB_REF _CNV_S_2_RANGE______76 /end COMPU_METHOD
/begin COMPU_VTAB _CNV_S_2_RANGE______76 "" TAB_VERB 2 0 "0" 1 "1" /end COMPU_VTAB
/begin COMPU_METHOD _CNV_A_R_LINEAR_____78_CM "" RAT_FUNC "%6.3" "%" COEFFS 0 327.68 0. 0 0 1 /end COMPU_METHOD
/begin COMPU_METHOD _CNV_A_R_LINEAR_____80_CM "" RAT_FUNC "%6.3" "s" COEFFS 0 32. 0. 0 0 1 /end COMPU_METHOD
/begin COMPU_METHOD _CNV_A_R_LINEAR_____82_CM "" RAT_FUNC "%6.3" "Nm" COEFFS 0 2097152.000003239 3.316402435302734e-003 0 0 1 /end COMPU_METHOD
/begin COMPU_METHOD _CNV_A_R_LINEAR_____83_CM "" RAT_FUNC "%6.3" "Nm" COEFFS 0 8191.999999679995 -1.280019205296412e-006 0 0 1 /end COMPU_METHOD
/begin COMPU_METHOD _CNV_A_R_LINEAR_____87_CM "" RAT_FUNC "%6.3" "-" COEFFS 0 16. 0. 0 0 1 /end COMPU_METHOD
/begin COMPU_METHOD _CNV_A_R_LINEAR_____104_CM "" RAT_FUNC "%6.3" "-" COEFFS 0 8191.999999679995 0. 0 0 1 /end COMPU_METHOD
/begin COMPU_METHOD _CNV_A_R_LINEAR_____113_CM "" RAT_FUNC "%6.3" "[-]" COEFFS 0 64. 0. 0 0 1 /end COMPU_METHOD
/begin COMPU_METHOD _CNV_A_R_LINEAR_____114_CM "" RAT_FUNC "%6.3" "hPa" COEFFS 0 0.3768805207949945 0. 0 0 1 /end COMPU_METHOD
/begin COMPU_METHOD _CNV_A_R_LINEAR_____117_CM "" RAT_FUNC "%6.3" "°CRK" COEFFS 0 42.66666666666666 0. 0 0 1 /end COMPU_METHOD
/begin COMPU_METHOD _CNV_A_R_LINEAR_____118_CM "" RAT_FUNC "%6.3" "-" COEFFS 0 32. 0. 0 0 1 /end COMPU_METHOD
/begin COMPU_METHOD _CNV_A_R_LINEAR_____138_CM "" RAT_FUNC "%6.3" "hPa" COEFFS 0 0.3768805207949945 1.251092653546948e-003 0 0 1 /end COMPU_METHOD
/begin COMPU_METHOD _CNV_A_R_LINEAR_____139_CM "" RAT_FUNC "%6.3" "g/s" COEFFS 0 43.3652807775378 0. 0 0 1 /end COMPU_METHOD
/begin COMPU_METHOD _CNV_S_3_RANGE_STAT_140_CM "" TAB_VERB "%6.3" "-" COMPU_TAB_REF _CNV_S_3_RANGE_STAT_140 /end COMPU_METHOD
/begin COMPU_VTAB _CNV_S_3_RANGE_STAT_140 "" TAB_VERB 3 0 "FUP_INITIAL_PRESSURE" 1 "FUP_PRESSURE_CONTROL" 2 "FUP_OVER_PRESSURE" /end COMPU_VTAB
/begin COMPU_METHOD _CNV_A_R_LINEAR_____141_CM "" RAT_FUNC "%6.3" "hPa" COEFFS 0 0.3768805207949945 32768.00125109265 0 0 1 /end COMPU_METHOD
/begin COMPU_METHOD _CNV_A_R_LINEAR_____142_CM "" RAT_FUNC "%6.3" "mg" COEFFS 0 5.89767818574514 0. 0 0 1 /end COMPU_METHOD
/begin COMPU_METHOD _CNV_A_R_LINEAR_____143_CM "" RAT_FUNC "%6.3" "%" COEFFS 0 1.28 0. 0 0 1 /end COMPU_METHOD
/begin COMPU_METHOD _CNV_A_R_LINEAR_____144_CM "" RAT_FUNC "%6.3" "%" COEFFS 0 655.3600000071681 0. 0 0 1 /end COMPU_METHOD
/begin COMPU_METHOD _CNV_A_R_LINEAR_____149_CM "" RAT_FUNC "%6.3" "%" COEFFS 0 655.3600000071681 3.584063961170614e-007 0 0 1 /end COMPU_METHOD
/begin COMPU_METHOD _CNV_A_R_LINEAR_____150_CM "" RAT_FUNC "%6.3" "s" COEFFS 0 50. 0. 0 0 1 /end COMPU_METHOD
/begin COMPU_METHOD _CNV_S_6_RANGE_STAT_151_CM "" TAB_VERB "%6.3" "-" COMPU_TAB_REF _CNV_S_6_RANGE_STAT_151 /end COMPU_METHOD
/begin COMPU_VTAB _CNV_S_6_RANGE_STAT_151 "" TAB_VERB 6 0 "EFP_OFF" 1 "EFP_ON_DLY" 2 "EFP_ON" 3 "EFP_OFF_DLY" 4 "EFP_EXT_ADJ" 5 "EFP_CRASH" /end COMPU_VTAB
/begin COMPU_METHOD _CNV_A_R_LINEAR_____157_CM "" RAT_FUNC "%6.3" "V" COEFFS 0 8.854166666666666 0. 0 0 1 /end COMPU_METHOD
/begin COMPU_METHOD _CNV_A_R_LINEAR_____158_CM "" RAT_FUNC "%6.3" "V" COEFFS 0 204.8 0. 0 0 1 /end COMPU_METHOD
/begin COMPU_METHOD _CNV_A_R_LINEAR_____159_CM "" RAT_FUNC "%6.3" "%" COEFFS 0 327.6800000071683 0. 0 0 1 /end COMPU_METHOD
/begin COMPU_METHOD _CNV_A_R_LINEAR_____171_CM "" RAT_FUNC "%6.3" "1/min/s" COEFFS 0 3.125e-002 0. 0 0 1 /end COMPU_METHOD
/begin COMPU_METHOD _CNV_A_R_LINEAR_____173_CM "" RAT_FUNC "%6.3" "rpm" COEFFS 0 4. 0. 0 0 1 /end COMPU_METHOD
/begin COMPU_METHOD _CNV_A_R_LINEAR_____175_CM "" RAT_FUNC "%6.3" "%/200ms" COEFFS 0 10.2 0. 0 0 1 /end COMPU_METHOD
/begin COMPU_METHOD _CNV_A_R_LINEAR_____176_CM "" RAT_FUNC "%6.3" "s" COEFFS 0 5. -1. 0 0 1 /end COMPU_METHOD
/begin COMPU_METHOD _CNV_A_R_LINEAR_____179_CM "" RAT_FUNC "%6.3" "Nm/rpm" COEFFS 0 32. 0. 0 0 1 /end COMPU_METHOD
/begin COMPU_METHOD _CNV_A_R_LINEAR_____180_CM "" RAT_FUNC "%6.3" "rpm" COEFFS 0 3.125e-002 128. 0 0 1 /end COMPU_METHOD
/begin COMPU_METHOD _CNV_A_R_LINEAR_____181_CM "" RAT_FUNC "%6.3" "-" COEFFS 0 2048. 0. 0 0 1 /end COMPU_METHOD
/begin COMPU_METHOD _CNV_A_R_LINEAR_____187_CM "" RAT_FUNC "%6.3" "°CRK" COEFFS 0 42.66666666666666 32768. 0 0 1 /end COMPU_METHOD
/begin COMPU_METHOD _CNV_A_R_LINEAR_____188_CM "" RAT_FUNC "%6.3" "V" COEFFS 0 9.807692307692308 0. 0 0 1 /end COMPU_METHOD
/begin COMPU_METHOD _CNV_S_2_B_TRUE_222_CM "" TAB_VERB "%6.3" "-" COMPU_TAB_REF _CNV_S_2_B_TRUE_222 /end COMPU_METHOD
/begin COMPU_VTAB _CNV_S_2_B_TRUE_222 "" TAB_VERB 2 0 "----" 1 "TRUE" /end COMPU_VTAB
/begin COMPU_METHOD _CNV_A_R_spg_ubatt_223_CM "" RAT_FUNC "%6.3" "V" COEFFS 0 10.61571125265393 0. 0 0 1 /end COMPU_METHOD
/begin COMPU_METHOD _CNV_A_R_fak_ub_b2_224_CM "" RAT_FUNC "%6.3" "-" COEFFS 0 128. 0. 0 0 1 /end COMPU_METHOD
/begin COMPU_METHOD _CNV_A_R_sprzi_q0p1_225_CM "" RAT_FUNC "%6.3" "Grad Kw" COEFFS 0 10. 0. 0 0 1 /end COMPU_METHOD
/begin COMPU_METHOD _CNV_A_R_sprzi_q0p1_226_CM "" RAT_FUNC "%6.3" "Grad Kw" COEFFS 0 10. 32768. 0 0 1 /end COMPU_METHOD
/begin COMPU_METHOD _CNV_A_R_vnstv_q0p0_227_CM "" RAT_FUNC "%6.3" "%" COEFFS 0 100. 0. 0 0 1 /end COMPU_METHOD
/begin COMPU_METHOD _CNV_A_R_vnstv_q0p0_228_CM "" RAT_FUNC "%6.3" "%" COEFFS 0 327.68 32768. 0 0 1 /end COMPU_METHOD
/begin COMPU_METHOD _CNV_A_R_sprzivg_q0_229_CM "" RAT_FUNC "%6.3" "Grad KW/s" COEFFS 0 1.28 0. 0 0 1 /end COMPU_METHOD
/begin COMPU_METHOD _CNV_A_R_wkw_sw_b12_230_CM "" RAT_FUNC "%6.3" "Grad Kw" COEFFS 0 256. 0. 0 0 1 /end COMPU_METHOD
/begin COMPU_METHOD _CNV_A_R_sprzi_q0p0_231_CM "" RAT_FUNC "%6.3" "Grad Kw" COEFFS 0 20. 0. 0 0 1 /end COMPU_METHOD
/begin COMPU_METHOD _CNV_A_R_LINEAR_____232_CM "" RAT_FUNC "%6.3" "Grad C" COEFFS 0 1.333333333333333 64. 0 0 1 /end COMPU_METHOD
/begin COMPU_METHOD _CNV_R_R_sprzi_q0p1_233_CM "" RAT_FUNC "%6.3" "Grad kw" COEFFS 0. 10. 0. 0. 0. 1. /end COMPU_METHOD
/begin COMPU_METHOD _CNV_R_R_sprzi_q0p1_234_CM "" RAT_FUNC "%6.3" "Grad Kw" COEFFS 0. 10. 128. 0. 0. 1. /end COMPU_METHOD
/begin COMPU_METHOD _CNV_A_R_nmot_ub_q4_235_CM "" RAT_FUNC "%6.3" "rpm" COEFFS 0 2.5e-002 0. 0 0 1 /end COMPU_METHOD
/begin COMPU_METHOD _CNV_A_R_rel_ub_q0p_264_CM "" RAT_FUNC "%6.3" "%" COEFFS 0 1.333333333333333 0. 0 0 1 /end COMPU_METHOD
/begin COMPU_METHOD _CNV_A_R_vnstv_q0p0_265_CM "" RAT_FUNC "%6.3" "%" COEFFS 0 327.6799999999992 0. 0 0 1 /end COMPU_METHOD
/begin COMPU_METHOD _CNV_A_R_dez_266_CM "" RAT_FUNC "%6.3" "%" COEFFS 0 1. 0. 0 0 1 /end COMPU_METHOD
/begin COMPU_METHOD _CNV_A_R_LINEAR_____267_CM "" RAT_FUNC "%6.3" "-" COEFFS 0 10000. 9.094947017729282e-013 0 0 1 /end COMPU_METHOD
/begin COMPU_METHOD _CNV_S_5_RANGE_STAT_268_CM "" TAB_VERB "%6.3" "-" COMPU_TAB_REF _CNV_S_5_RANGE_STAT_268 /end COMPU_METHOD
/begin COMPU_VTAB _CNV_S_5_RANGE_STAT_268 "" TAB_VERB 5 0 "CP_T_NOT_ACT" 1 "T_CP_1_ACT" 2 "T_TI_AD_ACT" 3 "T_CP_2_ACT" 4 "T_CP_DEAC" /end COMPU_VTAB
/begin COMPU_METHOD _CNV_S_12_RANGE_STAT_269_CM "" TAB_VERB "%6.3" "-" COMPU_TAB_REF _CNV_S_12_RANGE_STAT_269 /end COMPU_METHOD
/begin COMPU_VTAB _CNV_S_12_RANGE_STAT_269 "" TAB_VERB 12 0 "CP_NO_TRA" 1 "MIN_PURGE_TO_NO_PURGE" 2 "NO_PURGE_TO_MIN_PURGE" 3 "RAMP_OPEN_TO_NO_PURGE" 4 "RAMP_OPEN_TO_MIN_PURGE" 5 "RAMP_OPEN_FAST_TO_NO_PURGE" 6 "RAMP_OPEN_FAST_TO_MIN_PURGE" 7 "MAX_PURGE_TO_NO_PURGE" 8 "MAX_PURGE_TO_MIN_PURGE" 9 "RAMP_CLOSE_TO_NO_PURGE" 10 "WAIT_RAMP_OPEN_TO_NO_PURGE" 11 "WAIT_RAMP_OPEN_TO_MIN_PURGE" /end COMPU_VTAB
/begin COMPU_METHOD _CNV_S_3_RANGE_STAT_270_CM "" TAB_VERB "%6.3" "-" COMPU_TAB_REF _CNV_S_3_RANGE_STAT_270 /end COMPU_METHOD
/begin COMPU_VTAB _CNV_S_3_RANGE_STAT_270 "" TAB_VERB 3 0 "CP_NO_DEAC" 1 "RAMP_OPEN_DEAC" 2 "MAX_PURGE_DEAC" /end COMPU_VTAB
/begin COMPU_METHOD _CNV_A_R_LINEAR_____271_CM "" RAT_FUNC "%6.3" "Hz" COEFFS 0 1. 0. 0 0 1 /end COMPU_METHOD
/begin COMPU_METHOD _CNV_A_R_LINEAR_____272_CM "" RAT_FUNC "%6.3" "kg/h" COEFFS 0 8191.999999679995 0. 0 0 1 /end COMPU_METHOD
/begin COMPU_METHOD _CNV_A_R_LINEAR_____273_CM "" RAT_FUNC "%6.3" "g" COEFFS 0 2949840.175137362 0. 0 0 1 /end COMPU_METHOD
/begin COMPU_METHOD _CNV_A_R_LINEAR_____274_CM "" RAT_FUNC "%6.3" "hPa" COEFFS 0 27.30625 0. 0 0 1 /end COMPU_METHOD
/begin COMPU_METHOD _CNV_A_R_LINEAR_____275_CM "" RAT_FUNC "%6.3" "-" COEFFS 0 255.9999997499962 0. 0 0 1 /end COMPU_METHOD
/begin COMPU_METHOD _CNV_A_R_LINEAR_____276_CM "" RAT_FUNC "%6.3" "%" COEFFS 0 655.34 0. 0 0 1 /end COMPU_METHOD
/begin COMPU_METHOD _CNV_A_R_LINEAR_____277_CM "" RAT_FUNC "%6.3" "hPa" COEFFS 0 54.6125 0. 0 0 1 /end COMPU_METHOD
/begin COMPU_METHOD _CNV_A_R_LINEAR_____278_CM "" RAT_FUNC "%6.3" "hPa" COEFFS 0 27.30625 32767.5 0 0 1 /end COMPU_METHOD
/begin COMPU_METHOD _CNV_A_R_LINEAR_____279_CM "" RAT_FUNC "%6.3" "%" COEFFS 0 2.56 128. 0 0 1 /end COMPU_METHOD
/begin COMPU_METHOD _CNV_A_R_LINEAR_____280_CM "" RAT_FUNC "%6.3" "-" COEFFS 0 1023.999999959999 0. 0 0 1 /end COMPU_METHOD
/begin COMPU_METHOD _CNV_A_R_LINEAR_____281_CM "" RAT_FUNC "%6.3" "hPa" COEFFS 0 12.06017666543982 -1.759293338545831e-002 0 0 1 /end COMPU_METHOD
/begin COMPU_METHOD _CNV_S_8_RANGE_STAT_282_CM "" TAB_VERB "%6.3" "-" COMPU_TAB_REF _CNV_S_8_RANGE_STAT_282 /end COMPU_METHOD
/begin COMPU_VTAB _CNV_S_8_RANGE_STAT_282 "" TAB_VERB 8 0 "CP_NOT_ACT" 1 "NO_PURGE" 2 "MIN_PURGE" 3 "RAMP_OPEN" 4 "RAMP_OPEN_FAST" 5 "MAX_PURGE" 6 "RAMP_CLOSE" 7 "WAIT_RAMP_OPEN" /end COMPU_VTAB
/begin COMPU_METHOD _CNV_A_R_LINEAR_____285_CM "" RAT_FUNC "%6.3" "-" COEFFS 0 7379.793318491542 0. 0 0 1 /end COMPU_METHOD
/begin COMPU_METHOD _CNV_A_R_LINEAR_____286_CM "" RAT_FUNC "%6.3" "cm²" COEFFS 0 1118.481084425738 0. 0 0 1 /end COMPU_METHOD
/begin COMPU_METHOD _CNV_A_R_LINEAR_____313_CM "" RAT_FUNC "%6.3" "ms" COEFFS 0 1.e-002 0. 0 0 1 /end COMPU_METHOD
/begin COMPU_METHOD _CNV_A_R_LINEAR_____314_CM "" RAT_FUNC "%6.3" "V" COEFFS 0 10. -106. 0 0 1 /end COMPU_METHOD
/begin COMPU_METHOD _CNV_A_R_LINEAR_____315_CM "" RAT_FUNC "%6.3" "1/s^2" COEFFS 0 100.5832246182181 2.916123092290945e-003 0 0 1 /end COMPU_METHOD
/begin COMPU_METHOD _CNV_A_R_LINEAR_____316_CM "" RAT_FUNC "%6.3" "-" COEFFS 0 127.5100401606426 0.4899598393574252 0 0 1 /end COMPU_METHOD
/begin COMPU_METHOD _CNV_A_R_LINEAR_____317_CM "" RAT_FUNC "%6.3" "%/V" COEFFS 0 819.2000030400465 0. 0 0 1 /end COMPU_METHOD
/begin COMPU_METHOD _CNV_A_R_LINEAR_____318_CM "" RAT_FUNC "%6.3" "1/s^2" COEFFS 0 100.5832246182181 32768.00291612309 0 0 1 /end COMPU_METHOD
/begin COMPU_METHOD _CNV_S_9_RANGE_STAT_319_CM "" TAB_VERB "%6.3" "[-]" COMPU_TAB_REF _CNV_S_9_RANGE_STAT_319 /end COMPU_METHOD
/begin COMPU_VTAB _CNV_S_9_RANGE_STAT_319 "" TAB_VERB 9 0 "SA_INACTIVE" 1 "SA_DELAY" 2 "SA_ACTIVE" 3 "INTERRUPT" 4 "SAV_DELAY" 5 "FINISHED" 6 "CANCELLED" 7 "EXT_ADJ" 8 "EXT_ADJ_FIN" /end COMPU_VTAB
/begin COMPU_METHOD _CNV_A_R_LINEAR_____374_CM "" RAT_FUNC "%6.3" "°CRK" COEFFS 0 -2.666666666666667 -106.6666666666667 0 0 1 /end COMPU_METHOD
/begin COMPU_METHOD _CNV_A_R_LINEAR_____375_CM "" RAT_FUNC "%6.3" "°CRK/10ms" COEFFS 0 42.66666666666666 0. 0 0 1 /end COMPU_METHOD
/begin COMPU_METHOD _CNV_A_R_LINEAR_____376_CM "" RAT_FUNC "%6.3" "-" COEFFS 0 32. 128. 0 0 1 /end COMPU_METHOD
/begin COMPU_METHOD _CNV_A_R_LINEAR_____377_CM "" RAT_FUNC "%6.3" "°CRK" COEFFS 0 2.666666666666667 -106.6666666666667 0 0 1 /end COMPU_METHOD
/begin COMPU_METHOD _CNV_A_R_LINEAR_____379_CM "" RAT_FUNC "%6.3" "-" COEFFS 0 65551.06000970239 0. 0 0 1 /end COMPU_METHOD
/begin RECORD_LAYOUT _REC_VAL_20_u2 FNC_VALUES 1 UWORD COLUMN_DIR DIRECT /end RECORD_LAYOUT
/begin RECORD_LAYOUT _REC_VAL_20_s2 FNC_VALUES 1 SWORD COLUMN_DIR DIRECT /end RECORD_LAYOUT
/begin RECORD_LAYOUT _REC_VAL_20_u1 FNC_VALUES 1 UBYTE COLUMN_DIR DIRECT /end RECORD_LAYOUT
/begin RECORD_LAYOUT _REC_VAL_20_s1 FNC_VALUES 1 SBYTE COLUMN_DIR DIRECT /end RECORD_LAYOUT
/begin RECORD_LAYOUT _REC_AXS_20_u2 NO_AXIS_PTS_X 1 UWORD AXIS_PTS_X 2 UWORD INDEX_INCR DIRECT /end RECORD_LAYOUT
/begin RECORD_LAYOUT _REC_AXS_20_u1 NO_AXIS_PTS_X 1 UBYTE AXIS_PTS_X 2 UBYTE INDEX_INCR DIRECT /end RECORD_LAYOUT
/begin RECORD_LAYOUT _REC_CUR_20_u2_u2 FNC_VALUES 1 UWORD COLUMN_DIR DIRECT /end RECORD_LAYOUT
/begin RECORD_LAYOUT _REC_MAP_20_u1_u1_u1 FNC_VALUES 1 UBYTE COLUMN_DIR DIRECT /end RECORD_LAYOUT
/begin RECORD_LAYOUT _REC_CUR_20_u2_u1 FNC_VALUES 1 UWORD COLUMN_DIR DIRECT /end RECORD_LAYOUT
/begin RECORD_LAYOUT _REC_CUR_20_u1_u1 FNC_VALUES 1 UBYTE COLUMN_DIR DIRECT /end RECORD_LAYOUT
/begin RECORD_LAYOUT _REC_MAP_20_u1_u2_u1 FNC_VALUES 1 UBYTE COLUMN_DIR DIRECT /end RECORD_LAYOUT
/begin RECORD_LAYOUT _REC_CUR_20_u1_u2 FNC_VALUES 1 UBYTE COLUMN_DIR DIRECT /end RECORD_LAYOUT
/begin RECORD_LAYOUT _REC_MAP_20_u2_u1_u1 FNC_VALUES 1 UWORD COLUMN_DIR DIRECT /end RECORD_LAYOUT
/begin RECORD_LAYOUT _REC_MAP_20_u2_u2_u1 FNC_VALUES 1 UWORD COLUMN_DIR DIRECT /end RECORD_LAYOUT
/begin RECORD_LAYOUT _REC_MAP_20_u2_u1_u2 FNC_VALUES 1 UWORD COLUMN_DIR DIRECT /end RECORD_LAYOUT
/begin RECORD_LAYOUT _REC_MAP_20_u1_u2_u2 FNC_VALUES 1 UBYTE COLUMN_DIR DIRECT /end RECORD_LAYOUT
/begin RECORD_LAYOUT _REC_CUR_32_u2_u2 NO_AXIS_PTS_X 1 UWORD AXIS_PTS_X 2 UWORD INDEX_INCR DIRECT FNC_VALUES 3 UWORD COLUMN_DIR DIRECT /end RECORD_LAYOUT
/begin RECORD_LAYOUT _REC_CUR_32_u1_u1 NO_AXIS_PTS_X 1 UBYTE AXIS_PTS_X 2 UBYTE INDEX_INCR DIRECT FNC_VALUES 3 UBYTE COLUMN_DIR DIRECT /end RECORD_LAYOUT
/begin RECORD_LAYOUT _REC_MAP_32_u1_u1_u1 NO_AXIS_PTS_X 1 UBYTE NO_AXIS_PTS_Y 2 UBYTE AXIS_PTS_X 3 UBYTE INDEX_INCR DIRECT AXIS_PTS_Y 4 UBYTE INDEX_INCR DIRECT FNC_VALUES 5 UBYTE COLUMN_DIR DIRECT /end RECORD_LAYOUT
/begin FUNCTION AUX_Auxiliary_Functions "AUX"
 /begin SUB_FUNCTION AUX_Blocking_of_the_air_conditio AUX_Engine_speed_limitation_cont AUX_Infinitely_variable_valve_ti AUX_Electrical_fuel_pump_control AUX_Electronically_controled_the AUX_Fuel_pressure_control AUX_Evaporative_emission_control AUX_IVVT_setpoint_stratified AUX_Eavanos AUX_Disa AUX_BSD_Generator AUX_IVVT_setpoint_coordination AUX_Exhaust_gas_recirculation AUX_Control_of_electric_fan AUX_Secondary_air AUX_Determination_of_secondary_a AUX_Port_Deactivation_Setpoint_C AUX_Power_Management AUX_Heading /end SUB_FUNCTION
/end FUNCTION
/begin FUNCTION AUX_Blocking_of_the_air_conditio "_Blocking of the air conditioner compressor"
 /begin DEF_CHARACTERISTIC C_ACCIN_DLY_1_LOCK_FL C_ACCIN_DLY_1 C_ACCIN_DLY_4 C_ACCIN_DLY_5 C_PVS_FL_ACCIN C_VS_MAX_ACCIN /end DEF_CHARACTERISTIC
 /begin OUT_MEASUREMENT LV_ACCOUT_RLY /end OUT_MEASUREMENT
/end FUNCTION
/begin FUNCTION AUX_Engine_speed_limitation_cont "_Engine speed limitation controller"
 /begin DEF_CHARACTERISTIC C_ADD_N_MAX_FCUT C_N_GRD_HYS C_TQI_MAX_PAS C_CRLC_N_GRD_FIL_1 C_CRLC_N_GRD_FIL_2 C_TQI_N_MAX_INC ID_FAC_N_MAX_I_AT__GEAR ID_FAC_N_MAX_P_MT__GEAR ID_FAC_N_MAX_I_MT__GEAR ID_FAC_N_MAX_P_AT__GEAR ID_T_N_MAX_PRED_AT__GEAR ID_T_N_MAX_PRED_MT__GEAR IP_N_GRD_THD__N_32 /end DEF_CHARACTERISTIC
 /begin OUT_MEASUREMENT LV_N_MAX_REQ_FCUT N_DIF_MAX_LIM N_PRED_MAX_LIM TQ_N_MAX_DIF TQ_N_MAX_DIF_I TQ_N_MAX_DIF_P TQ_N_MAX_INP_I TQI_N_MAX TQI_N_MAX_REF LV_N_MAX N_GRD_FIL N_GRD_FIL_FIL LV_VS_MAX N_MAX_VS_MAX VS_RATIO TQI_N_MAX_1 TQI_N_MAX_2 /end OUT_MEASUREMENT
/end FUNCTION
/begin FUNCTION AUX_Infinitely_variable_valve_ti "_Infinitely variable valve timing intake" /end FUNCTION
/begin FUNCTION AUX_Electrical_fuel_pump_control "_Electrical fuel pump control" /begin DEF_CHARACTERISTIC C_T_EFP_PREV C_T_EFP /end DEF_CHARACTERISTIC /begin OUT_MEASUREMENT LV_EFP T_DLY_EFP STATE_EFP /end OUT_MEASUREMENT /end FUNCTION
/begin FUNCTION AUX_Electronically_controled_the "_Electronically controled thermostat"
 /begin DEF_CHARACTERISTIC C_TCO_BOL_ECT C_TCO_EX_HYS_ECT C_TCO_EX_MAX_ECT C_TCO_MIN_ECT C_TCO_SP_TCO_EX_MAX C_TCO_SP_TIA_MAX C_TCO_SP_TOIL_MIN C_TIA_HYS_ECT C_TIA_MAX_ECT C_TOIL_HYS_ECT C_TOIL_MIN_ECT ldp_n_32__ectpwm_add ldp_tco_dif__ectpwm_i ldp_tco_dif__ectpwm_p ldp_tco_sp__ectpwm_add ldp_tco_st__dist ID_ECTPWM_ADD IP_DIST_MIN IP_ECTPWM_I IP_ECTPWM_P C_TOIL_MAX_ECT ID_TCO_SP_ECT__N__PV_MAX ldpm_pv_max_1 ID_TCO_SP_ECT_ACIN__N__PV_MAX /end DEF_CHARACTERISTIC
 /begin OUT_MEASUREMENT TCO_SP ECTPWM /end OUT_MEASUREMENT
/end FUNCTION
/begin FUNCTION AUX_Fuel_pressure_control "_Fuel pressure control"
 /begin DEF_CHARACTERISTIC IP_FUP_SP_HOM IP_FUP_SP_S IP_FPAPWM_BAS IP_FPAPWM_FAC IP_FPAPWM_P_FAC IP_FPAPWM_I_FAC IP_FPAPWM_P IP_FPAPWM_I C_FPAPWM_MAX C_FUP_MIN C_FUP_BOL C_FUP_MAX C_T_DLY_FUP_MAX C_FPA_MFF_INI C_MFP C_FPAPWM_MIN C_FPAPWM_I_MIN C_FPAPWM_I_MAX /end DEF_CHARACTERISTIC
 /begin OUT_MEASUREMENT FPAPWM_BAS FPAPWM_P FPAPWM_I FUP_SP FUP_DIF FPAPWM FPA_MFF STATE_FUP /end OUT_MEASUREMENT
/end FUNCTION
/begin FUNCTION AUX_Evaporative_emission_control "_Evaporative emission control"
 /begin DEF_CHARACTERISTIC C_TI_T_AD C_T_2_CP C_PRS_MAX_CPS C_TIA_MIN_CP C_N_CP_TOL C_N_CP_BOL C_MAF_CP_BOL C_MAF_CP_TOL C_T_DI_MAX_CP C_T_DI_RAMP_OPEN_CP C_T_DLY_CP C_T_DLY_MAX_1_CP C_T_DLY_MAX_2_CP C_MAF_CYL_DLY_CRLC C_FLOW_CPS_DLY_CRLC C_FUEL_FAC_CP C_CL_ST_CP C_CL_MAX_CP C_CL_MMV_THD C_LAM_DIF_MAX_CP C_N_FRQ_HYS_CPS C_CPPWM_FRQ_2 C_N_FRQ_1_CPS C_N_FRQ_2_CPS C_CPPWM_FRQ_1_CPS C_CPPWM_FRQ_2_CPS C_LAMB_SP_CP_FAC C_LAMB_FAC_CP C_CPPWM_AS LC_CPPWM_LIM_DIAG IP_TI_LAM_COR_CRLC__MAF_CYL IP_T_MAX_CP__CL_MMV IP_REL_FLOW_INC_CP__MAF_CYL IP_REL_FLOW_FAC_CP__CL_MMV IP_REL_FLOW_DEC_CP__MAF_CYL IP_REL_FLOW_CPS_S__N_32__MAF IP_REL_FLOW_CPS_HOM__N_32__MAF IP_CPPWM__FLOW_COR_CPS__PRS_CPS IP_FAC_AMP_CP__AMP IP_FAC_TIA_CP__TIA IP_CPPWM_VB_FAC__VB IP_FLOW_CPS__PRS_CPS IP_CPPWM_COR_FRQ__CPPWM_REF IP_FUEL_DLY_CPS__N_32 IP_FUEL_FAC_CPS__N_32 IP_FUEL_FAC_2_CPS__N_32 IP_REL_FLOW_MAX_CPS__N_32__MAF C_T_1_CP IP_CL_CRLC__N_32__MAF LC_LAM_CTL_CONF C_CPPWM_FRQ_1 C_CPPWM_FRQ_HYS_CPS IP_CPPWM_VB_ADD_1__VB IP_CPPWM_VB_ADD_2__VB IP_T_DLY_CP__MAF_CYL C_CRLC_LAMB_MMV IP_REL_FLOW_CPS_AFL__N_32__MAF IP_FUEL_MAX_CP_S__N_32__TQI_SP IP_FUEL_MAX_CP_AFL__N_32__MAF IP_FUEL_MAX_CP_HOM__N_32__MAF IP_MFF_FAC_CP__N_32__TQI_SP_S IP_CPPWM_MIN_DIAG__FRQ_REQ_CP IP_CPPWM_MAX_DIAG__FRQ_REQ_CP C_TCO_MIN_CP /end DEF_CHARACTERISTIC
 /begin OUT_MEASUREMENT TI_LAM_MMV LV_CP_ACT STATE_T_SDL_CP T_CP STATE_TRA_CP STATE_NORM_DEAC_CP REL_FLOW_CPS REL_FLOW_CPS_AV REL_FLOW_CPS_DI REL_FLOW_CPS_OLD REL_FLOW_CPS_OLD_DI REL_FLOW_SP_CPS MAF_CYL_DLY_MMV MAF_CYL_DLY CL CL_MMV CL_MMV_DI CL_MMV_OLD CL_MMV_OLD_DI LV_RAMP_CLOSE_END LV_RAMP_OPEN_END LV_RAMP_OPEN_ACT LV_MAX_PURGE_END LAM_0_CP_DI LAM_0_CP CL_MMV_NORM_PURGE_END FRQ_REQ_CP FUEL_FLOW_CP FUEL_FLOW_MAX_CP FLOW_COR_CPS FLOW_CPS_DLY_MMV CPPWM_SP CPPWM_CPS CPPWM_REF CPPWM LV_FRQ_CPS LAM_DIF_CP LAM_ADJ_CP LV_LAM_ADJ_CP T_DLY_MAX_CP MAF_CYL_DLY_OLD MAF_CYL_OLD MAF_CYL_OLD2 FLOW_CPS_DLY FLOW_CPS_DLY_OLD FLOW_CPS FLOW_CPS_OLD FLOW_CPS_OLD2 FUEL_FLOW_ADD_AD_CP FUEL_CPS FLOW_SP_CPS FLOW_TOT_CPS MAF_CPS LV_TI_AD_ENA LV_OBD_CDN_CLOSE_MOD MFF_SP_HOM_ENG CPPWM_CP_DIAGCP CPPWM_EXT_ADJ FUEL_TOT_CPS FUEL_FLOW_ADD_BUF_0_ FUEL_FLOW_ADD_BUF_1_ FUEL_FLOW_ADD_BUF_2_ FUEL_FLOW_ADD_BUF_3_ FUEL_FLOW_ADD_BUF_4_ FUEL_FLOW_ADD_BUF_5_ FUEL_FLOW_ADD_BUF_6_ FUEL_FLOW_ADD_BUF_7_ FUEL_FLOW_ADD_BUF_8_ FUEL_FLOW_ADD_BUF_9_ FUEL_FLOW_ADD_BUF_10_ FUEL_FLOW_ADD_BUF_11_ FUEL_FLOW_ADD_BUF_12_ FUEL_FLOW_ADD_BUF_13_ FUEL_FLOW_ADD_BUF_14_ FUEL_FLOW_ADD_BUF_15_ FUEL_FLOW_ADD_BUF_16_ FUEL_FLOW_ADD_BUF_17_ FUEL_FLOW_ADD_BUF_18_ FUEL_FLOW_ADD_BUF_19_ PRS_CPS LV_LAM_LIM LV_OBD_CDN_MIN_MOD LV_TI_LAM_COR_CP TI_LAM_CP STATE_CP LAMB /end OUT_MEASUREMENT
/end FUNCTION
/begin FUNCTION AUX_IVVT_setpoint_stratified "_IVVT setpoint stratified"
 /begin DEF_CHARACTERISTIC C_CRLC_MFF_SP_S IP_CAM_SP_2_EX_PL_S__N__MFF_MMV IP_CAM_SP_1_EX_PL_S__N__MFF_MMV IP_CAM_SP_1_IN_IS_S__N__MFF_MMV IP_CAM_SP_2_IN_IS_S__N__MFF_MMV IP_CAM_SP_1_EX_IS_S__N__MFF_MMV IP_CAM_SP_2_EX_IS_S__N__MFF_MMV IP_CAM_SP_1_IN_PL_S__N__MFF_MMV IP_CAM_SP_2_IN_PL_S__N__MFF_MMV /end DEF_CHARACTERISTIC
 /begin OUT_MEASUREMENT CAM_SP_AV_IN_S CAM_SP_AV_EX_S MFF_MMV /end OUT_MEASUREMENT
/end FUNCTION
/begin FUNCTION AUX_Eavanos "_Eavanos"
 /begin DEF_CHARACTERISTIC ESP_ADPWF ESP_BA ESP_ADTV ESP_TVHB ESP_WNWS VNSRTVMX VNSRTVMN VNSRTVIMX VNSRTVIMN SPRZG_AN_0_ SPRZG_AN_1_ SPRZG_AN_2_ SPRZG_AN_3_ NW_MIN_0_ NW_MIN_1_ NW_MIN_2_ NW_MIN_3_ VNS_ADT ASP_ADPWF ASP_BA ASP_ADTV ASP_TVHB ASP_WNWSASP_WNWS ESP2ADPWF ASP2ADPWF KLRANWI KLRANWP KLRENWI KLRENWP KLVNSTVUB VNS_ADEND NW3FLANKE_0_ NW3FLANKE_1_ NW3FLANKE_2_ NW3FLANKE_3_ NW2FLANKE_0_ NW2FLANKE_1_ NW2FLANKE_2_ NW2FLANKE_3_ NW1FLANKE_0_ NW1FLANKE_1_ NW1FLANKE_2_ NW1FLANKE_3_ NW0FLANKE_0_ NW0FLANKE_1_ NW0FLANKE_2_ NW0FLANKE_3_ NWSEGOFFS_0_ NWSEGOFFS_1_ NWSEGOFFS_2_ NWSEGOFFS_3_ KLNWPOST KLNWPOSN /end DEF_CHARACTERISTIC
 /begin OUT_MEASUREMENT Vnsfaktvub Vsa2adp Vsa2dwnw Vsa2dwnwkl Vsa2spris Vsa2sprs Vsa2tv Vsa2tv_i Vsa2tv_p Vsa2vg Vsadwnwkl Vsaspris Vsa_adp Vsa_dwnw Vsa_spri Vsa_sprs Vsa_tv Vsa_tv_i Vsa_tv_p Vsa_vg Vse2adp Vse2dwnw Vse2dwnwkl Vse2spri Vse2spris Vse2sprs Vse2tv Vse2tv_i Vse2vg Vsedwnwkl Vsespris Vse_adp Vse_dwnw Vse_spri Vse_sprs Vse_tv Vse_tv_i Vse_tv_p Vse_vg wnwi_w Vse2tv_p VSA2ADP_FL_0__A VSA2ADP_FL_1__A VSA2ADP_FL_2__A VSA2ADP_FL_3__A NW_POS_0__A NW_POS_1__A NW_POS_2__A NW_POS_3__A VSE2ADP_FL_0__A VSE2ADP_FL_1__A VSE2ADP_FL_2__A VSE2ADP_FL_3__A VSA_ADP_FL_0__A VSA_ADP_FL_1__A VSA_ADP_FL_2__A VSA_ADP_FL_3__A VSE_ADP_FL_0__A VSE_ADP_FL_1__A VSE_ADP_FL_2__A VSE_ADP_FL_3__A Vsa2stat B2VSAADERR B2VSAADNOK B2VSAADP VSE2STAT B2VSEADERR B2VSEADNOK B2VSEADP VSE_STAT B_VSEADERR B_VSEADNOK B_VSEADP VSA_STAT B_VSAADERR B_VSAADNOK B_VSAADP TMOT NWPOS_TKOR NWPOS_NKOR /end OUT_MEASUREMENT
/end FUNCTION
/begin FUNCTION AUX_Disa "_Disa"
 /begin DEF_CHARACTERISTIC DISA_BEGR DISA_U DISA_O DISA_RAMP DISAMN DISAIMX DISAIMN Di_dir Di_h_res DISA_KL_P DISA_KL_I DITV WLSU DI_HYST DISAMX DISA_OFF_THR DISA_SAVE DISA_SOL_OFST DI_SPRUNG DI_SCHALT /end DEF_CHARACTERISTIC
 /begin OUT_MEASUREMENT Vsa2spri St_di B_disa B_di_ausschalt B_di_einschalt Di Disa_soll Disaaus_i Disaaus_p D_disa_kl Disaaus_w D_disa_v D_disa_w Disa_ist Disa_oma Disa_roh Disa_uma Disolakt Ditv_aus Disa_spg Disa_lern Di_alt Di_cnt Disa_dir B_su Disa_off /end OUT_MEASUREMENT
/end FUNCTION
/begin FUNCTION AUX_BSD_Generator "_BSD-Generator" /begin DEF_CHARACTERISTIC GEN_DNMIN GENPDTIME /end DEF_CHARACTERISTIC
 /begin OUT_MEASUREMENT LAMB_MMV GENSTATROH GENTIMERPD ST_GEN B_KL61 B_GENHFTAK DFFGEN TLRFGEN UFGEN B_GENFEL B_GENFHT B_GENFME B_GENFBSD NMOT_W /end OUT_MEASUREMENT
/end FUNCTION
/begin FUNCTION AUX_IVVT_setpoint_coordination "_IVVT setpoint coordination"
 /begin DEF_CHARACTERISTIC IP_CAM_SP_2_EX_IS__N__MAF_IVVT C_CAM_SP_AS_EX C_CAM_SP_AS_IN C_CAM_SP_DIF_MAX C_LGRD_CAM_SP_TRA C_CAM_SP_AS_HYS_NEUT_EX C_CAM_SP_AS_HYS_NEUT_IN C_T_AST_IVVT C_CAM_SP_IN_AD C_T_CAM_SP_LGRD C_CAM_SP_EX_AD IP_FAC_CAM_IN_IS__TCO_TCO_ST IP_CAM_SP_2_EX_FL__N IP_FAC_CAM_IN_PL__TCO_TCO_ST ID_PV_MAX_FL_IVVT__N IP_CAM_SP_2_EX_PL__N__MAF_IVVT IP_CAM_SP_2_IN_FL__N IP_CAM_SP_1_EX_FL__N IP_CAM_SP_2_IN_IS__N__MAF_IVVT IP_CAM_SP_1_EX_IS__N__MAF_IVVT IP_CAM_SP_2_IN_PL__N__MAF_IVVT IP_CAM_SP_1_EX_PL__N__MAF_IVVT IP_CAM_SP_ADD_EX_CH_IS__TCO_ST IP_CAM_SP_1_IN_FL__N IP_FAC_CAM_EX_IS__TCO_TCO_ST IP_CAM_SP_1_IN_IS__N__MAF_IVVT IP_CAM_SP_ADD_IN_CH_IS__TCO_ST IP_FAC_CAM_EX_PL__TCO_TCO_ST IP_CAM_SP_1_IN_PL__N__MAF_IVVT /end DEF_CHARACTERISTIC
 /begin OUT_MEASUREMENT CAM_SP_AV_EX_HOM CAM_SP_AV_IN_HOM CAM_SP_AV_LGRD_EX CAM_SP_IN_LIM LV_TRAN_IVVT_EX CAM_SP_AV_LGRD_IN CAM_SP_IN_HYS LV_TRAN_IVVT_IN CAM_SP_EX CAM_SP_EX_LIM LV_PVS_FL_IVVT CAM_SP_IN CAM_SP_EX_HYS FAC_CAM_IN_IS FAC_CAM_EX_IS FAC_CAM_EX_PL LV_IVVT_AD_REQ FAC_CAM_IN_PL T_CAM_SP_ACT CAM_SP_AV_IN CAM_SP_REF_IN CAM_SP_AV_EX CAM_SP_REF_EX /end OUT_MEASUREMENT
/end FUNCTION
/begin FUNCTION AUX_Exhaust_gas_recirculation "_Exhaust gas recirculation"
 /begin DEF_CHARACTERISTIC C_TCO_MIN_EGR C_T_AST_EGR C_FAC_VVT_THD C_ER_STND_CRLC C_ER_DIF_MAX_CRLC C_FAC_ER_POS C_FAC_ER_NEG C_MAF_EGR_AD_POS_BOL C_MAF_EGR_AD_POS_TOL C_N_EGR_AD_POS_TOL C_MAF_EGR_AD_BOL C_MAF_EGR_AD_TOL C_N_EGR_AD_POS_BOL C_N_EGR_AD_BOL C_N_EGR_AD_TOL C_T_EGR_RATIO_AD_POS C_EGR_RATIO_AD_CRLC C_ER_EGR_CTR_TOL C_EGR_RATIO_SP_AD_MIN C_PSI_SP_MIN_EGR C_EGR_THR_TOL C_EGR_THR_BOL C_EGR_THR_LGRD_STOP C_V_AD_SLOP_EGR C_EGRPWM_MAX_POS C_EGRPWM_MAX_NEG C_EGRPWM_I_MAX_NEG C_EGRPWM_I_MAX_POS C_T_EGR_DLY1 C_T_EGR_DLY2 C_EGRPWM_DFT C_EGRPWM_OVL_LIM C_V_AD_DYW_EGR C_DLY_AD_BOL_EGR C_V_AD_MIN_BOL_EGR C_V_AD_MAX_BOL_EGR C_V_AD_INI_BOL_EGR IP_EGR_RATIO_HOM__MAF__N_32 IP_EGR_RATIO_S IP_EGR_RATIO_MIN__MAF__N_32 IP_FAC_TCO_EGR__TCO IP_EGR_RATIO_LGRD__MAF_CYL IP_ER_STD_THD__MAF__N_32 IP_EGR_RATIO_INC__MAF_CYL IP_EGR_ADD_NEG__ER_EGR IP_ER_EGR_CTR_INC__ER_EGR IP_STK_SP_EGR__AR_RED_SP_EGR IP_EGRPWM_PREV__STK_SP_EGR IP_EGRPWM_P__STK_DIF_EGR IP_EGRPWM_I__STK_DIF_EGR /end DEF_CHARACTERISTIC
 /begin OUT_MEASUREMENT LV_EGR_ACT ER_STND_DIF_0 ER_STND_DIF_1 ER_STND_DIF_2 ER_STND_DIF_3 ER_STND_DIF_4 ER_STND_DIF_5 ER_STND_MMV_0 ER_STND_MMV_1 ER_STND_MMV_2 ER_STND_MMV_3 ER_STND_MMV_4 ER_STND_MMV_5 ER_STND_0 ER_STND_1 ER_STND_2 ER_STND_3 ER_STND_4 ER_STND_5 ER_STD_0 ER_STD_1 ER_STD_2 ER_STD_3 ER_STD_4 ER_STD_5 EGR_RATIO_SP ER_STD_MAX ER_DIF_MAX ER_EGR FAC_EGR_RATIO EGR_RATIO_AD_MEM EGR_RATIO_ADD_AD ER_EGR_CTR T_EGR_RATIO_AD_POS MAF_SP_EGR PSI_SP_EGR AR_RED_SP_EGR EGRPWM_PREV STK_DIF_EGR EGRPWM_I EGRPWM_P EGRPWM_TMP EGRPWM STATE_OVL_EGR V_AD_BOL_EGR AD_BOL_EGR STK_SP_EGR_TMP STK_SP_EGR /end OUT_MEASUREMENT
/end FUNCTION
/begin FUNCTION AUX_Control_of_electric_fan "_Control of electric fan"
 /begin DEF_CHARACTERISTIC ID_ECFPWM_IGK_OFF__TEMP_CAT_ IP_N_ECF_TEMP_CAT_ ID_N_ECF_MIN_ACCIN_ IP_N_ECF_VS_COR_ IP_TEMP_SUB_ECF_INI_ IP_N_PERC_ECF_ C_TCO_HYS_CAT C_TOIL_HYS_CAT C_CRLC_INC_CAT_ECF_ C_CRLC_DEC_CAT_ECF_ C_N_ECF_HYS C_N_PERC_ECF_LGRD C_T_N_PERC_ECF_AS C_T_N_PERC_ECF_ACT C_T_N_ECF_AST C_ECFPWM_MIN C_ECFPWM_MAX C_N_PERC_ACT_ECF C_ECFPWM_ACT_ECF C_TCO_EX_MAX_VS_HYS C_TCO_EX_MAX_VS IP_N_ECF C_VB_ECF_GRD_MAX C_VB_ECF /end DEF_CHARACTERISTIC
 /begin OUT_MEASUREMENT TEMP_MMV_SUB_CAT_ECF TEMP_MMV_SUB_CAT_ECF_STOP ECFPWM_ECF N_ECF_MIN_HYS N_ECF_COR N_ECF_COR_FIL N_PERC ECFPWM_IGK_OFF /end OUT_MEASUREMENT
/end FUNCTION
/begin FUNCTION AUX_Secondary_air "_Secondary air"
 /begin DEF_CHARACTERISTIC C_N_MAX_SA_DEAC C_N_MAX_SA_ACT C_T_DLY_SAP C_T_DLY_SAV C_T_DLY_SAV_OFF C_T_ON_SAWUP C_T_ON_SAWUP_IS ID_T_SA_OFF_1 IP_MAF_SA_DEAC__N_32 IP_MAF_SA_ACT__N_32 C_TCO_DIF_MIN_SA C_VB_MIN_SA C_CTR_MAX_REST_SA ID_T_SA_OFF_0 LC_ACR_CHK_SA_ /end DEF_CHARACTERISTIC
 /begin OUT_MEASUREMENT LV_SAP LV_SA LV_SA_END T_SAP_DLY T_SAV_DLY T_STATE_SA_ACT STATE_SA LV_SAWUP LV_SAV CTR_REST_SA LV_PUC_SA_INH /end OUT_MEASUREMENT
/end FUNCTION
/end MODULE
/end PROJECT
/* -------------------------------------------------------------------------
SIEMENS Automotive - Data Declaration System (DDS)
Quality FE<0> NCE<0> E<248> W<0>
Quantity Maps <835> Parameter<1866> Axes<490> Online<3292>
------------------------------------------------------------------------- */
