ASAP2_VERSION 1 31
/begin PROJECT MS45 "Rover Motorsteuerung V6"
/begin HEADER "_default_HeaderComment" PROJECT_NO _50 /end HEADER
/begin MODULE _default_ModuleName "_default_ModuleLongIdentifier"
/begin MOD_COMMON "_default_ModCommonComment" DEPOSIT ABSOLUTE BYTE_ORDER MSB_FIRST ALIGNMENT_BYTE 1 ALIGNMENT_WORD 2 ALIGNMENT_LONG 4 ALIGNMENT_FLOAT32_IEEE 4 ALIGNMENT_FLOAT64_IEEE 8 /end MOD_COMMON
/begin CHARACTERISTIC C_AMP_HYS "maximum value between two acquired ambient pressure values" VALUE 0x67b5a _REC_VAL_20_u2 5434. _CNV_A_R_LINEAR_____1_CM 0. 5434. FORMAT "%7.2" /end CHARACTERISTIC
/begin CHARACTERISTIC C_CLRC_TQ_MAX_CLU "Correlation constant for torque losses" VALUE 0x67b60 _REC_VAL_20_u2 0.99998474 _CNV_A_R_LINEAR_____2_CM 0. 0.99998474 FORMAT "%7.5" /end CHARACTERISTIC
/begin CHARACTERISTIC C_CLRC_TQ_MIN_CLU "Correlation constant for torque losses" VALUE 0x67b62 _REC_VAL_20_u2 0.99998474 _CNV_A_R_LINEAR_____2_CM 0. 0.99998474 FORMAT "%7.5" /end CHARACTERISTIC
/begin CHARACTERISTIC C_CS_PN_T_MAX "Time threshold for detecting of clutch switch" VALUE 0x67b68 _REC_VAL_20_u2 655350. _CNV_A_R_LINEAR_____3_CM 0. 655350. FORMAT "%6.0" /end CHARACTERISTIC
/begin CHARACTERISTIC C_FIL_AJ_INP_0 "Filter constant 0 applied on input value of second order low pass filter" VALUE 0x67b98 _REC_VAL_20_s2 3.125e-002 _CNV_A_R_LINEAR_____9_CM -1.5625e-002 1.5625e-002 FORMAT "%6.5" /end CHARACTERISTIC
/begin CHARACTERISTIC C_FIL_AJ_INP_1 "Filter constant 1 applied on input value of second order low pass filter" VALUE 0x67b9a _REC_VAL_20_s2 3.125e-002 _CNV_A_R_LINEAR_____9_CM -1.5625e-002 1.5625e-002 FORMAT "%6.5" /end CHARACTERISTIC
/begin CHARACTERISTIC C_FIL_AJ_INP_2 "Filter constant 2 applied on input value of second order low pass filter" VALUE 0x67b9c _REC_VAL_20_s2 3.125e-002 _CNV_A_R_LINEAR_____9_CM -1.5625e-002 1.5625e-002 FORMAT "%6.5" /end CHARACTERISTIC
/begin CHARACTERISTIC C_FIL_AJ_OUT_1 "Filter constant 1 applied in output value of second order low pass filter" VALUE 0x67b9e _REC_VAL_20_s2 3.999938965 _CNV_A_R_LINEAR_____10_CM -2. 1.999938965 FORMAT "%8.4" /end CHARACTERISTIC
/begin CHARACTERISTIC C_FIL_AJ_OUT_2 "Filter constant 2 applied on output value of second order low pass filter" VALUE 0x67ba0 _REC_VAL_20_s2 3.999938965 _CNV_A_R_LINEAR_____10_CM -2. 1.999938965 FORMAT "%8.4" /end CHARACTERISTIC
/begin CHARACTERISTIC C_N_DIF_AJ_AC_1 "Engine speed difference threshold for acitvation anti jerk function at acceleration - first wave trigger" VALUE 0x67bf6 _REC_VAL_20_s2 65535. _CNV_A_R_LINEAR_____0_CM -32768. 32767. FORMAT "%6.0" /end CHARACTERISTIC
/begin CHARACTERISTIC C_N_DIF_AJ_AC_2 "Engine speed difference threshold for acitvation anti jerk function at acceleration - second wave trigger" VALUE 0x67bf8 _REC_VAL_20_s2 65535. _CNV_A_R_LINEAR_____0_CM -32768. 32767. FORMAT "%6.0" /end CHARACTERISTIC
/begin CHARACTERISTIC C_N_DIF_AJ_DEACC_1 "Engine speed difference threshold for acitvation anti jerk function at deacceleration - first wave trigger" VALUE 0x67bfa _REC_VAL_20_s2 65535. _CNV_A_R_LINEAR_____0_CM -32768. 32767. FORMAT "%6.0" /end CHARACTERISTIC
/begin CHARACTERISTIC C_N_DIF_AJ_DEACC_2 "Engine speed difference threshold for acitvation anti jerk function at deacceleration - second wave trigger" VALUE 0x67bfc _REC_VAL_20_s2 65535. _CNV_A_R_LINEAR_____0_CM -32768. 32767. FORMAT "%6.0" /end CHARACTERISTIC
/begin CHARACTERISTIC C_N_DIF_TQ_ST_1 "N_DIF threshold 1 for deactivating TQ_ST" VALUE 0x67c0a _REC_VAL_20_s2 65535. _CNV_A_R_LINEAR_____13_CM -32768. 32767. FORMAT "%5.0" /end CHARACTERISTIC
/begin CHARACTERISTIC C_N_DIF_TQ_ST_2 "N_DIF threshold 2 for deactivating TQ_ST" VALUE 0x67c0c _REC_VAL_20_s2 65535. _CNV_A_R_LINEAR_____13_CM -32768. 32767. FORMAT "%5.0" /end CHARACTERISTIC
/begin CHARACTERISTIC C_N_GRD_THD_NEG "Engine speed gradient for torque increase" VALUE 0x67c10 _REC_VAL_20_s1 8160. _CNV_A_R_LINEAR_____14_CM -4096. 4064. FORMAT "%5.0" /end CHARACTERISTIC
/begin CHARACTERISTIC C_N_GRD_THD_POS "Engine speed gradient for torque decrease" VALUE 0x67c11 _REC_VAL_20_s1 8160. _CNV_A_R_LINEAR_____14_CM -4096. 4064. FORMAT "%5.0" /end CHARACTERISTIC
/begin CHARACTERISTIC C_N_THD_MAX_AJ "Maximum engine speed threshold for anti jerk function" VALUE 0x67c24 _REC_VAL_20_u2 8160. _CNV_A_R_LINEAR_____0_CM 0. 8160. FORMAT "%4.0" /end CHARACTERISTIC
/begin CHARACTERISTIC C_N_THD_MIN_AJ "Minimum engine speed threshold for anti jerk function" VALUE 0x67c26 _REC_VAL_20_u2 8160. _CNV_A_R_LINEAR_____0_CM 0. 8160. FORMAT "%4.0" /end CHARACTERISTIC
/begin CHARACTERISTIC C_T_ACT_MAX_AJ "Maximum active time of anti jerk function after activation" VALUE 0x67c45 _REC_VAL_20_u1 25.5 _CNV_A_R_LINEAR_____18_CM 0. 25.5 FORMAT "%3.1" /end CHARACTERISTIC
/begin CHARACTERISTIC C_T_PAS_AJ_DLY "Delay time after closed drivetrain determination for PT2 filter actualisation" VALUE 0x67c6d _REC_VAL_20_u1 2.55 _CNV_A_R_LINEAR_____21_CM 0. 2.55 FORMAT "%3.2" /end CHARACTERISTIC
/begin CHARACTERISTIC C_T_TQ_ADD_DLY_ST "Time delay for deactivation torque lead" VALUE 0x67c8e _REC_VAL_20_u2 655.35 _CNV_A_R_LINEAR_____21_CM 0. 655.35 FORMAT "%5.2" /end CHARACTERISTIC
/begin CHARACTERISTIC C_TOIL_GRD_MAX_DIAG "Max. permissible oil temperature gradient" VALUE 0x67ce5 _REC_VAL_20_u1 255. _CNV_A_R_LINEAR_____30_CM 0. 255. FORMAT "%3.0" /end CHARACTERISTIC
/begin CHARACTERISTIC C_TQ_ADD_CH_LGRD "Limitation gradient for TQ_ADD_CH deactivation ramp" VALUE 0x67cfa _REC_VAL_20_u2 1023.96875 _CNV_A_R_LINEAR_____37_CM 0. 1023.96875 FORMAT "%7.2" /end CHARACTERISTIC
/begin CHARACTERISTIC C_TQ_ADD_MIN_CRU "Minimum threshold for authorizing torque lead request at active cruise control" VALUE 0x67d04 _REC_VAL_20_s2 2047.96875 _CNV_A_R_LINEAR_____37_CM -1024. 1023.96875 FORMAT "%7.1" /end CHARACTERISTIC
/begin CHARACTERISTIC C_TQ_DIF_1 "Torque threshold 1 for bottom level offset of smoothing zone" VALUE 0x67d0a _REC_VAL_20_s2 2047.96875 _CNV_A_R_LINEAR_____37_CM -1024. 1023.96875 FORMAT "%7.1" /end CHARACTERISTIC
/begin CHARACTERISTIC C_TQ_DIF_2 "Torque threshold 2 for top level offset of smoothing zone" VALUE 0x67d0c _REC_VAL_20_s2 2047.96875 _CNV_A_R_LINEAR_____37_CM -1024. 1023.96875 FORMAT "%7.1" /end CHARACTERISTIC
/begin CHARACTERISTIC C_TQ_DIF_HYS_1 "Torque hysteresis 1 for bottom level offset of smoothing zone" VALUE 0x67d0e _REC_VAL_20_s2 2047.96875 _CNV_A_R_LINEAR_____37_CM -1024. 1023.96875 FORMAT "%7.1" /end CHARACTERISTIC
/begin CHARACTERISTIC C_TQ_DIF_HYS_2 "Torque hysteresis 2 for top level offset of smoothing zone" VALUE 0x67d10 _REC_VAL_20_s2 2047.96875 _CNV_A_R_LINEAR_____37_CM -1024. 1023.96875 FORMAT "%7.1" /end CHARACTERISTIC
/begin CHARACTERISTIC C_TQ_DIF_HYS_IS_1 "Torque hysteresis 1 for bottom level offset of smoothing zone during idle speed control " VALUE 0x67d12 _REC_VAL_20_s2 2047.96875 _CNV_A_R_LINEAR_____37_CM -1024. 1023.96875 FORMAT "%7.1" /end CHARACTERISTIC
/begin CHARACTERISTIC C_TQ_DIF_HYS_IS_2 "Torque hysteresis 2 for top level offset of smoothing zone during idle speed control" VALUE 0x67d14 _REC_VAL_20_s2 2047.96875 _CNV_A_R_LINEAR_____37_CM -1024. 1023.96875 FORMAT "%7.1" /end CHARACTERISTIC
/begin CHARACTERISTIC C_TQ_DIF_IS_1 "Torque threshold 1 for bottom level offset of smoothing zone during idle speed control" VALUE 0x67d16 _REC_VAL_20_s2 2047.96875 _CNV_A_R_LINEAR_____37_CM -1024. 1023.96875 FORMAT "%7.1" /end CHARACTERISTIC
/begin CHARACTERISTIC C_TQ_DIF_IS_2 "Torque threshold 2 for top level offset of smoothing zone during idle speed control" VALUE 0x67d18 _REC_VAL_20_s2 2047.96875 _CNV_A_R_LINEAR_____37_CM -1024. 1023.96875 FORMAT "%7.1" /end CHARACTERISTIC
/begin CHARACTERISTIC C_TQ_TRA_THD_DOWN_1 "Torque threshold 1 for decreasing torque" VALUE 0x67d34 _REC_VAL_20_s2 2047.96875 _CNV_A_R_LINEAR_____37_CM -1024. 1023.96875 FORMAT "%7.1" /end CHARACTERISTIC
/begin CHARACTERISTIC C_TQ_TRA_THD_DOWN_2 "Torque threshold 2 for decreasing torque" VALUE 0x67d36 _REC_VAL_20_s2 2047.96875 _CNV_A_R_LINEAR_____37_CM -1024. 1023.96875 FORMAT "%7.1" /end CHARACTERISTIC
/begin CHARACTERISTIC C_TQ_TRA_THD_UP_1 "Torque threshold 1 for increasing torque" VALUE 0x67d38 _REC_VAL_20_s2 2047.96875 _CNV_A_R_LINEAR_____37_CM -1024. 1023.96875 FORMAT "%7.1" /end CHARACTERISTIC
/begin CHARACTERISTIC C_TQ_TRA_THD_UP_2 "Torque threshold 2 for increasing torque" VALUE 0x67d3a _REC_VAL_20_s2 2047.96875 _CNV_A_R_LINEAR_____37_CM -1024. 1023.96875 FORMAT "%7.1" /end CHARACTERISTIC
/begin CHARACTERISTIC C_TQFR_DEC_ST "Decrement for start correction of friction torque" VALUE 0x67d3c _REC_VAL_20_s2 1024. _CNV_A_R_LINEAR_____37_CM -1024. 0. FORMAT "%6.2" /end CHARACTERISTIC
/begin CHARACTERISTIC C_TQI_BOL_SET_HYS "Hysteresis for recognition bottom level indicated engine torque" VALUE 0x67d3e _REC_VAL_20_u2 1023.96875 _CNV_A_R_LINEAR_____37_CM 0. 1023.96875 FORMAT "%7.2" /end CHARACTERISTIC
/begin CHARACTERISTIC C_TQI_FAC_FL "Full load correction " VALUE 0x67d40 _REC_VAL_20_u2 1.99996948 _CNV_A_R_LINEAR_____5_CM 0. 1.99996948 FORMAT "%7.5" /end CHARACTERISTIC
/begin CHARACTERISTIC C_TQI_SP_MAN "Manual torque setpoint request by application tool" VALUE 0x67d46 _REC_VAL_20_s2 2047.96875 _CNV_A_R_LINEAR_____37_CM -1024. 1023.96875 FORMAT "%7.1" /end CHARACTERISTIC
/begin CHARACTERISTIC LC_AJ_DEACC "Logical constant for AJ trigger at deacceleration" VALUE 0x67d80 _REC_VAL_20_u1 1. _CNV_A_R_LINEAR_____13_CM 0. 1. FORMAT "%1.0" /end CHARACTERISTIC
/begin CHARACTERISTIC LC_TQ_TRA_INH "Logical parameter inhibition torque transient (0 ... torque transient active, 1... torque transient passive)" VALUE 0x67d91 _REC_VAL_20_u1 1. _CNV_A_R_LINEAR_____13_CM 0. 1. FORMAT "%1.0" /end CHARACTERISTIC
/begin MEASUREMENT N "engine speed with a resolution of 1rpm" UWORD _CNV_A_R_LINEAR_____0_CM 1 100. 0. 8160. ECU_ADDRESS 0x3fcdd6 FORMAT "%4.0" /end MEASUREMENT
/begin MEASUREMENT N_32 "engine speed with a resolution of 32rpm" UBYTE _CNV_A_R_LINEAR_____15_CM 1 100. 0. 8160. ECU_ADDRESS 0x3fd943 FORMAT "%4.0" /end MEASUREMENT
/begin MEASUREMENT N_VS_RATIO "Engine speed / vehicle speed ratio" UBYTE _CNV_A_R_LINEAR_____45_CM 1 100. 0. 255. ECU_ADDRESS 0x3fd7fb FORMAT "%3.0" /end MEASUREMENT
/begin AXIS_PTS ldp_fac_tq_req_clu__tq_add_ch "" 0x614e8 FAC_TQ_REQ_CLU _REC_AXS_20_u2 1.99996948 _CNV_A_R_LINEAR_____5_CM 8 0. 1.99996948 FORMAT "%7.5" /end AXIS_PTS
/begin AXIS_PTS ldp_n_32__tq_add_ch_is "" 0x6166d N_32 _REC_AXS_20_u1 8160. _CNV_A_R_LINEAR_____15_CM 8 0. 8160. FORMAT "%4.0" /end AXIS_PTS
/begin AXIS_PTS ldp_n_ratio_conv_fac_tq_conv "" 0x61797 N_RATIO_CONV _REC_AXS_20_u1 0.9960940000000002 _CNV_A_R_LINEAR_____8_CM 8 0. 0.996094 FORMAT "%5.3" /end AXIS_PTS
/begin AXIS_PTS ldp_n_tq_add_st "" 0x617c4 N_32 _REC_AXS_20_u1 8160. _CNV_A_R_LINEAR_____15_CM 8 0. 8160. FORMAT "%4.0" /end AXIS_PTS
/begin AXIS_PTS ldp_n_tq_add_tra "" 0x617cd N_32 _REC_AXS_20_u1 8160. _CNV_A_R_LINEAR_____15_CM 8 0. 8160. FORMAT "%4.0" /end AXIS_PTS
/begin AXIS_PTS ldp_t_ast__fac_tq_add_ch "" 0x61824 T_AST _REC_AXS_20_u2 6553.5 _CNV_A_R_LINEAR_____18_CM 8 0. 6553.5 FORMAT "%5.1" /end AXIS_PTS
/begin AXIS_PTS ldp_tco__fac_tq_add_ch "" 0x61866 TCO _REC_AXS_20_u1 190.5 _CNV_A_R_LINEAR_____22_CM 8 -48. 142.5 FORMAT "%5.1" /end AXIS_PTS
/begin AXIS_PTS ldp_tco__fac_tq_add_ch_is "" 0x6186f TCO _REC_AXS_20_u1 190.5 _CNV_A_R_LINEAR_____22_CM 8 -48. 142.5 FORMAT "%5.1" /end AXIS_PTS
/begin AXIS_PTS ldp_tco_st_tqfr_st "" 0x61910 TCO_ST _REC_AXS_20_u1 190.5 _CNV_A_R_LINEAR_____22_CM 4 -48. 142.5 FORMAT "%5.1" /end AXIS_PTS
/begin AXIS_PTS ldp_toil_fac_conv "" 0x61939 TOIL _REC_AXS_20_u1 200. _CNV_A_R_LINEAR_____32_CM 8 -40. 160. FORMAT "%3.0" /end AXIS_PTS
/begin AXIS_PTS ldp_toil_t_dly_conv "" 0x61942 TOIL _REC_AXS_20_u1 200. _CNV_A_R_LINEAR_____32_CM 8 -40. 160. FORMAT "%3.0" /end AXIS_PTS
/begin AXIS_PTS ldp_toil_t_dly_n_sp_is "" 0x6194b TOIL _REC_AXS_20_u1 200. _CNV_A_R_LINEAR_____32_CM 8 -40. 160. FORMAT "%3.0" /end AXIS_PTS
/begin AXIS_PTS ldp_toil_t_ramp_conv_neg "" 0x61954 TOIL _REC_AXS_20_u1 200. _CNV_A_R_LINEAR_____32_CM 8 -40. 160. FORMAT "%3.0" /end AXIS_PTS
/begin AXIS_PTS ldp_toil_t_ramp_conv_pos "" 0x6195d TOIL _REC_AXS_20_u1 200. _CNV_A_R_LINEAR_____32_CM 8 -40. 160. FORMAT "%3.0" /end AXIS_PTS
/begin AXIS_PTS ldp_toil_tqfr_add "" 0x61966 TOIL _REC_AXS_20_u1 200. _CNV_A_R_LINEAR_____32_CM 8 -40. 160. FORMAT "%3.0" /end AXIS_PTS
/begin AXIS_PTS ldp_v_amp__amp_raw "" 0x61a32 V_AMP _REC_AXS_20_u2 4.99511719 _CNV_A_R_LINEAR_____38_CM 8 0. 4.99511719 FORMAT "%5.3" /end AXIS_PTS
/begin AXIS_PTS ldp_v_toil__toil "" 0x61a99 V_TOIL _REC_AXS_20_u1 4.98046875 _CNV_A_R_LINEAR_____40_CM 16 0. 4.98046875 FORMAT "%5.3" /end AXIS_PTS
/begin AXIS_PTS ldp_vs__amp_raw_cor "" 0x61ac5 VS _REC_AXS_20_u1 255. _CNV_A_R_LINEAR_____43_CM 8 0. 255. FORMAT "%3.0" /end AXIS_PTS
/begin AXIS_PTS ldpm_gr_at_100 "" 0x61af6 GR_AT _REC_AXS_20_u1 255. _CNV_A_R_LINEAR_____13_CM 13 0. 255. FORMAT "%3.0" /end AXIS_PTS
/begin AXIS_PTS ldpm_gr_at_2 "" 0x61b04 GR_AT _REC_AXS_20_u1 255. _CNV_A_R_LINEAR_____13_CM 13 0. 255. FORMAT "%3.0" /end AXIS_PTS
/begin AXIS_PTS ldpm_gr_mt_100 "" 0x61b20 GR_MT _REC_AXS_20_u1 255. _CNV_A_R_LINEAR_____13_CM 13 0. 255. FORMAT "%3.0" /end AXIS_PTS
/begin AXIS_PTS ldpm_gr_mt_2 "" 0x61b2e GR_MT _REC_AXS_20_u1 255. _CNV_A_R_LINEAR_____13_CM 13 0. 255. FORMAT "%3.0" /end AXIS_PTS
/begin AXIS_PTS ldpm_maf_100 "" 0x61b4a MAF _REC_AXS_20_u2 1389. _CNV_A_R_LINEAR_____56_CM 12 0. 1389. FORMAT "%4.0" /end AXIS_PTS
/begin AXIS_PTS ldpm_n_110 "" 0x61bc3 N_32 _REC_AXS_20_u1 8160. _CNV_A_R_LINEAR_____15_CM 8 0. 8160. FORMAT "%4.0" /end AXIS_PTS
/begin CHARACTERISTIC ID_FAC_INV_VEH_MASS_AT "Inverse vehicle mass equivalent for automatic transmission" CURVE 0x65030 _REC_CUR_20_u2_u1 0.99998474 _CNV_A_R_LINEAR_____57_CM 0. 0.99998474 FORMAT "%6.4"
 /begin AXIS_DESCR COM_AXIS GR_AT _CNV_A_R_LINEAR_____13_CM 13 0. 255. FORMAT "%3.0" AXIS_PTS_REF ldpm_gr_at_100 /end AXIS_DESCR
/end CHARACTERISTIC
/begin CHARACTERISTIC ID_FAC_INV_VEH_MASS_MT "Inverse vehicle mass equivalent for manual transmission" CURVE 0x6504a _REC_CUR_20_u2_u1 0.99998474 _CNV_A_R_LINEAR_____57_CM 0. 0.99998474 FORMAT "%6.4"
 /begin AXIS_DESCR COM_AXIS GR_MT _CNV_A_R_LINEAR_____13_CM 13 0. 255. FORMAT "%3.0" AXIS_PTS_REF ldpm_gr_mt_100 /end AXIS_DESCR
/end CHARACTERISTIC
/begin CHARACTERISTIC ID_FAC_TQ_DE_AJ_AT "Torque deviation compensation factor for AJ  N_DIF_REF determination" CURVE 0x651fe _REC_CUR_20_u2_u1 7.99987793 _CNV_A_R_LINEAR_____58_CM 0. 7.99987793 FORMAT "%6.4"
 /begin AXIS_DESCR COM_AXIS GR_AT _CNV_A_R_LINEAR_____13_CM 13 0. 255. FORMAT "%3.0" AXIS_PTS_REF ldpm_gr_at_100 /end AXIS_DESCR
/end CHARACTERISTIC
/begin CHARACTERISTIC ID_FAC_TQ_DE_AJ_MT "Engine speed difference threshold for acitvation anti jerk function" CURVE 0x65218 _REC_CUR_20_u2_u1 7.99987793 _CNV_A_R_LINEAR_____58_CM 0. 7.99987793 FORMAT "%6.4"
 /begin AXIS_DESCR COM_AXIS GR_MT _CNV_A_R_LINEAR_____13_CM 13 0. 255. FORMAT "%3.0" AXIS_PTS_REF ldpm_gr_mt_100 /end AXIS_DESCR
/end CHARACTERISTIC
/begin CHARACTERISTIC ID_GR_MT "Index table for Gear Ratio detection" CURVE 0x653ca _REC_CUR_20_u1_u1 255. _CNV_A_R_LINEAR_____13_CM 0. 255. FORMAT "%3.0"
 /begin AXIS_DESCR COM_AXIS N_VS_RATIO _CNV_A_R_LINEAR_____13_CM 13 0. 255. FORMAT "%3.0" AXIS_PTS_REF ldp_n_vs_ratio_gr_mt /end AXIS_DESCR
/end CHARACTERISTIC
/begin CHARACTERISTIC IP_AMP_RAW "correlation table for the linearization of the ambient pressure value acquisition" CURVE 0x659f4 _REC_CUR_20_u2_u2 5434. _CNV_A_R_LINEAR_____1_CM 0. 5434. FORMAT "%7.2"
 /begin AXIS_DESCR COM_AXIS V_AMP _CNV_A_R_LINEAR_____38_CM 8 0. 4.99511719 FORMAT "%5.3" AXIS_PTS_REF ldp_v_amp__amp_raw /end AXIS_DESCR
/end CHARACTERISTIC
/begin CHARACTERISTIC IP_AMP_RAW_COR__VS "correlation table for the linearization of the ambient pressure with the vehicle speed" CURVE 0x65a04 _REC_CUR_20_u2_u1 5434. _CNV_A_R_LINEAR_____1_CM 0. 5434. FORMAT "%7.2"
 /begin AXIS_DESCR COM_AXIS VS _CNV_A_R_LINEAR_____43_CM 8 0. 255. FORMAT "%3.0" AXIS_PTS_REF ldp_vs__amp_raw_cor /end AXIS_DESCR
/end CHARACTERISTIC
/begin CHARACTERISTIC IP_FAC_TQ_ADD_CH "coolant temperature and time after start depending correction TQ_ADD_CH" MAP 0x65c50 _REC_MAP_20_u1_u2_u1 0.9960940000000002 _CNV_A_R_LINEAR_____8_CM 0. 0.996094 FORMAT "%5.3"
 /begin AXIS_DESCR COM_AXIS T_AST _CNV_A_R_LINEAR_____18_CM 8 0. 6553.5 FORMAT "%5.1" AXIS_PTS_REF ldp_t_ast__fac_tq_add_ch /end AXIS_DESCR
 /begin AXIS_DESCR COM_AXIS TCO _CNV_A_R_LINEAR_____22_CM 8 -48. 142.5 FORMAT "%5.1" AXIS_PTS_REF ldp_tco__fac_tq_add_ch /end AXIS_DESCR
/end CHARACTERISTIC
/begin CHARACTERISTIC IP_FAC_TQ_ADD_CH_IS "coolant temperature and time after start depending correction TQ_ADD_CH" CURVE 0x65c90 _REC_CUR_20_u1_u1 0.9960940000000002 _CNV_A_R_LINEAR_____8_CM 0. 0.996094 FORMAT "%5.3"
 /begin AXIS_DESCR COM_AXIS TCO _CNV_A_R_LINEAR_____22_CM 8 -48. 142.5 FORMAT "%5.1" AXIS_PTS_REF ldp_tco__fac_tq_add_ch_is /end AXIS_DESCR
/end CHARACTERISTIC
/begin CHARACTERISTIC IP_N_TUR__GR_AT__VS "Turbine speed" MAP 0x66a32 _REC_MAP_20_u2_u1_u1 65535. _CNV_A_R_LINEAR_____0_CM 0. 65535. FORMAT "%5.0"
 /begin AXIS_DESCR COM_AXIS GR_AT _CNV_A_R_LINEAR_____17_CM 13 0. 8. FORMAT "%1.0" AXIS_PTS_REF ldp_gr_at_n_tur /end AXIS_DESCR
 /begin AXIS_DESCR COM_AXIS VS _CNV_A_R_LINEAR_____43_CM 2 0. 255. FORMAT "%3.0" AXIS_PTS_REF ldp_vs_n_tur /end AXIS_DESCR
/end CHARACTERISTIC
/begin CHARACTERISTIC IP_T_DEC_TRA_1_MT "Time constant for torque decrease 1 for manual transmission" MAP 0x66c52 _REC_MAP_20_u1_u1_u1 2.55 _CNV_A_R_LINEAR_____21_CM 0. 2.55 FORMAT "%3.2"
 /begin AXIS_DESCR COM_AXIS N_32 _CNV_A_R_LINEAR_____15_CM 8 0. 8160. FORMAT "%4.0" AXIS_PTS_REF ldpm_n_110 /end AXIS_DESCR
 /begin AXIS_DESCR COM_AXIS GR_MT _CNV_A_R_LINEAR_____13_CM 13 0. 255. FORMAT "%3.0" AXIS_PTS_REF ldpm_gr_mt_2 /end AXIS_DESCR
/end CHARACTERISTIC
/begin CHARACTERISTIC IP_T_DEC_TRA_2_AT "Time constant for torque decrease 2 for automatic transmission" MAP 0x66cba _REC_MAP_20_u1_u1_u1 2.55 _CNV_A_R_LINEAR_____21_CM 0. 2.55 FORMAT "%3.2"
 /begin AXIS_DESCR COM_AXIS N_32 _CNV_A_R_LINEAR_____15_CM 8 0. 8160. FORMAT "%4.0" AXIS_PTS_REF ldpm_n_110 /end AXIS_DESCR
 /begin AXIS_DESCR COM_AXIS GR_AT _CNV_A_R_LINEAR_____13_CM 13 0. 255. FORMAT "%3.0" AXIS_PTS_REF ldpm_gr_at_2 /end AXIS_DESCR
/end CHARACTERISTIC
/begin CHARACTERISTIC IP_T_DEC_TRA_2_MT "Time constant for torque decrease 2 for manual transmission" MAP 0x66d22 _REC_MAP_20_u1_u1_u1 2.55 _CNV_A_R_LINEAR_____21_CM 0. 2.55 FORMAT "%3.2"
 /begin AXIS_DESCR COM_AXIS N_32 _CNV_A_R_LINEAR_____15_CM 8 0. 8160. FORMAT "%4.0" AXIS_PTS_REF ldpm_n_110 /end AXIS_DESCR
 /begin AXIS_DESCR COM_AXIS GR_MT _CNV_A_R_LINEAR_____13_CM 13 0. 255. FORMAT "%3.0" AXIS_PTS_REF ldpm_gr_mt_2 /end AXIS_DESCR
/end CHARACTERISTIC
/begin CHARACTERISTIC IP_T_DEC_TRA_3_AT "Time constant for torque decrease 3 for automatic transmission" MAP 0x66d8a _REC_MAP_20_u1_u1_u1 2.55 _CNV_A_R_LINEAR_____21_CM 0. 2.55 FORMAT "%3.2"
 /begin AXIS_DESCR COM_AXIS N_32 _CNV_A_R_LINEAR_____15_CM 8 0. 8160. FORMAT "%4.0" AXIS_PTS_REF ldpm_n_110 /end AXIS_DESCR
 /begin AXIS_DESCR COM_AXIS GR_AT _CNV_A_R_LINEAR_____13_CM 13 0. 255. FORMAT "%3.0" AXIS_PTS_REF ldpm_gr_at_2 /end AXIS_DESCR
/end CHARACTERISTIC
/begin CHARACTERISTIC IP_T_DEC_TRA_3_MT "Time constant for torque decrease 3 for manual transmission" MAP 0x66df2 _REC_MAP_20_u1_u1_u1 2.55 _CNV_A_R_LINEAR_____21_CM 0. 2.55 FORMAT "%3.2"
 /begin AXIS_DESCR COM_AXIS N_32 _CNV_A_R_LINEAR_____15_CM 8 0. 8160. FORMAT "%4.0" AXIS_PTS_REF ldpm_n_110 /end AXIS_DESCR
 /begin AXIS_DESCR COM_AXIS GR_MT _CNV_A_R_LINEAR_____13_CM 13 0. 255. FORMAT "%3.0" AXIS_PTS_REF ldpm_gr_mt_2 /end AXIS_DESCR
/end CHARACTERISTIC
/begin CHARACTERISTIC IP_T_DEC_TRA_IS_AT "Time constant for torque decrease at idle for automatic transmission" MAP 0x66e5a _REC_MAP_20_u1_u1_u1 2.55 _CNV_A_R_LINEAR_____21_CM 0. 2.55 FORMAT "%3.2"
 /begin AXIS_DESCR COM_AXIS N_32 _CNV_A_R_LINEAR_____15_CM 8 0. 8160. FORMAT "%4.0" AXIS_PTS_REF ldpm_n_110 /end AXIS_DESCR
 /begin AXIS_DESCR COM_AXIS GR_AT _CNV_A_R_LINEAR_____13_CM 13 0. 255. FORMAT "%3.0" AXIS_PTS_REF ldpm_gr_at_2 /end AXIS_DESCR
/end CHARACTERISTIC
/begin CHARACTERISTIC IP_T_DEC_TRA_IS_MT "Time constant for torque decrease at idle for manual transmission" MAP 0x66ec2 _REC_MAP_20_u1_u1_u1 2.55 _CNV_A_R_LINEAR_____21_CM 0. 2.55 FORMAT "%3.2"
 /begin AXIS_DESCR COM_AXIS N_32 _CNV_A_R_LINEAR_____15_CM 8 0. 8160. FORMAT "%4.0" AXIS_PTS_REF ldpm_n_110 /end AXIS_DESCR
 /begin AXIS_DESCR COM_AXIS GR_MT _CNV_A_R_LINEAR_____13_CM 13 0. 255. FORMAT "%3.0" AXIS_PTS_REF ldpm_gr_mt_2 /end AXIS_DESCR
/end CHARACTERISTIC
/begin CHARACTERISTIC IP_T_DLY_CONV__TOIL "Time delay for TQ_CONV activation" CURVE 0x66f2a _REC_CUR_20_u1_u1 2550. _CNV_A_R_LINEAR_____3_CM 0. 2550. FORMAT "%4.0"
 /begin AXIS_DESCR COM_AXIS TOIL _CNV_A_R_LINEAR_____32_CM 8 -40. 160. FORMAT "%3.0" AXIS_PTS_REF ldp_toil_t_dly_conv /end AXIS_DESCR
/end CHARACTERISTIC
/begin CHARACTERISTIC IP_T_DLY_N_SP_IS__TOIL "Time delay for change of idle speed setpoint " CURVE 0x66f32 _REC_CUR_20_u1_u1 2550. _CNV_A_R_LINEAR_____3_CM 0. 2550. FORMAT "%4.0"
 /begin AXIS_DESCR COM_AXIS TOIL _CNV_A_R_LINEAR_____32_CM 8 -40. 160. FORMAT "%3.0" AXIS_PTS_REF ldp_toil_t_dly_n_sp_is /end AXIS_DESCR
/end CHARACTERISTIC
/begin CHARACTERISTIC IP_T_INC_TRA_1_AT "Time constant for torque increase 1 for automatic transmission" MAP 0x66f3a _REC_MAP_20_u1_u1_u1 2.55 _CNV_A_R_LINEAR_____21_CM 0. 2.55 FORMAT "%3.2"
 /begin AXIS_DESCR COM_AXIS N_32 _CNV_A_R_LINEAR_____15_CM 8 0. 8160. FORMAT "%4.0" AXIS_PTS_REF ldpm_n_110 /end AXIS_DESCR
 /begin AXIS_DESCR COM_AXIS GR_AT _CNV_A_R_LINEAR_____13_CM 13 0. 255. FORMAT "%3.0" AXIS_PTS_REF ldpm_gr_at_2 /end AXIS_DESCR
/end CHARACTERISTIC
/begin CHARACTERISTIC IP_T_INC_TRA_1_MT "Time constant for torque increase 1 for manual transmission" MAP 0x66fa2 _REC_MAP_20_u1_u1_u1 2.55 _CNV_A_R_LINEAR_____21_CM 0. 2.55 FORMAT "%3.2"
 /begin AXIS_DESCR COM_AXIS N_32 _CNV_A_R_LINEAR_____15_CM 8 0. 8160. FORMAT "%4.0" AXIS_PTS_REF ldpm_n_110 /end AXIS_DESCR
 /begin AXIS_DESCR COM_AXIS GR_MT _CNV_A_R_LINEAR_____13_CM 13 0. 255. FORMAT "%3.0" AXIS_PTS_REF ldpm_gr_mt_2 /end AXIS_DESCR
/end CHARACTERISTIC
/begin CHARACTERISTIC IP_T_INC_TRA_2_AT "Time constant for torque increase 2 for automatic transmission" MAP 0x6700a _REC_MAP_20_u1_u1_u1 2.55 _CNV_A_R_LINEAR_____21_CM 0. 2.55 FORMAT "%3.2"
 /begin AXIS_DESCR COM_AXIS N_32 _CNV_A_R_LINEAR_____15_CM 8 0. 8160. FORMAT "%4.0" AXIS_PTS_REF ldpm_n_110 /end AXIS_DESCR
 /begin AXIS_DESCR COM_AXIS GR_AT _CNV_A_R_LINEAR_____13_CM 13 0. 255. FORMAT "%3.0" AXIS_PTS_REF ldpm_gr_at_2 /end AXIS_DESCR
/end CHARACTERISTIC
/begin CHARACTERISTIC IP_T_INC_TRA_2_MT "Time constant for torque increase 2 for manual transmission" MAP 0x67072 _REC_MAP_20_u1_u1_u1 2.55 _CNV_A_R_LINEAR_____21_CM 0. 2.55 FORMAT "%3.2"
 /begin AXIS_DESCR COM_AXIS N_32 _CNV_A_R_LINEAR_____15_CM 8 0. 8160. FORMAT "%4.0" AXIS_PTS_REF ldpm_n_110 /end AXIS_DESCR
 /begin AXIS_DESCR COM_AXIS GR_MT _CNV_A_R_LINEAR_____13_CM 13 0. 255. FORMAT "%3.0" AXIS_PTS_REF ldpm_gr_mt_2 /end AXIS_DESCR
/end CHARACTERISTIC
/begin CHARACTERISTIC IP_T_INC_TRA_3_AT "Time constant for torque increase 3 for automatic transmission" MAP 0x670da _REC_MAP_20_u1_u1_u1 2.55 _CNV_A_R_LINEAR_____21_CM 0. 2.55 FORMAT "%3.2"
 /begin AXIS_DESCR COM_AXIS N_32 _CNV_A_R_LINEAR_____15_CM 8 0. 8160. FORMAT "%4.0" AXIS_PTS_REF ldpm_n_110 /end AXIS_DESCR
 /begin AXIS_DESCR COM_AXIS GR_AT _CNV_A_R_LINEAR_____13_CM 13 0. 255. FORMAT "%3.0" AXIS_PTS_REF ldpm_gr_at_2 /end AXIS_DESCR
/end CHARACTERISTIC
/begin CHARACTERISTIC IP_T_INC_TRA_3_MT "Time constant for torque increase 3 for manual transmission" MAP 0x67142 _REC_MAP_20_u1_u1_u1 2.55 _CNV_A_R_LINEAR_____21_CM 0. 2.55 FORMAT "%3.2"
 /begin AXIS_DESCR COM_AXIS N_32 _CNV_A_R_LINEAR_____15_CM 8 0. 8160. FORMAT "%4.0" AXIS_PTS_REF ldpm_n_110 /end AXIS_DESCR
 /begin AXIS_DESCR COM_AXIS GR_MT _CNV_A_R_LINEAR_____13_CM 13 0. 255. FORMAT "%3.0" AXIS_PTS_REF ldpm_gr_mt_2 /end AXIS_DESCR
/end CHARACTERISTIC
/begin CHARACTERISTIC IP_T_INC_TRA_IS_AT "Time constant for torque increase at idle for automatic transmission" MAP 0x671aa _REC_MAP_20_u1_u1_u1 2.55 _CNV_A_R_LINEAR_____21_CM 0. 2.55 FORMAT "%3.2"
 /begin AXIS_DESCR COM_AXIS N_32 _CNV_A_R_LINEAR_____15_CM 8 0. 8160. FORMAT "%4.0" AXIS_PTS_REF ldpm_n_110 /end AXIS_DESCR
 /begin AXIS_DESCR COM_AXIS GR_AT _CNV_A_R_LINEAR_____13_CM 13 0. 255. FORMAT "%3.0" AXIS_PTS_REF ldpm_gr_at_2 /end AXIS_DESCR
/end CHARACTERISTIC
/begin CHARACTERISTIC IP_T_INC_TRA_IS_MT "Time constant for torque increase at idle for manual transmission" MAP 0x67212 _REC_MAP_20_u1_u1_u1 2.55 _CNV_A_R_LINEAR_____21_CM 0. 2.55 FORMAT "%3.2"
 /begin AXIS_DESCR COM_AXIS N_32 _CNV_A_R_LINEAR_____15_CM 8 0. 8160. FORMAT "%4.0" AXIS_PTS_REF ldpm_n_110 /end AXIS_DESCR
 /begin AXIS_DESCR COM_AXIS GR_MT _CNV_A_R_LINEAR_____13_CM 13 0. 255. FORMAT "%3.0" AXIS_PTS_REF ldpm_gr_mt_2 /end AXIS_DESCR
/end CHARACTERISTIC
/begin CHARACTERISTIC IP_T_RAMP_CONV_NEG__TOIL "Ramp after shift disengaging" CURVE 0x67282 _REC_CUR_20_u1_u1 2550. _CNV_A_R_LINEAR_____3_CM 0. 2550. FORMAT "%4.0"
 /begin AXIS_DESCR COM_AXIS TOIL _CNV_A_R_LINEAR_____32_CM 8 -40. 160. FORMAT "%3.0" AXIS_PTS_REF ldp_toil_t_ramp_conv_neg /end AXIS_DESCR
/end CHARACTERISTIC
/begin CHARACTERISTIC IP_T_RAMP_CONV_POS__TOIL "Ramp after shift engaging" CURVE 0x6728a _REC_CUR_20_u1_u1 2550. _CNV_A_R_LINEAR_____3_CM 0. 2550. FORMAT "%4.0"
 /begin AXIS_DESCR COM_AXIS TOIL _CNV_A_R_LINEAR_____32_CM 8 -40. 160. FORMAT "%3.0" AXIS_PTS_REF ldp_toil_t_ramp_conv_pos /end AXIS_DESCR
/end CHARACTERISTIC
/begin CHARACTERISTIC IP_TOIL "Conversion table for linearization of TOIL value acquisition" CURVE 0x6764e _REC_CUR_20_u1_u1 200. _CNV_A_R_LINEAR_____32_CM -40. 160. FORMAT "%3.0"
 /begin AXIS_DESCR COM_AXIS V_TOIL _CNV_A_R_LINEAR_____40_CM 16 0. 4.98046875 FORMAT "%5.3" AXIS_PTS_REF ldp_v_toil__toil /end AXIS_DESCR
/end CHARACTERISTIC
/begin CHARACTERISTIC IP_TQ_ADD_CH_IS "coolant temperature and time after start depending correction TQ_ADD_CH" CURVE 0x676de _REC_CUR_20_u2_u1 2047.96875 _CNV_A_R_LINEAR_____65_CM -1024. 1023.96875 FORMAT "%6.2"
 /begin AXIS_DESCR COM_AXIS N_32 _CNV_A_R_LINEAR_____15_CM 8 0. 8160. FORMAT "%4.0" AXIS_PTS_REF ldp_n_32__tq_add_ch_is /end AXIS_DESCR
/end CHARACTERISTIC
/begin CHARACTERISTIC IP_TQ_ADD_ST__N "Torque lead at engine start" CURVE 0x676fa _REC_CUR_20_u2_u1 2047.96875 _CNV_A_R_LINEAR_____65_CM -1024. 1023.96875 FORMAT "%6.2"
 /begin AXIS_DESCR COM_AXIS N_32 _CNV_A_R_LINEAR_____15_CM 8 0. 8160. FORMAT "%4.0" AXIS_PTS_REF ldp_n_tq_add_st /end AXIS_DESCR
/end CHARACTERISTIC
/begin CHARACTERISTIC IP_TQ_ADD_TRA__N "Torque lead at transient torque conditions" CURVE 0x6770a _REC_CUR_20_u2_u1 1023.96875 _CNV_A_R_LINEAR_____37_CM 0. 1023.96875 FORMAT "%7.2"
 /begin AXIS_DESCR COM_AXIS N_32 _CNV_A_R_LINEAR_____15_CM 8 0. 8160. FORMAT "%4.0" AXIS_PTS_REF ldp_n_tq_add_tra /end AXIS_DESCR
/end CHARACTERISTIC
/begin CHARACTERISTIC IP_TQFR "Base friction torque and pumping losses" MAP 0x6784a _REC_MAP_20_u2_u1_u2 1024. _CNV_A_R_LINEAR_____65_CM -1024. 0. FORMAT "%6.2"
 /begin AXIS_DESCR COM_AXIS N_32 _CNV_A_R_LINEAR_____15_CM 16 0. 8160. FORMAT "%4.0" AXIS_PTS_REF ldpm_n_32_100 /end AXIS_DESCR
 /begin AXIS_DESCR COM_AXIS MAF _CNV_A_R_LINEAR_____56_CM 4 0. 1389. FORMAT "%7.2" AXIS_PTS_REF ldp_maf_cyl_stk__tqfr /end AXIS_DESCR
/end CHARACTERISTIC
/begin CHARACTERISTIC IP_TQFR_ADD "Coolant and oil temperature correction of friction  torque" MAP 0x678ca _REC_MAP_20_u2_u1_u1 2047.96875 _CNV_A_R_LINEAR_____65_CM -1024. 1023.96875 FORMAT "%6.2"
 /begin AXIS_DESCR COM_AXIS TCO _CNV_A_R_LINEAR_____22_CM 8 -48. 142.5 FORMAT "%5.1" AXIS_PTS_REF ldp_tco__tqfr_add /end AXIS_DESCR
 /begin AXIS_DESCR COM_AXIS TOIL _CNV_A_R_LINEAR_____32_CM 8 -40. 160. FORMAT "%3.0" AXIS_PTS_REF ldp_toil_tqfr_add /end AXIS_DESCR
/end CHARACTERISTIC
/begin CHARACTERISTIC IP_TQFR_ST "Friction torque increase after start" CURVE 0x6794a _REC_CUR_20_u2_u1 1024. _CNV_A_R_LINEAR_____65_CM -1024. 0. FORMAT "%6.2"
 /begin AXIS_DESCR COM_AXIS TCO_ST _CNV_A_R_LINEAR_____22_CM 4 -48. 142.5 FORMAT "%5.1" AXIS_PTS_REF ldp_tco_st_tqfr_st /end AXIS_DESCR
/end CHARACTERISTIC
/begin MEASUREMENT AMP_MES "valid ambient pressure" UWORD _CNV_A_R_LINEAR_____1_CM 1 100. 0. 5434. ECU_ADDRESS 0x3fc700 FORMAT "%7.2" /end MEASUREMENT
/begin MEASUREMENT FAC_AMP "factor of the ambient pressure related to the reference ambient pressure" UWORD _CNV_A_R_LINEAR_____5_CM 1 100. 0. 1.99996948 ECU_ADDRESS 0x3fc702 FORMAT "%7.5" /end MEASUREMENT
/begin MEASUREMENT FAC_TQ_REQ_DRIV "Scaling factor for requested torque at clutch from driver" UWORD _CNV_A_R_LINEAR_____5_CM 1 100. 0. 1.99996948 ECU_ADDRESS 0x3fd032 FORMAT "%7.5" /end MEASUREMENT
/begin MEASUREMENT LV_PAS_AJ "LV anti-jerk function passive" UBYTE _CNV_S_2_RANGE______74_CM 1 100. 0. 1. ECU_ADDRESS 0x3fd57c BIT_MASK 0x1 /end MEASUREMENT
/begin MEASUREMENT LV_TQ_ADD_REQ "Logical variable torque reserve request can be applied" UBYTE _CNV_S_2_RANGE______74_CM 1 100. 0. 1. ECU_ADDRESS 0x3fd576 /end MEASUREMENT
/begin MEASUREMENT LV_TQ_ADD_ST "Logical variable torque reserve at engine start" UBYTE _CNV_S_2_RANGE______74_CM 1 100. 0. 1. ECU_ADDRESS 0x3fd586 BIT_MASK 0x1 /end MEASUREMENT
/begin MEASUREMENT LV_TQ_FAST_ENA "???" UBYTE _CNV_S_2_RANGE______74_CM 1 100. 0. 1. ECU_ADDRESS 0x3fd55d BIT_MASK 0x1 /end MEASUREMENT
/begin MEASUREMENT LV_TQ_INTV "Logical variable fast torque intervention allowed" UBYTE _CNV_S_2_RANGE______74_CM 1 100. 0. 1. ECU_ADDRESS 0x3fd570 BIT_MASK 0x1 /end MEASUREMENT
/begin MEASUREMENT LV_TQ_INTV_REQ "Logical variable fast torque intervention requested" UBYTE _CNV_S_2_RANGE______74_CM 1 100. 0. 1. ECU_ADDRESS 0x3fd56f BIT_MASK 0x1 /end MEASUREMENT
/begin MEASUREMENT LV_TQ_MIN_CLU "Logical variable for coordination engine start torque and minimum torque and clutch" UBYTE _CNV_S_2_RANGE______74_CM 1 100. 0. 1. ECU_ADDRESS 0x3fd55b BIT_MASK 0x1 /end MEASUREMENT
/begin MEASUREMENT LV_TQ_TRA "Logical variable transient torque function acitve" UBYTE _CNV_S_2_RANGE______74_CM 1 100. 0. 1. ECU_ADDRESS 0x3fd573 BIT_MASK 0x1 /end MEASUREMENT
/begin MEASUREMENT LV_TQI_BOL_SET "Logical variable it is set if  TQI_SP  falls below TQI_BOL" UBYTE _CNV_S_2_RANGE______74_CM 1 100. 0. 1. ECU_ADDRESS 0x3fd571 BIT_MASK 0x1 /end MEASUREMENT
/begin MEASUREMENT MAF_MDL "Deviation of model air mass flow" UWORD _CNV_A_R_LINEAR_____52_CM 1 100. 0. 2047.96875 ECU_ADDRESS 0x3fcd58 FORMAT "%7.2" /end MEASUREMENT
/begin MEASUREMENT MAP_MDL "Deviation between measured and callculated manifold pressure" UWORD _CNV_A_R_LINEAR_____1_CM 1 100. 0. 5434. ECU_ADDRESS 0x3fcd5a FORMAT "%7.2" /end MEASUREMENT
/begin MEASUREMENT N_DIF_AJ "engine-speed deviation at jerking vehicle" SWORD _CNV_A_R_LINEAR_____0_CM 1 100. -32768. 32767. ECU_ADDRESS 0x3fd108 FORMAT "%6.0" /end MEASUREMENT
/begin MEASUREMENT N_DIF_REF_LPF_AJ "low-pass filtered N_DIF_REF_AJ for AJ function " SWORD _CNV_A_R_LINEAR_____0_CM 1 100. -32768. 32767. ECU_ADDRESS 0x3fd114 FORMAT "%6.0" /end MEASUREMENT
/begin MEASUREMENT TQ_ADD_CH "torque increase for load determination" SWORD _CNV_A_R_LINEAR_____37_CM 1 100. -1024. 1023.96875 ECU_ADDRESS 0x3fd11e FORMAT "%6.2" /end MEASUREMENT
/begin MEASUREMENT TQ_ADD_REQ "Requested torque reserve after max.coordination" SWORD _CNV_A_R_LINEAR_____37_CM 1 100. -1024. 1023.96875 ECU_ADDRESS 0x3fd0fe FORMAT "%6.2" /end MEASUREMENT
/begin MEASUREMENT TQ_ADD_ST "Torque reserve at engine start" SWORD _CNV_A_R_LINEAR_____37_CM 1 100. -1024. 1023.96875 ECU_ADDRESS 0x3fd144 FORMAT "%6.2" /end MEASUREMENT
/begin MEASUREMENT TQ_ADD_TRA "Torque lead for transient trorque" SWORD _CNV_A_R_LINEAR_____37_CM 1 100. -1024. 1023.96875 ECU_ADDRESS 0x3fd0d6 FORMAT "%6.2" /end MEASUREMENT
/begin MEASUREMENT TQ_ADD_TRA_1 "Torque lead output from map IP_TQ_ADD_TRA for transient torque" SWORD _CNV_A_R_LINEAR_____37_CM 1 100. -1024. 1023.96875 ECU_ADDRESS 0x3fd0de FORMAT "%6.2" /end MEASUREMENT
/begin MEASUREMENT TQ_DIF_AJ "Torque output for anti  jerk " SWORD _CNV_A_R_LINEAR_____37_CM 1 100. -1024. 1023.96875 ECU_ADDRESS 0x3fd106 FORMAT "%6.2" /end MEASUREMENT
/begin MEASUREMENT TQ_FAST_CLU "fast torque request at clutch" SWORD _CNV_A_R_LINEAR_____37_CM 1 100. -1024. 1023.96875 ECU_ADDRESS 0x3fd11a FORMAT "%6.2" /end MEASUREMENT
/begin MEASUREMENT TQ_LOSS_ACC "Engine torque losses air conditioning compressor" SWORD _CNV_A_R_LINEAR_____37_CM 1 100. -1024. 1023.96875 ECU_ADDRESS 0x3fd102 FORMAT "%6.2" /end MEASUREMENT
/begin MEASUREMENT TQ_LOSS_ECF "Engine torque losses electric cooling fan" SWORD _CNV_A_R_LINEAR_____37_CM 1 100. -1024. 1023.96875 ECU_ADDRESS 0x3fd07c FORMAT "%6.2" /end MEASUREMENT
/begin MEASUREMENT TQ_MDL_DE_AJ "torque deviation compensation for AJ" SWORD _CNV_A_R_LINEAR_____37_CM 1 100. -1024. 1023.96875 ECU_ADDRESS 0x3fd11c FORMAT "%6.2" /end MEASUREMENT
/begin MEASUREMENT TQ_RANGE "Range of TQ_REQ_TRA_CLU" ULONG _CNV_S_3_STATE_TQ_R_84_CM 1 100. 1. 3. ECU_ADDRESS 0x3fc1cc /end MEASUREMENT
/begin MEASUREMENT TQ_REQ_TRA_OLD_CLU "Old torque value at steady state conditions" SWORD _CNV_A_R_LINEAR_____37_CM 1 100. -1024. 1023.96875 ECU_ADDRESS 0x3fd0dc FORMAT "%6.2" /end MEASUREMENT
/begin MEASUREMENT TQ_REQ_TRA_STATE "State of torque transient phase" ULONG _CNV_S_3_STATE_TQ_R_85_CM 1 100. 0. 2. ECU_ADDRESS 0x3fc1c8 /end MEASUREMENT
/begin MEASUREMENT TQFR_ADD "Additive temperature correction of engine friction torque " SWORD _CNV_A_R_LINEAR_____37_CM 1 100. -1024. 1023.96875 ECU_ADDRESS 0x3fc22a FORMAT "%6.2" /end MEASUREMENT
/begin MEASUREMENT TQFR_ST "Additive start correction of engine friction torque" SWORD _CNV_A_R_LINEAR_____37_CM 1 100. -1024. 1023.96875 ECU_ADDRESS 0x3fc22c FORMAT "%6.2" /end MEASUREMENT
/begin MEASUREMENT TQI_ADD_MAX "Maximum possible indicated engine torque inclusive torque reserve" SWORD _CNV_A_R_LINEAR_____37_CM 1 100. -1024. 1023.96875 ECU_ADDRESS 0x3fd0e4 FORMAT "%6.2" /end MEASUREMENT
/begin MEASUREMENT TQI_BAS "Basic indicated engine torque" SWORD _CNV_A_R_LINEAR_____37_CM 1 100. -1024. 1023.96875 ECU_ADDRESS 0x3fd0ac FORMAT "%6.2" /end MEASUREMENT
/begin MEASUREMENT TQI_BAS_COR "Corrected indicated basic engine torque at active torque lead" SWORD _CNV_A_R_LINEAR_____37_CM 1 100. -1024. 1023.96875 ECU_ADDRESS 0x3fd090 FORMAT "%6.2" /end MEASUREMENT
/begin MEASUREMENT TQI_BOL "Indicated engine torque bottom level at minimum load and maximum spark retard for engine run free of misfire " SWORD _CNV_A_R_LINEAR_____37_CM 1 100. -1024. 1023.96875 ECU_ADDRESS 0x3fd0a6 FORMAT "%6.2" /end MEASUREMENT
/begin MEASUREMENT TQI_MIN_PU "Indicated engine torque minimum value at trailing throttle conditons" SWORD _CNV_A_R_LINEAR_____37_CM 1 100. -1024. 1023.96875 ECU_ADDRESS 0x3fd0a4 FORMAT "%6.2" /end MEASUREMENT
/begin MEASUREMENT TQI_P_MAX "???" SWORD _CNV_A_R_LINEAR_____37_CM 1 100. -1024. 1023.96875 ECU_ADDRESS 0x3fd058 FORMAT "%6.2" /end MEASUREMENT
/begin MEASUREMENT TQI_REF_IGA "Indicated engine torque corrected by EFF_IGA_BAS_COR" SWORD _CNV_A_R_LINEAR_____37_CM 1 100. -1024. 1023.96875 ECU_ADDRESS 0x3fd0b4 FORMAT "%6.2" /end MEASUREMENT
/begin MEASUREMENT TQI_REF_IGA_LAMB "Indicated engine torque corrected by EFF_IGA_BAS_COR and EFF_LAMB_BAS" SWORD _CNV_A_R_LINEAR_____37_CM 1 100. -1024. 1023.96875 ECU_ADDRESS 0x3fd0b2 FORMAT "%6.2" /end MEASUREMENT
/begin MEASUREMENT TQI_REF_IGA_MIN_LAMB "Indicated engine torque corrected by EFF_IGA_MIN and EFF_LAMB_BAS" SWORD _CNV_A_R_LINEAR_____37_CM 1 100. -1024. 1023.96875 ECU_ADDRESS 0x3fd0ba FORMAT "%6.2" /end MEASUREMENT
/begin MEASUREMENT TQI_REF_IGA_SCC "Indicated engine torque corrected by EFF_IGA_BAS_COR and EFF_SCC_BAS" SWORD _CNV_A_R_LINEAR_____37_CM 1 100. -1024. 1023.96875 ECU_ADDRESS 0x3fd0b8 FORMAT "%6.2" /end MEASUREMENT
/begin MEASUREMENT TQI_REF_LAMB "Indicated engine torque corrected by EFF_LAMB_BAS" SWORD _CNV_A_R_LINEAR_____37_CM 1 100. -1024. 1023.96875 ECU_ADDRESS 0x3fd0b0 FORMAT "%6.2" /end MEASUREMENT
/begin MEASUREMENT TQI_REF_LAMB_SCC "Indicated engine torque corrected by EFF_LAMB_BAS and EFF_SCC_BAS" SWORD _CNV_A_R_LINEAR_____37_CM 1 100. -1024. 1023.96875 ECU_ADDRESS 0x3fd0ae FORMAT "%6.2" /end MEASUREMENT
/begin MEASUREMENT TQI_REF_SCC "Indicated engine torque corrected by EFF_SCC_BAS" SWORD _CNV_A_R_LINEAR_____37_CM 1 100. -1024. 1023.96875 ECU_ADDRESS 0x3fd0b6 FORMAT "%6.2" /end MEASUREMENT
/begin MEASUREMENT TQI_REQ_TRA "Indicated torque request after transient torque function" SWORD _CNV_A_R_LINEAR_____37_CM 1 100. -1024. 1023.96875 ECU_ADDRESS 0x3fd0d2 FORMAT "%6.2" /end MEASUREMENT
/begin MEASUREMENT TQI_SP "Setpoint indicated engine torque" SWORD _CNV_A_R_LINEAR_____37_CM 1 100. -1024. 1023.96875 ECU_ADDRESS 0x3fd082 FORMAT "%6.2" /end MEASUREMENT
/begin MEASUREMENT TQI_SP_1 "Non smoothed setpoint indicated engine torque" SWORD _CNV_A_R_LINEAR_____37_CM 1 100. -1024. 1023.96875 ECU_ADDRESS 0x3fd08a FORMAT "%6.2" /end MEASUREMENT
/begin MEASUREMENT TQI_SP_2 "Smooth setpoint indicated engine torque" SWORD _CNV_A_R_LINEAR_____37_CM 1 100. -1024. 1023.96875 ECU_ADDRESS 0x3fd08c FORMAT "%6.2" /end MEASUREMENT
/begin MEASUREMENT TQI_SP_3 "Intermitted setpoint indicated engine torque after selection" SWORD _CNV_A_R_LINEAR_____37_CM 1 100. -1024. 1023.96875 ECU_ADDRESS 0x3fd08e FORMAT "%6.2" /end MEASUREMENT
/begin MEASUREMENT TQI_VS_MAX "???" SWORD _CNV_A_R_LINEAR_____37_CM 1 100. -1024. 1023.96875 ECU_ADDRESS 0x3fd056 FORMAT "%6.2" /end MEASUREMENT
/begin MEASUREMENT LV_DRI "Logical variable for engaged drive" UBYTE _CNV_S_2_RANGE______74_CM 1 100. 0. 1. ECU_ADDRESS 0x3fd423 BIT_MASK 0x1 /end MEASUREMENT
/begin MEASUREMENT EFF_LAMB_BAS_COR "Basic lambda efficiency" UWORD _CNV_A_R_LINEAR_____5_CM 1 100. 0. 1.99996948 ECU_ADDRESS 0x3fcc88 FORMAT "%7.5" /end MEASUREMENT
/begin MEASUREMENT EFF_SCC_BAS "Basic efficiency fuel  cut-off" UWORD _CNV_A_R_LINEAR_____5_CM 1 100. 0. 1.99996948 ECU_ADDRESS 0x3fd130 FORMAT "%7.5" /end MEASUREMENT
/begin MEASUREMENT EFF_SCC_AV "Actual efficiency fuel cut-off" UWORD _CNV_A_R_LINEAR_____5_CM 1 100. 0. 1.99996948 ECU_ADDRESS 0x3fd132 FORMAT "%7.5" /end MEASUREMENT
/begin MEASUREMENT LV_DLY_N_SP_IS "Flag for idle speed setpoint change" UBYTE _CNV_S_2_RANGE______76_CM 1 100. 0. 1. ECU_ADDRESS 0x3fd580 BIT_MASK 0x1 /end MEASUREMENT
/begin MEASUREMENT MAF_MAX_COR "Maximum intake air depending on engine speed an air density" UWORD _CNV_A_R_LINEAR_____56_CM 1 100. 0. 1389. ECU_ADDRESS 0x3fcd08 FORMAT "%6.2" /end MEASUREMENT
/begin MEASUREMENT T_SEG_AV "Current segment-time" UWORD _CNV_A_R_LINEAR_____24_CM 1 100. 0. 262.14 ECU_ADDRESS 0x3fcdd8 FORMAT "%7.3" /end MEASUREMENT
/begin MEASUREMENT TQ_ADD_ACT "Active clutch torque inclusive torque reserve" SWORD _CNV_A_R_LINEAR_____37_CM 1 100. -1024. 1023.96875 ECU_ADDRESS 0x3fd0e6 FORMAT "%7.1" /end MEASUREMENT
/begin MEASUREMENT TQ_CONV "Converter Torque" SWORD _CNV_A_R_LINEAR_____37_CM 1 100. -1024. 1023.96875 ECU_ADDRESS 0x3fd120 FORMAT "%6.2" /end MEASUREMENT
/begin MEASUREMENT TQ_LOSS_SCHA "Torque losses super-charger" SWORD _CNV_A_R_LINEAR_____37_CM 1 100. -1024. 1023.96875 ECU_ADDRESS 0x3fd04a FORMAT "%7.1" /end MEASUREMENT
/begin MEASUREMENT GR_MT "Manual transmission gear ratio" UBYTE _CNV_A_R_LINEAR_____13_CM 1 100. 0. 255. ECU_ADDRESS 0x3fd7f8 FORMAT "%3.0" /end MEASUREMENT
/begin MEASUREMENT N_REF_AJ "reference engine-speed for anti-jerk function" SWORD _CNV_A_R_LINEAR_____0_CM 1 100. -32768. 32767. ECU_ADDRESS 0x3fc1d0 FORMAT "%6.0" /end MEASUREMENT
/begin MEASUREMENT CS_T "Timer for clutch switch detection" UWORD _CNV_A_R_LINEAR_____3_CM 1 100. 0. 655350. ECU_ADDRESS 0x3fc70a FORMAT "%6.0" /end MEASUREMENT
/begin MEASUREMENT FAC_N_DIF_IS "Control factor for the engine self stabilizing" SWORD _CNV_A_R_LINEAR_____90_CM 1 100. -8. 7.99975586 ECU_ADDRESS 0x3fd03c FORMAT "%7.4" /end MEASUREMENT
/begin MEASUREMENT ECU_STATE "Information on ECU state" UBYTE _CNV_S_6_RANGE_ECU__92_CM 1 100. 0. 5. ECU_ADDRESS 0x3fd845 /end MEASUREMENT
/begin MEASUREMENT TQI_FAST "Indicated engine torque fast request" SWORD _CNV_A_R_LINEAR_____37_CM 1 100. -1024. 1023.96875 ECU_ADDRESS 0x3fd080 FORMAT "%6.2" /end MEASUREMENT
/begin MEASUREMENT TQI_GS_FAST_DEC "Torque decrement for fast torque intervention during gear shift" UWORD _CNV_A_R_LINEAR_____37_CM 1 100. 0. 1023.96875 ECU_ADDRESS 0x3fc8c0 FORMAT "%7.2" /end MEASUREMENT
/begin MEASUREMENT LV_GS_ENA "Logical variable for GS intervention enabling" UBYTE _CNV_S_2_RANGE______74_CM 1 100. 0. 1. ECU_ADDRESS 0x3fd4a6 BIT_MASK 0x1 /end MEASUREMENT
/begin CHARACTERISTIC C_TQI_GS_SLOW_HYS "Additional Hysteresis for TQI_GS_REQ_CAN to use TQI_GS_SLOW_DEC, too" VALUE 0x67d42 _REC_VAL_20_u1 0.4980468800000001 _CNV_A_R_LINEAR_____27_CM 0. 0.49804688 FORMAT "%5.3" /end CHARACTERISTIC
/begin AXIS_PTS ldp_n__tq_loss_acc "" 0x616d2 N_32 _REC_AXS_20_u1 8160. _CNV_A_R_LINEAR_____15_CM 6 0. 8160. FORMAT "%7.4" /end AXIS_PTS
/begin AXIS_PTS ldp_t_acc__fac_tq_loss_acc_on "" 0x61809 T_ACC _REC_AXS_20_u1 2.55 _CNV_A_R_LINEAR_____21_CM 8 0. 2.55 FORMAT "%4.2" /end AXIS_PTS
/begin AXIS_PTS ldp_t_acc__fac_tq_loss_acc_off "" 0x61800 T_ACC _REC_AXS_20_u1 2.55 _CNV_A_R_LINEAR_____21_CM 8 0. 2.55 FORMAT "%4.2" /end AXIS_PTS
/begin CHARACTERISTIC C_TQ_LOSS_ACC_SUB "Substitute value in case of error CAN_ACP or CAN_TQ_LOSS_ACC_INP" VALUE 0x67d26 _REC_VAL_20_s2 40.96 _CNV_A_R_LINEAR_____37_CM -1024. 0. FORMAT "%8.3" /end CHARACTERISTIC
/begin MEASUREMENT LV_ACT_AJ "LV anti-jerk function active" UBYTE _CNV_S_2_RANGE______74_CM 1 100. 0. 1. ECU_ADDRESS 0x3fd578 BIT_MASK 0x1 /end MEASUREMENT
/begin CHARACTERISTIC C_TCO_TMOT_STA "Temperature threshold for actuating the overtemperature warning light" VALUE 0x67cb6 _REC_VAL_20_u1 190.5 _CNV_A_R_LINEAR_____22_CM -48. 142.5 FORMAT "%5.1" /end CHARACTERISTIC
/begin CHARACTERISTIC C_TMOT_SUM_HYS "Hysteresis for temperature threshold C_TCO_TMOT_STA" VALUE 0x67ce4 _REC_VAL_20_u1 190.5 _CNV_A_R_LINEAR_____23_CM 0. 190.5 FORMAT "%5.1" /end CHARACTERISTIC
/begin CHARACTERISTIC C_T_TCO_CAN_AST "Time condition for transmitting the coolant temperature to the CAN" VALUE 0x67c76 _REC_VAL_20_u2 6553.5 _CNV_A_R_LINEAR_____18_CM 0. 6553.5 FORMAT "%6.1" /end CHARACTERISTIC
/begin MEASUREMENT TQ_ACCIN_CAN "ACC-torque from CAN" UBYTE _CNV_A_R_LINEAR_____86_CM 1 100. 0. 31. ECU_ADDRESS 0x3fd81f FORMAT "%3.0" /end MEASUREMENT
/begin MEASUREMENT TQ_LOSS_ACC_INP "ACC-torque for torque function" SWORD _CNV_A_R_LINEAR_____37_CM 1 100. -1024. 1023.96875 ECU_ADDRESS 0x3fc744 FORMAT "%7.1" /end MEASUREMENT
/begin MEASUREMENT N_ECF "Setpoint step of electric cooling fan speed" UBYTE _CNV_A_R_LINEAR_____17_CM 1 100. 0. 15. ECU_ADDRESS 0x3fd81e FORMAT "%2.0" /end MEASUREMENT
/begin MEASUREMENT STATE_EFP_CRASH_CAN "Request for switch off fuel pump after crash" UBYTE _CNV_A_R_LINEAR_____17_CM 1 100. 0. 3. ECU_ADDRESS 0x3fd821 FORMAT "%2.0" /end MEASUREMENT
/begin MEASUREMENT LV_REQ_TCO_L "LV requirement for low coolant temperature" UBYTE _CNV_S_2_RANGE______76_CM 1 100. 0. 1. ECU_ADDRESS 0x3fd44a BIT_MASK 0x1 /end MEASUREMENT
/begin MEASUREMENT ACP "AC-fluid presssure" UBYTE _CNV_A_R_LINEAR_____93_CM 1 100. 0. 127.5 ECU_ADDRESS 0x3fd9b4 FORMAT "%6.2" /end MEASUREMENT
/begin MEASUREMENT GEAR_SEL_DISP "Gear stick position" UBYTE _CNV_A_R_LINEAR_____17_CM 1 100. 0. 15. ECU_ADDRESS 0x3fd81b FORMAT "%2.0" /end MEASUREMENT
/begin MEASUREMENT TQI_GS_REQ_CAN "Relative torque request during gearshift intervention" UBYTE _CNV_A_R_LINEAR_____8_CM 1 100. 0. 0.996094 ECU_ADDRESS 0x3fd819 FORMAT "%5.3" /end MEASUREMENT
/begin MEASUREMENT TQI_GS_REQ "Absolute torque request during gearshift intervention" SWORD _CNV_A_R_LINEAR_____37_CM 1 100. -1024. 1023.96875 ECU_ADDRESS 0x3fc742 FORMAT "%7.1" /end MEASUREMENT
/begin CHARACTERISTIC C_TQ_STND "Standard torque" VALUE 0x67d2e _REC_VAL_20_s2 2047.96875 _CNV_A_R_LINEAR_____37_CM -1024. 1023.96875 FORMAT "%7.1" /end CHARACTERISTIC
/begin CHARACTERISTIC C_AMP_CRLC "correlation value for the compensation of the noise signal of the ambient pressure signal" VALUE 0x67b58 _REC_VAL_20_u1 0.9960940000000002 _CNV_A_R_LINEAR_____8_CM 0. 0.996094 FORMAT "%5.3" /end CHARACTERISTIC
/begin CHARACTERISTIC IP_FAC_TQ_LOSS_ACC_OFF "TQ_LOSS_ACC weighting factor at ACC deactivation" CURVE 0x65cb8 _REC_CUR_20_u1_u1 1.99220002 _CNV_A_R_LINEAR_____64_CM 0. 1.99220002 FORMAT "%5.3"
 /begin AXIS_DESCR COM_AXIS T_ACC _CNV_A_R_LINEAR_____21_CM 8 0. 2.55 FORMAT "%4.2" AXIS_PTS_REF ldp_t_acc__fac_tq_loss_acc_off /end AXIS_DESCR
/end CHARACTERISTIC
/begin CHARACTERISTIC IP_FAC_TQ_LOSS_ACC_ON "TQ_LOSS_ACC weighting factor at ACC activation" CURVE 0x65cc0 _REC_CUR_20_u1_u1 1.99220002 _CNV_A_R_LINEAR_____64_CM 0. 1.99220002 FORMAT "%5.3"
 /begin AXIS_DESCR COM_AXIS T_ACC _CNV_A_R_LINEAR_____21_CM 8 0. 2.55 FORMAT "%4.2" AXIS_PTS_REF ldp_t_acc__fac_tq_loss_acc_on /end AXIS_DESCR
/end CHARACTERISTIC
/begin CHARACTERISTIC C_FAC_AMP_MIN "BOT for FAC_AMP" VALUE 0x67b84 _REC_VAL_20_u2 1.99996948 _CNV_A_R_LINEAR_____5_CM 0. 1.99996948 FORMAT "%7.5" /end CHARACTERISTIC
/begin CHARACTERISTIC C_FAC_AMP_MAX "TOP for FAC_AMP" VALUE 0x67b82 _REC_VAL_20_u2 1.99996948 _CNV_A_R_LINEAR_____5_CM 0. 1.99996948 FORMAT "%7.5" /end CHARACTERISTIC
/begin MEASUREMENT LV_REQ_HEAT "LV increased heater power request" UBYTE _CNV_S_2_RANGE______76_CM 1 100. 0. 1. ECU_ADDRESS 0x3fd451 BIT_MASK 0x1 /end MEASUREMENT
/begin CHARACTERISTIC LC_TQI_SP_MAN_ACT "Logical constant manual torque active" VALUE 0x67d92 _REC_VAL_20_u1 1. _CNV_A_R_LINEAR_____13_CM 0. 1. FORMAT "%1.0" /end CHARACTERISTIC
/begin MEASUREMENT TQ_ST "Engine Start Torque" SWORD _CNV_A_R_LINEAR_____37_CM 1 100. -1024. 1023.96875 ECU_ADDRESS 0x3fd142 FORMAT "%6.2" /end MEASUREMENT
/begin MEASUREMENT TQ_ST_1 "Engine Start Torque raw value" SWORD _CNV_A_R_LINEAR_____37_CM 1 100. -1024. 1023.96875 ECU_ADDRESS 0x3fd146 FORMAT "%6.2" /end MEASUREMENT
/begin CHARACTERISTIC IP_TQ_ST "Engine torque at start" CURVE 0x6783a _REC_CUR_20_u2_u2 2047.96875 _CNV_A_R_LINEAR_____65_CM -1024. 1023.96875 FORMAT "%6.2"
 /begin AXIS_DESCR COM_AXIS N_DIF_ST _CNV_A_R_LINEAR_____53_CM 8 -32768. 32767. FORMAT "%6.0" AXIS_PTS_REF ldp_n_dif_st /end AXIS_DESCR
/end CHARACTERISTIC
/begin AXIS_PTS ldp_maf_cyl_stk__tqfr "" 0x615ea MAF _REC_AXS_20_u2 1389. _CNV_A_R_LINEAR_____56_CM 4 0. 1389. FORMAT "%7.2" /end AXIS_PTS
/begin MEASUREMENT TQ_MAX_CLU "Maximum torque at clutch" SWORD _CNV_A_R_LINEAR_____37_CM 1 100. -1024. 1023.96875 ECU_ADDRESS 0x3fd034 FORMAT "%6.2" /end MEASUREMENT
/begin CHARACTERISTIC IP_FAC_N_DIF_IS "Idle self stabilizing factor" CURVE 0x65c00 _REC_CUR_20_u2_u2 15.999756 _CNV_A_R_LINEAR_____103_CM -8. 7.999756 FORMAT "%7.5"
 /begin AXIS_DESCR COM_AXIS N_SP_IS_RATIO _CNV_A_R_LINEAR_____104_CM 8 0. 7.99987793 FORMAT "%6.4" AXIS_PTS_REF ldp_n_sp_is_ratio /end AXIS_DESCR
/end CHARACTERISTIC
/begin AXIS_PTS ldp_n_sp_is_ratio "" 0x617a0 N_SP_IS_RATIO _REC_AXS_20_u2 7.99987793 _CNV_A_R_LINEAR_____104_CM 8 0. 7.99987793 FORMAT "%6.4" /end AXIS_PTS
/begin CHARACTERISTIC C_TQ_ADD_HYS_CRU "Torque lead hysteresis for deactivation torque lead request at active cruise control" VALUE 0x67d00 _REC_VAL_20_s2 2047.96875 _CNV_A_R_LINEAR_____37_CM -1024. 1023.96875 FORMAT "%7.1" /end CHARACTERISTIC
/begin MEASUREMENT LAMB_REF_COR "Corrected lambda reference value" UWORD _CNV_A_R_LINEAR_____50_CM 1 100. 0. 31.99902344 ECU_ADDRESS 0x3fcc8e /end MEASUREMENT
/begin MEASUREMENT LAMB_DIF_BAS "Basic lambda difference to corrected reference lambda" UWORD _CNV_A_R_LINEAR_____105_CM 1 100. -32. 31.99902344 ECU_ADDRESS 0x3fcc96 FORMAT "%8.4" /end MEASUREMENT
/begin MEASUREMENT LAMB_DIF_AV "Actual lambda difference to corrected reference lambda" SWORD _CNV_A_R_LINEAR_____106_CM 1 100. -32.00000000125 31.99902343875 ECU_ADDRESS 0x3fcc98 /end MEASUREMENT
/begin MEASUREMENT LAMB_REF_ADD_TCO "Additive correction of reference lambda value " SWORD _CNV_A_R_LINEAR_____106_CM 1 100. -32.00000000125 31.99902343875 ECU_ADDRESS 0x3fcc94 /end MEASUREMENT
/begin MEASUREMENT LAMB_DIF_MAX "Maximum lambda difference to corrected reference lambda" SWORD _CNV_A_R_LINEAR_____106_CM 1 100. -32.00000000125 31.99902343875 ECU_ADDRESS 0x3fcc9a /end MEASUREMENT
/begin MEASUREMENT EFF_LAMB_AV "Actual lambda efficiency" UWORD _CNV_A_R_LINEAR_____5_CM 1 100. 0. 1.99996948 ECU_ADDRESS 0x3fcc8a FORMAT "%7.5" /end MEASUREMENT
/begin MEASUREMENT EFF_LAMB_MIN "Minimum lambda efficiency" UWORD _CNV_A_R_LINEAR_____5_CM 1 100. 0. 1.99996948 ECU_ADDRESS 0x3fcc8c FORMAT "%7.5" /end MEASUREMENT
/begin AXIS_PTS ldp_tco__tqfr_add "" 0x618b3 TCO _REC_AXS_20_u1 190.5 _CNV_A_R_LINEAR_____22_CM 8 -48. 142.5 FORMAT "%5.1" /end AXIS_PTS
/begin AXIS_PTS ldp_tco__lamb_ref_add "" 0x61898 TCO _REC_AXS_20_u1 190.5 _CNV_A_R_LINEAR_____22_CM 6 -48. 142.5 FORMAT "%5.1" /end AXIS_PTS
/begin CHARACTERISTIC IP_EFF_LAMB__LAMB_DIF "Lambda Efficiency" CURVE 0x65a6c _REC_CUR_20_u2_u2 1.99996948 _CNV_A_R_LINEAR_____5_CM 0. 1.99996948 FORMAT "%7.5"
 /begin AXIS_DESCR COM_AXIS ONLINE_DUMMY _CNV_A_R_LINEAR_____105_CM 16 -32. 31.99902344 FORMAT "%8.4" AXIS_PTS_REF ldp_lamb_dif__eff_lamb /end AXIS_DESCR
/end CHARACTERISTIC
/begin AXIS_PTS ldp_lamb_dif__eff_lamb "" 0x6156e LAMB_DIF _REC_AXS_20_u2 63.99902344 _CNV_A_R_LINEAR_____105_CM 16 -32. 31.99902344 FORMAT "%8.4" /end AXIS_PTS
/begin CHARACTERISTIC IP_LAMB_REF_ADD "Additive lambda correction versus coolant temperature" CURVE 0x66626 _REC_CUR_20_u2_u1 63.99902344 _CNV_A_R_LINEAR_____105_CM -32. 31.99902344 FORMAT "%8.4"
 /begin AXIS_DESCR COM_AXIS TCO _CNV_A_R_LINEAR_____22_CM 6 -48. 142.5 FORMAT "%5.1" AXIS_PTS_REF ldp_tco__lamb_ref_add /end AXIS_DESCR
/end CHARACTERISTIC
/begin CHARACTERISTIC IP_FAC_TQ_CONV__N_RATIO_CONV "Torque request factor" CURVE 0x65ca8 _REC_CUR_20_u2_u1 1.99996948 _CNV_A_R_LINEAR_____5_CM 0. 1.99996948 FORMAT "%7.5"
 /begin AXIS_DESCR COM_AXIS N_RATIO_CONV _CNV_A_R_LINEAR_____8_CM 8 0. 0.996094 FORMAT "%5.3" AXIS_PTS_REF ldp_n_ratio_conv_fac_tq_conv /end AXIS_DESCR
/end CHARACTERISTIC
/begin CHARACTERISTIC C_TQ_ADD_CRLC_ST "Correlation constant for torque  lead" VALUE 0x67cfc _REC_VAL_20_u1 0.9960940000000002 _CNV_A_R_LINEAR_____8_CM 0. 0.996094 FORMAT "%5.3" /end CHARACTERISTIC
/begin CHARACTERISTIC C_TQ_ST_CRLC "Correlation constant for negative PT1 filtering" VALUE 0x67d2c _REC_VAL_20_u1 0.9960940000000002 _CNV_A_R_LINEAR_____8_CM 0. 0.996094 FORMAT "%5.3" /end CHARACTERISTIC
/begin MEASUREMENT TQ_LOSS_PSTE "Torque losses power steering" SWORD _CNV_A_R_LINEAR_____37_CM 1 100. -1024. 1023.96875 ECU_ADDRESS 0x3fd04c FORMAT "%7.1" /end MEASUREMENT
/begin MEASUREMENT TQI_REF_MAX "Maximum indicated torque from IP_TQI_REF" SWORD _CNV_A_R_LINEAR_____37_CM 1 100. -1024. 1023.96875 ECU_ADDRESS 0x3fd038 FORMAT "%6.2" /end MEASUREMENT
/begin MEASUREMENT TQFR_BAS "Basis engine friction torque inclusive adaptation value" SWORD _CNV_A_R_LINEAR_____37_CM 1 100. -1024. 1023.96875 ECU_ADDRESS 0x3fc228 FORMAT "%6.2" /end MEASUREMENT
/begin MEASUREMENT TQFR "Basis engine friction torque {visible is high word TQFR^sword(1)}" SWORD _CNV_A_R_LINEAR_____37_CM 1 100. -1024. 1023.96875 ECU_ADDRESS 0x3fc230 FORMAT "%6.2" /end MEASUREMENT
/begin AXIS_PTS ldp_n__lamb_ref "" 0x616a1 N_32 _REC_AXS_20_u1 816. _CNV_A_R_LINEAR_____15_CM 6 0. 8160. FORMAT "%4.0" /end AXIS_PTS
/begin MEASUREMENT LV_REQ_AJ "LV anti-jerk function requested" UBYTE _CNV_S_2_RANGE______74_CM 1 100. 0. 1. ECU_ADDRESS 0x3fd57a BIT_MASK 0x1 /end MEASUREMENT
/begin AXIS_PTS ldp_tqi_sp_maf__maf_sp "" 0x61a18 TQI_SP_MAF _REC_AXS_20_u2 1023.96875 _CNV_A_R_LINEAR_____37_CM 12 0. 1023.96875 FORMAT "%7.2" /end AXIS_PTS
/begin CHARACTERISTIC IP_LAMB_REF "Reference lambda" MAP 0x665de _REC_MAP_20_u2_u1_u1 31.99902344 _CNV_A_R_LINEAR_____50_CM 0. 31.99902344 FORMAT "%7.4"
 /begin AXIS_DESCR COM_AXIS N_32 _CNV_A_R_LINEAR_____15_CM 6 0. 8160. FORMAT "%4.0" AXIS_PTS_REF ldp_n__lamb_ref /end AXIS_DESCR
 /begin AXIS_DESCR COM_AXIS MAF _CNV_A_R_LINEAR_____51_CM 6 0. 1389. FORMAT "%4.0" AXIS_PTS_REF ldp_maf__lamb_ref /end AXIS_DESCR
/end CHARACTERISTIC
/begin MEASUREMENT FUP_MES_MMV "fuel pressure moving mean value" UWORD _CNV_A_R_LINEAR_____114_CM 1 100. 0. 173888. ECU_ADDRESS 0x3fc5fe FORMAT "%6.0" /end MEASUREMENT
/begin AXIS_PTS ldp_fup_bas__fup_mes "" 0x61508 FUP _REC_AXS_20_u2 4.99511719 _CNV_A_R_LINEAR_____38_CM 8 0. 4.99511719 FORMAT "%5.3" /end AXIS_PTS
/begin CHARACTERISTIC C_FUP_NOM "Nominal fuel pressure" VALUE 0x67bb0 _REC_VAL_20_u2 5434. _CNV_A_R_LINEAR_____1_CM 0. 5434. FORMAT "%7.2" /end CHARACTERISTIC
/begin CHARACTERISTIC C_FUP_MES_CRLC "Fuel pressure filter factor" VALUE 0x67bac _REC_VAL_20_u1 0.99610001 _CNV_A_R_LINEAR_____68_CM 0. 0.99610001 FORMAT "%5.3" /end CHARACTERISTIC
/begin CHARACTERISTIC IP_FUP_MES "Fuel pressure sensor linearisation table" CURVE 0x65d88 _REC_CUR_20_u2_u2 173888. _CNV_A_R_LINEAR_____114_CM 0. 173888. FORMAT "%6.0"
 /begin AXIS_DESCR COM_AXIS FUP _CNV_A_R_LINEAR_____38_CM 8 0. 4.99511719 FORMAT "%5.3" AXIS_PTS_REF ldp_fup_bas__fup_mes /end AXIS_DESCR
/end CHARACTERISTIC
/begin CHARACTERISTIC C_TCO_SWI_WUP "TCO condition for setting the bit S_WL" VALUE 0x67cb5 _REC_VAL_20_u1 190.5 _CNV_A_R_LINEAR_____22_CM -48. 142.5 FORMAT "%5.1" /end CHARACTERISTIC
/begin CHARACTERISTIC C_N_DIF_REF_AJ_MAX "Maximum limitation of N_DIF_REF_AJ" VALUE 0x67c04 _REC_VAL_20_s2 65535. _CNV_A_R_LINEAR_____0_CM -32768. 32767. FORMAT "%6.0" /end CHARACTERISTIC
/begin CHARACTERISTIC C_N_DIF_REF_AJ_MIN "Minimum limitation of N_DIF_REF_AJ" VALUE 0x67c06 _REC_VAL_20_s2 65535. _CNV_A_R_LINEAR_____0_CM -32768. 32767. FORMAT "%6.0" /end CHARACTERISTIC
/begin CHARACTERISTIC LC_AJ_INH_AT "Logical constant for anti jerk function to inhibit the AT influence on the activation conditions" VALUE 0x67d81 _REC_VAL_20_u1 1. _CNV_A_R_LINEAR_____17_CM 0. 1. FORMAT "%2.0" /end CHARACTERISTIC
/begin CHARACTERISTIC LC_AJ_INH_DT "Logical constant for anti jerk function to inhibit theDT influence on the activation conditions" VALUE 0x67d82 _REC_VAL_20_u1 1. _CNV_A_R_LINEAR_____17_CM 0. 1. FORMAT "%2.0" /end CHARACTERISTIC
/begin MEASUREMENT LV_TQ_LOSS_ACC_INP_ORNG "???" UBYTE _CNV_S_2_RANGE______74_CM 1 100. 0. 1. ECU_ADDRESS 0x3fd560 BIT_MASK 0x1 /end MEASUREMENT
/begin MEASUREMENT LAMB_BAS_COR_MAX "Maximum value basic lambda value" UWORD _CNV_A_R_LINEAR_____50_CM 1 100. 0. 31.99902344 ECU_ADDRESS 0x3fd052 /end MEASUREMENT
/begin MEASUREMENT LAMB_SCC "Lambda setpoint at single cylinder cut off" UWORD _CNV_A_R_LINEAR_____50_CM 1 100. 0. 31.99902344 ECU_ADDRESS 0x3fd054 /end MEASUREMENT
/begin MEASUREMENT TQI_MAX "Maximum indicated torque " SWORD _CNV_A_R_LINEAR_____37_CM 1 100. -1024. 1023.96875 ECU_ADDRESS 0x3fd036 FORMAT "%6.2" /end MEASUREMENT
/begin CHARACTERISTIC LC_TQ_INTV_INH_AS "Logical constant fast torque intervention inhibited by application system" VALUE 0x67d8f _REC_VAL_20_u1 1. _CNV_A_R_LINEAR_____13_CM 0. 1. FORMAT "%1.0" /end CHARACTERISTIC
/begin CHARACTERISTIC C_VS_MIN_DT "Threshold for vehicle running and drive-train closed detection " VALUE 0x67d77 _REC_VAL_20_u1 255. _CNV_A_R_LINEAR_____43_CM 0. 255. FORMAT "%3.0" /end CHARACTERISTIC
/begin MEASUREMENT FUP "fuel pressure value" UWORD _CNV_A_R_LINEAR_____114_CM 1 100. 0. 173888. ECU_ADDRESS 0x3fc5fc FORMAT "%6.0" /end MEASUREMENT
/begin MEASUREMENT FUP_BAR "fuel pressure value" UWORD _CNV_A_R_LINEAR_____145_CM 1 100. 0. 173.888 ECU_ADDRESS 0x3fc602 FORMAT "%7.3" /end MEASUREMENT
/begin MEASUREMENT N_DIF_REF_AJ "limited reference engine-speed deviation for anti-jerk function" SWORD _CNV_A_R_LINEAR_____0_CM 1 100. -32768. 32767. ECU_ADDRESS 0x3fd10e FORMAT "%6.0" /end MEASUREMENT
/begin MEASUREMENT N_DIF_REF_AJ_INTER "reference engine-speed deviation for anti-jerk function without limitation" SWORD _CNV_A_R_LINEAR_____0_CM 1 100. -32768. 32767. ECU_ADDRESS 0x3fd10c FORMAT "%6.0" /end MEASUREMENT
/begin MEASUREMENT LV_CAN_GS_ACK "???" UBYTE _CNV_S_2_RANGE______74_CM 1 100. 0. 1. ECU_ADDRESS 0x3fd55e BIT_MASK 0x1 /end MEASUREMENT
/begin MEASUREMENT LV_ACP_ORNG "???" UBYTE _CNV_S_2_RANGE______76_CM 1 100. 0. 1. ECU_ADDRESS 0x3fd561 /end MEASUREMENT
/begin CHARACTERISTIC C_CAM_INI_IN "valve spread angle inlet camshafts with IVVT passive" VALUE 0x69df2 _REC_VAL_20_s2 1535.9765625 _CNV_A_R_LINEAR_____117_CM -768. 767.9765625 FORMAT "%7.2" /end CHARACTERISTIC
/begin CHARACTERISTIC C_CAM_INI_EX "valve spread angle exhaust camshaft  with IVVT passive" VALUE 0x69df4 _REC_VAL_20_s2 1535.9765625 _CNV_A_R_LINEAR_____117_CM -768. 767.9765625 FORMAT "%7.2" /end CHARACTERISTIC
/begin MEASUREMENT LV_DT "Logical variable drive train engaged" UBYTE _CNV_S_2_RANGE______74_CM 1 100. 0. 1. ECU_ADDRESS 0x3fd425 BIT_MASK 0x1 /end MEASUREMENT
/begin MEASUREMENT MAF_SP_TQI "MAF setpoint for torque interventions" UWORD _CNV_A_R_LINEAR_____56_CM 1 100. 0. 1389. ECU_ADDRESS 0x3fd084 FORMAT "%6.2" /end MEASUREMENT
/begin MEASUREMENT LV_CS "Boolean for clutch switch detection" UBYTE _CNV_S_2_RANGE______74_CM 1 100. 0. 1. ECU_ADDRESS 0x3fd424 BIT_MASK 0x1 /end MEASUREMENT
/begin MEASUREMENT LV_TQ_IGA_ENA "???" UBYTE _CNV_S_2_RANGE______74_CM 1 100. 0. 1. ECU_ADDRESS 0x3fd55f BIT_MASK 0x1 /end MEASUREMENT
/begin MEASUREMENT TQI_SP_MAF "Indicated engine torque set-point has to realized by mass air flow control" SWORD _CNV_A_R_LINEAR_____37_CM 1 100. -1024. 1023.96875 ECU_ADDRESS 0x3fd092 FORMAT "%6.2" /end MEASUREMENT
/begin MEASUREMENT TQI_SP_MAF_1 "Indicated engine torque set-point has to realized by mass air flow control intermediate 1" SWORD _CNV_A_R_LINEAR_____37_CM 1 100. -1024. 1023.96875 ECU_ADDRESS 0x3fd086 FORMAT "%6.2" /end MEASUREMENT
/begin MEASUREMENT TQI_SP_MAF_2 "Indicated engine torque set-point has to realized by mass air flow control intermediate 2" SWORD _CNV_A_R_LINEAR_____37_CM 1 100. -1024. 1023.96875 ECU_ADDRESS 0x3fd088 FORMAT "%6.2" /end MEASUREMENT
/begin MEASUREMENT EFF_EGR_S "???" UWORD _CNV_A_R_LINEAR_____5_CM 1 100. 0. 1.99996948 ECU_ADDRESS 0x3fd05c FORMAT "%7.5" /end MEASUREMENT
/begin MEASUREMENT EFF_PHA_S "???" UWORD _CNV_A_R_LINEAR_____5_CM 1 100. 0. 1.99996948 ECU_ADDRESS 0x3fd05e FORMAT "%7.5" /end MEASUREMENT
/begin MEASUREMENT TQI_REF "Reference indicated engine torque" UWORD _CNV_A_R_LINEAR_____37_CM 1 100. 0. 1023.96875 ECU_ADDRESS 0x3fd0aa FORMAT "%7.2" /end MEASUREMENT
/begin MEASUREMENT TQ_MIN_CLU "Minimum  torque at clutch " SWORD _CNV_A_R_LINEAR_____37_CM 1 100. -1024. 1023.96875 ECU_ADDRESS 0x3fd03a FORMAT "%6.2" /end MEASUREMENT
/begin MEASUREMENT TQ_MIN_CLU_1 "Minimum  torque at clutch intermitted value" SWORD _CNV_A_R_LINEAR_____37_CM 1 100. -1024. 1023.96875 ECU_ADDRESS 0x3fd03e FORMAT "%6.2" /end MEASUREMENT
/begin CHARACTERISTIC IP_TQI_REF__N__MAF "Indicated engine torque at reference conditions" MAP 0x679b2 _REC_MAP_20_u2_u1_u2 1023.96875 _CNV_A_R_LINEAR_____37_CM 0. 1023.96875 FORMAT "%7.2"
 /begin AXIS_DESCR COM_AXIS N_32 _CNV_A_R_LINEAR_____15_CM 16 0. 8160. FORMAT "%4.0" AXIS_PTS_REF ldpm_n_32_100 /end AXIS_DESCR
 /begin AXIS_DESCR COM_AXIS MAF _CNV_A_R_LINEAR_____56_CM 12 0. 1389. FORMAT "%4.0" AXIS_PTS_REF ldpm_maf_100 /end AXIS_DESCR
/end CHARACTERISTIC
/begin CHARACTERISTIC C_CRLC_TQFR "Correlation constant for TQFR-filtering" VALUE 0x67b67 _REC_VAL_20_u1 0.9960940000000002 _CNV_A_R_LINEAR_____8_CM 0. 0.996094 FORMAT "%5.3" /end CHARACTERISTIC
/begin MEASUREMENT T_TRA "Actual time value for torque ramps" UBYTE _CNV_A_R_LINEAR_____21_CM 1 100. 0. 2.55 ECU_ADDRESS 0x3fd996 FORMAT "%4.2" /end MEASUREMENT
/begin MEASUREMENT TQ_ADD_ACC "Torque reserve for switching on air conditioning compressor" SWORD _CNV_A_R_LINEAR_____37_CM 1 100. -1024. 1023.96875 ECU_ADDRESS 0x3fd100 FORMAT "%7.1" /end MEASUREMENT
/begin CHARACTERISTIC C_TQ_AD_ADD_S_SWI "Adaptive engine torque adaption value for switch between hom and strat" VALUE 0x67f2e _REC_VAL_20_s2 2047.96875 _CNV_A_R_LINEAR_____37_CM -1024. 1023.96875 FORMAT "%7.1" /end CHARACTERISTIC
/begin MEASUREMENT SEG_NR_ER "Segment counter for segment identification (0...NC_CYL_NR - 1)" UBYTE _CNV_A_R_LINEAR_____17_CM 1 100. 0. 30. ECU_ADDRESS 0x3fd858 FORMAT "%2.0" /end MEASUREMENT
/begin MEASUREMENT SEG_T_COR_BUF_0 "Buffer for corrected, measured segment time, calculated every segment; after adaptation" UWORD _CNV_A_R_LINEAR_____165_CM 1 100. 0. 65535. ECU_ADDRESS 0x3fc87e FORMAT "%5.0" /end MEASUREMENT
/begin MEASUREMENT SEG_T_COR_BUF_1 "Buffer for corrected, measured segment time, calculated every segment; after adaptation" UWORD _CNV_A_R_LINEAR_____165_CM 1 100. 0. 65535. ECU_ADDRESS 0x3fc880 FORMAT "%5.0" /end MEASUREMENT
/begin MEASUREMENT SEG_T_COR_BUF_2 "Buffer for corrected, measured segment time, calculated every segment; after adaptation" UWORD _CNV_A_R_LINEAR_____165_CM 1 100. 0. 65535. ECU_ADDRESS 0x3fc882 FORMAT "%5.0" /end MEASUREMENT
/begin MEASUREMENT SEG_T_COR_BUF_3 "Buffer for corrected, measured segment time, calculated every segment; after adaptation" UWORD _CNV_A_R_LINEAR_____165_CM 1 100. 0. 65535. ECU_ADDRESS 0x3fc884 FORMAT "%5.0" /end MEASUREMENT
/begin MEASUREMENT SEG_T_COR_BUF_4 "Buffer for corrected, measured segment time, calculated every segment; after adaptation" UWORD _CNV_A_R_LINEAR_____165_CM 1 100. 0. 65535. ECU_ADDRESS 0x3fc886 FORMAT "%5.0" /end MEASUREMENT
/begin MEASUREMENT SEG_T_COR_BUF_5 "Buffer for corrected, measured segment time, calculated every segment; after adaptation" UWORD _CNV_A_R_LINEAR_____165_CM 1 100. 0. 65535. ECU_ADDRESS 0x3fc888 FORMAT "%5.0" /end MEASUREMENT
/begin MEASUREMENT SEG_T_COR_BUF_6 "Buffer for corrected, measured segment time, calculated every segment; after adaptation" UWORD _CNV_A_R_LINEAR_____165_CM 1 100. 0. 65535. ECU_ADDRESS 0x3fc88a FORMAT "%5.0" /end MEASUREMENT
/begin MEASUREMENT SEG_T_COR_BUF_7 "Buffer for corrected, measured segment time, calculated every segment; after adaptation" UWORD _CNV_A_R_LINEAR_____165_CM 1 100. 0. 65535. ECU_ADDRESS 0x3fc88c FORMAT "%5.0" /end MEASUREMENT
/begin MEASUREMENT SEG_T_COR_BUF_8 "Buffer for corrected, measured segment time, calculated every segment; after adaptation" UWORD _CNV_A_R_LINEAR_____165_CM 1 100. 0. 65535. ECU_ADDRESS 0x3fc88e FORMAT "%5.0" /end MEASUREMENT
/begin MEASUREMENT SEG_T_COR_BUF_9 "Buffer for corrected, measured segment time, calculated every segment; after adaptation" UWORD _CNV_A_R_LINEAR_____165_CM 1 100. 0. 65535. ECU_ADDRESS 0x3fc890 FORMAT "%5.0" /end MEASUREMENT
/begin MEASUREMENT SEG_T_COR_BUF_10 "Buffer for corrected, measured segment time, calculated every segment; after adaptation" UWORD _CNV_A_R_LINEAR_____165_CM 1 100. 0. 65535. ECU_ADDRESS 0x3fc892 FORMAT "%5.0" /end MEASUREMENT
/begin MEASUREMENT SEG_T_COR_BUF_11 "Buffer for corrected, measured segment time, calculated every segment; after adaptation" UWORD _CNV_A_R_LINEAR_____165_CM 1 100. 0. 65535. ECU_ADDRESS 0x3fc894 FORMAT "%5.0" /end MEASUREMENT
/begin MEASUREMENT SEG_AD_MMV_0 "Adaptive values (for each segment)" SWORD _CNV_A_R_LINEAR_____166_CM 1 100. -7.8125 7.8123 ECU_ADDRESS 0x3fc854 FORMAT "%7.4" /end MEASUREMENT
/begin MEASUREMENT SEG_AD_MMV_1 "Adaptive values (for each segment)" SWORD _CNV_A_R_LINEAR_____166_CM 1 100. -7.8125 7.8123 ECU_ADDRESS 0x3fc856 FORMAT "%7.4" /end MEASUREMENT
/begin MEASUREMENT SEG_AD_MMV_2 "Adaptive values (for each segment)" SWORD _CNV_A_R_LINEAR_____166_CM 1 100. -7.8125 7.8123 ECU_ADDRESS 0x3fc858 FORMAT "%7.4" /end MEASUREMENT
/begin MEASUREMENT SEG_AD_MMV_3 "Adaptive values (for each segment)" SWORD _CNV_A_R_LINEAR_____166_CM 1 100. -7.8125 7.8123 ECU_ADDRESS 0x3fc85a FORMAT "%7.4" /end MEASUREMENT
/begin MEASUREMENT SEG_AD_MMV_4 "Adaptive values (for each segment)" SWORD _CNV_A_R_LINEAR_____166_CM 1 100. -7.8125 7.8123 ECU_ADDRESS 0x3fc85c FORMAT "%7.4" /end MEASUREMENT
/begin MEASUREMENT SEG_AD_MMV_5 "Adaptive values (for each segment)" SWORD _CNV_A_R_LINEAR_____166_CM 1 100. -7.8125 7.8123 ECU_ADDRESS 0x3fc85e FORMAT "%7.4" /end MEASUREMENT
/begin CHARACTERISTIC C_N_SEG_T_AD_MAX_ER "Maximum engine speed threshold for crankshaft crankshaft position wheel learning." VALUE 0x681be _REC_VAL_20_u1 8160. _CNV_A_R_LINEAR_____15_CM 0. 8160. FORMAT "%4.0" /end CHARACTERISTIC
/begin CHARACTERISTIC C_N_SEG_T_AD_MIN_ER "Minimum engine speed threshold for crankshaft crankshaft position wheel learning." VALUE 0x681bf _REC_VAL_20_u1 8160. _CNV_A_R_LINEAR_____15_CM 0. 8160. FORMAT "%4.0" /end CHARACTERISTIC
/begin CHARACTERISTIC C_SEG_T_AD_COR_DRV1_MAX_ER "Maximum value of DRV1_ER (dynamic part of engine roughness) for crankshaft crankshaft position wheel learning" VALUE 0x681c0 _REC_VAL_20_u2 32767. _CNV_A_R_LINEAR_____165_CM 0. 32767. FORMAT "%5.0" /end CHARACTERISTIC
/begin CHARACTERISTIC C_CRK_DIF_MAX_ER "Limitation of adaptation range ( mechanical tolerance)" VALUE 0x681c2 _REC_VAL_20_u2 7.8125 _CNV_A_R_LINEAR_____167_CM 0. 7.8125 FORMAT "%4.2" /end CHARACTERISTIC
/begin CHARACTERISTIC C_SEG_T_AD_CRLC_ER "Correlation factor for segment adaptation" VALUE 0x681c4 _REC_VAL_20_u2 0.99998474 _CNV_A_R_LINEAR_____2_CM 0. 0.99998474 FORMAT "%7.5" /end CHARACTERISTIC
/begin CHARACTERISTIC C_SEG_T_FAST_AD_CRLC_ER "Correlation factor for segment adaptation \"fast\" (only necessary if NC_USE_EXT_ADJ = 1)" VALUE 0x681c6 _REC_VAL_20_u2 0.99998474 _CNV_A_R_LINEAR_____2_CM 0. 0.99998474 FORMAT "%7.5" /end CHARACTERISTIC
/begin CHARACTERISTIC C_T_SEG_AD_DLY "Minimum time after active segment adaption with no new segment adaption" VALUE 0x681c8 _REC_VAL_20_u1 25.5 _CNV_A_R_LINEAR_____18_CM 0. 25.5 FORMAT "%4.1" /end CHARACTERISTIC
/begin MEASUREMENT ER_AV "currently used engine roughness value, updated each SEG" SWORD _CNV_A_R_LINEAR_____165_CM 1 100. -32768. 32767. ECU_ADDRESS 0x3fc860 FORMAT "%6.0" /end MEASUREMENT
/begin MEASUREMENT DRV0_ER "Static component for engine roughness calculation updated each SEG " SLONG _CNV_A_R_LINEAR_____168_CM 1 100. -2147483647. 2147483648. ECU_ADDRESS 0x3fc864 FORMAT "%11.0" /end MEASUREMENT
/begin MEASUREMENT DRV1_ER "Dynamic component for engine roughness calculation updated each SEG " SWORD _CNV_A_R_LINEAR_____165_CM 1 100. -32768. 32767. ECU_ADDRESS 0x3fc868 FORMAT "%6.0" /end MEASUREMENT
/begin MEASUREMENT DRV2_MMV_ER "Averaged curvature component for engine roughness calculation updated each SEG " SWORD _CNV_A_R_LINEAR_____165_CM 1 100. -32768. 32767. ECU_ADDRESS 0x3fc86a FORMAT "%6.0" /end MEASUREMENT
/begin MEASUREMENT ER_RR "currently used engine roughness value without DRV2_MMV_ER, updated each SEG" SWORD _CNV_A_R_LINEAR_____165_CM 1 100. -32768. 32767. ECU_ADDRESS 0x3fc870 FORMAT "%6.0" /end MEASUREMENT
/begin AXIS_PTS ldpm_n_32__drv2_er "" 0x61e46 N_32 _REC_AXS_20_u1 8160. _CNV_A_R_LINEAR_____15_CM 4 0. 8160. FORMAT "%4.0" /end AXIS_PTS
/begin CHARACTERISTIC IP_FAC_DRV2_ER_MT "Weighting factor for engine roughness curvature component calculation (correction amount), MT Vehicle" CURVE 0x681c9 _REC_CUR_20_u1_u1 3.984375 _CNV_A_R_LINEAR_____113_CM 0. 3.984375 FORMAT "%4.2"
 /begin AXIS_DESCR COM_AXIS N_32 _CNV_A_R_LINEAR_____15_CM 4 0. 8160. FORMAT "%4.0" AXIS_PTS_REF ldpm_n_32__drv2_er /end AXIS_DESCR
/end CHARACTERISTIC
/begin CHARACTERISTIC IP_FAC_DRV2_ER_AT "Weighting factor for engine roughness curvature component calculation (correction amount), AT Vehicle" CURVE 0x681cd _REC_CUR_20_u1_u1 3.984375 _CNV_A_R_LINEAR_____113_CM 0. 3.984375 FORMAT "%4.2"
 /begin AXIS_DESCR COM_AXIS N_32 _CNV_A_R_LINEAR_____15_CM 4 0. 8160. FORMAT "%4.0" AXIS_PTS_REF ldpm_n_32__drv2_er /end AXIS_DESCR
/end CHARACTERISTIC
/begin CHARACTERISTIC IP_CRLC_DRV2_ER_AT "Correlation factor for engine roughness curvature component calculation (correction duration), AT Vehicle" CURVE 0x681d1 _REC_CUR_20_u1_u1 0.9960940000000002 _CNV_A_R_LINEAR_____8_CM 0. 0.996094 FORMAT "%5.3"
 /begin AXIS_DESCR COM_AXIS N_32 _CNV_A_R_LINEAR_____15_CM 4 0. 8160. FORMAT "%4.0" AXIS_PTS_REF ldpm_n_32__drv2_er /end AXIS_DESCR
/end CHARACTERISTIC
/begin CHARACTERISTIC IP_CRLC_DRV2_ER_MT "Correlation factor for engine roughness curvature component calculation (correction duration),MT Vehicle" CURVE 0x681d5 _REC_CUR_20_u1_u1 0.9960940000000002 _CNV_A_R_LINEAR_____8_CM 0. 0.996094 FORMAT "%5.3"
 /begin AXIS_DESCR COM_AXIS N_32 _CNV_A_R_LINEAR_____15_CM 4 0. 8160. FORMAT "%4.0" AXIS_PTS_REF ldpm_n_32__drv2_er /end AXIS_DESCR
/end CHARACTERISTIC
/begin MEASUREMENT LV_SEG_AD_FDOUT "Boolean for segment adaptation fade out condition" UBYTE _CNV_S_2_RANGE______74_CM 1 100. 0. 1. ECU_ADDRESS 0x3fd48e BIT_MASK 0x1 /end MEASUREMENT
/begin MEASUREMENT IV_OFF_ER "Cylinder(s) concerned by ER fade out due to injection cut off" UBYTE _CNV_A_R_LINEAR_____13_CM 1 100. 0. 255. ECU_ADDRESS 0x3fd950 FORMAT "%3.0" /end MEASUREMENT
/begin MEASUREMENT LV_IGA_DIF_MAX_ER "Boolean for ignition retardation above threshold for ER fade out" UBYTE _CNV_S_2_RANGE______74_CM 1 100. 0. 1. ECU_ADDRESS 0x3fd48f BIT_MASK 0x1 /end MEASUREMENT
/begin MEASUREMENT LV_INH_SEG_AD "Boolean for Segment adaptation inhibitation by project specific conditions" UBYTE _CNV_S_2_RANGE______74_CM 1 100. 0. 1. ECU_ADDRESS 0x3fd490 BIT_MASK 0x1 /end MEASUREMENT
/begin AXIS_PTS ldpm_tqi_av__thd_er "" 0x61e5a TQI_AV _REC_AXS_20_u2 1023.96875 _CNV_A_R_LINEAR_____37_CM 6 0. 1023.96875 FORMAT "%7.2" /end AXIS_PTS
/begin AXIS_PTS ldpm_maf__thd_er "" 0x61e4c MAF _REC_AXS_20_u2 1389. _CNV_A_R_LINEAR_____56_CM 6 0. 1389. FORMAT "%4.0" /end AXIS_PTS
/begin CHARACTERISTIC IP_MAF_DIF_MAX_ER__MAF "Maximum air-mass gradient per SEG for fade out condition" CURVE 0x681dc _REC_CUR_20_u2_u2 1389. _CNV_A_R_LINEAR_____56_CM 0. 1389. FORMAT "%7.2"
 /begin AXIS_DESCR COM_AXIS MAF _CNV_A_R_LINEAR_____56_CM 6 0. 1389. FORMAT "%4.0" AXIS_PTS_REF ldpm_maf__thd_er /end AXIS_DESCR
/end CHARACTERISTIC
/begin CHARACTERISTIC IP_TQI_AV_DIF_MAX_ER__TQI_AV "Maximum actual torque gradient fade out condition" CURVE 0x681e8 _REC_CUR_20_u2_u2 2047.96875 _CNV_A_R_LINEAR_____65_CM -1024. 1023.96875 FORMAT "%6.2"
 /begin AXIS_DESCR COM_AXIS TQI_AV _CNV_A_R_LINEAR_____37_CM 6 0. 1023.96875 FORMAT "%7.2" AXIS_PTS_REF ldpm_tqi_av__thd_er /end AXIS_DESCR
/end CHARACTERISTIC
/begin CHARACTERISTIC C_MAF_DIF_DLY_ER "Fade out duration when maximum air-mass gradient has been detected" VALUE 0x681fa _REC_VAL_20_u2 655.34 _CNV_A_R_LINEAR_____21_CM 1.e-002 655.35 FORMAT "%5.2" /end CHARACTERISTIC
/begin CHARACTERISTIC C_TQI_AV_DIF_DLY_ER "Fade out duration when maximum actual torque gradient has been detected" VALUE 0x681fc _REC_VAL_20_u2 655.34 _CNV_A_R_LINEAR_____21_CM 1.e-002 655.35 FORMAT "%5.2" /end CHARACTERISTIC
/begin CHARACTERISTIC C_TPS_GRD_DLY_ER "Fade out duration when maximum throttle gradient has been detected" VALUE 0x681fe _REC_VAL_20_u2 655.34 _CNV_A_R_LINEAR_____21_CM 1.e-002 655.35 FORMAT "%5.2" /end CHARACTERISTIC
/begin CHARACTERISTIC C_ACCOUT_DLY_ER "Fade out duration when air-conditioning compressor has been switched on or off" VALUE 0x68200 _REC_VAL_20_u2 655.34 _CNV_A_R_LINEAR_____21_CM 1.e-002 655.35 FORMAT "%5.2" /end CHARACTERISTIC
/begin CHARACTERISTIC C_T_AST_DLY_ER "Fade out duration after engine operating state START has been exited" VALUE 0x68202 _REC_VAL_20_u2 6553.400000000001 _CNV_A_R_LINEAR_____18_CM 0.1 6553.5 FORMAT "%6.1" /end CHARACTERISTIC
/begin CHARACTERISTIC C_IGA_DIF_MAX_ER "Ignition time retardation difference per TDC (each SEG °CRK) for fade out condition" VALUE 0x68204 _REC_VAL_20_u1 95.625 _CNV_A_R_LINEAR_____6_CM 0. 95.625 FORMAT "%5.2" /end CHARACTERISTIC
/begin CHARACTERISTIC C_IGA_DIF_CYCNR_ER "Fade out duration when ignition time retardation difference per TDC has been detected" VALUE 0x68205 _REC_VAL_20_u1 255. _CNV_A_R_LINEAR_____13_CM 0. 255. FORMAT "%3.0" /end CHARACTERISTIC
/begin MEASUREMENT SEG_T_COR "Corrected, measured segment time, calculated every segment; after adaptation" UWORD _CNV_A_R_LINEAR_____165_CM 1 100. 0. 65535. ECU_ADDRESS 0x3fc86e FORMAT "%5.0" /end MEASUREMENT
/begin MEASUREMENT LV_SEG_AD_LIM "Boolean for segment adaptation values at limit" UBYTE _CNV_S_2_RANGE______74_CM 1 100. 0. 1. ECU_ADDRESS 0x3fd48b BIT_MASK 0x1 /end MEASUREMENT
/begin MEASUREMENT FUP_MES "measured fuel pressure value" UWORD _CNV_A_R_LINEAR_____114_CM 1 100. 0. 173888. ECU_ADDRESS 0x3fc600 FORMAT "%6.0" /end MEASUREMENT
/begin MEASUREMENT LV_FUP_CLC_SWI "logical variable for fuel pressure acquisition for port injection" UBYTE _CNV_S_2_RANGE______74_CM 1 100. 0. 1. ECU_ADDRESS 0x3fd407 /end MEASUREMENT
/begin MEASUREMENT N_GRD "Engine speed gradient" SBYTE _CNV_A_R_LINEAR_____171_CM 1 100. -4096. 4064. ECU_ADDRESS 0x3fd944 FORMAT "%4.0" /end MEASUREMENT
/begin MEASUREMENT CAM_AV_EX_0 "Actual value valve spread angle exhaust cam 0" SWORD _CNV_A_R_LINEAR_____117_CM 1 100. -768. 767.9765625 ECU_ADDRESS 0x3fd2c6 FORMAT "%7.2" /end MEASUREMENT
/begin MEASUREMENT CAM_AV_EX_1 "Actual value valve spread angle exhaust cam 1" SWORD _CNV_A_R_LINEAR_____117_CM 1 100. -768. 767.9765625 ECU_ADDRESS 0x3fd2c8 FORMAT "%7.2" /end MEASUREMENT
/begin MEASUREMENT CAM_AD_EX_FL_0_0 "" SWORD _CNV_A_R_LINEAR_____117_CM 1 100. -768. 767.9765625 ECU_ADDRESS 0x3fd2e2 FORMAT "%7.2" /end MEASUREMENT
/begin MEASUREMENT CAM_AD_EX_FL_0_1 "" SWORD _CNV_A_R_LINEAR_____117_CM 1 100. -768. 767.9765625 ECU_ADDRESS 0x3fd2e4 FORMAT "%7.2" /end MEASUREMENT
/begin MEASUREMENT CAM_AD_EX_FL_0_2 "" SWORD _CNV_A_R_LINEAR_____117_CM 1 100. -768. 767.9765625 ECU_ADDRESS 0x3fd2e6 FORMAT "%7.2" /end MEASUREMENT
/begin MEASUREMENT CAM_AD_EX_FL_0_3 "" SWORD _CNV_A_R_LINEAR_____117_CM 1 100. -768. 767.9765625 ECU_ADDRESS 0x3fd2e8 FORMAT "%7.2" /end MEASUREMENT
/begin MEASUREMENT CAM_AD_EX_FL_1_0 "" SWORD _CNV_A_R_LINEAR_____117_CM 1 100. -768. 767.9765625 ECU_ADDRESS 0x3fd2ea FORMAT "%7.2" /end MEASUREMENT
/begin MEASUREMENT CAM_AD_EX_FL_1_1 "" SWORD _CNV_A_R_LINEAR_____117_CM 1 100. -768. 767.9765625 ECU_ADDRESS 0x3fd2ec FORMAT "%7.2" /end MEASUREMENT
/begin MEASUREMENT CAM_AD_EX_FL_1_2 "" SWORD _CNV_A_R_LINEAR_____117_CM 1 100. -768. 767.9765625 ECU_ADDRESS 0x3fd2ee FORMAT "%7.2" /end MEASUREMENT
/begin MEASUREMENT CAM_AD_EX_FL_1_3 "" SWORD _CNV_A_R_LINEAR_____117_CM 1 100. -768. 767.9765625 ECU_ADDRESS 0x3fd2f0 FORMAT "%7.2" /end MEASUREMENT
/begin MEASUREMENT CAM_AD_IN_FL_0_0 "" SWORD _CNV_A_R_LINEAR_____117_CM 1 100. -768. 767.9765625 ECU_ADDRESS 0x3fd2d2 FORMAT "%7.2" /end MEASUREMENT
/begin MEASUREMENT CAM_AD_IN_FL_0_1 "" SWORD _CNV_A_R_LINEAR_____117_CM 1 100. -768. 767.9765625 ECU_ADDRESS 0x3fd2d4 FORMAT "%7.2" /end MEASUREMENT
/begin MEASUREMENT CAM_AD_IN_FL_0_2 "" SWORD _CNV_A_R_LINEAR_____117_CM 1 100. -768. 767.9765625 ECU_ADDRESS 0x3fd2d6 FORMAT "%7.2" /end MEASUREMENT
/begin MEASUREMENT CAM_AD_IN_FL_0_3 "" SWORD _CNV_A_R_LINEAR_____117_CM 1 100. -768. 767.9765625 ECU_ADDRESS 0x3fd2d8 FORMAT "%7.2" /end MEASUREMENT
/begin MEASUREMENT CAM_AD_IN_FL_1_0 "" SWORD _CNV_A_R_LINEAR_____117_CM 1 100. -768. 767.9765625 ECU_ADDRESS 0x3fd2da FORMAT "%7.2" /end MEASUREMENT
/begin MEASUREMENT CAM_AD_IN_FL_1_1 "" SWORD _CNV_A_R_LINEAR_____117_CM 1 100. -768. 767.9765625 ECU_ADDRESS 0x3fd2dc FORMAT "%7.2" /end MEASUREMENT
/begin MEASUREMENT CAM_AD_IN_FL_1_2 "" SWORD _CNV_A_R_LINEAR_____117_CM 1 100. -768. 767.9765625 ECU_ADDRESS 0x3fd2de FORMAT "%7.2" /end MEASUREMENT
/begin MEASUREMENT CAM_AD_IN_FL_1_3 "" SWORD _CNV_A_R_LINEAR_____117_CM 1 100. -768. 767.9765625 ECU_ADDRESS 0x3fd2e0 FORMAT "%7.2" /end MEASUREMENT
/begin MEASUREMENT CAM_AD_IN_0 "Adaption angle inlet cam 0" SWORD _CNV_A_R_LINEAR_____117_CM 1 100. -768. 767.9765625 ECU_ADDRESS 0x3fd2ca FORMAT "%7.2" /end MEASUREMENT
/begin MEASUREMENT CAM_AD_IN_1 "Adaption angle inlet cam 1" SWORD _CNV_A_R_LINEAR_____117_CM 1 100. -768. 767.9765625 ECU_ADDRESS 0x3fd2cc FORMAT "%7.2" /end MEASUREMENT
/begin MEASUREMENT CAM_AD_EX_0 "Adaption angle exhaust cam 0" SWORD _CNV_A_R_LINEAR_____117_CM 1 100. -768. 767.9765625 ECU_ADDRESS 0x3fd2ce FORMAT "%7.2" /end MEASUREMENT
/begin MEASUREMENT CAM_AD_EX_1 "Adaption angle exhaust cam 1" SWORD _CNV_A_R_LINEAR_____117_CM 1 100. -768. 767.9765625 ECU_ADDRESS 0x3fd2d0 FORMAT "%7.2" /end MEASUREMENT
/begin MEASUREMENT CAM_AV_IN_0 "Actual value valve spread angle inlet cam 0" SWORD _CNV_A_R_LINEAR_____117_CM 1 100. -768. 767.9765625 ECU_ADDRESS 0x3fd2c2 FORMAT "%7.2" /end MEASUREMENT
/begin MEASUREMENT CAM_AV_IN_1 "Actual value valve spread angle inlet cam 1" SWORD _CNV_A_R_LINEAR_____117_CM 1 100. -768. 767.9765625 ECU_ADDRESS 0x3fd2c4 FORMAT "%7.2" /end MEASUREMENT
/begin MEASUREMENT IVVTPWM_1 "Pulsewidth modulated signal for cam-actuator 1" UWORD _CNV_A_R_LINEAR_____144_CM 1 100. 0. 99.99847412 ECU_ADDRESS 0x3fd2f4 /end MEASUREMENT
/begin MEASUREMENT IVVTPWM_0 "Pulsewidth modulated signal for cam-actuator 0" UWORD _CNV_A_R_LINEAR_____144_CM 1 100. 0. 99.99847412 ECU_ADDRESS 0x3fd2f2 /end MEASUREMENT
/begin AXIS_PTS ldp_ecfpwm_ecf__pow_loss_ecf "" 0x6203c ECFPWM_ECF _REC_AXS_20_u1 99.609375 _CNV_A_R_LINEAR_____16_CM 8 0. 99.609375 FORMAT "%4.1" /end AXIS_PTS
/begin CHARACTERISTIC IP_POW_LOSS_ECF "" CURVE 0x6891a _REC_CUR_20_u1_u1 -5100. _CNV_A_R_LINEAR_____177_CM 0. -5100. FORMAT "%5.0"
 /begin AXIS_DESCR COM_AXIS ECFPWM_ECF _CNV_A_R_LINEAR_____16_CM 8 0. 99.609375 FORMAT "%4.1" AXIS_PTS_REF ldp_ecfpwm_ecf__pow_loss_ecf /end AXIS_DESCR
/end CHARACTERISTIC
/begin CHARACTERISTIC C_LGRD_TQ_LOSS_ECF "ECF-torque loss limitation gradient" VALUE 0x68922 _REC_VAL_20_u2 1023.96875 _CNV_A_R_LINEAR_____178_CM 0. 1023.96875 FORMAT "%7.2" /end CHARACTERISTIC
/begin AXIS_PTS ldp_acp__tq_loss_acc "" 0x61480 ACP _REC_AXS_20_u1 127.5 _CNV_A_R_LINEAR_____93_CM 6 0. 127.5 FORMAT "%6.2" /end AXIS_PTS
/begin MEASUREMENT LV_ACIN "LV switch ACC readiness" UBYTE _CNV_S_2_RANGE______76_CM 1 100. 0. 1. ECU_ADDRESS 0x3fd448 BIT_MASK 0x1 /end MEASUREMENT
/begin CHARACTERISTIC IP_FAC_TQ_AJ "Torque conversion factor for anti-jerk funktion" CURVE 0x65c98 _REC_CUR_20_u2_u1 1.99996948 _CNV_A_R_LINEAR_____5_CM 0. 1.99996948 FORMAT "%7.5"
 /begin AXIS_DESCR COM_AXIS N_32 _CNV_A_R_LINEAR_____15_CM 8 0. 8160. FORMAT "%4.0" AXIS_PTS_REF ldp_n_32__fac_tq_aj /end AXIS_DESCR
/end CHARACTERISTIC
/begin MEASUREMENT TQ_REQ_TRA_CLU "Torque request at clutch after transient torque function" SWORD _CNV_A_R_LINEAR_____37_CM 1 100. -1024. 1023.96875 ECU_ADDRESS 0x3fd0d4 FORMAT "%6.2" /end MEASUREMENT
/begin MEASUREMENT TQ_REQ_DIF_TRA "Deviation of TQ_REQ_CLU and TQ_REQ_TRA_CLU limited to \"0\" Nm" SWORD _CNV_A_R_LINEAR_____37_CM 1 100. -1024. 1023.96875 ECU_ADDRESS 0x3fd0d8 FORMAT "%6.2" /end MEASUREMENT
/begin AXIS_PTS ldpm_tco__tqi_min_pu "" 0x618bc TCO _REC_AXS_20_u1 190.5 _CNV_A_R_LINEAR_____22_CM 4 -48. 142.5 FORMAT "%5.1" /end AXIS_PTS
/begin CHARACTERISTIC IP_TQI_MIN_PU_RNG_L "Indicated engine torque minimum level at trailing throttle conditions at low range mode" MAP 0x689a2 _REC_MAP_20_u2_u1_u1 1023.96875 _CNV_A_R_LINEAR_____37_CM 0. 1023.96875 FORMAT "%7.2"
 /begin AXIS_DESCR COM_AXIS N_32 _CNV_A_R_LINEAR_____15_CM 12 0. 8160. FORMAT "%4.0" AXIS_PTS_REF ldpm_n_32__tqi_min_pu /end AXIS_DESCR
 /begin AXIS_DESCR COM_AXIS TCO _CNV_A_R_LINEAR_____22_CM 4 -48. 142.5 FORMAT "%5.1" AXIS_PTS_REF ldpm_tco__tqi_min_pu /end AXIS_DESCR
/end CHARACTERISTIC
/begin CHARACTERISTIC IP_TQI_MIN_PU "Indicated engine torque minimum level at trailing throttle conditions" MAP 0x67952 _REC_MAP_20_u2_u1_u1 1023.96875 _CNV_A_R_LINEAR_____37_CM 0. 1023.96875 FORMAT "%7.2"
 /begin AXIS_DESCR COM_AXIS N_32 _CNV_A_R_LINEAR_____15_CM 12 0. 8160. FORMAT "%4.0" AXIS_PTS_REF ldpm_n_32__tqi_min_pu /end AXIS_DESCR
 /begin AXIS_DESCR COM_AXIS TCO _CNV_A_R_LINEAR_____22_CM 4 -48. 142.5 FORMAT "%5.1" AXIS_PTS_REF ldpm_tco__tqi_min_pu /end AXIS_DESCR
/end CHARACTERISTIC
/begin CHARACTERISTIC IP_TQI_ADD_PUC "Minimum load limitation on indicatedtorque level during PUC" CURVE 0x68a02 _REC_CUR_20_u2_u1 2047.96875 _CNV_A_R_LINEAR_____65_CM -1024. 1023.96875 FORMAT "%6.2"
 /begin AXIS_DESCR COM_AXIS N_32 _CNV_A_R_LINEAR_____15_CM 12 0. 8160. FORMAT "%4.0" AXIS_PTS_REF ldpm_n_32__tqi_min_pu /end AXIS_DESCR
/end CHARACTERISTIC
/begin CHARACTERISTIC IP_TQI_ADD_PUC_RNG_L "Minimum load limitation on indicatedtorque level during PUC at low range mode" CURVE 0x68a1a _REC_CUR_20_u2_u1 2047.96875 _CNV_A_R_LINEAR_____65_CM -1024. 1023.96875 FORMAT "%6.2"
 /begin AXIS_DESCR COM_AXIS N_32 _CNV_A_R_LINEAR_____15_CM 12 0. 8160. FORMAT "%4.0" AXIS_PTS_REF ldpm_n_32__tqi_min_pu /end AXIS_DESCR
/end CHARACTERISTIC
/begin AXIS_PTS ldpm_n_fac_tq_req_driv "" 0x61754 N_32 _REC_AXS_20_u1 8160. _CNV_A_R_LINEAR_____15_CM 8 0. 8160. FORMAT "%4.0" /end AXIS_PTS
/begin AXIS_PTS ldpm_pv_av_fac_tq_req_driv "" 0x617ec PV_AV _REC_AXS_20_u1 99.609375 _CNV_A_R_LINEAR_____16_CM 8 0. 99.609375 FORMAT "%5.2" /end AXIS_PTS
/begin CHARACTERISTIC IP_FAC_TQ_REQ_DRIV_RNG_L "Scaling factor for requested torque at clutch from driver in low range mode" MAP 0x68a32 _REC_MAP_20_u2_u1_u1 1.99996948 _CNV_A_R_LINEAR_____5_CM 0. 1.99996948 FORMAT "%7.5"
 /begin AXIS_DESCR COM_AXIS N_32 _CNV_A_R_LINEAR_____15_CM 8 0. 8160. FORMAT "%4.0" AXIS_PTS_REF ldpm_n_fac_tq_req_driv /end AXIS_DESCR
 /begin AXIS_DESCR COM_AXIS PV_AV _CNV_A_R_LINEAR_____16_CM 8 0. 99.609375 FORMAT "%5.2" AXIS_PTS_REF ldpm_pv_av_fac_tq_req_driv /end AXIS_DESCR
/end CHARACTERISTIC
/begin MEASUREMENT GR_AT "Automatic transmission gear ratio" UBYTE _CNV_A_R_LINEAR_____13_CM 1 100. 0. 255. ECU_ADDRESS 0x3fd7f9 FORMAT "%3.0" /end MEASUREMENT
/begin MEASUREMENT LV_RNG_L "Logical variable for engaged low range" UBYTE _CNV_S_2_RANGE______74_CM 1 100. 0. 1. ECU_ADDRESS 0x3fd427 /end MEASUREMENT
/begin AXIS_PTS ldp_n_vs_ratio_gr_mt "" 0x617d6 N_VS_RATIO _REC_AXS_20_u1 255. _CNV_A_R_LINEAR_____13_CM 13 0. 255. FORMAT "%3.0" /end AXIS_PTS
/begin MEASUREMENT STATE_TXU_CR "Current range state" UBYTE _CNV_A_R_LINEAR_____17_CM 1 100. 0. 7. ECU_ADDRESS 0x3fd7cf FORMAT "%2.0" /end MEASUREMENT
/begin MEASUREMENT STATE_TXU_TR "Target range state" UBYTE _CNV_A_R_LINEAR_____17_CM 1 100. 0. 7. ECU_ADDRESS 0x3fd7d0 FORMAT "%2.0" /end MEASUREMENT
/begin MEASUREMENT STATE_TXU_ERR "TXU error status" UBYTE _CNV_A_R_LINEAR_____17_CM 1 100. 0. 15. ECU_ADDRESS 0x3fd7d1 FORMAT "%2.0" /end MEASUREMENT
/begin MEASUREMENT STATE_TXU "TXU status" UBYTE _CNV_A_R_LINEAR_____17_CM 1 100. 0. 15. ECU_ADDRESS 0x3fd7d2 FORMAT "%2.0" /end MEASUREMENT
/begin MEASUREMENT STATE_TXU_MT "status manual transmission" UBYTE _CNV_A_R_LINEAR_____17_CM 1 100. 0. 1. ECU_ADDRESS 0x3fd7d4 FORMAT "%2.0" /end MEASUREMENT
/begin MEASUREMENT TXU_WAL "Warning light transfer case control unit" UBYTE _CNV_A_R_LINEAR_____17_CM 1 100. 0. 1. ECU_ADDRESS 0x3fd7d5 FORMAT "%2.0" /end MEASUREMENT
/begin MEASUREMENT TXU_DISP_COGS_SUM "Display transfer case cogs" UBYTE _CNV_A_R_LINEAR_____17_CM 1 100. 0. 3. ECU_ADDRESS 0x3fd7d6 FORMAT "%2.0" /end MEASUREMENT
/begin MEASUREMENT TXU_DISP_RNG_SUM "Display transfer case range" UBYTE _CNV_A_R_LINEAR_____17_CM 1 100. 0. 3. ECU_ADDRESS 0x3fd7d7 FORMAT "%2.0" /end MEASUREMENT
/begin MEASUREMENT TXU_DISP_GEAR_SUM "Display transfer case gear" UBYTE _CNV_A_R_LINEAR_____17_CM 1 100. 0. 15. ECU_ADDRESS 0x3fd7d8 FORMAT "%2.0" /end MEASUREMENT
/begin AXIS_PTS ldp_gr_at_n_tur "" 0x6152c GR_AT _REC_AXS_20_u1 8. _CNV_A_R_LINEAR_____17_CM 13 0. 8. FORMAT "%1.0" /end AXIS_PTS
/begin CHARACTERISTIC LC_TQ_INTV_ENA_AS "Logical constant fast torque intervention enabled by application system" VALUE 0x67d8e _REC_VAL_20_u1 1. _CNV_A_R_LINEAR_____13_CM 0. 1. FORMAT "%1.0" /end CHARACTERISTIC
/begin CHARACTERISTIC LC_TAM_MAN_AS "Logical constant switch TAM from CAN or application system" VALUE 0x68c46 _REC_VAL_20_u1 1. _CNV_A_R_LINEAR_____13_CM 0. 1. FORMAT "%1.0" /end CHARACTERISTIC
/begin CHARACTERISTIC C_TAM_MAN_AS "Ambient temperature TAM by application system" VALUE 0x68c47 _REC_VAL_20_u1 190.5 _CNV_A_R_LINEAR_____22_CM -48. 142.5 FORMAT "%5.1" /end CHARACTERISTIC
/begin CHARACTERISTIC C_MAF_REF "reference air mass flow for rl" VALUE 0x67be6 _REC_VAL_20_u2 1389. _CNV_A_R_LINEAR_____56_CM 0. 1389. FORMAT "%4.0" /end CHARACTERISTIC
/begin CHARACTERISTIC C_MIN_VS_RATIO "Minimum engine speed / vehicle speed ratio calculation" VALUE 0x68c48 _REC_VAL_20_u1 255. _CNV_A_R_LINEAR_____43_CM 0. 255. FORMAT "%3.0" /end CHARACTERISTIC
/begin CHARACTERISTIC LC_RNG_L_MAN_AS "logical constant for to activate IP_FAC_TQ_REQ_DRIV_RNG_L (low range mode) in case if LV_RNG_L = 0 (default value = 0)" VALUE 0x68c49 _REC_VAL_20_u1 1. _CNV_A_R_LINEAR_____17_CM 0. 1. FORMAT "%2.0" /end CHARACTERISTIC
/begin CHARACTERISTIC IP_FAC_CONV__TOIL "Converter characteristic" CURVE 0x65bc4 _REC_CUR_20_u2_u1 4.88e-004 _CNV_A_R_LINEAR_____184_CM 0. 4.88e-004 FORMAT "%8.7"
 /begin AXIS_DESCR COM_AXIS TOIL _CNV_A_R_LINEAR_____32_CM 8 -40. 160. FORMAT "%3.0" AXIS_PTS_REF ldp_toil_fac_conv /end AXIS_DESCR
/end CHARACTERISTIC
/begin CHARACTERISTIC C_EXC_INI "initialization value of valve lift eccentric" VALUE 0x68dcc _REC_VAL_20_u2 99.99847412 _CNV_A_R_LINEAR_____144_CM 0. 99.99847412 /end CHARACTERISTIC
/begin CHARACTERISTIC C_STATE_VVL "Calibratable State Bit of VVL Basic Function (Command to VVL conrol unit)" VALUE 0x68dce _REC_VAL_20_u1 7. _CNV_A_R_LINEAR_____17_CM 0. 7. FORMAT "%2.0" /end CHARACTERISTIC
/begin CHARACTERISTIC C_STATE_VVL_AD "Calibratable State Bit of Valve Lift Learning (Command to VVL conrol unit)" VALUE 0x68dcf _REC_VAL_20_u1 7. _CNV_A_R_LINEAR_____17_CM 0. 7. FORMAT "%2.0" /end CHARACTERISTIC
/begin AXIS_PTS ldp_vs_n_tur "" 0x61ace VS _REC_AXS_20_u1 255. _CNV_A_R_LINEAR_____43_CM 2 0. 255. FORMAT "%3.0" /end AXIS_PTS
/begin MEASUREMENT TOIL "Oil temperature" UBYTE _CNV_A_R_LINEAR_____32_CM 1 100. -40. 160. ECU_ADDRESS 0x3fd95d FORMAT "%3.0" /end MEASUREMENT
/begin MEASUREMENT TOIL_STOP "Oil temperature at transition to ES" UBYTE _CNV_A_R_LINEAR_____32_CM 1 100. -40. 160. ECU_ADDRESS 0x3fd95e FORMAT "%3.0" /end MEASUREMENT
/begin MEASUREMENT LV_CAN_EGS_LIH "Logical value gear box limp home" UBYTE _CNV_S_2_RANGE______74_CM 1 100. 0. 1. ECU_ADDRESS 0x3fd443 BIT_MASK 0x1 /end MEASUREMENT
/begin AXIS_PTS ldp_tps_av__tps_grd_max_er "" 0x61e68 TPS_AV _REC_AXS_20_u2 119.5 _CNV_A_R_LINEAR_____34_CM 6 0. 119.5 FORMAT "%7.3" /end AXIS_PTS
/begin CHARACTERISTIC IP_TPS_GRD_MAX_ER__TPS_AV "Maximum throttle gradient threshold for fade out condition" CURVE 0x681f4 _REC_CUR_20_u1_u2 2987.5 _CNV_A_R_LINEAR_____81_CM 0. 2987.5 FORMAT "%6.1"
 /begin AXIS_DESCR COM_AXIS TPS_AV _CNV_A_R_LINEAR_____34_CM 6 0. 119.5 FORMAT "%7.3" AXIS_PTS_REF ldp_tps_av__tps_grd_max_er /end AXIS_DESCR
/end CHARACTERISTIC
/begin CHARACTERISTIC IP_T_DEC_TRA_1_AT "Time constant for torque decrease 1 for automatic transmission" MAP 0x66bea _REC_MAP_20_u1_u1_u1 2.55 _CNV_A_R_LINEAR_____21_CM 0. 2.55 FORMAT "%3.2"
 /begin AXIS_DESCR COM_AXIS N_32 _CNV_A_R_LINEAR_____15_CM 8 0. 8160. FORMAT "%4.0" AXIS_PTS_REF ldpm_n_110 /end AXIS_DESCR
 /begin AXIS_DESCR COM_AXIS GR_AT _CNV_A_R_LINEAR_____13_CM 13 0. 255. FORMAT "%3.0" AXIS_PTS_REF ldpm_gr_at_2 /end AXIS_DESCR
/end CHARACTERISTIC
/begin MEASUREMENT NR_PAT_SCC "Selected index of fuel cut-off pattern" UBYTE _CNV_A_R_LINEAR_____13_CM 1 100. 0. 255. ECU_ADDRESS 0x3fd99d FORMAT "%3.0" /end MEASUREMENT
/begin MEASUREMENT TQI_REF_IGA_MIN_SCC "indicated reference torque for single cylinder cut-off " UWORD _CNV_A_R_LINEAR_____65_CM 1 100. -1024. 1023.96875 ECU_ADDRESS 0x3fd12e FORMAT "%6.2" /end MEASUREMENT
/begin CHARACTERISTIC C_EFF_SCC_SP_HYS "Hysteresis applied on EFF_SCC_SP for NR_PAT_SCC calculation" VALUE 0x67b78 _REC_VAL_20_u2 1.99996948 _CNV_A_R_LINEAR_____5_CM 0. 1.99996948 FORMAT "%7.5" /end CHARACTERISTIC
/begin CHARACTERISTIC C_EFF_SCC_SP_MAN "setpoint for efficiency of fuel cut-off set by application intervention" VALUE 0x69144 _REC_VAL_20_u2 1.99996948 _CNV_A_R_LINEAR_____5_CM 0. 1.99996948 FORMAT "%7.5" /end CHARACTERISTIC
/begin CHARACTERISTIC C_HYS_EFF_IGA_MIN_TEG "hysteresis in falling direction for IGA_MIN_TEG correction" VALUE 0x69146 _REC_VAL_20_u2 1.99996948 _CNV_A_R_LINEAR_____5_CM 0. 1.99996948 FORMAT "%7.5" /end CHARACTERISTIC
/begin CHARACTERISTIC C_MIN_DEC_EFF_IGA_MIN_TEG_1 "minimum decrement for first decrease phase " VALUE 0x69148 _REC_VAL_20_u2 1.99996948 _CNV_A_R_LINEAR_____5_CM 0. 1.99996948 FORMAT "%7.5" /end CHARACTERISTIC
/begin CHARACTERISTIC C_MIN_DEC_EFF_IGA_MIN_TEG_2 "minimum decrement for second decrease phase " VALUE 0x6914a _REC_VAL_20_u2 1.99996948 _CNV_A_R_LINEAR_____5_CM 0. 1.99996948 FORMAT "%7.5" /end CHARACTERISTIC
/begin CHARACTERISTIC LC_ENA_EFF_SCC_BAS_MAN "logical variable for manually adjusting basic efficiency fuel cut-off" VALUE 0x6914d _REC_VAL_20_u1 1. _CNV_A_R_LINEAR_____17_CM 0. 1. FORMAT "%2.0" /end CHARACTERISTIC
/begin CHARACTERISTIC C_EFF_SCC_BAS_MAN "manually adjusted basic efficiency fuel cut-off" VALUE 0x6914e _REC_VAL_20_u2 1.99996948 _CNV_A_R_LINEAR_____5_CM 0. 1.99996948 FORMAT "%7.5" /end CHARACTERISTIC
/begin MEASUREMENT EFF_IGA_MIN_SCC "minimum reference efficiency for single cylinder cut-off " UWORD _CNV_A_R_LINEAR_____5_CM 1 100. 0. 1.99996948 ECU_ADDRESS 0x3fd136 FORMAT "%7.5" /end MEASUREMENT
/begin MEASUREMENT LV_AUTH_TQ_PAT "Logical variable for authorizing fuel cut-off pattern" UBYTE _CNV_S_2_RANGE______74_CM 1 100. 0. 1. ECU_ADDRESS 0x3fd582 /end MEASUREMENT
/begin CHARACTERISTIC LC_EFF_SCC_SP_MAN "flag for setting EFF_SCC_SP by application system" VALUE 0x6914c _REC_VAL_20_u1 1. _CNV_A_R_LINEAR_____17_CM 0. 1. FORMAT "%2.0" /end CHARACTERISTIC
/begin CHARACTERISTIC LC_ENA_FCUT_TOT_GS "logical variable for setting scaling factor due to gear shift intervention" VALUE 0x69150 _REC_VAL_20_u1 1. _CNV_A_R_LINEAR_____17_CM 0. 1. FORMAT "%2.0" /end CHARACTERISTIC
/begin CHARACTERISTIC LC_INH_FCUT_GS "inhibition flag for fuel cut-off due to gear shift intervention" VALUE 0x69152 _REC_VAL_20_u1 1. _CNV_A_R_LINEAR_____17_CM 0. 1. FORMAT "%2.0" /end CHARACTERISTIC
/begin CHARACTERISTIC LC_INH_FCUT_N_MAX "inhibition flag for fuel cut-off due to speed limitation" VALUE 0x69153 _REC_VAL_20_u1 1. _CNV_A_R_LINEAR_____17_CM 0. 1. FORMAT "%2.0" /end CHARACTERISTIC
/begin CHARACTERISTIC LC_TQ_SCC_INH_MAN "inhibition flag for fuel cut-off due to torque management" VALUE 0x69154 _REC_VAL_20_u1 1. _CNV_A_R_LINEAR_____17_CM 0. 1. FORMAT "%2.0" /end CHARACTERISTIC
/begin CHARACTERISTIC LC_TQ_SCC_ENA_MAN "flag for enabling SCC by application system" VALUE 0x69155 _REC_VAL_20_u1 1. _CNV_A_R_LINEAR_____17_CM 0. 1. FORMAT "%2.0" /end CHARACTERISTIC
/begin CHARACTERISTIC C_FAC_IGA_MIN_TEG_IGA_BAS "manually adjusted scaling factor for efficiency calculation with EFF_IGA_MIN_TEG and EFF_IGA_BAS_COR" VALUE 0x69156 _REC_VAL_20_u2 1. _CNV_A_R_LINEAR_____192_CM 0. 1. FORMAT "%6.4" /end CHARACTERISTIC
/begin MEASUREMENT FAC_IGA_MIN_TEG_IGA_BAS "scaling factor for efficiency calculation with EFF_IGA_MIN_TEG and EFF_IGA_BAS_COR" UWORD _CNV_A_R_LINEAR_____5_CM 1 100. 0. 1.99996948 ECU_ADDRESS 0x3fd140 FORMAT "%7.5" /end MEASUREMENT
/begin AXIS_PTS ldp_n_dif_st "" 0x61742 N_DIF_ST _REC_AXS_20_u2 65535. _CNV_A_R_LINEAR_____53_CM 8 -32768. 32767. FORMAT "%6.0" /end AXIS_PTS
/begin CHARACTERISTIC IP_TQ_ADD_CH "basic torque increase for catalyst heating" MAP 0x6765e _REC_MAP_20_u2_u1_u2 2047.96875 _CNV_A_R_LINEAR_____65_CM -1024. 1023.96875 FORMAT "%6.2"
 /begin AXIS_DESCR COM_AXIS N_32 _CNV_A_R_LINEAR_____15_CM 8 0. 8160. FORMAT "%4.0" AXIS_PTS_REF ldp_n_32__tq_add_ch /end AXIS_DESCR
 /begin AXIS_DESCR COM_AXIS FAC_TQ_REQ_CLU _CNV_A_R_LINEAR_____5_CM 8 0. 1.99996948 FORMAT "%7.5" AXIS_PTS_REF ldp_fac_tq_req_clu__tq_add_ch /end AXIS_DESCR
/end CHARACTERISTIC
/begin CHARACTERISTIC C_TQ_ADD_HYS "Torque lead hysteresis for deactivation torque lead request" VALUE 0x67cfe _REC_VAL_20_s2 2047.96875 _CNV_A_R_LINEAR_____37_CM -1024. 1023.96875 FORMAT "%7.1" /end CHARACTERISTIC
/begin MEASUREMENT GEAR_INFO "Gear information from EGS-ECU" UBYTE _CNV_A_R_LINEAR_____17_CM 1 100. 0. 7. ECU_ADDRESS 0x3fd818 FORMAT "%2.0" /end MEASUREMENT
/begin MEASUREMENT TQI_TXU "Torque override for TXU function" UBYTE _CNV_A_R_LINEAR_____16_CM 1 100. 0. 99.609375 ECU_ADDRESS 0x3fd7d3 FORMAT "%5.2" /end MEASUREMENT
/begin MEASUREMENT LV_ASR_REQ "logical variable for ASR request" UBYTE _CNV_S_2_RANGE______74_CM 1 100. 0. 1. ECU_ADDRESS 0x3fd433 /end MEASUREMENT
/begin MEASUREMENT TQI_MSR_CAN "relative indicated engine torque requested by MSR" UBYTE _CNV_A_R_LINEAR_____16_CM 1 100. 0. 99.609375 ECU_ADDRESS 0x3fd80c FORMAT "%5.1" /end MEASUREMENT
/begin MEASUREMENT TQI_ASR_SLOW_CAN "relative indicated engine torque requested by ASR (slow path)" UBYTE _CNV_A_R_LINEAR_____16_CM 1 100. 0. 99.609375 ECU_ADDRESS 0x3fd80d FORMAT "%5.1" /end MEASUREMENT
/begin MEASUREMENT LV_MSR_REQ "logical variable for MSR request" UBYTE _CNV_S_2_RANGE______74_CM 1 100. 0. 1. ECU_ADDRESS 0x3fd434 /end MEASUREMENT
/begin MEASUREMENT VS_CAN "vehicle speed signal from CAN" UBYTE _CNV_A_R_LINEAR_____43_CM 1 100. 0. 255. ECU_ADDRESS 0x3fd80e FORMAT "%3.0" /end MEASUREMENT
/begin MEASUREMENT WHEEL "vehicle speed signal from CAN for cruise control" UWORD _CNV_A_R_LINEAR_____153_CM 1 100. 0. 511.99218 ECU_ADDRESS 0x3fc73e FORMAT "%7.3" /end MEASUREMENT
/begin MEASUREMENT LV_PLAUS_ASR_CTL "logical variable for ASR intervention is active" UBYTE _CNV_S_2_RANGE______74_CM 1 100. 0. 1. ECU_ADDRESS 0x3fd436 /end MEASUREMENT
/begin MEASUREMENT LV_PLAUS_ESP_CTL "logical variable for DSC intervention is active" UBYTE _CNV_S_2_RANGE______74_CM 1 100. 0. 1. ECU_ADDRESS 0x3fd438 /end MEASUREMENT
/begin MEASUREMENT TQ_AD_ADD_S_SWI "Adaptive engine torque value for switch between hom. and strat." SWORD _CNV_A_R_LINEAR_____37_CM 1 100. -1024. 1023.96875 ECU_ADDRESS 0x3fd068 FORMAT "%7.1" /end MEASUREMENT
/begin MEASUREMENT TQ_ADD_SO2P "Adaptive engine torque value for switch between hom. and strat." SWORD _CNV_A_R_LINEAR_____37_CM 1 100. -1024. 1023.96875 ECU_ADDRESS 0x3fd076 FORMAT "%7.1" /end MEASUREMENT
/begin MEASUREMENT TQI_REQ_LIM_FAST "???" SWORD _CNV_A_R_LINEAR_____37_CM 1 100. -1024. 1023.96875 ECU_ADDRESS 0x3fd072 FORMAT "%7.1" /end MEASUREMENT
/begin MEASUREMENT TQI_REQ_LIM_SLOW "???" SWORD _CNV_A_R_LINEAR_____37_CM 1 100. -1024. 1023.96875 ECU_ADDRESS 0x3fd074 FORMAT "%7.1" /end MEASUREMENT
/begin MEASUREMENT LV_GS_ACT "Logical variable for torque intervention due to gear shift" UBYTE _CNV_S_2_RANGE______74_CM 1 100. 0. 1. ECU_ADDRESS 0x3fd4a7 BIT_MASK 0x1 /end MEASUREMENT
/begin CHARACTERISTIC C_T_MAX_TQR_GS_INTV "Maximum duration of torque reduction due to gear shift intervention" VALUE 0x691cc _REC_VAL_20_u2 655.35 _CNV_A_R_LINEAR_____21_CM 0. 655.35 FORMAT "%6.2" /end CHARACTERISTIC
/begin MEASUREMENT T_TQR_GS_INTV "duration of gear shift torque intervention" UWORD _CNV_A_R_LINEAR_____21_CM 1 100. 0. 655.35 ECU_ADDRESS 0x3fc8c4 FORMAT "%6.2" /end MEASUREMENT
/begin MEASUREMENT LV_ETCU_DISABLE "Logical variable for disabling GS intervention due to EMS error" UBYTE _CNV_S_2_RANGE______74_CM 1 100. 0. 1. ECU_ADDRESS 0x3fd4a5 BIT_MASK 0x1 /end MEASUREMENT
/begin MEASUREMENT TQI_ASR_FAST_CAN "relative indicated engine torque requested by ASR (fast path)" UBYTE _CNV_A_R_LINEAR_____16_CM 1 100. 0. 99.609375 ECU_ADDRESS 0x3fd80b FORMAT "%5.1" /end MEASUREMENT
/begin MEASUREMENT EFF_TOT_BAS "Total basic efficiency" UWORD _CNV_A_R_LINEAR_____5_CM 1 100. 0. 1.99996948 ECU_ADDRESS 0x3fd0bc FORMAT "%7.5" /end MEASUREMENT
/begin MEASUREMENT EFF_TOT_BAS_SLOW "Total basic efficiency for feedback to slow torque path" UWORD _CNV_A_R_LINEAR_____5_CM 1 100. 0. 1.99996948 ECU_ADDRESS 0x3fd0be FORMAT "%7.5" /end MEASUREMENT
/begin CHARACTERISTIC LC_MOD_EFF_AV "Logical variable switch to EFF_LAMB_AV and EFF_SCC_AV calculation mode for TQI_BAS" VALUE 0x691d5 _REC_VAL_20_u1 1. _CNV_A_R_LINEAR_____13_CM 0. 1. FORMAT "%1.0" /end CHARACTERISTIC
/begin MEASUREMENT EFF_LAMB_SP_BAS "Basic lambda setpoint efficiency" UWORD _CNV_A_R_LINEAR_____5_CM 1 100. 0. 1.99996948 ECU_ADDRESS 0x3fcc90 FORMAT "%7.5" /end MEASUREMENT
/begin MEASUREMENT LAMB_REF "Lambda reference valua" UWORD _CNV_A_R_LINEAR_____50_CM 1 100. 0. 31.99902344 ECU_ADDRESS 0x3fcc92 /end MEASUREMENT
/begin MEASUREMENT LAMB_DIF_SP_BAS "Basic lambda setpoint difference to corrected reference lambda" SWORD _CNV_A_R_LINEAR_____106_CM 1 100. -32.00000000125 31.99902343875 ECU_ADDRESS 0x3fcc9c /end MEASUREMENT
/begin CHARACTERISTIC C_CRLC_AMP_AD "Correlation constants for the ambient pressure adaptation" VALUE 0x67b64 _REC_VAL_20_u1 0.9960940000000002 _CNV_A_R_LINEAR_____8_CM 0. 0.996094 FORMAT "%5.3" /end CHARACTERISTIC
/begin CHARACTERISTIC C_TCO_THD_AMP_AD "Threshold of TCO in case of no working load sensor" VALUE 0x691d6 _REC_VAL_20_u1 190.5 _CNV_A_R_LINEAR_____22_CM -48. 142.5 FORMAT "%5.1" /end CHARACTERISTIC
/begin CHARACTERISTIC C_TQ_ADD_MIN "Minimum threshold for authorizing torque lead request" VALUE 0x67d02 _REC_VAL_20_s2 2047.96875 _CNV_A_R_LINEAR_____37_CM -1024. 1023.96875 FORMAT "%7.1" /end CHARACTERISTIC
/begin CHARACTERISTIC LC_INH_TQ_ADD_CH "Logical constant for deactivation torque-reserve request for catalyst heating" VALUE 0x691d7 _REC_VAL_20_u1 1. _CNV_A_R_LINEAR_____17_CM 0. 1. FORMAT "%2.0" /end CHARACTERISTIC
/begin CHARACTERISTIC LC_INH_TQ_ADD "Logical constant for deactivation general torque-reserve request" VALUE 0x691d8 _REC_VAL_20_u1 1. _CNV_A_R_LINEAR_____17_CM 0. 1. FORMAT "%2.0" /end CHARACTERISTIC
/begin AXIS_PTS ldp_n_32__fac_tq_aj "" 0x6162e N_32 _REC_AXS_20_u1 8160. _CNV_A_R_LINEAR_____15_CM 8 0. 8160. FORMAT "%4.0" /end AXIS_PTS
/begin AXIS_PTS ldp_n_32__fac_tq_req_clu_is "" 0x6207a N_32 _REC_AXS_20_u1 8160. _CNV_A_R_LINEAR_____15_CM 3 0. 8160. FORMAT "%4.0" /end AXIS_PTS
/begin CHARACTERISTIC IP_FAC_TQ_REQ_DRIV "Scaling factor for requested torque at clutch from driver" MAP 0x65cc8 _REC_MAP_20_u2_u1_u1 1.99996948 _CNV_A_R_LINEAR_____5_CM 0. 1.99996948 FORMAT "%7.5"
 /begin AXIS_DESCR COM_AXIS N_32 _CNV_A_R_LINEAR_____15_CM 8 0. 8160. FORMAT "%4.0" AXIS_PTS_REF ldpm_n_fac_tq_req_driv /end AXIS_DESCR
 /begin AXIS_DESCR COM_AXIS PV_AV _CNV_A_R_LINEAR_____16_CM 8 0. 99.609375 FORMAT "%5.2" AXIS_PTS_REF ldpm_pv_av_fac_tq_req_driv /end AXIS_DESCR
/end CHARACTERISTIC
/begin CHARACTERISTIC IP_FAC_TQ_REQ_CLU_IS__N_32 "Threshold on FAC_TQ_REQ_CLU for IS detection" CURVE 0x691da _REC_CUR_20_u2_u1 1.99996948 _CNV_A_R_LINEAR_____5_CM 0. 1.99996948 FORMAT "%7.5"
 /begin AXIS_DESCR COM_AXIS N_32 _CNV_A_R_LINEAR_____15_CM 3 0. 8160. FORMAT "%4.0" AXIS_PTS_REF ldp_n_32__fac_tq_req_clu_is /end AXIS_DESCR
/end CHARACTERISTIC
/begin CHARACTERISTIC C_FAC_TQ_REQ_CLU_IS_HYS "Hysteresis on threshold on FAC_TQ_REQ_CLU_for IS detection" VALUE 0x691e0 _REC_VAL_20_u2 1.99996948 _CNV_A_R_LINEAR_____5_CM 0. 1.99996948 FORMAT "%7.5" /end CHARACTERISTIC
/begin MEASUREMENT LV_ERR_VS_CAN "logical variable for VS_CAN error" UBYTE _CNV_S_2_RANGE______77_R_CM 1 100. 0. 255. ECU_ADDRESS 0x3fd435 /end MEASUREMENT
/begin MEASUREMENT LV_CAN_FRS "logical variable fuel reserve" UBYTE _CNV_S_2_RANGE______77_R_CM 1 100. 0. 255. ECU_ADDRESS 0x3fd44b /end MEASUREMENT
/begin MEASUREMENT TQI_GS_SLOW_DEC "Torque decrement for slow torque intervention during gear shift" UWORD _CNV_A_R_LINEAR_____37_CM 1 100. 0. 1023.96875 ECU_ADDRESS 0x3fc8c2 FORMAT "%7.2" /end MEASUREMENT
/begin MEASUREMENT TQI_GS_SLOW_INC "???" UWORD _CNV_A_R_LINEAR_____37_CM 1 100. 0. 1023.96875 ECU_ADDRESS 0x3fd07a FORMAT "%7.2" /end MEASUREMENT
/begin MEASUREMENT TQI_GS_FAST_INC "???" UWORD _CNV_A_R_LINEAR_____37_CM 1 100. 0. 1023.96875 ECU_ADDRESS 0x3fd078 FORMAT "%7.2" /end MEASUREMENT
/begin AXIS_PTS ldp_n_32__tq_add_ch "" 0x61664 N_32 _REC_AXS_20_u1 8160. _CNV_A_R_LINEAR_____15_CM 8 0. 8160. FORMAT "%4.0" /end AXIS_PTS
/begin AXIS_PTS ldp_n_32__tq_loss_acc "" 0x6207e N_32 _REC_AXS_20_u1 8160. _CNV_A_R_LINEAR_____15_CM 6 0. 8160. FORMAT "%4.0" /end AXIS_PTS
/begin AXIS_PTS ldp_tq_accin_can__tq_loss_acc "" 0x62085 TQ_ACCIN_CAN _REC_AXS_20_u1 31. _CNV_A_R_LINEAR_____86_CM 6 0. 31. FORMAT "%3.0" /end AXIS_PTS
/begin CHARACTERISTIC IP_TQ_LOSS_ACC "ACC torque loss due to engine-speed and ACC fluid-pressure" MAP 0x677f2 _REC_MAP_20_u2_u1_u1 2047.96875 _CNV_A_R_LINEAR_____65_CM -1024. 1023.96875 FORMAT "%6.2"
 /begin AXIS_DESCR COM_AXIS N_32 _CNV_A_R_LINEAR_____15_CM 6 0. 8160. FORMAT "%7.4" AXIS_PTS_REF ldp_n__tq_loss_acc /end AXIS_DESCR
 /begin AXIS_DESCR COM_AXIS ACP _CNV_A_R_LINEAR_____93_CM 6 0. 127.5 FORMAT "%6.2" AXIS_PTS_REF ldp_acp__tq_loss_acc /end AXIS_DESCR
/end CHARACTERISTIC
/begin CHARACTERISTIC IP_TQ_LOSS_ACC_INP "ACC torque loss due to engine-speed and ACC torque demand" MAP 0x691e2 _REC_MAP_20_u2_u1_u1 2047.96875 _CNV_A_R_LINEAR_____65_CM -1024. 1023.96875 FORMAT "%6.2"
 /begin AXIS_DESCR COM_AXIS N_32 _CNV_A_R_LINEAR_____15_CM 6 0. 8160. FORMAT "%4.0" AXIS_PTS_REF ldp_n_32__tq_loss_acc /end AXIS_DESCR
 /begin AXIS_DESCR COM_AXIS TQ_ACCIN_CAN _CNV_A_R_LINEAR_____86_CM 6 0. 31. FORMAT "%3.0" AXIS_PTS_REF ldp_tq_accin_can__tq_loss_acc /end AXIS_DESCR
/end CHARACTERISTIC
/begin CHARACTERISTIC C_T_AST_SWI_WUP "Time condition for setting the bit S_WL" VALUE 0x67c46 _REC_VAL_20_u2 6553.5 _CNV_A_R_LINEAR_____18_CM 0. 6553.5 FORMAT "%6.1" /end CHARACTERISTIC
/begin CHARACTERISTIC C_PV_CAN_DIAG "limitation of PV_CAN at MTC error is active" VALUE 0x6922a _REC_VAL_20_u1 99.609375 _CNV_A_R_LINEAR_____16_CM 0. 99.609375 FORMAT "%4.1" /end CHARACTERISTIC
/begin MEASUREMENT LV_ACK_TCS "Logical variable TCS acknowledge" UBYTE _CNV_S_2_RANGE______74_CM 1 100. 0. 1. ECU_ADDRESS 0x3fd442 BIT_MASK 0x1 /end MEASUREMENT
/begin CHARACTERISTIC C_T_CTR_MAX_ASR_CAN "maximum value timeout counter ASC message (default value 10)" VALUE 0x6922c _REC_VAL_20_u1 2.55 _CNV_A_R_LINEAR_____21_CM 0. 2.55 FORMAT "%4.2" /end CHARACTERISTIC
/begin CHARACTERISTIC C_MAX_MSG_MISS_ASR_CAN "maximum number of mised ASC messages (default value 10)" VALUE 0x6922d _REC_VAL_20_u1 255. _CNV_A_R_LINEAR_____13_CM 0. 255. FORMAT "%3.0" /end CHARACTERISTIC
/begin MEASUREMENT TQI_ADD_ACT "Active indicated engine torque inclusive torque reserve" SWORD _CNV_A_R_LINEAR_____37_CM 1 100. -1024. 1023.96875 ECU_ADDRESS 0x3fd0e2 FORMAT "%6.2" /end MEASUREMENT
/begin MEASUREMENT TQI_ADD_ACT_TMP_1 "Temporary indicated engine-torque request inclusive torque reserve - for slow torque coordination input" SWORD _CNV_A_R_LINEAR_____37_CM 1 100. -1024. 1023.96875 ECU_ADDRESS 0x3fd0f6 FORMAT "%6.2" /end MEASUREMENT
/begin MEASUREMENT TQI_ADD_ACT_TMP_2 "Indicated engine-torque request inclusive torque reserve - for general torque-reserve request" SWORD _CNV_A_R_LINEAR_____37_CM 1 100. -1024. 1023.96875 ECU_ADDRESS 0x3fd0f8 FORMAT "%6.2" /end MEASUREMENT
/begin MEASUREMENT TQI_ADD_ACT_TMP_3 "Indicated engine-torque request inclusive torque reserve - for catalyst-heating torque-reserve request" SWORD _CNV_A_R_LINEAR_____37_CM 1 100. -1024. 1023.96875 ECU_ADDRESS 0x3fd0fa FORMAT "%6.2" /end MEASUREMENT
/begin MEASUREMENT TQI_ADD_MAX_TOL "Maximum possible indicated engine torque inclusive torque reserve at IGA_MIN" SWORD _CNV_A_R_LINEAR_____37_CM 1 100. -1024. 1023.96875 ECU_ADDRESS 0x3fd0f4 FORMAT "%6.2" /end MEASUREMENT
/begin MEASUREMENT TQI_ADD_MAX_TEG "Maximum possible indicated engine torque inclusive torque reserve at IGA_MIN_TEG" SWORD _CNV_A_R_LINEAR_____37_CM 1 100. -1024. 1023.96875 ECU_ADDRESS 0x3fd0f0 FORMAT "%6.2" /end MEASUREMENT
/begin MEASUREMENT TQ_ADD_REQ_ACT "Actual realized torque-reserve-request for slow torque coordination input" SWORD _CNV_A_R_LINEAR_____37_CM 1 100. -1024. 1023.96875 ECU_ADDRESS 0x3fd0e8 FORMAT "%6.2" /end MEASUREMENT
/begin MEASUREMENT TQ_ADD_REQ_CH "Requested torque reserve for catalyt-heating" SWORD _CNV_A_R_LINEAR_____37_CM 1 100. -1024. 1023.96875 ECU_ADDRESS 0x3fd0fc FORMAT "%6.2" /end MEASUREMENT
/begin MEASUREMENT TQ_ADD_MAX "Maximum possible torque reserve" SWORD _CNV_A_R_LINEAR_____37_CM 1 100. -1024. 1023.96875 ECU_ADDRESS 0x3fd0f2 FORMAT "%6.2" /end MEASUREMENT
/begin MEASUREMENT TQ_ADD_REQ_MAX_TEG "Maximum possible torque reserve request due to EFF_IGA_MIN_TEG" SWORD _CNV_A_R_LINEAR_____37_CM 1 100. -1024. 1023.96875 ECU_ADDRESS 0x3fd0e0 FORMAT "%6.2" /end MEASUREMENT
/begin MEASUREMENT MAF_KGH_ADD_MAX "Maximum possible engine load for catalyst heating - kg/h" UWORD _CNV_A_R_LINEAR_____52_CM 1 100. 0. 2047.96875 ECU_ADDRESS 0x3fd0ea FORMAT "%7.2" /end MEASUREMENT
/begin MEASUREMENT MAF_ADD_MAX "Maximum possible engine load for catalyst heating - mg/Stk" UWORD _CNV_A_R_LINEAR_____56_CM 1 100. 0. 1389. ECU_ADDRESS 0x3fd0ec FORMAT "%7.2" /end MEASUREMENT
/begin MEASUREMENT EFF_IGA_MIN_ADD_MAX "Minimum possible ignition efficiency for catalyst heating" UWORD _CNV_A_R_LINEAR_____5_CM 1 100. 0. 1.99996948 ECU_ADDRESS 0x3fd0ee FORMAT "%7.5" /end MEASUREMENT
/begin AXIS_PTS ldpm_n_32_100 "" 0x61c41 N_32 _REC_AXS_20_u1 8160. _CNV_A_R_LINEAR_____15_CM 16 0. 8160. FORMAT "%4.0" /end AXIS_PTS
/begin MEASUREMENT LV_CT "Logical variable detection of driver passive" UBYTE _CNV_S_2_RANGE______74_CM 1 100. 0. 1. ECU_ADDRESS 0x3fd46c BIT_MASK 0x1 /end MEASUREMENT
/begin MEASUREMENT TQI_CAT_PROT "???" SWORD _CNV_A_R_LINEAR_____37_CM 1 100. -1024. 1023.96875 ECU_ADDRESS 0x3fd05a FORMAT "%6.2" /end MEASUREMENT
/begin MEASUREMENT STATE_CC "state of converter clutch (CC)" UBYTE _CNV_S_4_RANGE_STAT_203_CM 1 100. 0. 3. ECU_ADDRESS 0x3fd81a /end MEASUREMENT
/begin CHARACTERISTIC LC_INH_FCUT_ASR "inhibition flag for fuel cut-off due to ASR" VALUE 0x69151 _REC_VAL_20_u1 1. _CNV_A_R_LINEAR_____17_CM 0. 1. FORMAT "%2.0" /end CHARACTERISTIC
/begin MEASUREMENT LV_ACCIN "LV ACC request" UBYTE _CNV_S_2_RANGE______76_CM 1 100. 0. 1. ECU_ADDRESS 0x3fd449 BIT_MASK 0x1 /end MEASUREMENT
/begin MEASUREMENT LV_FCUT_FAST "Logical variable for authorizing fuel cut off pattern" UBYTE _CNV_S_2_RANGE______76_CM 1 100. 0. 1. ECU_ADDRESS 0x3fd583 BIT_MASK 0x1 /end MEASUREMENT
/begin MEASUREMENT T_MAX_FCUT_FAST "time counter for clutch switch observation fast fuel cut off" UBYTE _CNV_A_R_LINEAR_____21_CM 1 100. 0. 2.55 ECU_ADDRESS 0x3fd99e FORMAT "%4.2" /end MEASUREMENT
/begin CHARACTERISTIC C_TCO_MIN_FCUT_FAST "min. coolant temperature fast fuel cut-off" VALUE 0x69249 _REC_VAL_20_u1 190.5 _CNV_A_R_LINEAR_____22_CM -48. 142.5 FORMAT "%5.1" /end CHARACTERISTIC
/begin CHARACTERISTIC C_MAF_DIF_MIN_FCUT_FAST "min. load decrease fast fuel cut-off" VALUE 0x6924a _REC_VAL_20_u1 1389. _CNV_A_R_LINEAR_____51_CM 0. 1389. FORMAT "%4.0" /end CHARACTERISTIC
/begin CHARACTERISTIC C_T_MAX_FCUT_FAST "max. time cllutch switch observation fast fuel cut-off" VALUE 0x6924b _REC_VAL_20_u1 2.55 _CNV_A_R_LINEAR_____21_CM 0. 2.55 FORMAT "%4.2" /end CHARACTERISTIC
/begin CHARACTERISTIC LC_INH_FCUT_FAST "inhibition flag for fuel cut-off due fast fuel cut-off" VALUE 0x69248 _REC_VAL_20_u1 1. _CNV_A_R_LINEAR_____17_CM 0. 1. FORMAT "%2.0" /end CHARACTERISTIC
/begin CHARACTERISTIC LC_ENA_FCUT_TOT_ASR "logical variable for setting scaling factor due to ASR" VALUE 0x6924c _REC_VAL_20_u1 1. _CNV_A_R_LINEAR_____17_CM 0. 1. FORMAT "%2.0" /end CHARACTERISTIC
/begin CHARACTERISTIC LC_ENA_FCUT_TOT_N_MAX "logical variable for setting scaling factor due to engine speed limitation" VALUE 0x6924d _REC_VAL_20_u1 1. _CNV_A_R_LINEAR_____17_CM 0. 1. FORMAT "%2.0" /end CHARACTERISTIC
/begin CHARACTERISTIC LC_ENA_FCUT_TOT_FAST "logical variable for setting scaling factor due to fast fuel cut-off" VALUE 0x6924e _REC_VAL_20_u1 1. _CNV_A_R_LINEAR_____17_CM 0. 1. FORMAT "%2.0" /end CHARACTERISTIC
/begin MEASUREMENT EFF_SCC_SP "Setpoint efficiency fuel cut-off pattern" UWORD _CNV_A_R_LINEAR_____5_CM 1 100. 0. 1.99996948 ECU_ADDRESS 0x3fd134 FORMAT "%7.5" /end MEASUREMENT
/begin MEASUREMENT EFF_SCC_SP_HYS "Setpoint efficiency fuel cut-off pattern with hysteresis" UWORD _CNV_A_R_LINEAR_____5_CM 1 100. 0. 1.99996948 ECU_ADDRESS 0x3fd13e FORMAT "%7.5" /end MEASUREMENT
/begin AXIS_PTS ldp_eff_scc_sp__nr_pat_scc "" 0x62094 EFF_SCC_SP _REC_AXS_20_u2 1.99996948 _CNV_A_R_LINEAR_____5_CM 13 0. 1.99996948 FORMAT "%7.5" /end AXIS_PTS
/begin CHARACTERISTIC ID_NR_PAT_SCC "SCC pattern depending on SCC efficiency" CURVE 0x6924f _REC_CUR_20_u1_u2 255. _CNV_A_R_LINEAR_____13_CM 0. 255. FORMAT "%3.0"
 /begin AXIS_DESCR COM_AXIS EFF_SCC_SP _CNV_A_R_LINEAR_____5_CM 13 0. 1.99996948 FORMAT "%7.5" AXIS_PTS_REF ldp_eff_scc_sp__nr_pat_scc /end AXIS_DESCR
/end CHARACTERISTIC
/begin CHARACTERISTIC C_T_ES_TCO_PLAUS_MAX "Threshold for maximum T_ES time" VALUE 0x6929a _REC_VAL_20_u2 65535. _CNV_A_R_LINEAR_____205_CM 0. 65535. FORMAT "%5.0" /end CHARACTERISTIC
/begin CHARACTERISTIC C_T_ES_TCO_PLAUS_MIN "Threshold for minimum T_ES time" VALUE 0x6929c _REC_VAL_20_u2 65535. _CNV_A_R_LINEAR_____205_CM 0. 65535. FORMAT "%5.0" /end CHARACTERISTIC
/begin CHARACTERISTIC C_TCO_STOP_T_ES_PLAUS_MIN "Threshold for minimum differences of cooling temperature " VALUE 0x6929e _REC_VAL_20_u1 190.5 _CNV_A_R_LINEAR_____23_CM 0. 190.5 FORMAT "%5.1" /end CHARACTERISTIC
/begin CHARACTERISTIC C_T_ES_SUB "substitute value of T_ES" VALUE 0x692a0 _REC_VAL_20_u2 65535. _CNV_A_R_LINEAR_____205_CM 0. 65535. FORMAT "%5.0" /end CHARACTERISTIC
/begin CHARACTERISTIC LC_MIS_INH "Global switch for inhibiting (deactivation) of all misfire modules" VALUE 0x692f2 _REC_VAL_20_u1 1. _CNV_A_R_LINEAR_____17_CM 0. 1. FORMAT "%2.0" /end CHARACTERISTIC
/begin MEASUREMENT LV_SEG_AD_ACT_STATE "Boolean for state of segment adaptation process (Passive : Active)" UBYTE _CNV_S_2_RANGE______74_CM 1 100. 0. 1. ECU_ADDRESS 0x3fd48c BIT_MASK 0x1 /end MEASUREMENT
/begin CHARACTERISTIC IP_MAF_SP "Setpoint mass air flow depending on slow torque setpoint" MAP 0x66652 _REC_MAP_20_u2_u1_u2 1389. _CNV_A_R_LINEAR_____56_CM 0. 1389. FORMAT "%4.0"
 /begin AXIS_DESCR COM_AXIS N_32 _CNV_A_R_LINEAR_____15_CM 16 0. 8160. FORMAT "%4.0" AXIS_PTS_REF ldpm_n_32_100 /end AXIS_DESCR
 /begin AXIS_DESCR COM_AXIS TQI_SP_MAF _CNV_A_R_LINEAR_____37_CM 12 0. 1023.96875 FORMAT "%7.2" AXIS_PTS_REF ldp_tqi_sp_maf__maf_sp /end AXIS_DESCR
/end CHARACTERISTIC
/begin MEASUREMENT GEAR "" UBYTE _CNV_A_R_LINEAR_____17_CM 1 100. 0. 6. ECU_ADDRESS 0x3fd7fa FORMAT "%1.0" /end MEASUREMENT
/begin MEASUREMENT ANG_PSTE "sttering wheel sensor angle" SWORD _CNV_A_R_LINEAR_____212_CM 1 100. -1433.6 1433.6 ECU_ADDRESS 0x3fc234 FORMAT "%8.3" /end MEASUREMENT
/begin MEASUREMENT VEL_ANG_PSTE "sttering wheel sensor velocity" SWORD _CNV_A_R_LINEAR_____213_CM 1 100. -1433.6 1433.6 ECU_ADDRESS 0x3fc236 FORMAT "%8.3" /end MEASUREMENT
/begin MEASUREMENT STATE_SENS_ANG_PSTE "status of wheel sensor" UBYTE _CNV_A_R_LINEAR_____17_CM 1 100. 0. 7. ECU_ADDRESS 0x3fd5fd FORMAT "%2.0" /end MEASUREMENT
/begin MEASUREMENT ER_0 "Buffer for  engine roughness value, updated each SEG" SWORD _CNV_A_R_LINEAR_____165_CM 1 100. -32768. 32767. ECU_ADDRESS 0x3fc872 FORMAT "%6.0" /end MEASUREMENT
/begin MEASUREMENT ER_1 "Buffer for  engine roughness value, updated each SEG" SWORD _CNV_A_R_LINEAR_____165_CM 1 100. -32768. 32767. ECU_ADDRESS 0x3fc874 FORMAT "%6.0" /end MEASUREMENT
/begin MEASUREMENT ER_2 "Buffer for  engine roughness value, updated each SEG" SWORD _CNV_A_R_LINEAR_____165_CM 1 100. -32768. 32767. ECU_ADDRESS 0x3fc876 FORMAT "%6.0" /end MEASUREMENT
/begin MEASUREMENT ER_3 "Buffer for  engine roughness value, updated each SEG" SWORD _CNV_A_R_LINEAR_____165_CM 1 100. -32768. 32767. ECU_ADDRESS 0x3fc878 FORMAT "%6.0" /end MEASUREMENT
/begin MEASUREMENT ER_4 "Buffer for  engine roughness value, updated each SEG" SWORD _CNV_A_R_LINEAR_____165_CM 1 100. -32768. 32767. ECU_ADDRESS 0x3fc87a FORMAT "%6.0" /end MEASUREMENT
/begin MEASUREMENT ER_5 "Buffer for  engine roughness value, updated each SEG" SWORD _CNV_A_R_LINEAR_____165_CM 1 100. -32768. 32767. ECU_ADDRESS 0x3fc87c FORMAT "%6.0" /end MEASUREMENT
/begin AXIS_PTS ldp_maf__lamb_ref "" 0x615c8 MAF _REC_AXS_20_u1 1389. _CNV_A_R_LINEAR_____51_CM 6 0. 1389. FORMAT "%4.0" /end AXIS_PTS
/begin MEASUREMENT TQ_LOSS "Engine torque losses" SWORD _CNV_A_R_LINEAR_____37_CM 1 100. -1024. 1023.96875 ECU_ADDRESS 0x3fd12c FORMAT "%6.2" /end MEASUREMENT
/begin CHARACTERISTIC LC_AJ_AC "Logical constant for AJ trigger at acceleration" VALUE 0x67d7f _REC_VAL_20_u1 1. _CNV_A_R_LINEAR_____13_CM 0. 1. FORMAT "%1.0" /end CHARACTERISTIC
/begin AXIS_PTS ldpm_n_32__tqi_min_pu "" 0x61676 N_32 _REC_AXS_20_u1 8160. _CNV_A_R_LINEAR_____15_CM 12 0. 8160. FORMAT "%4.0" /end AXIS_PTS
/begin CHARACTERISTIC C_TCO_STOP_T_ES_PLAUS_MAX "Threshold for maximum differences of cooling temperature" VALUE 0x6929f _REC_VAL_20_u1 190.5 _CNV_A_R_LINEAR_____23_CM 0. 190.5 FORMAT "%5.1" /end CHARACTERISTIC
/begin CHARACTERISTIC C_TCO_STOP_T_ES_MIN "Threshold for minimum cooling temperature at engine stop" VALUE 0x69df6 _REC_VAL_20_u1 190.5 _CNV_A_R_LINEAR_____22_CM -48. 142.5 FORMAT "%5.1" /end CHARACTERISTIC
/begin CHARACTERISTIC APPIDLGSP "Alternator speed stage" VALUE 0x69df7 _REC_VAL_20_u1 1. _CNV_A_R_LINEAR_____13_CM 0. 1. FORMAT "%1.0" /end CHARACTERISTIC
/begin MEASUREMENT TQ_LOSS_SA "Torque losses power steering" SWORD _CNV_A_R_LINEAR_____37_CM 1 100. -1024. 1023.96875 ECU_ADDRESS 0x3fd048 FORMAT "%6.2" /end MEASUREMENT
/begin MEASUREMENT TQ_LOSS_THERMO "Engine torque losses thermostat" SWORD _CNV_A_R_LINEAR_____37_CM 1 100. -1024. 1023.96875 ECU_ADDRESS 0x3fd04e FORMAT "%7.1" /end MEASUREMENT
/begin MEASUREMENT TQ_LOSS_WIN_HEAT "Engine torque losses rar window heater" SWORD _CNV_A_R_LINEAR_____37_CM 1 100. -1024. 1023.96875 ECU_ADDRESS 0x3fd050 FORMAT "%7.1" /end MEASUREMENT
/begin MEASUREMENT T_ACC "Timer for duration of transient TQ_LOSS_ACC correction " UBYTE _CNV_A_R_LINEAR_____21_CM 1 100. 0. 2.55 ECU_ADDRESS 0x3fd997 FORMAT "%4.2" /end MEASUREMENT
/begin MEASUREMENT T_ES "Engine off duration" UWORD _CNV_A_R_LINEAR_____205_CM 1 100. 0. 65535. ECU_ADDRESS 0x3fc748 FORMAT "%5.0" /end MEASUREMENT
/begin MEASUREMENT T_REL_CAN_ES "Time counter value at the start of engine off phase" UWORD _CNV_A_R_LINEAR_____205_CM 1 100. 0. 65535. ECU_ADDRESS 0x3fc74a FORMAT "%5.0" /end MEASUREMENT
/begin MEASUREMENT T_REL_CAN_ST "Time counter value at the end of engine off phase" UWORD _CNV_A_R_LINEAR_____205_CM 1 100. 0. 65535. ECU_ADDRESS 0x3fc74c FORMAT "%5.0" /end MEASUREMENT
/begin MEASUREMENT LV_T_REL_CAN_REG "T_REL_CAN receiving of INSTR2 message" UBYTE _CNV_S_2_RANGE______74_CM 1 100. 0. 1. ECU_ADDRESS 0x3fd44d /end MEASUREMENT
/begin MEASUREMENT LV_T_ES_NOT_PLAUS "T_ES not plausible" UBYTE _CNV_S_2_RANGE______74_CM 1 100. 0. 1. ECU_ADDRESS 0x3fd44c /end MEASUREMENT
/begin MEASUREMENT CTR_KM_CAN "vehicle kilometer reading from CAN message INSTR2" UWORD _CNV_A_R_LINEAR_____220_CM 1 100. 0. 655350. ECU_ADDRESS 0x3fc746 FORMAT "%6.0" /end MEASUREMENT
/begin MEASUREMENT T_REL_CAN "relative time counter" UWORD _CNV_A_R_LINEAR_____205_CM 1 100. 0. 65535. ECU_ADDRESS 0x3fc74e FORMAT "%5.0" /end MEASUREMENT
/begin MEASUREMENT TAM "Ambient temperature" UBYTE _CNV_A_R_LINEAR_____22_CM 1 100. -48. 142.5 ECU_ADDRESS 0x3fd81d FORMAT "%5.1" /end MEASUREMENT
/begin MEASUREMENT LV_LTG_SWI_CAN "logical variable for day- (0)or night lighting (1)" UBYTE _CNV_S_2_RANGE______74_CM 1 100. 0. 1. ECU_ADDRESS 0x3fd44e /end MEASUREMENT
/begin MEASUREMENT FAC_AR_RED_DIF "Weighting factor for reduced area share to THR and ISA" UBYTE _CNV_A_R_LINEAR_____8_CM 1 100. 0. 0.996094 ECU_ADDRESS 0x3fd93a FORMAT "%5.3" /end MEASUREMENT
/begin MEASUREMENT Aspr "???" UBYTE _CNV_A_R_sprzi_q0p8_221_CM 1 100. 0. 204. ECU_ADDRESS 0x3fd9f5 FORMAT "%6.2" /end MEASUREMENT
/begin MEASUREMENT B_nmot "LV detected engine speed" UBYTE _CNV_S_2_B_TRUE_222_CM 1 100. 0. 1. ECU_ADDRESS 0x3fd9f2 BIT_MASK 0x1 /end MEASUREMENT
/begin MEASUREMENT B_pwf "LV powerfail, loss of adapted values" UBYTE _CNV_S_2_B_TRUE_222_CM 1 100. 0. 1. ECU_ADDRESS 0x3fd9f3 BIT_MASK 0x1 /end MEASUREMENT
/begin MEASUREMENT B_st "LV engine operating state start" UBYTE _CNV_S_2_B_TRUE_222_CM 1 100. 0. 1. ECU_ADDRESS 0x3fd9f4 BIT_MASK 0x1 /end MEASUREMENT
/begin MEASUREMENT Espr "???" UBYTE _CNV_A_R_sprzi_q0p8_221_CM 1 100. 0. 204. ECU_ADDRESS 0x3fd9f6 FORMAT "%6.2" /end MEASUREMENT
/begin MEASUREMENT ub "battery voltage" UBYTE _CNV_A_R_spg_ubatt_223_CM 1 100. 0. 24.021 ECU_ADDRESS 0x3fd9f7 FORMAT "%8.4" /end MEASUREMENT
/begin MEASUREMENT VLS_DOWN_1 "Downstream oxygen sensor voltage" UWORD _CNV_A_R_LINEAR_____38_CM 1 100. 0. 4.99511719 ECU_ADDRESS 0x3fca64 FORMAT "%5.3" /end MEASUREMENT
/begin MEASUREMENT VLS_UP_1 "Upstream oxygen sensor voltage" UWORD _CNV_A_R_LINEAR_____38_CM 1 100. 0. 4.99511719 ECU_ADDRESS 0x3fca34 FORMAT "%5.3" /end MEASUREMENT
/begin MEASUREMENT VLS_DOWN_2 "Downstream oxygen sensor voltage" UWORD _CNV_A_R_LINEAR_____38_CM 1 100. 0. 4.99511719 ECU_ADDRESS 0x3fcbd0 FORMAT "%5.3" /end MEASUREMENT
/begin MEASUREMENT VLS_UP_2 "Upstream oxygen sensor voltage" UWORD _CNV_A_R_LINEAR_____38_CM 1 100. 0. 4.99511719 ECU_ADDRESS 0x3fcba0 FORMAT "%5.3" /end MEASUREMENT
/begin MEASUREMENT nmot "engine speed" UBYTE _CNV_A_R_nmot_ub_q4_235_CM 1 100. 0. 10200. ECU_ADDRESS 0x3fd9f8 FORMAT "%8.4" /end MEASUREMENT
/begin MEASUREMENT rl "relative air charge" UBYTE _CNV_A_R_rel_ub_q0p_264_CM 1 100. 0. 191.25 ECU_ADDRESS 0x3fd9fa FORMAT "%8.4" /end MEASUREMENT
/begin AXIS_PTS ldp_n_32_ar_red_egr "" 0x60f96 N_32 _REC_AXS_20_u1 816. _CNV_A_R_LINEAR_____15_CM 6 0. 8160. FORMAT "%4.0" /end AXIS_PTS
/begin CHARACTERISTIC IP_AR_RED_EGR__N_32__STK_AV_EGR "reduced area at the EGR-valve" MAP 0x639fc _REC_MAP_20_u2_u1_u1 58.592855 _CNV_A_R_LINEAR_____286_CM 0. 58.592855 FORMAT "%7.4"
 /begin AXIS_DESCR COM_AXIS N_32 _CNV_A_R_LINEAR_____15_CM 6 0. 8160. FORMAT "%4.0" AXIS_PTS_REF ldp_n_32_ar_red_egr /end AXIS_DESCR
 /begin AXIS_DESCR COM_AXIS STK_AV_EGR _CNV_A_R_LINEAR_____16_CM 8 0. 99.609375 FORMAT "%5.2" AXIS_PTS_REF ldp_stk_av_egr_ar_red_egr /end AXIS_DESCR
/end CHARACTERISTIC
/begin MEASUREMENT AMP "Ambient pressure (measured or adapted)" UWORD _CNV_A_R_LINEAR_____1_CM 1 100. 0. 5434. ECU_ADDRESS 0x3fcd46 FORMAT "%7.2" /end MEASUREMENT
/begin MEASUREMENT AMP_MDL_DIF_I_MMV "Moving mean I-value of the closed loop control of ambient pressure" SWORD _CNV_A_R_LINEAR_____281_CM 1 100. -2717.04 2716.96 ECU_ADDRESS 0x3fcd4c FORMAT "%8.2" /end MEASUREMENT
/begin MEASUREMENT AMP_MDL_DIF_I "I-value of the closed loop control of ambient pressure" SWORD _CNV_A_R_LINEAR_____281_CM 1 100. -2717.04 2716.96 ECU_ADDRESS 0x3fcd4a FORMAT "%8.2" /end MEASUREMENT
/begin MEASUREMENT AMP_MDL_DIF_P "P-value of the closed loop control of ambient pressure" SWORD _CNV_A_R_LINEAR_____281_CM 1 100. -2717.04 2716.96 ECU_ADDRESS 0x3fcd6a FORMAT "%8.2" /end MEASUREMENT
/begin MEASUREMENT AMP_ESTIM "Estimated ambient pressure" UWORD _CNV_A_R_LINEAR_____1_CM 1 100. 0. 5434. ECU_ADDRESS 0x3fcd68 FORMAT "%7.2" /end MEASUREMENT
/begin MEASUREMENT AMP_AD_DIF "Change of the adapted ambient pressure" SWORD _CNV_A_R_LINEAR_____281_CM 1 100. -2717.04 2716.96 ECU_ADDRESS 0x3fcd66 FORMAT "%8.2" /end MEASUREMENT
/begin MEASUREMENT AMP_AD "Adapted ambient pressure" UWORD _CNV_A_R_LINEAR_____1_CM 1 100. 0. 5434. ECU_ADDRESS 0x3fcd4e FORMAT "%7.2" /end MEASUREMENT
/begin MEASUREMENT AR_RED_BAS_MMV "Moving mean value of the basic reduced area" UWORD _CNV_A_R_LINEAR_____286_CM 1 100. 0. 58.592855 ECU_ADDRESS 0x3fcd72 FORMAT "%7.4" /end MEASUREMENT
/begin MEASUREMENT MAF_KGH_MMV "Moving mean value of the mass air flow" UWORD _CNV_A_R_LINEAR_____52_CM 1 100. 0. 2047.96875 ECU_ADDRESS 0x3fcd74 FORMAT "%7.2" /end MEASUREMENT
/begin MEASUREMENT SEG_CTR_AMP_AD_PL "Segment counter for ambient pressure adaptation during part load" UWORD _CNV_A_R_LINEAR_____17_CM 1 100. 0. 65535. ECU_ADDRESS 0x3fcd6e FORMAT "%5.0" /end MEASUREMENT
/begin CHARACTERISTIC C_AMP_AD_PL_HYS "hyteresis for ambient pressure adaptation during part load" VALUE 0x63a66 _REC_VAL_20_u2 5434. _CNV_A_R_LINEAR_____1_CM 0. 5434. FORMAT "%7.2" /end CHARACTERISTIC
/begin CHARACTERISTIC C_AMP_AD_COR_CLRC "Correlation constant for ambient pressure learning" VALUE 0x63a68 _REC_VAL_20_u1 0.9960940000000002 _CNV_A_R_LINEAR_____8_CM 0. 0.996094 FORMAT "%5.3" /end CHARACTERISTIC
/begin CHARACTERISTIC C_AMP_AD_DIF_NEG "Negative correction of the ambient pressure adaptation during part load" VALUE 0x63a6a _REC_VAL_20_s2 5434. _CNV_A_R_LINEAR_____281_CM -2717.04 2716.96 FORMAT "%8.2" /end CHARACTERISTIC
/begin CHARACTERISTIC C_AMP_AD_DIF_POS "Positive correction of the ambient pressure adaptation during part load" VALUE 0x63a6c _REC_VAL_20_s2 5434. _CNV_A_R_LINEAR_____281_CM -2717.04 2716.96 FORMAT "%8.2" /end CHARACTERISTIC
/begin CHARACTERISTIC C_AMP_DIF_TI_LAM_POS "positive correction of the ambient pressure adaptation with lambda controller" VALUE 0x63a70 _REC_VAL_20_s2 5434. _CNV_A_R_LINEAR_____281_CM -2717.04 2716.96 FORMAT "%8.2" /end CHARACTERISTIC
/begin CHARACTERISTIC C_AMP_MAX "maximum value for ambient pressure" VALUE 0x63a72 _REC_VAL_20_u2 5434. _CNV_A_R_LINEAR_____1_CM 0. 5434. FORMAT "%7.2" /end CHARACTERISTIC
/begin CHARACTERISTIC C_AMP_MIN " minimum value for ambient pressure" VALUE 0x63a74 _REC_VAL_20_u2 5434. _CNV_A_R_LINEAR_____1_CM 0. 5434. FORMAT "%7.2" /end CHARACTERISTIC
/begin CHARACTERISTIC C_AMP_INI "initial value for the ambient pressure" VALUE 0x63a76 _REC_VAL_20_u2 5434. _CNV_A_R_LINEAR_____1_CM 0. 5434. FORMAT "%7.2" /end CHARACTERISTIC
/begin CHARACTERISTIC C_AMP_I_1 "I -value for the ambient pressure correction (LV_MAF_CTL = 1)" VALUE 0x63a7a _REC_VAL_20_u2 58350000. _CNV_A_R_LINEAR_____288_CM 0. 58350000. FORMAT "%8.0" /end CHARACTERISTIC
/begin CHARACTERISTIC C_AMP_DIF_TI_LAM_NEG "Negative correction of the ambient pressure adaptation with lambda controller" VALUE 0x63a6e _REC_VAL_20_s2 5434. _CNV_A_R_LINEAR_____281_CM -2717.04 2716.96 FORMAT "%8.2" /end CHARACTERISTIC
/begin CHARACTERISTIC C_AMP_MDL_DIF_I_MAX "Upper threshold of integral part of pressure controller" VALUE 0x63a7c _REC_VAL_20_s2 5434. _CNV_A_R_LINEAR_____281_CM -2717.04 2716.96 FORMAT "%8.2" /end CHARACTERISTIC
/begin CHARACTERISTIC C_AMP_MDL_DIF_I_MIN "Lower threshold of integral part of pressure controller" VALUE 0x63a7e _REC_VAL_20_s2 5434. _CNV_A_R_LINEAR_____281_CM -2717.04 2716.96 FORMAT "%8.2" /end CHARACTERISTIC
/begin CHARACTERISTIC C_AMP_P_1 "P - Value for ambient pressure control (LV_MAF_CTL = 1)" VALUE 0x63a80 _REC_VAL_20_u2 42.51956000000001 _CNV_A_R_LINEAR_____289_CM 0. 42.51956 FORMAT "%8.5" /end CHARACTERISTIC
/begin CHARACTERISTIC C_AMP_P_2 "P - Value for ambient pressure control (LV_MAP_CTL = 1)" VALUE 0x63a82 _REC_VAL_20_u2 0.99998474 _CNV_A_R_LINEAR_____2_CM 0. 0.99998474 FORMAT "%7.5" /end CHARACTERISTIC
/begin CHARACTERISTIC C_CRLC_MAF_KGH_AMP_AD_PL "correlation constant for moving mean value calculation of MAF_KGH" VALUE 0x63a85 _REC_VAL_20_u1 0.9960940000000002 _CNV_A_R_LINEAR_____8_CM 0. 0.996094 FORMAT "%5.3" /end CHARACTERISTIC
/begin CHARACTERISTIC C_CRLC_AMP_MDL_DIF_I_MMV "Correlation constant for moving mean value calculation of AMP_MDL_DIF_I" VALUE 0x63a86 _REC_VAL_20_u1 0.9960940000000002 _CNV_A_R_LINEAR_____8_CM 0. 0.996094 FORMAT "%5.3" /end CHARACTERISTIC
/begin CHARACTERISTIC C_MAP_DRV1_MAX_AMP_AD_PL "maximum value of the first derivative of manifold pressure for ambient pressure adaptation part load" VALUE 0x63a88 _REC_VAL_20_u2 82.91626000000001 _CNV_A_R_LINEAR_____290_CM 0. 82.91625999999999 FORMAT "%5.3" /end CHARACTERISTIC
/begin CHARACTERISTIC C_N_AMP_AD_MIN "Minimum engine speed for ambient pressure learning" VALUE 0x63a8a _REC_VAL_20_u1 8160. _CNV_A_R_LINEAR_____15_CM 0. 8160. FORMAT "%4.0" /end CHARACTERISTIC
/begin CHARACTERISTIC C_N_AMP_AD_MAX "Maximum engine speed for ambient pressure learning" VALUE 0x63a8b _REC_VAL_20_u1 8160. _CNV_A_R_LINEAR_____15_CM 0. 8160. FORMAT "%4.0" /end CHARACTERISTIC
/begin CHARACTERISTIC C_N_MIN_AMP_AD_PL "minimum value of the engine speed for ambient pressure adaptation part load" VALUE 0x63a8c _REC_VAL_20_u1 8160. _CNV_A_R_LINEAR_____15_CM 0. 8160. FORMAT "%4.0" /end CHARACTERISTIC
/begin CHARACTERISTIC C_PQ_AMP_AD "pressure quotient for adaptation ambient pressure" VALUE 0x63a8e _REC_VAL_20_u2 0.99998474 _CNV_A_R_LINEAR_____2_CM 0. 0.99998474 FORMAT "%7.5" /end CHARACTERISTIC
/begin CHARACTERISTIC C_PQ_AMP_AD_PL "pressure quotient for adaptation ambient pressure at PL" VALUE 0x63a90 _REC_VAL_20_u2 0.99998474 _CNV_A_R_LINEAR_____2_CM 0. 0.99998474 FORMAT "%7.5" /end CHARACTERISTIC
/begin CHARACTERISTIC C_PQ_AMP_CTL "Pressure quotient to switch from area to pressure control" VALUE 0x63a92 _REC_VAL_20_u2 0.99998474 _CNV_A_R_LINEAR_____2_CM 0. 0.99998474 FORMAT "%7.5" /end CHARACTERISTIC
/begin CHARACTERISTIC C_SEG_CTR_AMP_AD "Segment counter of waiting time before allowing adaptation of ambient pressure (typical value ³ 200)" VALUE 0x63a98 _REC_VAL_20_u2 65535. _CNV_A_R_LINEAR_____17_CM 0. 65535. FORMAT "%5.0" /end CHARACTERISTIC
/begin CHARACTERISTIC C_SEG_CTR_AMP_AD_PL "segment counter for moving mean value calculation of AR_RED_BAS, MAF_KGH_MMV" VALUE 0x63a96 _REC_VAL_20_u2 65535. _CNV_A_R_LINEAR_____17_CM 0. 65535. FORMAT "%5.0" /end CHARACTERISTIC
/begin CHARACTERISTIC C_T_AST_AMP_CTL_DEAC "Time for deactivation of pressure control after start" VALUE 0x63a9a _REC_VAL_20_u2 6553.5 _CNV_A_R_LINEAR_____18_CM 0. 6553.5 FORMAT "%6.1" /end CHARACTERISTIC
/begin CHARACTERISTIC C_TI_LAM_MAF_PULS_MAX "positive threshold of the ambient pressure adaptation in pulsation" VALUE 0x63a9c _REC_VAL_20_s2 99.99847412 _CNV_A_R_LINEAR_____149_CM -50. 49.99847412 FORMAT "%6.2" /end CHARACTERISTIC
/begin CHARACTERISTIC C_TI_LAM_MAF_PULS_MIN "negative threshold of the ambient pressure adaptation in pulsation" VALUE 0x63a9e _REC_VAL_20_s2 99.99847412 _CNV_A_R_LINEAR_____149_CM -50. 49.99847412 FORMAT "%6.2" /end CHARACTERISTIC
/begin CHARACTERISTIC C_TPS_MIN_AMP_AD_PL "minimum value of the throttle position for ambient pressure adaptation part load" VALUE 0x63aa0 _REC_VAL_20_u2 119.5 _CNV_A_R_LINEAR_____34_CM 0. 119.5 /end CHARACTERISTIC
/begin MEASUREMENT AR_RED_AD_ADD "Additive adaptive factor" SWORD _CNV_A_R_LINEAR_____291_CM 1 100. -29.296875 29.29598047 ECU_ADDRESS 0x3fcd34 FORMAT "%8.4" /end MEASUREMENT
/begin MEASUREMENT AR_RED_AD_FAC "Multiplicative adaptive factor" SWORD _CNV_A_R_LINEAR_____149_CM 1 100. -50. 49.99847412 ECU_ADDRESS 0x3fcd36 FORMAT "%7.3" /end MEASUREMENT
/begin MEASUREMENT AR_RED_AD_FAC_COR "Correction factor for entire adaptive factor" SWORD _CNV_A_R_LINEAR_____149_CM 1 100. -50. 49.99847412 ECU_ADDRESS 0x3fcd38 FORMAT "%7.3" /end MEASUREMENT
/begin MEASUREMENT AR_RED_DIF_I_REL_MMV "Moving mean I-value (relative) of the closed loop control reduced throttle area" SWORD _CNV_A_R_LINEAR_____149_CM 1 100. -50. 49.99847412 ECU_ADDRESS 0x3fcd32 FORMAT "%7.3" /end MEASUREMENT
/begin MEASUREMENT AR_RED_DIF_P_REL "P-value (relative) of the closed loop control reduced throttle area" SWORD _CNV_A_R_LINEAR_____149_CM 1 100. -50. 49.99847412 ECU_ADDRESS 0x3fcd5c FORMAT "%7.3" /end MEASUREMENT
/begin MEASUREMENT MAP_MDL_MV "Mean value of the model manifold pressure" UWORD _CNV_A_R_LINEAR_____1_CM 1 100. 0. 5434. ECU_ADDRESS 0x3fcd42 FORMAT "%7.2" /end MEASUREMENT
/begin MEASUREMENT MAP_MDL_DIF "Deviation between measured and callculated manifold pressure" SWORD _CNV_A_R_LINEAR_____281_CM 1 100. -2717.04 2716.96 ECU_ADDRESS 0x3fcd44 FORMAT "%8.2" /end MEASUREMENT
/begin MEASUREMENT MAF_MDL_MV "Model air mass flow mean value" UWORD _CNV_A_R_LINEAR_____52_CM 1 100. 0. 2047.96875 ECU_ADDRESS 0x3fcd3e FORMAT "%7.2" /end MEASUREMENT
/begin MEASUREMENT MAF_MDL_DIF "Deviation of model air mass flow" SWORD _CNV_A_R_LINEAR_____52_CM 1 100. -1024. 1023.96875 ECU_ADDRESS 0x3fcd40 FORMAT "%6.2" /end MEASUREMENT
/begin CHARACTERISTIC C_AMP_I_2 "I - Value for the ambient pressure correction(LV_MAF_CTL = 1)" VALUE 0x63a78 _REC_VAL_20_u2 61.034223 _CNV_A_R_LINEAR_____292_CM 0. 61.034223 FORMAT "%7.4" /end CHARACTERISTIC
/begin CHARACTERISTIC C_AR_RED_AD_ADD_MIN "Minimum allowed value for additive reduced area adaptation" VALUE 0x63aa6 _REC_VAL_20_s2 58.59285547 _CNV_A_R_LINEAR_____291_CM -29.296875 29.29598047 FORMAT "%8.4" /end CHARACTERISTIC
/begin CHARACTERISTIC C_AR_RED_AD_FAC_MAX "Maximum allowed value for multiplicative reduced area adaptation" VALUE 0x63aa8 _REC_VAL_20_s2 99.99847412 _CNV_A_R_LINEAR_____149_CM -50. 49.99847412 FORMAT "%7.3" /end CHARACTERISTIC
/begin CHARACTERISTIC C_AR_RED_AD_FAC_MIN "Minimum allowed value for multiplicative reduced area adaptation" VALUE 0x63aaa _REC_VAL_20_s2 99.99847412 _CNV_A_R_LINEAR_____149_CM -50. 49.99847412 FORMAT "%7.3" /end CHARACTERISTIC
/begin CHARACTERISTIC C_AR_RED_DIF_I_REL_MIN "Minimum value for AR_RED_ DIF_I_REL" VALUE 0x63aae _REC_VAL_20_s2 99.99847412 _CNV_A_R_LINEAR_____149_CM -50. 49.99847412 FORMAT "%7.3" /end CHARACTERISTIC
/begin CHARACTERISTIC C_CRLC_AR_RED_BAS_AMP_AD_PL "correlation constant for moving mean value calculation of AR_RED_BAS" VALUE 0x63a84 _REC_VAL_20_u1 0.9960940000000002 _CNV_A_R_LINEAR_____8_CM 0. 0.996094 FORMAT "%5.3" /end CHARACTERISTIC
/begin CHARACTERISTIC C_CRLC_AR_RED_DIF_I_REL_MMV "Correlation constant for the moving mean value calculation of AR_RED_DIF_I_REL" VALUE 0x63ab1 _REC_VAL_20_u1 0.9960940000000002 _CNV_A_R_LINEAR_____8_CM 0. 0.996094 FORMAT "%5.3" /end CHARACTERISTIC
/begin CHARACTERISTIC C_N__AR_RED__AD_ADD_MAX "Maximum engine speed for learning of additive adaptation value" VALUE 0x63ab2 _REC_VAL_20_u1 8160. _CNV_A_R_LINEAR_____15_CM 0. 8160. FORMAT "%4.0" /end CHARACTERISTIC
/begin CHARACTERISTIC C_N__AR_RED__AD_ADD_MIN "Minimum engine speed for learning of additive adaptation value" VALUE 0x63ab3 _REC_VAL_20_u1 8160. _CNV_A_R_LINEAR_____15_CM 0. 8160. FORMAT "%4.0" /end CHARACTERISTIC
/begin CHARACTERISTIC C_N__AR_RED__AD_FAC_MIN "Minimum engine speed for learning of multiplicative adaptation value" VALUE 0x63ab4 _REC_VAL_20_u1 8160. _CNV_A_R_LINEAR_____15_CM 0. 8160. FORMAT "%4.0" /end CHARACTERISTIC
/begin CHARACTERISTIC C_N__AR_RED__AD_FAC_MAX "Maximum engine speed for learning of multiplicative adaptation value" VALUE 0x63ab5 _REC_VAL_20_u1 8160. _CNV_A_R_LINEAR_____15_CM 0. 8160. FORMAT "%4.0" /end CHARACTERISTIC
/begin CHARACTERISTIC C_PQ__AR_RED__AD_FAC_MAX "Maximum pressure quotient for learning of multiplicative adaptation value" VALUE 0x63ab8 _REC_VAL_20_u2 0.99998474 _CNV_A_R_LINEAR_____2_CM 0. 0.99998474 FORMAT "%7.5" /end CHARACTERISTIC
/begin CHARACTERISTIC C_PQ__AR_RED__AD_FAC_MIN "Minimum pressure quotient for learning of multiplicative adaptation value" VALUE 0x63aba _REC_VAL_20_u2 0.99998474 _CNV_A_R_LINEAR_____2_CM 0. 0.99998474 FORMAT "%7.5" /end CHARACTERISTIC
/begin CHARACTERISTIC C_PQ__AR_RED__AD_ADD_MAX "Maximum pressure quotient for learning of additive adaptation value" VALUE 0x63abc _REC_VAL_20_u2 0.99998474 _CNV_A_R_LINEAR_____2_CM 0. 0.99998474 FORMAT "%7.5" /end CHARACTERISTIC
/begin CHARACTERISTIC C_T_AST_AR_RED_CTL_DEAC "Time to deactivate reduced area control after engine start" VALUE 0x63abe _REC_VAL_20_u2 6553.5 _CNV_A_R_LINEAR_____18_CM 0. 6553.5 FORMAT "%6.1" /end CHARACTERISTIC
/begin AXIS_PTS ldp_stk_av_egr_ar_red_egr "" 0x60fa4 STK_AV_EGR _REC_AXS_20_u1 99.609375 _CNV_A_R_LINEAR_____16_CM 8 0. 99.609375 FORMAT "%5.2" /end AXIS_PTS
/begin AXIS_PTS ldp_pq__fac_ar_red_cor "" 0x60fae PQ _REC_AXS_20_u2 0.99998474 _CNV_A_R_LINEAR_____2_CM 8 0. 0.99998474 FORMAT "%7.5" /end AXIS_PTS
/begin AXIS_PTS ldpm_pq_ar_red "" 0x60fc8 PQ _REC_AXS_20_u2 0.99998474 _CNV_A_R_LINEAR_____2_CM 4 0. 0.99998474 FORMAT "%7.5" /end AXIS_PTS
/begin CHARACTERISTIC IP_FAC_AR_RED_COR__PQ "Weighting function for decreasing multiplicative learning controller value during PQ>C_PQ_AMP_CTL" CURVE 0x63af0 _REC_CUR_20_u1_u2 0.9960940000000002 _CNV_A_R_LINEAR_____8_CM 0. 0.996094 FORMAT "%5.3"
 /begin AXIS_DESCR COM_AXIS PQ _CNV_A_R_LINEAR_____2_CM 8 0. 0.99998474 FORMAT "%7.5" AXIS_PTS_REF ldp_pq__fac_ar_red_cor /end AXIS_DESCR
/end CHARACTERISTIC
/begin CHARACTERISTIC IP_AR_RED_I_REL_1__N__PQ "I-value (relative) reduced throttle area (MAF-controlled)" MAP 0x63ac0 _REC_MAP_20_u2_u1_u2 171660. _CNV_A_R_LINEAR_____293_CM 0. 171660. FORMAT "%6.0"
 /begin AXIS_DESCR COM_AXIS N_32 _CNV_A_R_LINEAR_____15_CM 6 0. 8160. FORMAT "%4.0" AXIS_PTS_REF ldpm_n_ar_red /end AXIS_DESCR
 /begin AXIS_DESCR COM_AXIS PQ _CNV_A_R_LINEAR_____2_CM 4 0. 0.99998474 FORMAT "%7.5" AXIS_PTS_REF ldpm_pq_ar_red /end AXIS_DESCR
/end CHARACTERISTIC
/begin CHARACTERISTIC IP_AR_RED_I_REL_2__N__PQ "I-value reduced throttle area (MAP-controlled)" MAP 0x63af8 _REC_MAP_20_u2_u1_u2 2.24636 _CNV_A_R_LINEAR_____294_CM 0. 2.24636 FORMAT "%6.4"
 /begin AXIS_DESCR COM_AXIS N_32 _CNV_A_R_LINEAR_____15_CM 6 0. 8160. FORMAT "%4.0" AXIS_PTS_REF ldpm_n_ar_red /end AXIS_DESCR
 /begin AXIS_DESCR COM_AXIS PQ _CNV_A_R_LINEAR_____2_CM 4 0. 0.99998474 FORMAT "%7.5" AXIS_PTS_REF ldpm_pq_ar_red /end AXIS_DESCR
/end CHARACTERISTIC
/begin CHARACTERISTIC IP_AR_RED_P_REL_2__N__PQ "P-value reduced throttle area (MAP-controlled)" MAP 0x63b28 _REC_MAP_20_u2_u1_u2 0.5888600000000001 _CNV_A_R_LINEAR_____295_CM 0. 0.5888600000000001 FORMAT "%7.5"
 /begin AXIS_DESCR COM_AXIS N_32 _CNV_A_R_LINEAR_____15_CM 6 0. 8160. FORMAT "%4.0" AXIS_PTS_REF ldpm_n_ar_red /end AXIS_DESCR
 /begin AXIS_DESCR COM_AXIS PQ _CNV_A_R_LINEAR_____2_CM 4 0. 0.99998474 FORMAT "%7.5" AXIS_PTS_REF ldpm_pq_ar_red /end AXIS_DESCR
/end CHARACTERISTIC
/begin CHARACTERISTIC IP_CRLC_HFM "correlation constant for the first order time delay of the calculated air mass flow at the throttle" CURVE 0x63b88 _REC_CUR_20_u2_u2 0.99998474 _CNV_A_R_LINEAR_____2_CM 0. 0.99998474 FORMAT "%7.5"
 /begin AXIS_DESCR COM_AXIS ONLINE_DUMMY _CNV_A_R_LINEAR_____104_CM 6 0. 7.99987793 FORMAT "%6.4" AXIS_PTS_REF ldp_t_seg_t_1_ratio_crlc_hfm /end AXIS_DESCR
/end CHARACTERISTIC
/begin AXIS_PTS ldp_t_seg_t_1_ratio_crlc_hfm "" 0x60fd2 T_SEG_T_1_RATIO _REC_AXS_20_u2 7.99987793 _CNV_A_R_LINEAR_____104_CM 6 0. 7.99987793 FORMAT "%6.4" /end AXIS_PTS
/begin AXIS_PTS ldpm_maf_kgh_t_1_hfm "" 0x60fe0 MAF_KGH _REC_AXS_20_u2 204.796875 _CNV_A_R_LINEAR_____52_CM 4 0. 2047.96875 FORMAT "%7.2" /end AXIS_PTS
/begin CHARACTERISTIC IP_T_1_HFM "time constant hot film air mass meter" CURVE 0x63b94 _REC_CUR_20_u2_u2 65.535 _CNV_A_R_LINEAR_____296_CM 0. 65.535
 /begin AXIS_DESCR COM_AXIS MAF_KGH _CNV_A_R_LINEAR_____52_CM 4 0. 2047.96875 FORMAT "%7.2" AXIS_PTS_REF ldpm_maf_kgh_t_1_hfm /end AXIS_DESCR
/end CHARACTERISTIC
/begin MEASUREMENT PRS_EX "Pressure in the exhaust system" UWORD _CNV_A_R_LINEAR_____1_CM 1 100. 0. 5434. ECU_ADDRESS 0x3fcd78 FORMAT "%7.2" /end MEASUREMENT
/begin MEASUREMENT PRS_EX_INC "increase of exhaust pressure in comparison to ambient pressure" UWORD _CNV_A_R_LINEAR_____1_CM 1 100. 0. 5434. ECU_ADDRESS 0x3fcd7a FORMAT "%7.2" /end MEASUREMENT
/begin AXIS_PTS ldpm_maf_cyl_ex "" 0x6105a MAF_CYL _REC_AXS_20_u2 2047.96875 _CNV_A_R_LINEAR_____52_CM 8 0. 2047.96875 FORMAT "%6.2" /end AXIS_PTS
/begin CHARACTERISTIC IP_PRS_EX_INC "pressure increase in the exhaust pipe" CURVE 0x63e5c _REC_CUR_20_u2_u2 5434. _CNV_A_R_LINEAR_____1_CM 0. 5434. FORMAT "%7.2"
 /begin AXIS_DESCR COM_AXIS MAF_CYL _CNV_A_R_LINEAR_____52_CM 8 0. 2047.96875 FORMAT "%6.2" AXIS_PTS_REF ldpm_maf_cyl_ex /end AXIS_DESCR
/end CHARACTERISTIC
/begin CHARACTERISTIC IP_TEG_EGR__MAF_CYL "Temperature on the exhaust side of the EGR-Valve" CURVE 0x63e6c _REC_CUR_20_u2_u2 2047. _CNV_A_R_LINEAR_____94_CM 0. 2047. FORMAT "%7.2"
 /begin AXIS_DESCR COM_AXIS MAF_CYL _CNV_A_R_LINEAR_____52_CM 8 0. 2047.96875 FORMAT "%6.2" AXIS_PTS_REF ldpm_maf_cyl_ex /end AXIS_DESCR
/end CHARACTERISTIC
/begin MEASUREMENT TEG_EGR "Temperature on the exhaust side of the EGR-valve" UWORD _CNV_A_R_LINEAR_____94_CM 1 100. 0. 2047. ECU_ADDRESS 0x3fcd7c FORMAT "%7.2" /end MEASUREMENT
/begin MEASUREMENT EFF_MAF_S "Air efficiency in stratified combustion" UWORD _CNV_A_R_LINEAR_____5_CM 1 100. 0. 1.99996948 ECU_ADDRESS 0x3fcd94 FORMAT "%7.5" /end MEASUREMENT
/begin MEASUREMENT AR_RED_EGR "Reduced area at the EGR - valve (is only calculated if NC_EGR_CONF = 1)" UWORD _CNV_A_R_LINEAR_____286_CM 1 100. 0. 58.592855 ECU_ADDRESS 0x3fcd76 FORMAT "%7.4" /end MEASUREMENT
/begin CHARACTERISTIC C_LGRD_AMP_MDL_DIF_TRA "Linear negative gradient of ambient pressure control during reduced area control" VALUE 0x63a94 _REC_VAL_20_u2 5434. _CNV_A_R_LINEAR_____1_CM 0. 5434. FORMAT "%7.2" /end CHARACTERISTIC
/begin MEASUREMENT V_MAP "Voltage of the intake manifold pressure sensor (for diagnosis)" UWORD _CNV_A_R_LINEAR_____158_CM 1 100. 0. 5. ECU_ADDRESS 0x3fc26a FORMAT "%5.3" /end MEASUREMENT
/begin AXIS_PTS ldp_v_map_map_mes_bas "" 0x61180 V_MAP _REC_AXS_20_u2 4.5 _CNV_A_R_LINEAR_____158_CM 2 0. 5. FORMAT "%5.3" /end AXIS_PTS
/begin CHARACTERISTIC IP_MAP_MES_BAS__V_MAP "Conversion characteristic for MAP_MES_BAS" CURVE 0x642ea _REC_CUR_20_u2_u2 5434. _CNV_A_R_LINEAR_____1_CM 0. 5434. FORMAT "%7.2"
 /begin AXIS_DESCR COM_AXIS V_MAP _CNV_A_R_LINEAR_____158_CM 2 0. 5. FORMAT "%5.3" AXIS_PTS_REF ldp_v_map_map_mes_bas /end AXIS_DESCR
/end CHARACTERISTIC
/begin MEASUREMENT LV_LOAD_RATIO_CHK "" UBYTE _CNV_S_2_RANGE______76_CM 1 100. 0. 1. ECU_ADDRESS 0x3fd5ad /end MEASUREMENT
/begin MEASUREMENT MAP_MES_BAS "Intake manifold air pressure per segment measured" UWORD _CNV_A_R_LINEAR_____1_CM 1 100. 0. 5434. ECU_ADDRESS 0x3fc268 FORMAT "%7.2" /end MEASUREMENT
/begin MEASUREMENT AMP_MDL "Ambient pressure used for model adjustment" UWORD _CNV_A_R_LINEAR_____1_CM 1 100. 0. 5434. ECU_ADDRESS 0x3fcd48 FORMAT "%7.2" /end MEASUREMENT
/begin CHARACTERISTIC C_LGRD_AR_RED_DIF_TRA "Linear negative gradient of reduced area control during ambient pressure control" VALUE 0x63ab6 _REC_VAL_20_u2 99.99847412 _CNV_A_R_LINEAR_____144_CM 0. 99.99847412 /end CHARACTERISTIC
/begin CHARACTERISTIC C_CRLC_MAP_MDL "correlation constant for model manifold pressure" VALUE 0x63ab0 _REC_VAL_20_u1 0.9960940000000002 _CNV_A_R_LINEAR_____8_CM 0. 0.996094 FORMAT "%5.3" /end CHARACTERISTIC
/begin CHARACTERISTIC C_CRLC_AR_RED_AD_ADD "Factor for the additive reduced area adaption" VALUE 0x642f0 _REC_VAL_20_u1 0.9960940000000002 _CNV_A_R_LINEAR_____8_CM 0. 0.996094 FORMAT "%5.3" /end CHARACTERISTIC
/begin CHARACTERISTIC C_CRLC_AR_RED_AD_FAC "Factor for the multiplicative reduced area adaption" VALUE 0x642f1 _REC_VAL_20_u1 0.9960940000000002 _CNV_A_R_LINEAR_____8_CM 0. 0.996094 FORMAT "%5.3" /end CHARACTERISTIC
/begin CHARACTERISTIC C_AR_RED_DIF_I_REL_MAX "Maximum value for AR_RED_ DIF_I_REL" VALUE 0x63aac _REC_VAL_20_s2 99.99847412 _CNV_A_R_LINEAR_____149_CM -50. 49.99847412 FORMAT "%7.3" /end CHARACTERISTIC
/begin CHARACTERISTIC C_AR_RED_AD_ADD_MAX "Maximum allowed value for additive reduced area adaptation" VALUE 0x63aa4 _REC_VAL_20_s2 58.59285547 _CNV_A_R_LINEAR_____291_CM -29.296875 29.29598047 FORMAT "%8.4" /end CHARACTERISTIC
/begin CHARACTERISTIC LC_AR_RED_AD_ENA "Logical variable enabled for permission of adaptive values for PUC" VALUE 0x63aa2 _REC_VAL_20_u1 1. _CNV_A_R_LINEAR_____13_CM 0. 1. FORMAT "%1.0" /end CHARACTERISTIC
/begin MEASUREMENT AR_RED "Reduced area at the throttle" UWORD _CNV_A_R_LINEAR_____286_CM 1 100. 0. 58.592855 ECU_ADDRESS 0x3fcd2c FORMAT "%7.4" /end MEASUREMENT
/begin AXIS_PTS ldpm_n_ar_red "" 0x60fc0 N_32 _REC_AXS_20_u1 8160. _CNV_A_R_LINEAR_____15_CM 6 0. 8160. FORMAT "%4.0" /end AXIS_PTS
/begin CHARACTERISTIC IP_AR_RED_P_REL_1__N__PQ "P-value reduced throttle area (MAF-controlled)" MAP 0x63b58 _REC_MAP_20_u2_u1_u2 12.5005 _CNV_A_R_LINEAR_____304_CM 0. 12.5005 FORMAT "%7.4"
 /begin AXIS_DESCR COM_AXIS N_32 _CNV_A_R_LINEAR_____15_CM 6 0. 8160. FORMAT "%4.0" AXIS_PTS_REF ldpm_n_ar_red /end AXIS_DESCR
 /begin AXIS_DESCR COM_AXIS PQ _CNV_A_R_LINEAR_____2_CM 4 0. 0.99998474 FORMAT "%7.5" AXIS_PTS_REF ldpm_pq_ar_red /end AXIS_DESCR
/end CHARACTERISTIC
/begin MEASUREMENT AR_RED_BAS "Basic reduced opening area" UWORD _CNV_A_R_LINEAR_____286_CM 1 100. 0. 58.592855 ECU_ADDRESS 0x3fcd7e FORMAT "%7.4" /end MEASUREMENT
/begin AXIS_PTS ldp_tps_seg_ar_red_thr "" 0x60fea TPS_SEG _REC_AXS_20_u2 119.5 _CNV_A_R_LINEAR_____34_CM 16 0. 119.5 /end AXIS_PTS
/begin CHARACTERISTIC IP_AR_RED_THR "reduced area at the throttle" CURVE 0x63b9c _REC_CUR_20_u2_u2 58.592855 _CNV_A_R_LINEAR_____286_CM 0. 58.592855 FORMAT "%7.4"
 /begin AXIS_DESCR COM_AXIS TPS_SEG _CNV_A_R_LINEAR_____34_CM 16 0. 119.5 AXIS_PTS_REF ldp_tps_seg_ar_red_thr /end AXIS_DESCR
/end CHARACTERISTIC
/begin MEASUREMENT AR_RED_DIF_I_REL "I-value (relative) of the closed loop control reduced throttle area" SWORD _CNV_A_R_LINEAR_____149_CM 1 100. -50. 49.99847412 ECU_ADDRESS 0x3fcd30 FORMAT "%7.3" /end MEASUREMENT
/begin MEASUREMENT AR_RED_DIF_REL "Correction of reduced throttle area" SWORD _CNV_A_R_LINEAR_____149_CM 1 100. -50. 49.99847412 ECU_ADDRESS 0x3fcd2e FORMAT "%7.3" /end MEASUREMENT
/begin MEASUREMENT AR_RED_ISA_DIF_REL "Correction of reduced throttle area" SWORD _CNV_A_R_LINEAR_____149_CM 1 100. -50. 49.99847412 ECU_ADDRESS 0x3fcd52 FORMAT "%7.3" /end MEASUREMENT
/begin MEASUREMENT AMP_MDL_DIF "Value of the closed loop control of ambient pressure (sum of I and P part)" SWORD _CNV_A_R_LINEAR_____281_CM 1 100. -2717.04 2716.96 ECU_ADDRESS 0x3fcd6c FORMAT "%8.2" /end MEASUREMENT
/begin MEASUREMENT UGEN "generator voltage setpoint" UBYTE _CNV_A_R_LINEAR_____314_CM 1 100. 10.6 16.9 ECU_ADDRESS 0x3fd9ef FORMAT "%4.1" /end MEASUREMENT
/begin CHARACTERISTIC GEN_APP_TLR "generator load response time setpoint" VALUE 0x68206 _REC_VAL_20_u1 25.5 _CNV_A_R_LINEAR_____18_CM 0. 25.5 FORMAT "%4.1" /end CHARACTERISTIC
/begin MEASUREMENT TLRGEN "generator load response time setpoint" UBYTE _CNV_A_R_LINEAR_____18_CM 1 100. 0. 25.5 ECU_ADDRESS 0x3fac11 FORMAT "%4.1" /end MEASUREMENT
/begin MEASUREMENT AR_RED_ISA "Reduced area at the ISA" UWORD _CNV_A_R_LINEAR_____286_CM 1 100. 0. 58.592855 ECU_ADDRESS 0x3fcd50 FORMAT "%7.4" /end MEASUREMENT
/begin MEASUREMENT AR_RED_ISA_DIF_I_REL_MMV "moving mean I-value (relative) of the closed loop control reduced ISA valve area" SWORD _CNV_A_R_LINEAR_____149_CM 1 100. -50. 49.99847412 ECU_ADDRESS 0x3fcd56 FORMAT "%7.3" /end MEASUREMENT
/begin MEASUREMENT AR_RED_THR_DIF_I_REL_MMV "moving mean I-value (relative) of the closed loop control reduced throttle area" SWORD _CNV_A_R_LINEAR_____149_CM 1 100. -50. 49.99847412 ECU_ADDRESS 0x3fcd54 FORMAT "%7.3" /end MEASUREMENT
/begin CHARACTERISTIC IP_FAC_AR_RED_DIF "P-value reduced throttle area (MAF-controlled)" CURVE 0x64948 _REC_CUR_20_u1_u1 0.99610001 _CNV_A_R_LINEAR_____68_CM 0. 0.99610001 FORMAT "%5.3"
 /begin AXIS_DESCR COM_AXIS MAF_TURB_RATIO _CNV_A_R_LINEAR_____68_CM 8 0. 0.99610001 FORMAT "%5.3" AXIS_PTS_REF ldp_maf_turb_ratio /end AXIS_DESCR
/end CHARACTERISTIC
/begin AXIS_PTS ldp_maf_turb_ratio "" 0x613b4 MAF_TURB_RATIO _REC_AXS_20_u1 0.99610001 _CNV_A_R_LINEAR_____68_CM 8 0. 0.99610001 FORMAT "%5.3" /end AXIS_PTS
/begin MEASUREMENT AR_RED_ISA_BAS "Basic reduced opening area at the idle speed actuator" UWORD _CNV_A_R_LINEAR_____286_CM 1 100. 0. 58.592855 ECU_ADDRESS 0x3fcd8c FORMAT "%7.4" /end MEASUREMENT
/begin CHARACTERISTIC IP_AR_RED_ISA "reduced area at the idle speed actuator" CURVE 0x64950 _REC_CUR_20_u2_u2 58.592855 _CNV_A_R_LINEAR_____286_CM 0. 58.592855 FORMAT "%7.4"
 /begin AXIS_DESCR COM_AXIS ISAPWM_MMV _CNV_A_R_LINEAR_____144_CM 16 0. 99.99847412 AXIS_PTS_REF ldp_isapwm_mmv /end AXIS_DESCR
/end CHARACTERISTIC
/begin AXIS_PTS ldp_isapwm_mmv "" 0x613be ISAPWM_MMV _REC_AXS_20_u2 99.99847412 _CNV_A_R_LINEAR_____144_CM 16 0. 99.99847412 /end AXIS_PTS
/begin CHARACTERISTIC GEN_APP_UG "generator voltage setpoint" VALUE 0x6e34d _REC_VAL_20_u1 6.299999999999999 _CNV_A_R_LINEAR_____314_CM 10.6 16.9 FORMAT "%4.1" /end CHARACTERISTIC
/begin CHARACTERISTIC IP_FAC_IVVT__VO "relative wave overlap" CURVE 0x64970 _REC_CUR_20_u1_u1 0.9960940000000002 _CNV_A_R_LINEAR_____8_CM 0. 0.996094 FORMAT "%5.3"
 /begin AXIS_DESCR COM_AXIS VO _CNV_A_R_LINEAR_____6_CM 8 0. 95.625 FORMAT "%5.2" AXIS_PTS_REF ldp_vo_fac_ivvt /end AXIS_DESCR
/end CHARACTERISTIC
/begin AXIS_PTS ldp_vo_fac_ivvt "" 0x613e0 VO _REC_AXS_20_u1 95.625 _CNV_A_R_LINEAR_____6_CM 8 0. 95.625 FORMAT "%5.2" /end AXIS_PTS
/begin MEASUREMENT VO_MIN "valve overlap minimum" UBYTE _CNV_A_R_LINEAR_____6_CM 1 100. 0. 95.625 ECU_ADDRESS 0x3fd8cd /end MEASUREMENT
/begin MEASUREMENT VO_MAX "valve overlap maximum" UBYTE _CNV_A_R_LINEAR_____6_CM 1 100. 0. 95.625 ECU_ADDRESS 0x3fd8ce /end MEASUREMENT
/begin MEASUREMENT CAM_AV_MV_IN "Average value inlet-CAM position" SWORD _CNV_A_R_LINEAR_____117_CM 1 100. -768. 767.9765625 ECU_ADDRESS 0x3fc964 FORMAT "%7.2" /end MEASUREMENT
/begin MEASUREMENT MAF_IVVT "Feedback free engine load for IVVT setpoint calculation" UWORD _CNV_A_R_LINEAR_____56_CM 1 100. 0. 1389. ECU_ADDRESS 0x3fc962 FORMAT "%7.2" /end MEASUREMENT
/begin MEASUREMENT STATE_IVVT "actual status IVVT-function" UBYTE _CNV_S_2_RANGE_STAT_378_CM 1 100. 0. 1. ECU_ADDRESS 0x3fd8d2 /end MEASUREMENT
/begin MEASUREMENT VO "actual valve overlap" UBYTE _CNV_A_R_LINEAR_____6_CM 1 100. 0. 95.625 ECU_ADDRESS 0x3fd8cc /end MEASUREMENT
/begin MEASUREMENT VO_0 "valve overlap cylinder bank 0" UBYTE _CNV_A_R_LINEAR_____6_CM 1 100. 0. 95.625 ECU_ADDRESS 0x3fd8d3 FORMAT "%5.1" /end MEASUREMENT
/begin MEASUREMENT FAC_IVVT "value representing the relative valve overlap" UBYTE _CNV_A_R_LINEAR_____44_CM 1 100. 0. 0.996094 ECU_ADDRESS 0x3fd8d1 FORMAT "%4.3" /end MEASUREMENT
/begin MEASUREMENT VO_1 "valve overlap cylinder bank 1" UBYTE _CNV_A_R_LINEAR_____6_CM 1 100. 0. 95.625 ECU_ADDRESS 0x3fd8d4 FORMAT "%5.1" /end MEASUREMENT
/begin CHARACTERISTIC C_T_DLY_IVVT_AST "delay time for IVVT activation after start" VALUE 0x64e8c _REC_VAL_20_u2 6553.5 _CNV_A_R_LINEAR_____18_CM 0. 6553.5 FORMAT "%6.1" /end CHARACTERISTIC
/begin CHARACTERISTIC C_CAM_OP_EX "outlet valves total opening angle" VALUE 0x64e8e _REC_VAL_20_s2 1535.9765625 _CNV_A_R_LINEAR_____117_CM -768. 767.9765625 FORMAT "%7.2" /end CHARACTERISTIC
/begin CHARACTERISTIC C_CAM_OP_IN "inlet valves total opening angle" VALUE 0x64e90 _REC_VAL_20_s2 1535.9765625 _CNV_A_R_LINEAR_____117_CM -768. 767.9765625 FORMAT "%7.2" /end CHARACTERISTIC
/begin CHARACTERISTIC C_CAM_PSN_HYS "possible deviation from reference cam position" VALUE 0x64e92 _REC_VAL_20_s2 1535.9765625 _CNV_A_R_LINEAR_____117_CM -768. 767.9765625 FORMAT "%7.2" /end CHARACTERISTIC
/begin CHARACTERISTIC C_CAM_ADJ_RNG_MAX_EX "adjustment range of exhaust camshaft" VALUE 0x64e94 _REC_VAL_20_s2 1535.9765625 _CNV_A_R_LINEAR_____117_CM -768. 767.9765625 FORMAT "%7.2" /end CHARACTERISTIC
/begin CHARACTERISTIC C_CAM_ADJ_RNG_MAX_IN "adjustment range of inlet camshaft" VALUE 0x64e96 _REC_VAL_20_s2 1535.9765625 _CNV_A_R_LINEAR_____117_CM -768. 767.9765625 FORMAT "%7.2" /end CHARACTERISTIC
/begin MEASUREMENT VO_SP "valve overlap setpoint" UBYTE _CNV_A_R_LINEAR_____6_CM 1 100. 0. 95.625 ECU_ADDRESS 0x3fd8cf /end MEASUREMENT
/begin MEASUREMENT VO_SP_REF "valve overlap setpoint at reference conditions (warm engine)" UBYTE _CNV_A_R_LINEAR_____6_CM 1 100. 0. 95.625 ECU_ADDRESS 0x3fd8d0 /end MEASUREMENT
/begin COMPU_METHOD _CNV_A_R_LINEAR_____0_CM "" RAT_FUNC "%6.3" "rpm" COEFFS 0 1. 0. 0 0 1 /end COMPU_METHOD
/begin COMPU_METHOD _CNV_A_R_LINEAR_____1_CM "" RAT_FUNC "%6.3" "hPa" COEFFS 0 12.06017666543982 0. 0 0 1 /end COMPU_METHOD
/begin COMPU_METHOD _CNV_A_R_LINEAR_____2_CM "" RAT_FUNC "%6.3" "-" COEFFS 0 65536.00007936121 0. 0 0 1 /end COMPU_METHOD
/begin COMPU_METHOD _CNV_A_R_LINEAR_____3_CM "" RAT_FUNC "%6.3" "ms" COEFFS 0 0.1 0. 0 0 1 /end COMPU_METHOD
/begin COMPU_METHOD _CNV_A_R_LINEAR_____5_CM "" RAT_FUNC "%6.3" "-" COEFFS 0 32768.00003968061 0. 0 0 1 /end COMPU_METHOD
/begin COMPU_METHOD _CNV_A_R_LINEAR_____6_CM "" RAT_FUNC "%6.3" "°CRK" COEFFS 0 2.666666666666667 0. 0 0 1 /end COMPU_METHOD
/begin COMPU_METHOD _CNV_A_R_LINEAR_____8_CM "" RAT_FUNC "%6.3" "[-]" COEFFS 0 255.9999357490357 0. 0 0 1 /end COMPU_METHOD
/begin COMPU_METHOD _CNV_A_R_LINEAR_____9_CM "" RAT_FUNC "%6.3" "-" COEFFS 0 1048576. 0. 0 0 1 /end COMPU_METHOD
/begin COMPU_METHOD _CNV_A_R_LINEAR_____10_CM "" RAT_FUNC "%6.3" "-" COEFFS 0 16383.99999935999 -1.280019205296412e-006 0 0 1 /end COMPU_METHOD
/begin COMPU_METHOD _CNV_A_R_LINEAR_____13_CM "" RAT_FUNC "%6.3" "[-]" COEFFS 0 1. 0. 0 0 1 /end COMPU_METHOD
/begin COMPU_METHOD _CNV_A_R_LINEAR_____14_CM "" RAT_FUNC "%6.3" "rpm/s" COEFFS 0 3.125e-002 0. 0 0 1 /end COMPU_METHOD
/begin COMPU_METHOD _CNV_A_R_LINEAR_____15_CM "" RAT_FUNC "%6.3" "rpm" COEFFS 0 3.125e-002 0. 0 0 1 /end COMPU_METHOD
/begin COMPU_METHOD _CNV_A_R_LINEAR_____16_CM "" RAT_FUNC "%6.3" "%" COEFFS 0 2.56 0. 0 0 1 /end COMPU_METHOD
/begin COMPU_METHOD _CNV_A_R_LINEAR_____17_CM "" RAT_FUNC "%6.3" "-" COEFFS 0 1. 0. 0 0 1 /end COMPU_METHOD
/begin COMPU_METHOD _CNV_A_R_LINEAR_____18_CM "" RAT_FUNC "%6.3" "s" COEFFS 0 10. 0. 0 0 1 /end COMPU_METHOD
/begin COMPU_METHOD _CNV_A_R_LINEAR_____21_CM "" RAT_FUNC "%6.3" "s" COEFFS 0 100. 0. 0 0 1 /end COMPU_METHOD
/begin COMPU_METHOD _CNV_A_R_LINEAR_____22_CM "" RAT_FUNC "%6.3" "°C" COEFFS 0 1.333333333333333 64. 0 0 1 /end COMPU_METHOD
/begin COMPU_METHOD _CNV_A_R_LINEAR_____23_CM "" RAT_FUNC "%6.3" "°C" COEFFS 0 1.333333333333333 0. 0 0 1 /end COMPU_METHOD
/begin COMPU_METHOD _CNV_A_R_LINEAR_____24_CM "" RAT_FUNC "%6.3" "ms" COEFFS 0 250. 0. 0 0 1 /end COMPU_METHOD
/begin COMPU_METHOD _CNV_A_R_LINEAR_____27_CM "" RAT_FUNC "%6.3" "-" COEFFS 0 511.9999948599216 0. 0 0 1 /end COMPU_METHOD
/begin COMPU_METHOD _CNV_A_R_LINEAR_____30_CM "" RAT_FUNC "%6.3" "°C/s" COEFFS 0 1. 0. 0 0 1 /end COMPU_METHOD
/begin COMPU_METHOD _CNV_A_R_LINEAR_____32_CM "" RAT_FUNC "%6.3" "°C" COEFFS 0 1. 40. 0 0 1 /end COMPU_METHOD
/begin COMPU_METHOD _CNV_A_R_LINEAR_____34_CM "" RAT_FUNC "%6.3" "°TPS" COEFFS 0 137.0962343096234 0. 0 0 1 /end COMPU_METHOD
/begin COMPU_METHOD _CNV_A_R_LINEAR_____37_CM "" RAT_FUNC "%6.3" "Nm" COEFFS 0 32. 0. 0 0 1 /end COMPU_METHOD
/begin COMPU_METHOD _CNV_A_R_LINEAR_____38_CM "" RAT_FUNC "%6.3" "V" COEFFS 0 204.7999998974999 0. 0 0 1 /end COMPU_METHOD
/begin COMPU_METHOD _CNV_A_R_LINEAR_____40_CM "" RAT_FUNC "%6.3" "V" COEFFS 0 51.2 0. 0 0 1 /end COMPU_METHOD
/begin COMPU_METHOD _CNV_A_R_LINEAR_____43_CM "" RAT_FUNC "%6.3" "km/h" COEFFS 0 1. 0. 0 0 1 /end COMPU_METHOD
/begin COMPU_METHOD _CNV_A_R_LINEAR_____44_CM "" RAT_FUNC "%6.3" "-" COEFFS 0 255.9999357490357 0. 0 0 1 /end COMPU_METHOD
/begin COMPU_METHOD _CNV_A_R_LINEAR_____45_CM "" RAT_FUNC "%6.3" "h/(km*min)" COEFFS 0 1. 0. 0 0 1 /end COMPU_METHOD
/begin COMPU_METHOD _CNV_A_R_LINEAR_____50_CM "" RAT_FUNC "%6.3" "-" COEFFS 0 1023.999999919998 0. 0 0 1 /end COMPU_METHOD
/begin COMPU_METHOD _CNV_A_R_LINEAR_____51_CM "" RAT_FUNC "%6.3" "mg/stk" COEFFS 0 0.183585313174946 0. 0 0 1 /end COMPU_METHOD
/begin COMPU_METHOD _CNV_A_R_LINEAR_____52_CM "" RAT_FUNC "%6.3" "kg/h" COEFFS 0 32. 0. 0 0 1 /end COMPU_METHOD
/begin COMPU_METHOD _CNV_A_R_LINEAR_____53_CM "" RAT_FUNC "%6.3" "rpm" COEFFS 0 1. 32768. 0 0 1 /end COMPU_METHOD
/begin COMPU_METHOD _CNV_A_R_LINEAR_____56_CM "" RAT_FUNC "%6.3" "mg/stk" COEFFS 0 47.18142548596112 0. 0 0 1 /end COMPU_METHOD
/begin COMPU_METHOD _CNV_A_R_LINEAR_____57_CM "" RAT_FUNC "%6.3" "rpm/Nm" COEFFS 0 65536.00007936121 0. 0 0 1 /end COMPU_METHOD
/begin COMPU_METHOD _CNV_A_R_LINEAR_____58_CM "" RAT_FUNC "%6.3" "Nm/rpm" COEFFS 0 8191.999999679995 0. 0 0 1 /end COMPU_METHOD
/begin COMPU_METHOD _CNV_A_R_LINEAR_____64_CM "" RAT_FUNC "%6.3" "-" COEFFS 0 127.9991955827809 0. 0 0 1 /end COMPU_METHOD
/begin COMPU_METHOD _CNV_A_R_LINEAR_____65_CM "" RAT_FUNC "%6.3" "Nm" COEFFS 0 32. 32768. 0 0 1 /end COMPU_METHOD
/begin COMPU_METHOD _CNV_A_R_LINEAR_____68_CM "" RAT_FUNC "%6.3" "-" COEFFS 0 255.9983911655618 0. 0 0 1 /end COMPU_METHOD
/begin COMPU_METHOD _CNV_S_2_RANGE______74_CM "" TAB_VERB "%6.3" "[-]" COMPU_TAB_REF _CNV_S_2_RANGE______74 /end COMPU_METHOD
/begin COMPU_VTAB _CNV_S_2_RANGE______74 "" TAB_VERB 2 0 "0" 1 "1" /end COMPU_VTAB
/begin COMPU_METHOD _CNV_S_2_RANGE______76_CM "" TAB_VERB "%6.3" "-" COMPU_TAB_REF _CNV_S_2_RANGE______76 /end COMPU_METHOD
/begin COMPU_VTAB _CNV_S_2_RANGE______76 "" TAB_VERB 2 0 "0" 1 "1" /end COMPU_VTAB
/begin COMPU_METHOD _CNV_S_2_RANGE______77_R_CM "" TAB_VERB "%6.3" "[-]" COMPU_TAB_REF _CNV_S_2_RANGE______77_R /end COMPU_METHOD
/begin COMPU_VTAB_RANGE _CNV_S_2_RANGE______77_R "" 2 0 0 "0" 1 255 "1" /end COMPU_VTAB_RANGE
/begin COMPU_METHOD _CNV_A_R_LINEAR_____81_CM "" RAT_FUNC "%6.3" "°TPS/s" COEFFS 0 8.535564853556485e-002 0. 0 0 1 /end COMPU_METHOD
/begin COMPU_METHOD _CNV_S_3_STATE_TQ_R_84_CM "" TAB_VERB "%6.3" "Nm" COMPU_TAB_REF _CNV_S_3_STATE_TQ_R_84 /end COMPU_METHOD
/begin COMPU_VTAB _CNV_S_3_STATE_TQ_R_84 "" TAB_VERB 3 1 "RANGE_1" 2 "RANGE_2" 3 "RANGE_3" /end COMPU_VTAB
/begin COMPU_METHOD _CNV_S_3_STATE_TQ_R_85_CM "" TAB_VERB "%6.3" "Nm" COMPU_TAB_REF _CNV_S_3_STATE_TQ_R_85 /end COMPU_METHOD
/begin COMPU_VTAB _CNV_S_3_STATE_TQ_R_85 "" TAB_VERB 3 0 "CONST" 1 "INC" 2 "DEC" /end COMPU_VTAB
/begin COMPU_METHOD _CNV_A_R_LINEAR_____86_CM "" RAT_FUNC "%6.3" "Nm" COEFFS 0 1. 0. 0 0 1 /end COMPU_METHOD
/begin COMPU_METHOD _CNV_A_R_LINEAR_____90_CM "" RAT_FUNC "%6.3" "-" COEFFS 0 4095.999999839998 -1.280019205296412e-006 0 0 1 /end COMPU_METHOD
/begin COMPU_METHOD _CNV_S_6_RANGE_ECU__92_CM "" TAB_VERB "%6.3" "[-]" COMPU_TAB_REF _CNV_S_6_RANGE_ECU__92 /end COMPU_METHOD
/begin COMPU_VTAB _CNV_S_6_RANGE_ECU__92 "" TAB_VERB 6 0 "ENG_STOP" 1 "RUN_ENG" 2 "SYN_ENG_IGK_ON" 3 "SYN_ENG_IGK_OFF" 4 "PWL" 5 "ENG_LOCK" /end COMPU_VTAB
/begin COMPU_METHOD _CNV_A_R_LINEAR_____93_CM "" RAT_FUNC "%6.3" "hPa" COEFFS 0 2. 0. 0 0 1 /end COMPU_METHOD
/begin COMPU_METHOD _CNV_A_R_LINEAR_____94_CM "" RAT_FUNC "%6.3" "°C" COEFFS 0 16. 0. 0 0 1 /end COMPU_METHOD
/begin COMPU_METHOD _CNV_A_R_LINEAR_____103_CM "" RAT_FUNC "%6.3" "-" COEFFS 0 4095.999963999451 32767.99971199561 0 0 1 /end COMPU_METHOD
/begin COMPU_METHOD _CNV_A_R_LINEAR_____104_CM "" RAT_FUNC "%6.3" "-" COEFFS 0 8191.999999679995 0. 0 0 1 /end COMPU_METHOD
/begin COMPU_METHOD _CNV_A_R_LINEAR_____105_CM "" RAT_FUNC "%6.3" "[-]" COEFFS 0 1023.999999959999 32767.99999871998 0 0 1 /end COMPU_METHOD
/begin COMPU_METHOD _CNV_A_R_LINEAR_____106_CM "" RAT_FUNC "%6.3" "-" COEFFS 0 1023.999999959999 -1.818989403545857e-011 0 0 1 /end COMPU_METHOD
/begin COMPU_METHOD _CNV_A_R_LINEAR_____113_CM "" RAT_FUNC "%6.3" "[-]" COEFFS 0 64. 0. 0 0 1 /end COMPU_METHOD
/begin COMPU_METHOD _CNV_A_R_LINEAR_____114_CM "" RAT_FUNC "%6.3" "hPa" COEFFS 0 0.3768805207949945 0. 0 0 1 /end COMPU_METHOD
/begin COMPU_METHOD _CNV_A_R_LINEAR_____117_CM "" RAT_FUNC "%6.3" "°CRK" COEFFS 0 42.66666666666666 0. 0 0 1 /end COMPU_METHOD
/begin COMPU_METHOD _CNV_A_R_LINEAR_____144_CM "" RAT_FUNC "%6.3" "%" COEFFS 0 655.3600000071681 0. 0 0 1 /end COMPU_METHOD
/begin COMPU_METHOD _CNV_A_R_LINEAR_____145_CM "" RAT_FUNC "%6.3" "bar" COEFFS 0 376.8805207949945 0. 0 0 1 /end COMPU_METHOD
/begin COMPU_METHOD _CNV_A_R_LINEAR_____149_CM "" RAT_FUNC "%6.3" "%" COEFFS 0 655.3600000071681 3.584063961170614e-007 0 0 1 /end COMPU_METHOD
/begin COMPU_METHOD _CNV_A_R_LINEAR_____153_CM "" RAT_FUNC "%6.3" "km/h" COEFFS 0 128.0000018750286 0. 0 0 1 /end COMPU_METHOD
/begin COMPU_METHOD _CNV_A_R_LINEAR_____158_CM "" RAT_FUNC "%6.3" "V" COEFFS 0 204.8 0. 0 0 1 /end COMPU_METHOD
/begin COMPU_METHOD _CNV_A_R_LINEAR_____165_CM "" RAT_FUNC "%6.3" "µs" COEFFS 0 1. 0. 0 0 1 /end COMPU_METHOD
/begin COMPU_METHOD _CNV_A_R_LINEAR_____166_CM "" RAT_FUNC "%6.3" "%." COEFFS 0 4194.293686959193 -8.057063130399911e-002 0 0 1 /end COMPU_METHOD
/begin COMPU_METHOD _CNV_A_R_LINEAR_____167_CM "" RAT_FUNC "%6.3" "%." COEFFS 0 65.408 0. 0 0 1 /end COMPU_METHOD
/begin COMPU_METHOD _CNV_A_R_LINEAR_____168_CM "" RAT_FUNC "%6.3" "µs" COEFFS 0 0.5312499998908606 -1006632960.765625 0 0 1 /end COMPU_METHOD
/begin COMPU_METHOD _CNV_A_R_LINEAR_____171_CM "" RAT_FUNC "%6.3" "1/min/s" COEFFS 0 3.125e-002 0. 0 0 1 /end COMPU_METHOD
/begin COMPU_METHOD _CNV_A_R_LINEAR_____177_CM "" RAT_FUNC "%6.3" "W" COEFFS 0 -5.e-002 0. 0 0 1 /end COMPU_METHOD
/begin COMPU_METHOD _CNV_A_R_LINEAR_____178_CM "" RAT_FUNC "%6.3" "Nm/100ms" COEFFS 0 32. 0. 0 0 1 /end COMPU_METHOD
/begin COMPU_METHOD _CNV_A_R_LINEAR_____184_CM "" RAT_FUNC "%6.3" "Nm/rpm*rpm" COEFFS 0 134293032.7868853 0. 0 0 1 /end COMPU_METHOD
/begin COMPU_METHOD _CNV_A_R_LINEAR_____192_CM "" RAT_FUNC "%6.3" "-" COEFFS 0 32768. 0. 0 0 1 /end COMPU_METHOD
/begin COMPU_METHOD _CNV_S_4_RANGE_STAT_203_CM "" TAB_VERB "%6.3" "[-]" COMPU_TAB_REF _CNV_S_4_RANGE_STAT_203 /end COMPU_METHOD
/begin COMPU_VTAB _CNV_S_4_RANGE_STAT_203 "" TAB_VERB 4 0 "CC open" 1 "CC controlled" 2 "CC closed" 3 "not defined" /end COMPU_VTAB
/begin COMPU_METHOD _CNV_A_R_LINEAR_____205_CM "" RAT_FUNC "%6.3" "min" COEFFS 0 1. 0. 0 0 1 /end COMPU_METHOD
/begin COMPU_METHOD _CNV_A_R_LINEAR_____212_CM "" RAT_FUNC "%6.3" "°STW" COEFFS 0 22.8564453125 -3.637978807091713e-012 0 0 1 /end COMPU_METHOD
/begin COMPU_METHOD _CNV_A_R_LINEAR_____213_CM "" RAT_FUNC "%6.3" "°STW/s" COEFFS 0 22.8564453125 -3.637978807091713e-012 0 0 1 /end COMPU_METHOD
/begin COMPU_METHOD _CNV_A_R_LINEAR_____220_CM "" RAT_FUNC "%6.3" "km" COEFFS 0 0.1 0. 0 0 1 /end COMPU_METHOD
/begin COMPU_METHOD _CNV_A_R_sprzi_q0p8_221_CM "" RAT_FUNC "%6.3" "Grad Kw" COEFFS 0 1.25 0. 0 0 1 /end COMPU_METHOD
/begin COMPU_METHOD _CNV_S_2_B_TRUE_222_CM "" TAB_VERB "%6.3" "-" COMPU_TAB_REF _CNV_S_2_B_TRUE_222 /end COMPU_METHOD
/begin COMPU_VTAB _CNV_S_2_B_TRUE_222 "" TAB_VERB 2 0 "----" 1 "TRUE" /end COMPU_VTAB
/begin COMPU_METHOD _CNV_A_R_spg_ubatt_223_CM "" RAT_FUNC "%6.3" "V" COEFFS 0 10.61571125265393 0. 0 0 1 /end COMPU_METHOD
/begin COMPU_METHOD _CNV_A_R_nmot_ub_q4_235_CM "" RAT_FUNC "%6.3" "rpm" COEFFS 0 2.5e-002 0. 0 0 1 /end COMPU_METHOD
/begin COMPU_METHOD _CNV_A_R_rel_ub_q0p_264_CM "" RAT_FUNC "%6.3" "%" COEFFS 0 1.333333333333333 0. 0 0 1 /end COMPU_METHOD
/begin COMPU_METHOD _CNV_A_R_LINEAR_____281_CM "" RAT_FUNC "%6.3" "hPa" COEFFS 0 12.06017666543982 -1.759293338545831e-002 0 0 1 /end COMPU_METHOD
/begin COMPU_METHOD _CNV_A_R_LINEAR_____286_CM "" RAT_FUNC "%6.3" "cm²" COEFFS 0 1118.481084425738 0. 0 0 1 /end COMPU_METHOD
/begin COMPU_METHOD _CNV_A_R_LINEAR_____288_CM "" RAT_FUNC "%6.3" "Pa/kg" COEFFS 0 1.123136246786632e-003 0. 0 0 1 /end COMPU_METHOD
/begin COMPU_METHOD _CNV_A_R_LINEAR_____289_CM "" RAT_FUNC "%6.3" "hPa" COEFFS 0 1541.2906436473 0. 0 0 1 /end COMPU_METHOD
/begin COMPU_METHOD _CNV_A_R_LINEAR_____290_CM "" RAT_FUNC "%6.3" "hPa/ms" COEFFS 0 395.1818376757466 0. 0 0 1 /end COMPU_METHOD
/begin COMPU_METHOD _CNV_A_R_LINEAR_____291_CM "" RAT_FUNC "%6.3" "cm²" COEFFS 0 1118.481075453891 2.574382087914273e-004 0 0 1 /end COMPU_METHOD
/begin COMPU_METHOD _CNV_A_R_LINEAR_____292_CM "" RAT_FUNC "%6.3" "1/s" COEFFS 0 1073.741857908145 0. 0 0 1 /end COMPU_METHOD
/begin COMPU_METHOD _CNV_A_R_LINEAR_____293_CM "" RAT_FUNC "%6.3" "%/kg" COEFFS 0 0.3817721076546662 0. 0 0 1 /end COMPU_METHOD
/begin COMPU_METHOD _CNV_A_R_LINEAR_____294_CM "" RAT_FUNC "%6.3" "%/(hPa*s)" COEFFS 0 29173.86349472035 0. 0 0 1 /end COMPU_METHOD
/begin COMPU_METHOD _CNV_A_R_LINEAR_____295_CM "" RAT_FUNC "%6.3" "%/hPa" COEFFS 0 111291.3086302347 0. 0 0 1 /end COMPU_METHOD
/begin COMPU_METHOD _CNV_A_R_LINEAR_____296_CM "" RAT_FUNC "%6.3" "ms" COEFFS 0 1000. 0. 0 0 1 /end COMPU_METHOD
/begin COMPU_METHOD _CNV_A_R_LINEAR_____304_CM "" RAT_FUNC "%6.3" "(%*h)/kg" COEFFS 0 5242.590296388145 0. 0 0 1 /end COMPU_METHOD
/begin COMPU_METHOD _CNV_A_R_LINEAR_____314_CM "" RAT_FUNC "%6.3" "V" COEFFS 0 10. -106. 0 0 1 /end COMPU_METHOD
/begin COMPU_METHOD _CNV_S_2_RANGE_STAT_378_CM "" TAB_VERB "%6.3" "-" COMPU_TAB_REF _CNV_S_2_RANGE_STAT_378 /end COMPU_METHOD
/begin COMPU_VTAB _CNV_S_2_RANGE_STAT_378 "" TAB_VERB 2 0 "PASSIVE" 1 "ACTIVE" /end COMPU_VTAB
/begin RECORD_LAYOUT _REC_VAL_20_u2 FNC_VALUES 1 UWORD COLUMN_DIR DIRECT /end RECORD_LAYOUT
/begin RECORD_LAYOUT _REC_VAL_20_s2 FNC_VALUES 1 SWORD COLUMN_DIR DIRECT /end RECORD_LAYOUT
/begin RECORD_LAYOUT _REC_VAL_20_u1 FNC_VALUES 1 UBYTE COLUMN_DIR DIRECT /end RECORD_LAYOUT
/begin RECORD_LAYOUT _REC_VAL_20_s1 FNC_VALUES 1 SBYTE COLUMN_DIR DIRECT /end RECORD_LAYOUT
/begin RECORD_LAYOUT _REC_AXS_20_u2 NO_AXIS_PTS_X 1 UWORD AXIS_PTS_X 2 UWORD INDEX_INCR DIRECT /end RECORD_LAYOUT
/begin RECORD_LAYOUT _REC_AXS_20_u1 NO_AXIS_PTS_X 1 UBYTE AXIS_PTS_X 2 UBYTE INDEX_INCR DIRECT /end RECORD_LAYOUT
/begin RECORD_LAYOUT _REC_CUR_20_u2_u2 FNC_VALUES 1 UWORD COLUMN_DIR DIRECT /end RECORD_LAYOUT
/begin RECORD_LAYOUT _REC_MAP_20_u1_u1_u1 FNC_VALUES 1 UBYTE COLUMN_DIR DIRECT /end RECORD_LAYOUT
/begin RECORD_LAYOUT _REC_CUR_20_u2_u1 FNC_VALUES 1 UWORD COLUMN_DIR DIRECT /end RECORD_LAYOUT
/begin RECORD_LAYOUT _REC_CUR_20_u1_u1 FNC_VALUES 1 UBYTE COLUMN_DIR DIRECT /end RECORD_LAYOUT
/begin RECORD_LAYOUT _REC_MAP_20_u1_u2_u1 FNC_VALUES 1 UBYTE COLUMN_DIR DIRECT /end RECORD_LAYOUT
/begin RECORD_LAYOUT _REC_CUR_20_u1_u2 FNC_VALUES 1 UBYTE COLUMN_DIR DIRECT /end RECORD_LAYOUT
/begin RECORD_LAYOUT _REC_MAP_20_u2_u1_u1 FNC_VALUES 1 UWORD COLUMN_DIR DIRECT /end RECORD_LAYOUT
/begin RECORD_LAYOUT _REC_MAP_20_u2_u1_u2 FNC_VALUES 1 UWORD COLUMN_DIR DIRECT /end RECORD_LAYOUT
/begin FUNCTION SYS_IVVT_Variables "_IVVT Variables"
 /begin DEF_CHARACTERISTIC IP_FAC_IVVT__VO C_T_DLY_IVVT_AST C_CAM_OP_EX C_CAM_OP_IN C_CAM_PSN_HYS C_CAM_ADJ_RNG_MAX_EX C_CAM_ADJ_RNG_MAX_IN /end DEF_CHARACTERISTIC
 /begin OUT_MEASUREMENT VO_MIN VO_MAX CAM_AV_MV_IN MAF_IVVT STATE_IVVT VO VO_0 FAC_IVVT VO_1 VO_SP VO_SP_REF /end OUT_MEASUREMENT
/end FUNCTION
/begin FUNCTION SYS_Gear_ratio_detection "_Gear ratio detection" /begin DEF_CHARACTERISTIC ID_GR_MT C_MIN_VS_RATIO /end DEF_CHARACTERISTIC /begin OUT_MEASUREMENT N_VS_RATIO LV_DRI GR_MT GR_AT LV_RNG_L /end OUT_MEASUREMENT /end FUNCTION
/begin FUNCTION SYS_Drive_train_engaged "_Drive train engaged" /begin DEF_CHARACTERISTIC C_VS_MIN_DT /end DEF_CHARACTERISTIC /begin OUT_MEASUREMENT LV_DT VLS_DOWN_1 VLS_UP_1 VLS_DOWN_2 VLS_UP_2 /end OUT_MEASUREMENT /end FUNCTION
/begin FUNCTION SYS_Clutch_switch_detection "_Clutch switch detection" /begin DEF_CHARACTERISTIC C_CS_PN_T_MAX /end DEF_CHARACTERISTIC /begin OUT_MEASUREMENT CS_T LV_CS /end OUT_MEASUREMENT /end FUNCTION
/begin FUNCTION SYS_Input_messages "_Input messages"
 /begin DEF_CHARACTERISTIC C_TCO_TMOT_STA C_TMOT_SUM_HYS C_T_TCO_CAN_AST C_TQ_STND C_TCO_SWI_WUP LC_TAM_MAN_AS C_TAM_MAN_AS C_EXC_INI C_STATE_VVL C_STATE_VVL_AD IP_TQ_LOSS_ACC_INP C_T_AST_SWI_WUP C_PV_CAN_DIAG C_T_CTR_MAX_ASR_CAN C_MAX_MSG_MISS_ASR_CAN /end DEF_CHARACTERISTIC
 /begin OUT_MEASUREMENT TQ_ACCIN_CAN TQ_LOSS_ACC_INP N_ECF STATE_EFP_CRASH_CAN LV_REQ_TCO_L GEAR_SEL_DISP TQI_GS_REQ_CAN TQI_GS_REQ LV_REQ_HEAT LV_ACIN STATE_TXU_CR STATE_TXU_TR STATE_TXU_ERR STATE_TXU STATE_TXU_MT TXU_WAL TXU_DISP_COGS_SUM TXU_DISP_RNG_SUM TXU_DISP_GEAR_SUM LV_CAN_EGS_LIH GEAR_INFO TQI_TXU LV_ASR_REQ TQI_MSR_CAN TQI_ASR_SLOW_CAN LV_MSR_REQ VS_CAN WHEEL LV_PLAUS_ASR_CTL LV_PLAUS_ESP_CTL TQI_ASR_FAST_CAN LV_ERR_VS_CAN LV_CAN_FRS LV_ACK_TCS STATE_CC LV_ACCIN GEAR ANG_PSTE VEL_ANG_PSTE STATE_SENS_ANG_PSTE CTR_KM_CAN T_REL_CAN TAM LV_LTG_SWI_CAN /end OUT_MEASUREMENT
/end FUNCTION
/begin FUNCTION SYS_Oil_temperature "_Oil temperature" /begin DEF_CHARACTERISTIC C_TOIL_GRD_MAX_DIAG IP_TOIL /end DEF_CHARACTERISTIC /begin OUT_MEASUREMENT TOIL TOIL_STOP /end OUT_MEASUREMENT /end FUNCTION
/begin FUNCTION SYS_Ambient_pressure_variables "_Ambient pressure variables"
 /begin DEF_CHARACTERISTIC C_AMP_HYS IP_AMP_RAW IP_AMP_RAW_COR__VS C_AMP_CRLC C_FAC_AMP_MIN C_FAC_AMP_MAX /end DEF_CHARACTERISTIC
 /begin OUT_MEASUREMENT AMP_MES FAC_AMP /end OUT_MEASUREMENT
/end FUNCTION
/begin FUNCTION SYS_System_variables_for_custome "_System variables for customer defined functions" /end FUNCTION
/begin FUNCTION SYS_System_variables_in_the_exha "_System variables in the exhaust pipe"
 /begin DEF_CHARACTERISTIC IP_AR_RED_EGR__N_32__STK_AV_EGR IP_PRS_EX_INC IP_TEG_EGR__MAF_CYL /end DEF_CHARACTERISTIC
 /begin OUT_MEASUREMENT PRS_EX PRS_EX_INC TEG_EGR AR_RED_EGR /end OUT_MEASUREMENT
/end FUNCTION
/begin FUNCTION SYS_Reduced_area_controller "_Reduced area controller"
 /begin DEF_CHARACTERISTIC C_AR_RED_AD_ADD_MIN C_AR_RED_AD_FAC_MAX C_AR_RED_AD_FAC_MIN C_AR_RED_DIF_I_REL_MIN C_CRLC_AR_RED_DIF_I_REL_MMV C_N__AR_RED__AD_ADD_MAX C_N__AR_RED__AD_ADD_MIN C_N__AR_RED__AD_FAC_MIN C_N__AR_RED__AD_FAC_MAX C_PQ__AR_RED__AD_FAC_MAX C_PQ__AR_RED__AD_FAC_MIN C_PQ__AR_RED__AD_ADD_MAX C_T_AST_AR_RED_CTL_DEAC IP_FAC_AR_RED_COR__PQ IP_AR_RED_I_REL_1__N__PQ IP_AR_RED_I_REL_2__N__PQ IP_AR_RED_P_REL_2__N__PQ IP_CRLC_HFM IP_T_1_HFM C_LGRD_AR_RED_DIF_TRA C_CRLC_MAP_MDL C_CRLC_AR_RED_AD_ADD C_CRLC_AR_RED_AD_FAC C_AR_RED_DIF_I_REL_MAX C_AR_RED_AD_ADD_MAX IP_AR_RED_P_REL_1__N__PQ IP_FAC_AR_RED_DIF /end DEF_CHARACTERISTIC
 /begin OUT_MEASUREMENT MAF_MDL MAP_MDL FAC_AR_RED_DIF AR_RED_AD_ADD AR_RED_AD_FAC AR_RED_AD_FAC_COR AR_RED_DIF_I_REL_MMV AR_RED_DIF_P_REL MAP_MDL_MV MAP_MDL_DIF MAF_MDL_MV MAF_MDL_DIF AR_RED AR_RED_DIF_I_REL AR_RED_DIF_REL AR_RED_ISA_DIF_REL AR_RED_ISA AR_RED_ISA_DIF_I_REL_MMV AR_RED_THR_DIF_I_REL_MMV /end OUT_MEASUREMENT
/end FUNCTION
/begin FUNCTION SYS_Ambient_Pressure_Control "_Ambient Pressure Control"
 /begin DEF_CHARACTERISTIC C_CRLC_AMP_AD C_TCO_THD_AMP_AD C_AMP_AD_PL_HYS C_AMP_AD_COR_CLRC C_AMP_AD_DIF_NEG C_AMP_AD_DIF_POS C_AMP_DIF_TI_LAM_POS C_AMP_MAX C_AMP_MIN C_AMP_INI C_AMP_I_1 C_AMP_DIF_TI_LAM_NEG C_AMP_MDL_DIF_I_MAX C_AMP_MDL_DIF_I_MIN C_AMP_P_1 C_AMP_P_2 C_CRLC_MAF_KGH_AMP_AD_PL C_CRLC_AMP_MDL_DIF_I_MMV C_MAP_DRV1_MAX_AMP_AD_PL C_N_AMP_AD_MIN C_N_AMP_AD_MAX C_N_MIN_AMP_AD_PL C_PQ_AMP_AD C_PQ_AMP_AD_PL C_PQ_AMP_CTL C_SEG_CTR_AMP_AD C_SEG_CTR_AMP_AD_PL C_T_AST_AMP_CTL_DEAC C_TI_LAM_MAF_PULS_MAX C_TI_LAM_MAF_PULS_MIN C_TPS_MIN_AMP_AD_PL C_AMP_I_2 C_CRLC_AR_RED_BAS_AMP_AD_PL C_LGRD_AMP_MDL_DIF_TRA LC_AR_RED_AD_ENA /end DEF_CHARACTERISTIC
 /begin OUT_MEASUREMENT AMP AMP_MDL_DIF_I_MMV AMP_MDL_DIF_I AMP_MDL_DIF_P AMP_ESTIM AMP_AD_DIF AMP_AD AR_RED_BAS_MMV MAF_KGH_MMV SEG_CTR_AMP_AD_PL AMP_MDL AMP_MDL_DIF /end OUT_MEASUREMENT
/end FUNCTION
/begin FUNCTION SYS_Engine_roughness_calculation "_Engine roughness calculation"
 /begin DEF_CHARACTERISTIC C_N_SEG_T_AD_MAX_ER C_N_SEG_T_AD_MIN_ER C_SEG_T_AD_COR_DRV1_MAX_ER C_CRK_DIF_MAX_ER C_SEG_T_AD_CRLC_ER C_SEG_T_FAST_AD_CRLC_ER C_T_SEG_AD_DLY IP_FAC_DRV2_ER_MT IP_FAC_DRV2_ER_AT IP_CRLC_DRV2_ER_AT IP_CRLC_DRV2_ER_MT IP_MAF_DIF_MAX_ER__MAF IP_TQI_AV_DIF_MAX_ER__TQI_AV C_MAF_DIF_DLY_ER C_TQI_AV_DIF_DLY_ER C_TPS_GRD_DLY_ER C_ACCOUT_DLY_ER C_T_AST_DLY_ER C_IGA_DIF_MAX_ER C_IGA_DIF_CYCNR_ER IP_TPS_GRD_MAX_ER__TPS_AV LC_MIS_INH /end DEF_CHARACTERISTIC
 /begin OUT_MEASUREMENT SEG_NR_ER SEG_T_COR_BUF_0 SEG_T_COR_BUF_1 SEG_T_COR_BUF_2 SEG_T_COR_BUF_3 SEG_T_COR_BUF_4 SEG_T_COR_BUF_5 SEG_T_COR_BUF_6 SEG_T_COR_BUF_7 SEG_T_COR_BUF_8 SEG_T_COR_BUF_9 SEG_T_COR_BUF_10 SEG_T_COR_BUF_11 SEG_AD_MMV_0 SEG_AD_MMV_1 SEG_AD_MMV_2 SEG_AD_MMV_3 SEG_AD_MMV_4 SEG_AD_MMV_5 ER_AV DRV0_ER DRV1_ER DRV2_MMV_ER ER_RR LV_SEG_AD_FDOUT IV_OFF_ER LV_IGA_DIF_MAX_ER LV_INH_SEG_AD SEG_T_COR LV_SEG_AD_LIM LV_SEG_AD_ACT_STATE ER_0 ER_1 ER_2 ER_3 ER_4 ER_5 /end OUT_MEASUREMENT
/end FUNCTION
/begin FUNCTION SYS_Engine_speed_calculation "_Engine speed calculation" /begin OUT_MEASUREMENT N N_32 T_SEG_AV N_GRD /end OUT_MEASUREMENT /end FUNCTION
/begin FUNCTION SYS_Fuel_pressure_acquisition "_Fuel pressure acquisition" /begin DEF_CHARACTERISTIC C_FUP_NOM C_FUP_MES_CRLC IP_FUP_MES /end DEF_CHARACTERISTIC /begin OUT_MEASUREMENT FUP_MES_MMV FUP FUP_BAR FUP_MES LV_FUP_CLC_SWI /end OUT_MEASUREMENT /end FUNCTION
/begin FUNCTION SYS_Detection_of_Driver_Passive "_Detection of Driver Passive" /begin DEF_CHARACTERISTIC IP_FAC_TQ_REQ_CLU_IS__N_32 C_FAC_TQ_REQ_CLU_IS_HYS /end DEF_CHARACTERISTIC /begin OUT_MEASUREMENT LV_CT /end OUT_MEASUREMENT /end FUNCTION
/begin FUNCTION SYS_System_variables_for_and_fro "_System variables for and from CUS"
 /begin DEF_CHARACTERISTIC C_CAM_INI_IN C_CAM_INI_EX C_MAF_REF APPIDLGSP GEN_APP_TLR GEN_APP_UG /end DEF_CHARACTERISTIC
 /begin OUT_MEASUREMENT CAM_AV_EX_0 CAM_AV_EX_1 CAM_AD_EX_FL_0_0 CAM_AD_EX_FL_0_1 CAM_AD_EX_FL_0_2 CAM_AD_EX_FL_0_3 CAM_AD_EX_FL_1_0 CAM_AD_EX_FL_1_1 CAM_AD_EX_FL_1_2 CAM_AD_EX_FL_1_3 CAM_AD_IN_FL_0_0 CAM_AD_IN_FL_0_1 CAM_AD_IN_FL_0_2 CAM_AD_IN_FL_0_3 CAM_AD_IN_FL_1_0 CAM_AD_IN_FL_1_1 CAM_AD_IN_FL_1_2 CAM_AD_IN_FL_1_3 CAM_AD_IN_0 CAM_AD_IN_1 CAM_AD_EX_0 CAM_AD_EX_1 CAM_AV_IN_0 CAM_AV_IN_1 IVVTPWM_1 IVVTPWM_0 Aspr B_nmot B_pwf B_st Espr ub nmot rl UGEN TLRGEN /end OUT_MEASUREMENT
/end FUNCTION
/begin FUNCTION SYS_ECU_state "_ECU state" /begin OUT_MEASUREMENT ECU_STATE /end OUT_MEASUREMENT /end FUNCTION
/begin FUNCTION SYS_Pressure_Variables "_Pressure Variables" /begin DEF_CHARACTERISTIC IP_MAP_MES_BAS__V_MAP /end DEF_CHARACTERISTIC /begin OUT_MEASUREMENT V_MAP LV_LOAD_RATIO_CHK MAP_MES_BAS /end OUT_MEASUREMENT /end FUNCTION
/begin FUNCTION SYS_Engine_off_duration "_Engine off duration"
 /begin DEF_CHARACTERISTIC C_T_ES_TCO_PLAUS_MAX C_T_ES_TCO_PLAUS_MIN C_TCO_STOP_T_ES_PLAUS_MIN C_T_ES_SUB C_TCO_STOP_T_ES_PLAUS_MAX C_TCO_STOP_T_ES_MIN /end DEF_CHARACTERISTIC
 /begin OUT_MEASUREMENT T_ES T_REL_CAN_ES T_REL_CAN_ST LV_T_REL_CAN_REG LV_T_ES_NOT_PLAUS /end OUT_MEASUREMENT
/end FUNCTION
/begin FUNCTION SYS_Calculation_of_the_basic_red "_Calculation of the basic reduced area" /begin DEF_CHARACTERISTIC IP_AR_RED_THR IP_AR_RED_ISA /end DEF_CHARACTERISTIC /begin OUT_MEASUREMENT AR_RED_BAS AR_RED_ISA_BAS /end OUT_MEASUREMENT /end FUNCTION
/begin FUNCTION TQM_Torque_Managment "TQM"
 /begin SUB_FUNCTION TQM_Torque_request_for_gear_shif TQM_Initialization_module TQM_Torque_control_at_engine_sta TQM_Reference_and_basic_torque TQM_Torque_losses TQM_Torque_loss_and_reserve_for_ TQM_Torque_based_catalyst_heatin TQM_Torque_based_pattern_calcula TQM_Minimum_torque_at_clutch TQM_Converter_torque TQM_Torque_transient TQM_Torque_reserve_coordination TQM_Minimum_indicated_torque_at_ TQM_Torque_coordination TQM_Torque_based_anti_jerk_funct TQM_Basic__actual_and_minimum_la TQM_Pedal_value_interpretation TQM_Maximum_torque_at_clutch TQM_Characteristic_quantity_stra TQM_Reference_and_basic_torque_f TQM_Torque_Request_at_Clutch_Gen TQM_Minimum_Maximum_Torque_Reque TQM_Torque_setpoint_for_stratifi TQM_Actual_Engine_Torque TQM_Actual_indicated_engine_torq TQM_Characteristic_quantity_homo TQM_Engine_torque_limitation TQM_Torque_Request_for_Traction_ TQM_Torque_Request_for_MSR TQM_Torque_Request_for_Cruise_Co /end SUB_FUNCTION
/end FUNCTION
/begin FUNCTION TQM_Torque_request_for_gear_shif "_Torque request for gear shift intervention" /begin DEF_CHARACTERISTIC C_TQI_GS_SLOW_HYS C_T_MAX_TQR_GS_INTV /end DEF_CHARACTERISTIC
 /begin OUT_MEASUREMENT TQI_GS_FAST_DEC LV_GS_ENA LV_GS_ACT T_TQR_GS_INTV LV_ETCU_DISABLE TQI_GS_SLOW_DEC /end OUT_MEASUREMENT
/end FUNCTION
/begin FUNCTION TQM_Initialization_module "_Initialization module"
 /begin OUT_MEASUREMENT LV_TQ_FAST_ENA TQI_P_MAX TQI_VS_MAX TQ_LOSS_SCHA ACP TQ_LOSS_PSTE LV_TQ_LOSS_ACC_INP_ORNG LAMB_BAS_COR_MAX LAMB_SCC LV_CAN_GS_ACK LV_ACP_ORNG LV_TQ_IGA_ENA EFF_EGR_S EFF_PHA_S TQ_AD_ADD_S_SWI TQ_ADD_SO2P TQI_REQ_LIM_FAST TQI_REQ_LIM_SLOW TQI_GS_SLOW_INC TQI_GS_FAST_INC TQI_CAT_PROT TQ_LOSS_SA TQ_LOSS_THERMO TQ_LOSS_WIN_HEAT EFF_MAF_S /end OUT_MEASUREMENT
/end FUNCTION
/begin FUNCTION TQM_Torque_control_at_engine_sta "_Torque control at engine start"
 /begin DEF_CHARACTERISTIC C_T_TQ_ADD_DLY_ST IP_TQ_ADD_ST__N IP_TQ_ST C_TQ_ADD_CRLC_ST C_TQ_ST_CRLC /end DEF_CHARACTERISTIC
 /begin OUT_MEASUREMENT LV_TQ_ADD_ST TQ_ADD_ST TQ_ST TQ_ST_1 /end OUT_MEASUREMENT
/end FUNCTION
/begin FUNCTION TQM_Reference_and_basic_torque "_Reference and basic torque" /begin DEF_CHARACTERISTIC IP_TQI_REF__N__MAF LC_MOD_EFF_AV /end DEF_CHARACTERISTIC
 /begin OUT_MEASUREMENT TQI_BAS TQI_REF_IGA TQI_REF_IGA_LAMB TQI_REF_IGA_MIN_LAMB TQI_REF_IGA_SCC TQI_REF_LAMB TQI_REF_LAMB_SCC TQI_REF_SCC TQI_REF EFF_TOT_BAS EFF_TOT_BAS_SLOW /end OUT_MEASUREMENT
/end FUNCTION
/begin FUNCTION TQM_Torque_losses "_Torque losses"
 /begin DEF_CHARACTERISTIC C_TQFR_DEC_ST IP_TQFR IP_TQFR_ADD IP_TQFR_ST C_CRLC_TQFR IP_POW_LOSS_ECF C_LGRD_TQ_LOSS_ECF /end DEF_CHARACTERISTIC
 /begin OUT_MEASUREMENT TQ_LOSS_ECF TQFR_ADD TQFR_ST TQFR_BAS TQFR TQ_LOSS /end OUT_MEASUREMENT
/end FUNCTION
/begin FUNCTION TQM_Torque_loss_and_reserve_for_ "_Torque loss and reserve for ACC"
 /begin DEF_CHARACTERISTIC C_TQ_LOSS_ACC_SUB IP_FAC_TQ_LOSS_ACC_OFF IP_FAC_TQ_LOSS_ACC_ON IP_TQ_LOSS_ACC /end DEF_CHARACTERISTIC
 /begin OUT_MEASUREMENT TQ_LOSS_ACC TQ_ADD_ACC T_ACC /end OUT_MEASUREMENT
/end FUNCTION
/begin FUNCTION TQM_Torque_based_catalyst_heatin "_Torque based catalyst heating"
 /begin DEF_CHARACTERISTIC C_TQ_ADD_CH_LGRD IP_FAC_TQ_ADD_CH IP_FAC_TQ_ADD_CH_IS IP_TQ_ADD_CH_IS IP_TQ_ADD_CH /end DEF_CHARACTERISTIC
 /begin OUT_MEASUREMENT TQ_ADD_CH /end OUT_MEASUREMENT
/end FUNCTION
/begin FUNCTION TQM_Torque_based_pattern_calcula "_Torque based pattern calculation"
 /begin DEF_CHARACTERISTIC C_EFF_SCC_SP_HYS C_EFF_SCC_SP_MAN C_HYS_EFF_IGA_MIN_TEG C_MIN_DEC_EFF_IGA_MIN_TEG_1 C_MIN_DEC_EFF_IGA_MIN_TEG_2 LC_ENA_EFF_SCC_BAS_MAN C_EFF_SCC_BAS_MAN LC_EFF_SCC_SP_MAN LC_ENA_FCUT_TOT_GS LC_INH_FCUT_GS LC_INH_FCUT_N_MAX LC_TQ_SCC_INH_MAN LC_TQ_SCC_ENA_MAN C_FAC_IGA_MIN_TEG_IGA_BAS LC_INH_FCUT_ASR C_TCO_MIN_FCUT_FAST C_MAF_DIF_MIN_FCUT_FAST C_T_MAX_FCUT_FAST LC_INH_FCUT_FAST LC_ENA_FCUT_TOT_ASR LC_ENA_FCUT_TOT_N_MAX LC_ENA_FCUT_TOT_FAST ID_NR_PAT_SCC /end DEF_CHARACTERISTIC
 /begin OUT_MEASUREMENT EFF_SCC_BAS EFF_SCC_AV NR_PAT_SCC TQI_REF_IGA_MIN_SCC EFF_IGA_MIN_SCC LV_AUTH_TQ_PAT FAC_IGA_MIN_TEG_IGA_BAS LV_FCUT_FAST T_MAX_FCUT_FAST EFF_SCC_SP EFF_SCC_SP_HYS /end OUT_MEASUREMENT
/end FUNCTION
/begin FUNCTION TQM_Minimum_torque_at_clutch "_Minimum torque at clutch"
 /begin DEF_CHARACTERISTIC C_CLRC_TQ_MIN_CLU C_N_DIF_TQ_ST_1 C_N_DIF_TQ_ST_2 IP_FAC_N_DIF_IS /end DEF_CHARACTERISTIC
 /begin OUT_MEASUREMENT LV_TQ_MIN_CLU FAC_N_DIF_IS TQ_MIN_CLU TQ_MIN_CLU_1 /end OUT_MEASUREMENT
/end FUNCTION
/begin FUNCTION TQM_Converter_torque "_Converter torque"
 /begin DEF_CHARACTERISTIC IP_N_TUR__GR_AT__VS IP_T_DLY_CONV__TOIL IP_T_DLY_N_SP_IS__TOIL IP_T_RAMP_CONV_NEG__TOIL IP_T_RAMP_CONV_POS__TOIL IP_FAC_TQ_CONV__N_RATIO_CONV IP_FAC_CONV__TOIL /end DEF_CHARACTERISTIC
 /begin OUT_MEASUREMENT LV_DLY_N_SP_IS TQ_CONV /end OUT_MEASUREMENT
/end FUNCTION
/begin FUNCTION TQM_Torque_transient "_Torque transient"
 /begin DEF_CHARACTERISTIC C_N_GRD_THD_NEG C_N_GRD_THD_POS C_TQ_TRA_THD_DOWN_1 C_TQ_TRA_THD_DOWN_2 C_TQ_TRA_THD_UP_1 C_TQ_TRA_THD_UP_2 LC_TQ_TRA_INH IP_T_DEC_TRA_1_MT IP_T_DEC_TRA_2_AT IP_T_DEC_TRA_2_MT IP_T_DEC_TRA_3_AT IP_T_DEC_TRA_3_MT IP_T_DEC_TRA_IS_AT IP_T_DEC_TRA_IS_MT IP_T_INC_TRA_1_AT IP_T_INC_TRA_1_MT IP_T_INC_TRA_2_AT IP_T_INC_TRA_2_MT IP_T_INC_TRA_3_AT IP_T_INC_TRA_3_MT IP_T_INC_TRA_IS_AT IP_T_INC_TRA_IS_MT IP_TQ_ADD_TRA__N IP_T_DEC_TRA_1_AT /end DEF_CHARACTERISTIC
 /begin OUT_MEASUREMENT LV_TQ_TRA TQ_ADD_TRA TQ_ADD_TRA_1 TQ_RANGE TQ_REQ_TRA_OLD_CLU TQ_REQ_TRA_STATE TQI_REQ_TRA T_TRA TQ_REQ_TRA_CLU TQ_REQ_DIF_TRA /end OUT_MEASUREMENT
/end FUNCTION
/begin FUNCTION TQM_Torque_reserve_coordination "_Torque reserve coordination"
 /begin DEF_CHARACTERISTIC C_TQ_ADD_MIN_CRU C_TQ_ADD_HYS_CRU C_TQ_ADD_HYS C_TQ_ADD_MIN LC_INH_TQ_ADD_CH LC_INH_TQ_ADD /end DEF_CHARACTERISTIC
 /begin OUT_MEASUREMENT LV_TQ_ADD_REQ TQ_ADD_REQ TQI_ADD_MAX TQ_ADD_ACT TQI_ADD_ACT TQI_ADD_ACT_TMP_1 TQI_ADD_ACT_TMP_2 TQI_ADD_ACT_TMP_3 TQI_ADD_MAX_TOL TQI_ADD_MAX_TEG TQ_ADD_REQ_ACT TQ_ADD_REQ_CH TQ_ADD_MAX TQ_ADD_REQ_MAX_TEG MAF_KGH_ADD_MAX MAF_ADD_MAX EFF_IGA_MIN_ADD_MAX /end OUT_MEASUREMENT
/end FUNCTION
/begin FUNCTION TQM_Minimum_indicated_torque_at_ "_Minimum indicated torque at trailing throttle conditions"
 /begin DEF_CHARACTERISTIC C_TQI_BOL_SET_HYS IP_TQI_MIN_PU_RNG_L IP_TQI_MIN_PU IP_TQI_ADD_PUC IP_TQI_ADD_PUC_RNG_L /end DEF_CHARACTERISTIC
 /begin OUT_MEASUREMENT LV_TQI_BOL_SET TQI_BOL TQI_MIN_PU /end OUT_MEASUREMENT
/end FUNCTION
/begin FUNCTION TQM_Torque_coordination "_Torque coordination"
 /begin DEF_CHARACTERISTIC C_TQ_DIF_1 C_TQ_DIF_2 C_TQ_DIF_HYS_1 C_TQ_DIF_HYS_2 C_TQ_DIF_HYS_IS_1 C_TQ_DIF_HYS_IS_2 C_TQ_DIF_IS_1 C_TQ_DIF_IS_2 C_TQI_SP_MAN LC_TQI_SP_MAN_ACT LC_TQ_INTV_INH_AS C_TQ_AD_ADD_S_SWI LC_TQ_INTV_ENA_AS IP_MAF_SP /end DEF_CHARACTERISTIC
 /begin OUT_MEASUREMENT LV_TQ_INTV LV_TQ_INTV_REQ TQI_BAS_COR TQI_SP TQI_SP_1 TQI_SP_2 TQI_SP_3 TQI_FAST MAF_SP_TQI TQI_SP_MAF TQI_SP_MAF_1 TQI_SP_MAF_2 /end OUT_MEASUREMENT
/end FUNCTION
/begin FUNCTION TQM_Torque_based_anti_jerk_funct "_Torque based anti jerk function"
 /begin DEF_CHARACTERISTIC C_FIL_AJ_INP_0 C_FIL_AJ_INP_1 C_FIL_AJ_INP_2 C_FIL_AJ_OUT_1 C_FIL_AJ_OUT_2 C_N_DIF_AJ_AC_1 C_N_DIF_AJ_AC_2 C_N_DIF_AJ_DEACC_1 C_N_DIF_AJ_DEACC_2 C_N_THD_MAX_AJ C_N_THD_MIN_AJ C_T_ACT_MAX_AJ C_T_PAS_AJ_DLY LC_AJ_DEACC ID_FAC_INV_VEH_MASS_AT ID_FAC_INV_VEH_MASS_MT ID_FAC_TQ_DE_AJ_AT ID_FAC_TQ_DE_AJ_MT C_N_DIF_REF_AJ_MAX C_N_DIF_REF_AJ_MIN LC_AJ_INH_AT LC_AJ_INH_DT IP_FAC_TQ_AJ LC_AJ_AC /end DEF_CHARACTERISTIC
 /begin OUT_MEASUREMENT LV_PAS_AJ N_DIF_AJ N_DIF_REF_LPF_AJ TQ_DIF_AJ TQ_FAST_CLU TQ_MDL_DE_AJ N_REF_AJ LV_ACT_AJ LV_REQ_AJ N_DIF_REF_AJ N_DIF_REF_AJ_INTER /end OUT_MEASUREMENT
/end FUNCTION
/begin FUNCTION TQM_Basic__actual_and_minimum_la "_Basic, actual and minimum lambda efficiency" /begin DEF_CHARACTERISTIC IP_EFF_LAMB__LAMB_DIF IP_LAMB_REF_ADD IP_LAMB_REF /end DEF_CHARACTERISTIC
 /begin OUT_MEASUREMENT EFF_LAMB_BAS_COR LAMB_REF_COR LAMB_DIF_BAS LAMB_DIF_AV LAMB_REF_ADD_TCO LAMB_DIF_MAX EFF_LAMB_AV EFF_LAMB_MIN EFF_LAMB_SP_BAS LAMB_REF LAMB_DIF_SP_BAS /end OUT_MEASUREMENT
/end FUNCTION
/begin FUNCTION TQM_Pedal_value_interpretation "_Pedal value interpretation"
 /begin DEF_CHARACTERISTIC IP_FAC_TQ_REQ_DRIV_RNG_L LC_RNG_L_MAN_AS IP_FAC_TQ_REQ_DRIV /end DEF_CHARACTERISTIC
 /begin OUT_MEASUREMENT FAC_TQ_REQ_DRIV /end OUT_MEASUREMENT
/end FUNCTION
/begin FUNCTION TQM_Maximum_torque_at_clutch "_Maximum torque at clutch" /begin DEF_CHARACTERISTIC C_CLRC_TQ_MAX_CLU C_TQI_FAC_FL /end DEF_CHARACTERISTIC /begin OUT_MEASUREMENT MAF_MAX_COR TQ_MAX_CLU TQI_REF_MAX TQI_MAX /end OUT_MEASUREMENT /end FUNCTION
/end MODULE
/end PROJECT
