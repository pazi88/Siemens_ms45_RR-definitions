ASAP2_VERSION 1 31
/begin PROJECT MS45 "Rover Motorsteuerung V6"
/begin HEADER "_default_HeaderComment" PROJECT_NO _50 /end HEADER
/begin MODULE _default_ModuleName "_default_ModuleLongIdentifier"
/begin MOD_COMMON "_default_ModCommonComment" DEPOSIT ABSOLUTE BYTE_ORDER MSB_FIRST ALIGNMENT_BYTE 1 ALIGNMENT_WORD 2 ALIGNMENT_LONG 4 ALIGNMENT_FLOAT32_IEEE 4 ALIGNMENT_FLOAT64_IEEE 8 /end MOD_COMMON
/begin CHARACTERISTIC C_FAC_TQ_IS_AD_CONV_MAX "Max. limitation for converter torque adaptation factor" VALUE 0x67b90 _REC_VAL_20_s2 4.882800000000001e-004 _CNV_A_R_LINEAR_____7_CM -2.4414e-004 2.4414e-004 FORMAT "%10.9" /end CHARACTERISTIC
/begin CHARACTERISTIC C_FAC_TQ_IS_AD_CONV_MIN "Min. limitation of converter torque adaptation factor" VALUE 0x67b92 _REC_VAL_20_s2 4.882800000000001e-004 _CNV_A_R_LINEAR_____7_CM -2.4414e-004 2.4414e-004 FORMAT "%10.9" /end CHARACTERISTIC
/begin CHARACTERISTIC C_N_DELTA "engine speed threshold for ISC adaptation" VALUE 0x67bf4 _REC_VAL_20_u2 8160. _CNV_A_R_LINEAR_____0_CM 0. 8160. FORMAT "%4.0" /end CHARACTERISTIC
/begin CHARACTERISTIC C_N_DIF_CRLC "Correlation factor for N_DIF_MMV calculation" VALUE 0x67bfe _REC_VAL_20_u1 0.9960940000000002 _CNV_A_R_LINEAR_____8_CM 0. 0.996094 FORMAT "%5.3" /end CHARACTERISTIC
/begin CHARACTERISTIC C_N_DIF_MIN_MMV "Minimum filtering constant" VALUE 0x67c02 _REC_VAL_20_s2 408. _CNV_A_R_LINEAR_____0_CM -4080. 0. FORMAT "%6.0" /end CHARACTERISTIC
/begin CHARACTERISTIC C_N_MAX_MTC_LIH "Engine speed limitation in case of fault detected by throttle monitoring or ETC safety concept" VALUE 0x67c1a _REC_VAL_20_u1 8160. _CNV_A_R_LINEAR_____15_CM 0. 8160. FORMAT "%4.0" /end CHARACTERISTIC
/begin CHARACTERISTIC C_PV_GRD_LIH_MAX "Max. (positive) pedal gradient in case of an error" VALUE 0x67c2d _REC_VAL_20_u1 99.609375 _CNV_A_R_LINEAR_____16_CM 0. 99.609375 FORMAT "%5.2" /end CHARACTERISTIC
/begin CHARACTERISTIC C_PV_LIH_MAX "Max. pedal position in case of an error" VALUE 0x67c2e _REC_VAL_20_u1 99.609375 _CNV_A_R_LINEAR_____16_CM 0. 99.609375 FORMAT "%5.2" /end CHARACTERISTIC
/begin CHARACTERISTIC C_T_RAMP_LIM_I_DT_IS "Time constant for ramp limit of I-controller output in case of idle speed controller passive and drive train engaged" VALUE 0x67c6e _REC_VAL_20_u2 655.35 _CNV_A_R_LINEAR_____21_CM 0. 655.35 FORMAT "%5.2" /end CHARACTERISTIC
/begin CHARACTERISTIC C_T_RAMP_LIM_I_IS "Time constant for ramp limit of I-controller output in case of idle speed controller passive" VALUE 0x67c70 _REC_VAL_20_u2 655.35 _CNV_A_R_LINEAR_____21_CM 0. 655.35 FORMAT "%5.2" /end CHARACTERISTIC
/begin CHARACTERISTIC C_T_RAMP_LIM_P_D_DT_IS "Time constant for ramp limit of P-, D-controller output in case of idle speed controller passive and LV_DT=1" VALUE 0x67c72 _REC_VAL_20_u2 655.35 _CNV_A_R_LINEAR_____21_CM 0. 655.35 FORMAT "%5.2" /end CHARACTERISTIC
/begin CHARACTERISTIC C_T_RAMP_LIM_P_D_IS "Time constant for ramp limit of P-, D-controller output in case of idle speed controller passive" VALUE 0x67c74 _REC_VAL_20_u2 655.35 _CNV_A_R_LINEAR_____21_CM 0. 655.35 FORMAT "%5.2" /end CHARACTERISTIC
/begin CHARACTERISTIC C_T_TCO_SUB_IS_1 "max. time in IS before interrupt of TCO model" VALUE 0x67c78 _REC_VAL_20_u2 65535. _CNV_A_R_LINEAR_____20_CM 0. 65535. FORMAT "%5.0" /end CHARACTERISTIC
/begin CHARACTERISTIC C_T_TCO_SUB_IS_2 "interrupt time TCO model during IS" VALUE 0x67c7a _REC_VAL_20_u2 65535. _CNV_A_R_LINEAR_____20_CM 0. 65535. FORMAT "%5.0" /end CHARACTERISTIC
/begin CHARACTERISTIC C_T_TCO_SUB_PUC "interrupt time TCO model during PUC" VALUE 0x67c7c _REC_VAL_20_u2 65535. _CNV_A_R_LINEAR_____20_CM 0. 65535. FORMAT "%5.0" /end CHARACTERISTIC
/begin CHARACTERISTIC C_TCO_SUB_BOL_2 "TCO substitute temperature 1 " VALUE 0x67cb3 _REC_VAL_20_u1 28.575 _CNV_A_R_LINEAR_____22_CM -48. 142.5 FORMAT "%5.1" /end CHARACTERISTIC
/begin CHARACTERISTIC C_TCO_SUB_TOL "upper limit TCO substitute temperature" VALUE 0x67cb4 _REC_VAL_20_u1 28.575 _CNV_A_R_LINEAR_____22_CM -48. 142.5 FORMAT "%5.1" /end CHARACTERISTIC
/begin CHARACTERISTIC C_TEMP_SUB_CAT_PUC "catalyst temperature at PUC" VALUE 0x67cc6 _REC_VAL_20_u1 1020. _CNV_A_R_LINEAR_____26_CM -33. 987. FORMAT "%3.0" /end CHARACTERISTIC
/begin CHARACTERISTIC C_TIA_DIAG "TIA threshold - TCO diagnosis" VALUE 0x67cda _REC_VAL_20_u1 28.575 _CNV_A_R_LINEAR_____22_CM -48. 142.5 FORMAT "%5.1" /end CHARACTERISTIC
/begin CHARACTERISTIC C_TIA_GRD_MAX_DIAG "Maximum permissible gradient for TIA" VALUE 0x67cdb _REC_VAL_20_u1 38.1 _CNV_A_R_LINEAR_____29_CM 0. 190.5 FORMAT "%4.1" /end CHARACTERISTIC
/begin CHARACTERISTIC C_TQ_BOL_I_DT_IS "Bottom limit for I-controller output and drive train closed" VALUE 0x67d06 _REC_VAL_20_s2 2047.96875 _CNV_A_R_LINEAR_____37_CM -1024. 1023.96875 FORMAT "%7.1" /end CHARACTERISTIC
/begin CHARACTERISTIC C_TQ_BOL_I_IS "Bottom limit for I-controller output" VALUE 0x67d08 _REC_VAL_20_s2 2047.96875 _CNV_A_R_LINEAR_____37_CM -1024. 1023.96875 FORMAT "%7.1" /end CHARACTERISTIC
/begin CHARACTERISTIC C_TQ_IS_AD_ACC_MIN "Min. limitation for ACC adaptation" VALUE 0x67d20 _REC_VAL_20_s2 2047.96875 _CNV_A_R_LINEAR_____37_CM -1024. 1023.96875 FORMAT "%7.1" /end CHARACTERISTIC
/begin CHARACTERISTIC C_TQ_IS_AD_MAX "Max. limitation of engine torque losses adaptation" VALUE 0x67d22 _REC_VAL_20_s2 2047.96875 _CNV_A_R_LINEAR_____37_CM -1024. 1023.96875 FORMAT "%7.1" /end CHARACTERISTIC
/begin CHARACTERISTIC C_TQ_IS_AD_MIN "Min. limitation of engine torque losses adaptation" VALUE 0x67d24 _REC_VAL_20_s2 2047.96875 _CNV_A_R_LINEAR_____37_CM -1024. 1023.96875 FORMAT "%7.1" /end CHARACTERISTIC
/begin CHARACTERISTIC C_TQ_PAS_I_ACC_IS "Final passive value for I-controller output and air conditioning compressor active" VALUE 0x67d28 _REC_VAL_20_s2 2047.96875 _CNV_A_R_LINEAR_____37_CM -1024. 1023.96875 FORMAT "%7.1" /end CHARACTERISTIC
/begin CHARACTERISTIC C_TQ_PAS_I_IS " Final passive value for I-controller output" VALUE 0x67d2a _REC_VAL_20_s2 2047.96875 _CNV_A_R_LINEAR_____37_CM -1024. 1023.96875 FORMAT "%7.1" /end CHARACTERISTIC
/begin CHARACTERISTIC C_TQ_TOL_I_DT_IS "Top limit for I-controller output and drive train closed" VALUE 0x67d30 _REC_VAL_20_s2 2047.96875 _CNV_A_R_LINEAR_____37_CM -1024. 1023.96875 FORMAT "%7.1" /end CHARACTERISTIC
/begin CHARACTERISTIC C_TQ_TOL_I_IS "Top limit for I-controller output" VALUE 0x67d32 _REC_VAL_20_s2 2047.96875 _CNV_A_R_LINEAR_____37_CM -1024. 1023.96875 FORMAT "%7.1" /end CHARACTERISTIC
/begin CHARACTERISTIC C_V_PVS_HYS_FIL "Area of the dejitter-filters" VALUE 0x67d4c _REC_VAL_20_u1 1.24511719 _CNV_A_R_LINEAR_____39_CM 0. 1.24511719 FORMAT "%4.3" /end CHARACTERISTIC
/begin CHARACTERISTIC C_V_PVS_THD_KD_1 "Difference between C_V_PVS_SP_FL_1 and kick-down-recognition (Channel 1)" VALUE 0x67d4d _REC_VAL_20_u1 4.98046875 _CNV_A_R_LINEAR_____40_CM 0. 4.98046875 FORMAT "%5.3" /end CHARACTERISTIC
/begin CHARACTERISTIC C_VS_MIN_RUN "minimum vehicle speed for detection of running vehicle" VALUE 0x67d7a _REC_VAL_20_u1 25.5 _CNV_A_R_LINEAR_____43_CM 0. 255. FORMAT "%3.0" /end CHARACTERISTIC
/begin MEASUREMENT N_DIF_COR "Idle speed control value" SWORD _CNV_A_R_LINEAR_____0_CM 1 100. -4096. 4064. ECU_ADDRESS 0x3fcdf0 FORMAT "%4.0" /end MEASUREMENT
/begin MEASUREMENT TCO_ST "coolant temperature at engine start" UBYTE _CNV_A_R_LINEAR_____22_CM 1 100. -48. 142.5 ECU_ADDRESS 0x3fd973 FORMAT "%5.1" /end MEASUREMENT
/begin AXIS_PTS ldp_maf_kgh_temp_sub_cat "" 0x61602 MAF_KGH _REC_AXS_20_u2 2047.96875 _CNV_A_R_LINEAR_____52_CM 6 0. 2047.96875 FORMAT "%6.2" /end AXIS_PTS
/begin AXIS_PTS ldp_n_dif_cor__tq_i_dt_is "" 0x616da N_DIF_COR _REC_AXS_20_u2 65535. _CNV_A_R_LINEAR_____53_CM 12 -32768. 32767. FORMAT "%6.0" /end AXIS_PTS
/begin AXIS_PTS ldp_n_dif_cor_p_d_dt_is "" 0x616f4 N_DIF_COR _REC_AXS_20_u2 65535. _CNV_A_R_LINEAR_____53_CM 12 -32768. 32767. FORMAT "%6.0" /end AXIS_PTS
/begin AXIS_PTS ldp_n_dif_cor_p_d_is "" 0x6170e N_DIF_COR _REC_AXS_20_u2 65535. _CNV_A_R_LINEAR_____53_CM 12 -32768. 32767. FORMAT "%6.0" /end AXIS_PTS
/begin AXIS_PTS ldp_n_dif_cor_tq_i_is "" 0x61728 N_DIF_COR _REC_AXS_20_u2 65535. _CNV_A_R_LINEAR_____53_CM 12 -32768. 32767. FORMAT "%6.0" /end AXIS_PTS
/begin AXIS_PTS ldp_n_grd_p_d_dt_is "" 0x6175d N_GRD _REC_AXS_20_u1 8160. _CNV_A_R_LINEAR_____54_CM 8 -4096. 4064. FORMAT "%5.0" /end AXIS_PTS
/begin AXIS_PTS ldp_n_grd_p_d_is "" 0x61766 N_GRD _REC_AXS_20_u1 8160. _CNV_A_R_LINEAR_____54_CM 8 -4096. 4064. FORMAT "%5.0" /end AXIS_PTS
/begin AXIS_PTS ldp_n_grd_tq_i_is "" 0x6176f N_GRD _REC_AXS_20_u1 8160. _CNV_A_R_LINEAR_____54_CM 8 -4096. 4064. FORMAT "%5.0" /end AXIS_PTS
/begin AXIS_PTS ldp_n_t_n_dif_ofs_pred "" 0x617b2 N _REC_AXS_20_u2 8160. _CNV_A_R_LINEAR_____0_CM 8 0. 8160. FORMAT "%4.0" /end AXIS_PTS
/begin AXIS_PTS ldp_tco_st_temp_mmv_ini_cat "" 0x61904 TCO_ST _REC_AXS_20_u1 190.5 _CNV_A_R_LINEAR_____22_CM 6 -48. 142.5 FORMAT "%5.1" /end AXIS_PTS
/begin AXIS_PTS ldp_v_tia_tia "" 0x61a88 V_TIA _REC_AXS_20_u1 4.447265625 _CNV_A_R_LINEAR_____40_CM 16 3.90625e-002 4.98046875 FORMAT "%5.3" /end AXIS_PTS
/begin AXIS_PTS ldpm_gr_mt_2 "" 0x61b2e GR_MT _REC_AXS_20_u1 255. _CNV_A_R_LINEAR_____13_CM 13 0. 255. FORMAT "%3.0" /end AXIS_PTS
/begin CHARACTERISTIC ID_CRLC_DEC_CAT__MAF_KGH "inertia value for decreasing catalyst temperature " CURVE 0x64fd4 _REC_CUR_20_u2_u2 0.99998474 _CNV_A_R_LINEAR_____2_CM 0. 0.99998474 FORMAT "%7.5"
 /begin AXIS_DESCR COM_AXIS MAF_KGH _CNV_A_R_LINEAR_____52_CM 6 0. 2047.96875 FORMAT "%6.2" AXIS_PTS_REF ldp_maf_kgh_temp_sub_cat /end AXIS_DESCR
/end CHARACTERISTIC
/begin CHARACTERISTIC ID_CRLC_INC_CAT__MAF_KGH "inertia value for increasing catalyst temperature " CURVE 0x64fe0 _REC_CUR_20_u2_u2 0.99998474 _CNV_A_R_LINEAR_____2_CM 0. 0.99998474 FORMAT "%7.5"
 /begin AXIS_DESCR COM_AXIS MAF_KGH _CNV_A_R_LINEAR_____52_CM 6 0. 2047.96875 FORMAT "%6.2" AXIS_PTS_REF ldp_maf_kgh_temp_sub_cat /end AXIS_DESCR
/end CHARACTERISTIC
/begin CHARACTERISTIC ID_TEMP_MMV_INI_CAT__TCO_ST "initialisation of catalyst temperature " CURVE 0x65986 _REC_CUR_20_u1_u1 1020. _CNV_A_R_LINEAR_____26_CM -33. 987. FORMAT "%3.0"
 /begin AXIS_DESCR COM_AXIS TCO_ST _CNV_A_R_LINEAR_____22_CM 6 -48. 142.5 FORMAT "%5.1" AXIS_PTS_REF ldp_tco_st_temp_mmv_ini_cat /end AXIS_DESCR
/end CHARACTERISTIC
/begin CHARACTERISTIC IP_P_D_DT_IS__N_DIF_COR__N_GRD "P- and D-component for idle speed controller at closed drive train" MAP 0x66a66 _REC_MAP_20_u2_u2_u1 2047.96875 _CNV_A_R_LINEAR_____65_CM -1024. 1023.96875 FORMAT "%6.2"
 /begin AXIS_DESCR COM_AXIS N_DIF_COR _CNV_A_R_LINEAR_____53_CM 12 -32768. 32767. FORMAT "%6.0" AXIS_PTS_REF ldp_n_dif_cor_p_d_dt_is /end AXIS_DESCR
 /begin AXIS_DESCR COM_AXIS N_GRD _CNV_A_R_LINEAR_____54_CM 8 -4096. 4064. FORMAT "%5.0" AXIS_PTS_REF ldp_n_grd_p_d_dt_is /end AXIS_DESCR
/end CHARACTERISTIC
/begin CHARACTERISTIC IP_P_D_IS__N_DIF_COR__N_GRD "P- and D-component for idle speed controller at open drive train" MAP 0x66b26 _REC_MAP_20_u2_u2_u1 2047.96875 _CNV_A_R_LINEAR_____65_CM -1024. 1023.96875 FORMAT "%6.2"
 /begin AXIS_DESCR COM_AXIS N_DIF_COR _CNV_A_R_LINEAR_____53_CM 12 -32768. 32767. FORMAT "%6.0" AXIS_PTS_REF ldp_n_dif_cor_p_d_is /end AXIS_DESCR
 /begin AXIS_DESCR COM_AXIS N_GRD _CNV_A_R_LINEAR_____54_CM 8 -4096. 4064. FORMAT "%5.0" AXIS_PTS_REF ldp_n_grd_p_d_is /end AXIS_DESCR
/end CHARACTERISTIC
/begin CHARACTERISTIC IP_TCO_SUB_INC__MAF_KGH "TCO increment" CURVE 0x672a2 _REC_CUR_20_u1_u2 37.95 _CNV_A_R_LINEAR_____66_CM 0.75 190.5 FORMAT "%6.2"
 /begin AXIS_DESCR COM_AXIS MAF_KGH _CNV_A_R_LINEAR_____52_CM 4 0. 2047.96875 FORMAT "%7.2" AXIS_PTS_REF ldp_maf_kgh__tco_sub_inc /end AXIS_DESCR
/end CHARACTERISTIC
/begin CHARACTERISTIC IP_TEMP_SUB_CAT__MAF_KGH "catalyst temperature in stabil conditions" CURVE 0x672e6 _REC_CUR_20_u1_u2 1020. _CNV_A_R_LINEAR_____26_CM -33. 987. FORMAT "%3.0"
 /begin AXIS_DESCR COM_AXIS MAF_KGH _CNV_A_R_LINEAR_____52_CM 6 0. 2047.96875 FORMAT "%6.2" AXIS_PTS_REF ldp_maf_kgh_temp_sub_cat /end AXIS_DESCR
/end CHARACTERISTIC
/begin CHARACTERISTIC IP_TIA__V_TIA "NTC characteristic" CURVE 0x6763e _REC_CUR_20_u1_u1 28.575 _CNV_A_R_LINEAR_____22_CM -48. 142.5 FORMAT "%5.1"
 /begin AXIS_DESCR COM_AXIS V_TIA _CNV_A_R_LINEAR_____40_CM 16 3.90625e-002 4.98046875 FORMAT "%5.3" AXIS_PTS_REF ldp_v_tia_tia /end AXIS_DESCR
/end CHARACTERISTIC
/begin CHARACTERISTIC IP_TQ_I_DT_IS "I-component for idle speed controller at closed drive train" CURVE 0x6771a _REC_CUR_20_u2_u2 7.99987793 _CNV_A_R_LINEAR_____71_CM -4. 3.99987793 FORMAT "%6.5"
 /begin AXIS_DESCR COM_AXIS N_DIF_COR _CNV_A_R_LINEAR_____53_CM 12 -32768. 32767. FORMAT "%6.0" AXIS_PTS_REF ldp_n_dif_cor__tq_i_dt_is /end AXIS_DESCR
/end CHARACTERISTIC
/begin CHARACTERISTIC IP_TQ_I_IS__N_DIF_COR__N_GRD "I-component for idle speed controller at open drive train" MAP 0x67732 _REC_MAP_20_u2_u2_u1 7.99987793 _CNV_A_R_LINEAR_____71_CM -4. 3.99987793 FORMAT "%5.4"
 /begin AXIS_DESCR COM_AXIS N_DIF_COR _CNV_A_R_LINEAR_____53_CM 12 -32768. 32767. FORMAT "%6.0" AXIS_PTS_REF ldp_n_dif_cor_tq_i_is /end AXIS_DESCR
 /begin AXIS_DESCR COM_AXIS N_GRD _CNV_A_R_LINEAR_____54_CM 8 -4096. 4064. FORMAT "%5.0" AXIS_PTS_REF ldp_n_grd_tq_i_is /end AXIS_DESCR
/end CHARACTERISTIC
/begin CHARACTERISTIC C_TI_MIN_POST_PULSE "minimum duration of ti post pulses" VALUE 0x67cd8 _REC_VAL_20_u2 0.5 _CNV_A_R_LINEAR_____24_CM 0. 5. FORMAT "%5.3" /end CHARACTERISTIC
/begin MEASUREMENT FAC_TQ_IS_AD_CONV "Converter torque adaptation factor" SWORD _CNV_A_R_LINEAR_____73_CM 1 100. -2.4414e-004 2.4414e-004 ECU_ADDRESS 0x3fc8f2 FORMAT "%9.8" /end MEASUREMENT
/begin MEASUREMENT LV_IS_AD_INH_OBD "Application incidence value" UBYTE _CNV_S_2_RANGE______74_CM 1 100. 0. 1. ECU_ADDRESS 0x3fd4c7 BIT_MASK 0x1 /end MEASUREMENT
/begin MEASUREMENT LV_TQ_P_D_ACT "Logical variable P_D-Controller output is active" UBYTE _CNV_S_2_RANGE______74_CM 1 100. 0. 1. ECU_ADDRESS 0x3fd4be BIT_MASK 0x1 /end MEASUREMENT
/begin MEASUREMENT LV_TQ_P_D_DT_ACT "Logical variable IP_P_D_DT_IS map is active" UBYTE _CNV_S_2_RANGE______74_CM 1 100. 0. 1. ECU_ADDRESS 0x3fd4bf BIT_MASK 0x1 /end MEASUREMENT
/begin MEASUREMENT LV_VB_JUMP "Boolean for  over voltage - ( Passive / Active )" UBYTE _CNV_S_2_RANGE______74_CM 1 100. 0. 1. ECU_ADDRESS 0x3fd58c BIT_MASK 0x1 /end MEASUREMENT
/begin MEASUREMENT N_DIF_MMV "N_DIF moving mean value" SWORD _CNV_A_R_LINEAR_____0_CM 1 100. -8160. 8160. ECU_ADDRESS 0x3fce02 FORMAT "%4.0" /end MEASUREMENT
/begin MEASUREMENT N_DIF_OFS_PRED "Predicted engine speed difference for torque reserve calculation" SWORD _CNV_A_R_LINEAR_____0_CM 1 100. -32768. 32767. ECU_ADDRESS 0x3fc936 FORMAT "%6.0" /end MEASUREMENT
/begin MEASUREMENT N_MAX_TOL_ST "Top level end of start engine speed" UBYTE _CNV_A_R_LINEAR_____15_CM 1 100. 0. 8160. ECU_ADDRESS 0x3fd94c FORMAT "%4.0" /end MEASUREMENT
/begin MEASUREMENT PV_AV_1 "degree of activation of the accelerator pedal from PVS-channel 1" UBYTE _CNV_A_R_LINEAR_____16_CM 1 100. 0. 99.609375 ECU_ADDRESS 0x3fd961 FORMAT "%3.1" /end MEASUREMENT
/begin MEASUREMENT PV_AV_2 "degree of activation of the accelerator pedal from PVS-channel 2" UBYTE _CNV_A_R_LINEAR_____16_CM 1 100. 0. 99.609375 ECU_ADDRESS 0x3fd962 FORMAT "%3.1" /end MEASUREMENT
/begin MEASUREMENT T_N_DIF_OFS_PRED "Prediction time for engine speed difference" UBYTE _CNV_A_R_LINEAR_____80_CM 1 100. 0. 7.96875 ECU_ADDRESS 0x3fd8c5 FORMAT "%4.2" /end MEASUREMENT
/begin MEASUREMENT TCO_EX "Radiator outlet temperature" UBYTE _CNV_A_R_LINEAR_____22_CM 1 100. -48. 142.5 ECU_ADDRESS 0x3fd97c FORMAT "%5.1" /end MEASUREMENT
/begin MEASUREMENT TCO_SUB "Substitute calculated TCO value" UBYTE _CNV_A_R_LINEAR_____22_CM 1 100. -48. 142.5 ECU_ADDRESS 0x3fd971 FORMAT "%5.1" /end MEASUREMENT
/begin MEASUREMENT TQ_ADD_CP "Torque reserve for canister purge at idle" SWORD _CNV_A_R_LINEAR_____37_CM 1 100. -1024. 1023.96875 ECU_ADDRESS 0x3fd128 FORMAT "%6.2" /end MEASUREMENT
/begin MEASUREMENT TQ_DIF_P_D_DT_IS_1 "P_D_DT Controler output weighted  for certain gear-ratio" SWORD _CNV_A_R_LINEAR_____37_CM 1 100. -1024. 1023.96875 ECU_ADDRESS 0x3fc914 FORMAT "%6.2" /end MEASUREMENT
/begin MEASUREMENT V_PVS_FIL_1 "Filtered PVS-voltage value for channel 1" UWORD _CNV_A_R_LINEAR_____38_CM 1 100. 0. 4.99511719 ECU_ADDRESS 0x3fce72 FORMAT "%5.3" /end MEASUREMENT
/begin MEASUREMENT V_PVS_FIL_2 "Filtered PVS-voltage value for channel 2" UWORD _CNV_A_R_LINEAR_____38_CM 1 100. 0. 4.99511719 ECU_ADDRESS 0x3fce74 FORMAT "%5.3" /end MEASUREMENT
/begin MEASUREMENT TCO_STOP "Coolant temperature at transition to ES" UBYTE _CNV_A_R_LINEAR_____22_CM 1 100. -48. 142.5 ECU_ADDRESS 0x3fd972 FORMAT "%5.1" /end MEASUREMENT
/begin MEASUREMENT N_MAX_THD "Actual engine speed limit" UWORD _CNV_A_R_LINEAR_____0_CM 1 100. 0. 8160. ECU_ADDRESS 0x3fce40 FORMAT "%4.0" /end MEASUREMENT
/begin MEASUREMENT LV_VS_RUN "Boolean for running vehicle" UBYTE _CNV_S_2_RANGE______74_CM 1 100. 0. 1. ECU_ADDRESS 0x3fd590 BIT_MASK 0x1 /end MEASUREMENT
/begin CHARACTERISTIC C_TCO_EX_DIF_DIAG "Difference between TCO and TCO - TCO_EX diagnosis" VALUE 0x67c9f _REC_VAL_20_u1 190.5 _CNV_A_R_LINEAR_____22_CM -48. 142.5 FORMAT "%5.1" /end CHARACTERISTIC
/begin MEASUREMENT TIA "Intake air temperature" UBYTE _CNV_A_R_LINEAR_____22_CM 1 100. -48. 142.5 ECU_ADDRESS 0x3fd980 FORMAT "%3.0" /end MEASUREMENT
/begin CHARACTERISTIC C_TCO_SUB_BOL_1 "TCO substitute temperature 1 " VALUE 0x67cb2 _REC_VAL_20_u1 28.575 _CNV_A_R_LINEAR_____22_CM -48. 142.5 FORMAT "%5.1" /end CHARACTERISTIC
/begin MEASUREMENT TQ_DIF_P_D_SLOW_IS "TQ_DIF_P_D_IS for slow-path of torque coordination" SWORD _CNV_A_R_LINEAR_____37_CM 1 100. -1024. 1023.96875 ECU_ADDRESS 0x3fc90e FORMAT "%6.2" /end MEASUREMENT
/begin MEASUREMENT TQ_DIF_P_D_IS "P- and D- controller output for idle speed control" SWORD _CNV_A_R_LINEAR_____37_CM 1 100. -1024. 1023.96875 ECU_ADDRESS 0x3fc908 FORMAT "%6.2" /end MEASUREMENT
/begin MEASUREMENT TQ_DIF_P_D_FAST_IS "TQ_DIF_P_D_IS for fast-path of torque coordination" SWORD _CNV_A_R_LINEAR_____37_CM 1 100. -1024. 1023.96875 ECU_ADDRESS 0x3fc910 FORMAT "%6.2" /end MEASUREMENT
/begin MEASUREMENT TQ_DIF_I_IS "I- controller output for idle speed control" SWORD _CNV_A_R_LINEAR_____37_CM 1 100. -1024. 1023.96875 ECU_ADDRESS 0x3fc90a FORMAT "%6.2" /end MEASUREMENT
/begin MEASUREMENT TQ_ADD_I_IS "Incrememt of limited integrator" SWORD _CNV_A_R_LINEAR_____37_CM 1 100. -1024. 1023.96875 ECU_ADDRESS 0x3fc90c FORMAT "%6.2" /end MEASUREMENT
/begin MEASUREMENT LV_REQ_ISC "Logical variable for idle speed controller activatIon request" UBYTE _CNV_S_2_RANGE______74_CM 1 100. 0. 1. ECU_ADDRESS 0x3fd4c8 BIT_MASK 0x1 /end MEASUREMENT
/begin MEASUREMENT BIOS_TI_OFS "offset injection time for dead time correction" UWORD _CNV_A_R_LINEAR_____24_CM 1 100. 0. 131.068 ECU_ADDRESS 0x3fc64c FORMAT "%7.3" /end MEASUREMENT
/begin MEASUREMENT BIOS_TI_MIN_POST_PULSE_INJ "minimum duration of ti post pulses" UWORD _CNV_A_R_LINEAR_____24_CM 1 100. 0. 5. ECU_ADDRESS 0x3fc64e FORMAT "%5.3" /end MEASUREMENT
/begin MEASUREMENT BIOS_EOI_LIM "latest possible end of injection before TDC" UWORD _CNV_A_R_LINEAR_____117_CM 1 100. 0. 720. ECU_ADDRESS 0x3fc650 FORMAT "%6.2" /end MEASUREMENT
/begin MEASUREMENT BIOS_LV_POST_PULS_INJ "logical variable to enable post pulses" UBYTE _CNV_S_2_RANGE______76_CM 1 100. 0. 1. ECU_ADDRESS 0x3fd408 BIT_MASK 0x1 /end MEASUREMENT
/begin CHARACTERISTIC LC_POST_PULS_INJ_ENA "Logical constant for enabling post pulse" VALUE 0x67d88 _REC_VAL_20_u1 1. _CNV_A_R_LINEAR_____13_CM 0. 1. FORMAT "%1.0" /end CHARACTERISTIC
/begin CHARACTERISTIC C_N_DIF_FAC "Weighting factor for the idle speed variable controller" VALUE 0x67bff _REC_VAL_20_u1 0.9960940000000002 _CNV_A_R_LINEAR_____8_CM 0. 0.996094 FORMAT "%5.3" /end CHARACTERISTIC
/begin AXIS_PTS ldp_t_ast__fac_n_grd_is "" 0x61812 T_AST _REC_AXS_20_u2 6553.5 _CNV_A_R_LINEAR_____18_CM 8 0. 6553.5 FORMAT "%5.1" /end AXIS_PTS
/begin AXIS_PTS ldp_tco__fac_n_grd_is "" 0x6185d TCO _REC_AXS_20_u1 190.5 _CNV_A_R_LINEAR_____22_CM 8 -48. 142.5 FORMAT "%6.2" /end AXIS_PTS
/begin CHARACTERISTIC IP_FAC_N_GRD_IS "Weighting factor N_GRD input for IP_P_D_IS" MAP 0x65c10 _REC_MAP_20_u1_u1_u2 1.9921875 _CNV_A_R_LINEAR_____67_CM 0. 1.9921875 FORMAT "%5.3"
 /begin AXIS_DESCR COM_AXIS TCO _CNV_A_R_LINEAR_____22_CM 8 -48. 142.5 FORMAT "%6.2" AXIS_PTS_REF ldp_tco__fac_n_grd_is /end AXIS_DESCR
 /begin AXIS_DESCR COM_AXIS T_AST _CNV_A_R_LINEAR_____18_CM 8 0. 6553.5 FORMAT "%5.1" AXIS_PTS_REF ldp_t_ast__fac_n_grd_is /end AXIS_DESCR
/end CHARACTERISTIC
/begin CHARACTERISTIC LC_TQ_DIF_I_INH_AS "Logical variable for ISCI I-part deactivation - default value at initialisation = 0" VALUE 0x67d8b _REC_VAL_20_u1 1. _CNV_A_R_LINEAR_____13_CM 0. 1. FORMAT "%1.0" /end CHARACTERISTIC
/begin CHARACTERISTIC LC_TQ_DIF_P_D_INH_AS "Logical variable for deactivation of TQ_DIF_P_D_IS -default value at initialisation = 0" VALUE 0x67d8c _REC_VAL_20_u1 1. _CNV_A_R_LINEAR_____13_CM 0. 1. FORMAT "%1.0" /end CHARACTERISTIC
/begin MEASUREMENT STATE_REQ_ISC "actual state for ISC request" UBYTE _CNV_S_3_STATE_REQ__135_CM 1 100. 0. 2. ECU_ADDRESS 0x3fd8c3 /end MEASUREMENT
/begin MEASUREMENT N_DIF_SAMPLE "Delta engine speed for time interval C_T_N_DIF_SAMPLE" SWORD _CNV_A_R_LINEAR_____0_CM 1 100. -32768. 32767. ECU_ADDRESS 0x3fc926 FORMAT "%6.0" /end MEASUREMENT
/begin MEASUREMENT N_DIF_RIS "Delta engine speed for time interval C_T_N_DIF_RIS" SWORD _CNV_A_R_LINEAR_____0_CM 1 100. -32768. 32767. ECU_ADDRESS 0x3fc92e FORMAT "%6.0" /end MEASUREMENT
/begin MEASUREMENT LV_N_DIF_SAMPLE "Logical variable for indicating falling engine speed  for idle speed controller activaton request" UBYTE _CNV_S_2_RANGE______76_CM 1 100. 0. 1. ECU_ADDRESS 0x3fd4c9 BIT_MASK 0x1 /end MEASUREMENT
/begin CHARACTERISTIC C_CRLC_TQ_ADD_CP "Filter constant" VALUE 0x67b65 _REC_VAL_20_u1 0.9960940000000002 _CNV_A_R_LINEAR_____136_CM 0. 0.996094 FORMAT "%5.3" /end CHARACTERISTIC
/begin CHARACTERISTIC LC_TQ_ADD_CP_ENA "Logical variable for activating/disactivating the torque reserve for canister purge in idle" VALUE 0x67d8a _REC_VAL_20_u1 1. _CNV_A_R_LINEAR_____13_CM 0. 1. FORMAT "%1.0" /end CHARACTERISTIC
/begin CHARACTERISTIC C_N_DIF_RIS_MIN "Minimum threshold for engine speed monitoring" VALUE 0x67c08 _REC_VAL_20_u2 8160. _CNV_A_R_LINEAR_____0_CM 0. 8160. FORMAT "%4.0" /end CHARACTERISTIC
/begin CHARACTERISTIC C_T_N_DIF_RIS "Sampling time for engine speed variation check" VALUE 0x67c6a _REC_VAL_20_u2 655.35 _CNV_A_R_LINEAR_____21_CM 0. 655.35 FORMAT "%6.2" /end CHARACTERISTIC
/begin CHARACTERISTIC C_T_N_DIF_SAMPLE "time period for determination of N_DIF_SAMPLE" VALUE 0x67c6c _REC_VAL_20_u1 2550. _CNV_A_R_LINEAR_____3_CM 0. 2550. FORMAT "%4.0" /end CHARACTERISTIC
/begin CHARACTERISTIC IP_TQ_ADD_CP "MAP for dtermination of TQ_ADD_CP in dependence of CL_MMV" CURVE 0x676ee _REC_CUR_20_u2_u2 2047.96875 _CNV_A_R_LINEAR_____65_CM -1024. 1023.96875 FORMAT "%6.2"
 /begin AXIS_DESCR COM_AXIS ONLINE_DUMMY _CNV_A_R_LINEAR_____104_CM 6 0. 7.99987793 FORMAT "%6.4" AXIS_PTS_REF ldp_cl_mmv /end AXIS_DESCR
/end CHARACTERISTIC
/begin CHARACTERISTIC C_FAC_TQ_IS_AD_ACC "Calibration parameter, LV_ACC=1" VALUE 0x67b8a _REC_VAL_20_u2 0.99998474 _CNV_A_R_LINEAR_____2_CM 0. 0.99998474 FORMAT "%7.5" /end CHARACTERISTIC
/begin CHARACTERISTIC C_FAC_TQ_IS_AD_CONV "Calibration parameter, LV_ACC=0, LV_DRI=1" VALUE 0x67b8e _REC_VAL_20_u2 4.88e-004 _CNV_A_R_LINEAR_____137_CM 0. 4.88e-004 FORMAT "%10.9" /end CHARACTERISTIC
/begin CHARACTERISTIC C_FAC_TQ_IS_AD_ACC_CONV "Calibration parameter, LV_ACC=1, LV_DRI=1" VALUE 0x67b8c _REC_VAL_20_u2 0.99998474 _CNV_A_R_LINEAR_____2_CM 0. 0.99998474 FORMAT "%7.5" /end CHARACTERISTIC
/begin CHARACTERISTIC C_TQ_IS_AD_ACC_MAX "Max. limitation for ACC torque adaptation" VALUE 0x67d1e _REC_VAL_20_s2 2047.96875 _CNV_A_R_LINEAR_____37_CM -1024. 1023.96875 FORMAT "%7.1" /end CHARACTERISTIC
/begin CHARACTERISTIC C_TQ_IS_AD_ACC_CONV_MAX "Max. limitation of air conditioning compressor and converter  torque adaptation" VALUE 0x67d1a _REC_VAL_20_s2 2047.96875 _CNV_A_R_LINEAR_____37_CM -1024. 1023.96875 FORMAT "%7.1" /end CHARACTERISTIC
/begin CHARACTERISTIC C_TQ_IS_AD_ACC_CONV_MIN "Min. limitation of air conditioning compressor and converter  torque adaptation" VALUE 0x67d1c _REC_VAL_20_s2 2047.96875 _CNV_A_R_LINEAR_____37_CM -1024. 1023.96875 FORMAT "%7.1" /end CHARACTERISTIC
/begin CHARACTERISTIC C_CRLC_TQ_DIF_IS_AD_ACC "Filter constant for LOW_PASS_1" VALUE 0x67b66 _REC_VAL_20_u1 0.9960940000000002 _CNV_A_R_LINEAR_____8_CM 0. 0.996094 FORMAT "%5.3" /end CHARACTERISTIC
/begin CHARACTERISTIC IP_ACIN_N_SP_IS "Nominal idle speed with air conditioner switched on" CURVE 0x659e8 _REC_CUR_20_u2_u1 8160. _CNV_A_R_LINEAR_____0_CM 0. 8160. FORMAT "%4.0"
 /begin AXIS_DESCR COM_AXIS TCO _CNV_A_R_LINEAR_____22_CM 6 -48. 142.5 FORMAT "%5.1" AXIS_PTS_REF ldpm_tco_4 /end AXIS_DESCR
/end CHARACTERISTIC
/begin CHARACTERISTIC IP_DRI_ACIN_N_SP_IS "Nominal idle speed with DRIVE (A/T) engaged and air conditioner switched on" CURVE 0x65a24 _REC_CUR_20_u2_u1 8160. _CNV_A_R_LINEAR_____0_CM 0. 8160. FORMAT "%4.0"
 /begin AXIS_DESCR COM_AXIS TCO _CNV_A_R_LINEAR_____22_CM 6 -48. 142.5 FORMAT "%5.1" AXIS_PTS_REF ldpm_tco_4 /end AXIS_DESCR
/end CHARACTERISTIC
/begin CHARACTERISTIC IP_N_SP_ADD_CAT "Additive term on nominal idle speed when Catalyst Heating function is active" MAP 0x669f4 _REC_MAP_20_u2_u1_u2 8160. _CNV_A_R_LINEAR_____0_CM 0. 8160. FORMAT "%4.0"
 /begin AXIS_DESCR COM_AXIS TCO _CNV_A_R_LINEAR_____22_CM 5 -48. 142.5 FORMAT "%5.1" AXIS_PTS_REF ldp_tco__n_sp_add_cat /end AXIS_DESCR
 /begin AXIS_DESCR COM_AXIS T_AST _CNV_A_R_LINEAR_____18_CM 5 0. 6553.5 FORMAT "%5.1" AXIS_PTS_REF ldp_t_ast__n_sp_add_cat /end AXIS_DESCR
/end CHARACTERISTIC
/begin AXIS_PTS ldp_tco__n_sp_add_cat "" 0x618ad TCO _REC_AXS_20_u1 190.5 _CNV_A_R_LINEAR_____22_CM 5 -48. 142.5 FORMAT "%5.1" /end AXIS_PTS
/begin AXIS_PTS ldp_t_ast__n_sp_add_cat "" 0x61848 T_AST _REC_AXS_20_u2 6553.5 _CNV_A_R_LINEAR_____18_CM 5 0. 6553.5 FORMAT "%5.1" /end AXIS_PTS
/begin AXIS_PTS ldpm_tco_is_1 "" 0x61d40 TCO _REC_AXS_20_u1 190.5 _CNV_A_R_LINEAR_____22_CM 8 -48. 142.5 FORMAT "%5.1" /end AXIS_PTS
/begin CHARACTERISTIC LC_TQ_P_D_SLOW_INH_AS "Logical variable for deactivation of TQ_DIF_P_D_IS - default value at initialisation = 0" VALUE 0x67d90 _REC_VAL_20_u1 1. _CNV_A_R_LINEAR_____13_CM 0. 1. FORMAT "%1.0" /end CHARACTERISTIC
/begin MEASUREMENT LV_N_MAX_MT "Boolean for engine speed limitation for stopped MT-vehicle active" UBYTE _CNV_S_2_RANGE______76_CM 1 100. 0. 1. ECU_ADDRESS 0x3fd50d BIT_MASK 0x1 /end MEASUREMENT
/begin MEASUREMENT LV_N_MAX_AT "Boolean for engine speed limitation for AT-vehicle at high gear ratio active" UBYTE _CNV_S_2_RANGE______76_CM 1 100. 0. 1. ECU_ADDRESS 0x3fd50e BIT_MASK 0x1 /end MEASUREMENT
/begin MEASUREMENT LV_N_MAX_GR "Boolean for engine speed limitation for MT-vehicle at high gear ratio active" UBYTE _CNV_S_2_RANGE______76_CM 1 100. 0. 1. ECU_ADDRESS 0x3fd50f BIT_MASK 0x1 /end MEASUREMENT
/begin CHARACTERISTIC C_N_MAX "General engine speed threshold for engine speed limitation" VALUE 0x67c13 _REC_VAL_20_u1 979.2000000000001 _CNV_A_R_LINEAR_____15_CM 0. 8160. FORMAT "%4.0" /end CHARACTERISTIC
/begin CHARACTERISTIC C_GR_MT "Gear ratio threshold for MT-vehicle engine speed limitation" VALUE 0x67bb2 _REC_VAL_20_u1 30.6 _CNV_A_R_LINEAR_____13_CM 0. 255. FORMAT "%3.0" /end CHARACTERISTIC
/begin CHARACTERISTIC C_N_MAX_MT "Engine speed limit for engine speed limitation of stopped MT-vehicle" VALUE 0x67c19 _REC_VAL_20_u1 979.2000000000001 _CNV_A_R_LINEAR_____15_CM 0. 8160. FORMAT "%4.0" /end CHARACTERISTIC
/begin CHARACTERISTIC C_VS_MIN_MT "Minimum vehicle speed threshold for engine speed limitation of stopped MT-vehicle " VALUE 0x67d79 _REC_VAL_20_u1 255. _CNV_A_R_LINEAR_____43_CM 0. 255. FORMAT "%3.0" /end CHARACTERISTIC
/begin CHARACTERISTIC C_VS_MIN_AT_1 "Minimum vehicle speed threshold for engine speed limitation of AT-vehicle with GR_AT = 0" VALUE 0x67d75 _REC_VAL_20_u1 255. _CNV_A_R_LINEAR_____43_CM 0. 255. FORMAT "%3.0" /end CHARACTERISTIC
/begin CHARACTERISTIC C_VS_MIN_AT_2 "Minimum vehicle speed threshold for engine speed limitation of AT-vehicle with GR_AT > 0" VALUE 0x67d76 _REC_VAL_20_u1 255. _CNV_A_R_LINEAR_____43_CM 0. 255. FORMAT "%3.0" /end CHARACTERISTIC
/begin CHARACTERISTIC C_N_MAX_GR "Engine speed limit for engine speed limitation for MT-vehicle at high gear ratio" VALUE 0x67c17 _REC_VAL_20_u1 979.2000000000001 _CNV_A_R_LINEAR_____15_CM 0. 8160. FORMAT "%4.0" /end CHARACTERISTIC
/begin CHARACTERISTIC C_N_MAX_AT "Engine speed limit for engine speed limitation of AT-vehicle" VALUE 0x67c14 _REC_VAL_20_u1 979.2000000000001 _CNV_A_R_LINEAR_____15_CM 0. 8160. FORMAT "%4.0" /end CHARACTERISTIC
/begin MEASUREMENT TQ_DIF_IS_AD_ACC_1 "ACC torque adaptation" SWORD _CNV_A_R_LINEAR_____37_CM 1 100. -1024. 1023.96875 ECU_ADDRESS 0x3fc906 FORMAT "%6.2" /end MEASUREMENT
/begin MEASUREMENT TQ_DIF_IS_AD_ACC "Low-pass filtered ACC torque adaptation or ACC and converter torque adaptation" SWORD _CNV_A_R_LINEAR_____37_CM 1 100. -1024. 1023.96875 ECU_ADDRESS 0x3fc8f4 FORMAT "%6.2" /end MEASUREMENT
/begin MEASUREMENT TQ_DIF_IS_AD_ACC_CONV "ACC and converter torque adaptation" SWORD _CNV_A_R_LINEAR_____37_CM 1 100. -1024. 1023.96875 ECU_ADDRESS 0x3fc904 FORMAT "%6.2" /end MEASUREMENT
/begin MEASUREMENT FAC_P_D_SLOW_TCO_IS "TCO depending factor for slow-path of torque coordination" UWORD _CNV_A_R_LINEAR_____5_CM 1 100. 0. 1.99996948 ECU_ADDRESS 0x3fc920 FORMAT "%7.5" /end MEASUREMENT
/begin MEASUREMENT FAC_P_D_FAST_TCO_IS "TCO depending factor for fast-path of torque coordination" UWORD _CNV_A_R_LINEAR_____5_CM 1 100. 0. 1.99996948 ECU_ADDRESS 0x3fc922 FORMAT "%7.5" /end MEASUREMENT
/begin MEASUREMENT FAC_N_GRD_IS "Weighting factor for N_GRD input for IP_P_D_IS" UBYTE _CNV_A_R_LINEAR_____64_CM 1 100. 0. 1.99220002 ECU_ADDRESS 0x3fd8be FORMAT "%5.3" /end MEASUREMENT
/begin CHARACTERISTIC IP_T_N_DIF_OFS_PRED__N "Time constant for calculation of predicted engine speed deviation" CURVE 0x6727a _REC_CUR_20_u1_u2 7.96875 _CNV_A_R_LINEAR_____80_CM 0. 7.96875 FORMAT "%4.2"
 /begin AXIS_DESCR COM_AXIS N _CNV_A_R_LINEAR_____0_CM 8 0. 8160. FORMAT "%4.0" AXIS_PTS_REF ldp_n_t_n_dif_ofs_pred /end AXIS_DESCR
/end CHARACTERISTIC
/begin CHARACTERISTIC IP_EFF_VOL_SLOP "Slope cylinder air mass flow including valve overlapping influences" MAP 0x65a8c _REC_MAP_20_u2_u2_u1 12.05964 _CNV_A_R_LINEAR_____147_CM 0. 12.05964 FORMAT "%6.4"
 /begin AXIS_DESCR COM_AXIS N _CNV_A_R_LINEAR_____0_CM 12 0. 8160. FORMAT "%4.0" AXIS_PTS_REF ldpm_n_eff_vol /end AXIS_DESCR
 /begin AXIS_DESCR COM_AXIS VO _CNV_A_R_LINEAR_____6_CM 8 0. 95.625 FORMAT "%5.2" AXIS_PTS_REF ldpm_vo__eff_vol /end AXIS_DESCR
/end CHARACTERISTIC
/begin MEASUREMENT LV_IGK "Boolean for ignition key status - ( Passive / Active )" UBYTE _CNV_S_2_RANGE______74_CM 1 100. 0. 1. ECU_ADDRESS 0x3fd58b BIT_MASK 0x1 /end MEASUREMENT
/begin CHARACTERISTIC C_TCO_AD_MIN_IS "temperature bottom limit for ISC adaptation" VALUE 0x67c9a _REC_VAL_20_u1 28.575 _CNV_A_R_LINEAR_____22_CM -48. 142.5 FORMAT "%5.1" /end CHARACTERISTIC
/begin MEASUREMENT VS_EDGE_CTR_AV "actual value of vehicle speed tooth counter" UWORD _CNV_A_R_LINEAR_____17_CM 1 100. 0. 65535. ECU_ADDRESS 0x3fd14e FORMAT "%5.0" /end MEASUREMENT
/begin MEASUREMENT VS_EDGE_T_AV "actual timestamp of last tooth" UWORD _CNV_A_R_LINEAR_____152_CM 1 100. 0. 524.28 ECU_ADDRESS 0x3fd150 FORMAT "%7.3" /end MEASUREMENT
/begin CHARACTERISTIC C_T_VST "Time delay for detection of vehicle speed" VALUE 0x67d93 _REC_VAL_20_u1 19. _CNV_A_R_LINEAR_____3_CM 10. 200. FORMAT "%3.0" /end CHARACTERISTIC
/begin CHARACTERISTIC C_VS_EDGE_SUM_MIN "Minimum number of wheel segments for evaluation of vehicle speedy gonzales" VALUE 0x67d94 _REC_VAL_20_u1 25.4 _CNV_A_R_LINEAR_____17_CM 1. 255. FORMAT "%3.0" /end CHARACTERISTIC
/begin MEASUREMENT VS_SENS "vehicle speed calculated from vehicle speed sensor" UWORD _CNV_A_R_LINEAR_____153_CM 1 100. 0. 511.99218 ECU_ADDRESS 0x3fd14a FORMAT "%7.3" /end MEASUREMENT
/begin MEASUREMENT VS_SENS_GRD "Vehicle speed gradient calculated from VS_SENS" SWORD _CNV_A_R_LINEAR_____154_CM 1 100. -256. 255.9921875 ECU_ADDRESS 0x3fd14c FORMAT "%8.3" /end MEASUREMENT
/begin MEASUREMENT LV_VST "boolean for stopped vehicle" UBYTE _CNV_S_2_RANGE______74_CM 1 100. 0. 1. ECU_ADDRESS 0x3fd591 BIT_MASK 0x1 /end MEASUREMENT
/begin MEASUREMENT N_DIF_ST "Engine speed deviation N_MAX_TOL_ST - N" SWORD _CNV_A_R_LINEAR_____0_CM 1 100. -32768. 32767. ECU_ADDRESS 0x3fcdf4 FORMAT "%6.0" /end MEASUREMENT
/begin MEASUREMENT N_SP_IS_RATIO "Ratio actual engine speed versus engine speed setpoint at idle" UWORD _CNV_A_R_LINEAR_____104_CM 1 100. 0. 7.99987793 ECU_ADDRESS 0x3fcdf2 FORMAT "%6.4" /end MEASUREMENT
/begin CHARACTERISTIC C_CRLC_VB "Low pass filter constant for VB_MMV" VALUE 0x67f1a _REC_VAL_20_u1 0.9960940000000002 _CNV_A_R_LINEAR_____8_CM 0. 0.996094 FORMAT "%5.3" /end CHARACTERISTIC
/begin AXIS_PTS ldp_vb_mmv_dri_n_sp_min_vb "" 0x61d8a VB_MMV _REC_AXS_20_u1 28.8 _CNV_A_R_LINEAR_____157_CM 2 0. 28.8 FORMAT "%3.1" /end AXIS_PTS
/begin CHARACTERISTIC IP_DRI_N_SP_IS "Nominal idle speed with DRIVE  (A/T) engaged" CURVE 0x65a30 _REC_CUR_20_u2_u1 8160. _CNV_A_R_LINEAR_____0_CM 0. 8160. FORMAT "%4.0"
 /begin AXIS_DESCR COM_AXIS TCO _CNV_A_R_LINEAR_____22_CM 6 -48. 142.5 FORMAT "%5.1" AXIS_PTS_REF ldpm_tco_4 /end AXIS_DESCR
/end CHARACTERISTIC
/begin AXIS_PTS ldp_vb_mmv_n_sp_min_vb "" 0x61d8d VB_MMV _REC_AXS_20_u1 28.8 _CNV_A_R_LINEAR_____157_CM 2 0. 28.8 FORMAT "%3.1" /end AXIS_PTS
/begin CHARACTERISTIC C_DRI_VS_MIN_VB "Minimum vehicle speed for activating battery charging in case LV_DRI = 1" VALUE 0x67f2c _REC_VAL_20_u1 255. _CNV_A_R_LINEAR_____43_CM 0. 255. FORMAT "%3.0" /end CHARACTERISTIC
/begin MEASUREMENT VB_MMV "???" UBYTE _CNV_A_R_LINEAR_____157_CM 1 100. 0. 28.8 ECU_ADDRESS 0x3fd9a2 FORMAT "%3.1" /end MEASUREMENT
/begin CHARACTERISTIC LC_N_GRD_FIL_P_D_INH_AS "Logical variable for switching between N_GRD and N_GRD_FIL_IS" VALUE 0x67f23 _REC_VAL_20_u1 1. _CNV_A_R_LINEAR_____13_CM 0. 1. FORMAT "%1.0" /end CHARACTERISTIC
/begin CHARACTERISTIC LC_N_GRD_FIL_I_INH_AS "Logical variable for switching between N_GRD and N_GRD_FIL" VALUE 0x67f56 _REC_VAL_20_u1 1. _CNV_A_R_LINEAR_____13_CM 0. 1. FORMAT "%1.0" /end CHARACTERISTIC
/begin AXIS_PTS ldpm_tia_maf_mdl_con_1 "" 0x61d52 TIA _REC_AXS_20_u1 190.5 _CNV_A_R_LINEAR_____22_CM 8 -48. 142.5 FORMAT "%5.1" /end AXIS_PTS
/begin AXIS_PTS ldpm_tqi_av__thd_er "" 0x61e5a TQI_AV _REC_AXS_20_u2 1023.96875 _CNV_A_R_LINEAR_____37_CM 6 0. 1023.96875 FORMAT "%7.2" /end AXIS_PTS
/begin MEASUREMENT N_GRD_FIL_IS "Filtered engine speed gradient for ISC" SBYTE _CNV_A_R_LINEAR_____14_CM 1 100. -4096. 4064. ECU_ADDRESS 0x3fd8bd FORMAT "%4.0" /end MEASUREMENT
/begin CHARACTERISTIC C_VS_FAC "" VALUE 0x67d70 _REC_VAL_20_u4 0.291271 _CNV_A_R_LINEAR_____169_CM 0. 0.291271 FORMAT "%10.9" /end CHARACTERISTIC
/begin MEASUREMENT N_GRD_P_D_IS "Filtered gradient for PD-part" SBYTE _CNV_A_R_LINEAR_____14_CM 1 100. -4096. 4064. ECU_ADDRESS 0x3fd8bf FORMAT "%5.0" /end MEASUREMENT
/begin MEASUREMENT N_GRD_I_IS "Filtered gradient for I-part" SBYTE _CNV_A_R_LINEAR_____14_CM 1 100. -4096. 4064. ECU_ADDRESS 0x3fd8c0 FORMAT "%5.0" /end MEASUREMENT
/begin MEASUREMENT LV_PAS_RAMP_ACT_IS "flag for ramp operation due to deactivation of ISC active" UBYTE _CNV_S_2_RANGE______74_CM 1 100. 0. 1. ECU_ADDRESS 0x3fd4bd /end MEASUREMENT
/begin CHARACTERISTIC C_PVS_SLOP_1 "Slope value of  the pedal value 1" VALUE 0x6885f _REC_VAL_20_u1 79.6875 _CNV_A_R_LINEAR_____172_CM 0. 79.6875 FORMAT "%4.1" /end CHARACTERISTIC
/begin CHARACTERISTIC C_PVS_SLOP_2 "Slope value of  the pedal value 2" VALUE 0x68860 _REC_VAL_20_u1 79.6875 _CNV_A_R_LINEAR_____172_CM 0. 79.6875 FORMAT "%4.1" /end CHARACTERISTIC
/begin MEASUREMENT LV_KD "Flag for Kick-Down-Recognition (internally recognized from both PVS-voltages)" UBYTE _CNV_S_2_RANGE______76_CM 1 100. 0. 1. ECU_ADDRESS 0x3fd514 BIT_MASK 0x1 /end MEASUREMENT
/begin CHARACTERISTIC C_V_PVS_THD_KD_2 "Difference between C_V_PVS_SP_FL_2 and kick-down-recognition (Channel 2)" VALUE 0x67d4e _REC_VAL_20_u1 4.98046875 _CNV_A_R_LINEAR_____40_CM 0. 4.98046875 FORMAT "%5.3" /end CHARACTERISTIC
/begin CHARACTERISTIC C_V_PVS_THD_KD_HYS_2 "Hysteresis of kick down recognition Channel 2" VALUE 0x68863 _REC_VAL_20_u1 4.98046875 _CNV_A_R_LINEAR_____40_CM 0. 4.98046875 FORMAT "%5.3" /end CHARACTERISTIC
/begin CHARACTERISTIC C_V_PVS_THD_KD_HYS_1 "Hysteresis of kick down recognition Channel 1" VALUE 0x68864 _REC_VAL_20_u1 4.98046875 _CNV_A_R_LINEAR_____40_CM 0. 4.98046875 FORMAT "%5.3" /end CHARACTERISTIC
/begin AXIS_PTS ldpm_tco_4 "" 0x61d0d TCO _REC_AXS_20_u1 190.5 _CNV_A_R_LINEAR_____22_CM 6 -48. 142.5 FORMAT "%5.1" /end AXIS_PTS
/begin AXIS_PTS ldpm_tco_4_rng_l "" 0x61e76 TCO _REC_AXS_20_u1 190.5 _CNV_A_R_LINEAR_____22_CM 6 -48. 142.5 FORMAT "%5.1" /end AXIS_PTS
/begin AXIS_PTS ldp_vb_mmv_dri_n_sp_vb_rng_l "" 0x61e7d VB_MMV _REC_AXS_20_u1 28.8 _CNV_A_R_LINEAR_____157_CM 2 0. 28.8 FORMAT "%3.1" /end AXIS_PTS
/begin AXIS_PTS ldp_vb_mmv_n_sp_min_vb_rng_l "" 0x61e80 VB_MMV _REC_AXS_20_u1 28.8 _CNV_A_R_LINEAR_____157_CM 2 0. 28.8 FORMAT "%3.1" /end AXIS_PTS
/begin CHARACTERISTIC IP_N_SP_IS_RNG_L "Nominal idle speed without additional load on the engine at low range mode" CURVE 0x66a26 _REC_CUR_20_u2_u1 8160. _CNV_A_R_LINEAR_____0_CM 0. 8160. FORMAT "%4.0"
 /begin AXIS_DESCR COM_AXIS TCO _CNV_A_R_LINEAR_____22_CM 6 -48. 142.5 FORMAT "%5.1" AXIS_PTS_REF ldpm_tco_4_rng_l /end AXIS_DESCR
/end CHARACTERISTIC
/begin CHARACTERISTIC IP_DRI_N_SP_IS_RNG_L "Nominal idle speed with DRIVE  (A/T) engaged at low range mode" CURVE 0x68872 _REC_CUR_20_u2_u1 8160. _CNV_A_R_LINEAR_____0_CM 0. 8160. FORMAT "%4.0"
 /begin AXIS_DESCR COM_AXIS TCO _CNV_A_R_LINEAR_____22_CM 6 -48. 142.5 FORMAT "%5.1" AXIS_PTS_REF ldpm_tco_4_rng_l /end AXIS_DESCR
/end CHARACTERISTIC
/begin CHARACTERISTIC IP_ACIN_N_SP_IS_RNG_L "Nominal idle speed with DRIVE (A/T) engaged and air conditioner switched on at low range mode" CURVE 0x6887e _REC_CUR_20_u2_u1 8160. _CNV_A_R_LINEAR_____0_CM 0. 8160. FORMAT "%4.0"
 /begin AXIS_DESCR COM_AXIS TCO _CNV_A_R_LINEAR_____22_CM 6 -48. 142.5 FORMAT "%5.1" AXIS_PTS_REF ldpm_tco_4_rng_l /end AXIS_DESCR
/end CHARACTERISTIC
/begin CHARACTERISTIC IP_DRI_ACIN_N_SP_IS_RNG_L "Nominal idle speed with DRIVE (A/T) engaged and air conditioner switched on at low range mode" CURVE 0x6888a _REC_CUR_20_u2_u1 8160. _CNV_A_R_LINEAR_____0_CM 0. 8160. FORMAT "%4.0"
 /begin AXIS_DESCR COM_AXIS TCO _CNV_A_R_LINEAR_____22_CM 6 -48. 142.5 FORMAT "%5.1" AXIS_PTS_REF ldpm_tco_4_rng_l /end AXIS_DESCR
/end CHARACTERISTIC
/begin CHARACTERISTIC IP_DRI_N_SP_VB_RNG_L_ "Minimum idle speed for low battery voltage in case LV_DRI = 1 at low range mode" CURVE 0x68896 _REC_CUR_20_u2_u1 8160. _CNV_A_R_LINEAR_____173_CM 0. 8160. FORMAT "%6.1"
 /begin AXIS_DESCR COM_AXIS VB_MMV _CNV_A_R_LINEAR_____157_CM 2 0. 28.8 FORMAT "%3.1" AXIS_PTS_REF ldp_vb_mmv_dri_n_sp_vb_rng_l /end AXIS_DESCR
/end CHARACTERISTIC
/begin CHARACTERISTIC IP_N_SP_MIN_VB_RNG_L_ "Minimum idle speed for low battery voltage in case LV_DRI = 0 at low range mode" CURVE 0x6889a _REC_CUR_20_u2_u1 8160. _CNV_A_R_LINEAR_____173_CM 0. 8160. FORMAT "%6.1"
 /begin AXIS_DESCR COM_AXIS VB_MMV _CNV_A_R_LINEAR_____157_CM 2 0. 28.8 FORMAT "%3.1" AXIS_PTS_REF ldp_vb_mmv_n_sp_min_vb_rng_l /end AXIS_DESCR
/end CHARACTERISTIC
/begin CHARACTERISTIC IP_N_SP_IS_LIH "Idle speed setpoint in case of limp home" CURVE 0x6889e _REC_CUR_20_u2_u1 8160. _CNV_A_R_LINEAR_____0_CM 0. 8160. FORMAT "%4.0"
 /begin AXIS_DESCR COM_AXIS TCO _CNV_A_R_LINEAR_____22_CM 6 -48. 142.5 FORMAT "%5.1" AXIS_PTS_REF ldpm_tco_4 /end AXIS_DESCR
/end CHARACTERISTIC
/begin CHARACTERISTIC IP_DRI_N_SP_IS_LIH "Idle speed setpoint in case of limp home and engaged drivetrain" CURVE 0x688aa _REC_CUR_20_u2_u1 8160. _CNV_A_R_LINEAR_____0_CM 0. 8160. FORMAT "%4.0"
 /begin AXIS_DESCR COM_AXIS TCO _CNV_A_R_LINEAR_____22_CM 6 -48. 142.5 FORMAT "%5.1" AXIS_PTS_REF ldpm_tco_4 /end AXIS_DESCR
/end CHARACTERISTIC
/begin CHARACTERISTIC C_N_SP_LGRD_IS "Nominal idle speed change limitation" VALUE 0x67c23 _REC_VAL_20_u1 12.7 _CNV_A_R_LINEAR_____174_CM 0.25 63.75 FORMAT "%5.2" /end CHARACTERISTIC
/begin MEASUREMENT TEMP_CAT "catalyst temperature" UWORD _CNV_A_R_LINEAR_____95_CM 1 100. -33. 990.984375 ECU_ADDRESS 0x3fce98 FORMAT "%6.2" /end MEASUREMENT
/begin CHARACTERISTIC IP_DRI_N_SP_MIN_VB__VB_MMV "Minimum idle speed for low battery voltage in case LV_DRI = 1" CURVE 0x67f24 _REC_CUR_20_u2_u1 8160. _CNV_A_R_LINEAR_____173_CM 0. 8160. FORMAT "%6.1"
 /begin AXIS_DESCR COM_AXIS VB_MMV _CNV_A_R_LINEAR_____157_CM 2 0. 28.8 FORMAT "%3.1" AXIS_PTS_REF ldp_vb_mmv_dri_n_sp_min_vb /end AXIS_DESCR
/end CHARACTERISTIC
/begin CHARACTERISTIC IP_N_SP_MIN_VB__VB_MMV "Minimum idle speed for low battery voltage in case LV_DRI = 0" CURVE 0x67f28 _REC_CUR_20_u2_u1 8160. _CNV_A_R_LINEAR_____173_CM 0. 8160. FORMAT "%6.1"
 /begin AXIS_DESCR COM_AXIS VB_MMV _CNV_A_R_LINEAR_____157_CM 2 0. 28.8 FORMAT "%3.1" AXIS_PTS_REF ldp_vb_mmv_n_sp_min_vb /end AXIS_DESCR
/end CHARACTERISTIC
/begin CHARACTERISTIC C_DRI_VS_MIN_VB_RNG_L "Minimum vehicle speed for activating battery charging in case LV_DRI = 1 at low range mode" VALUE 0x688b6 _REC_VAL_20_u1 255. _CNV_A_R_LINEAR_____43_CM 0. 255. FORMAT "%3.0" /end CHARACTERISTIC
/begin AXIS_PTS ldp_pv_av__n_max_mtc_cur_off "" 0x61ebd PV_AV _REC_AXS_20_u1 99.609375 _CNV_A_R_LINEAR_____16_CM 4 0. 99.609375 FORMAT "%5.2" /end AXIS_PTS
/begin CHARACTERISTIC IP_N_MAX_MTC_CUR_OFF__PV_AV "Engine speed limit for limp home modus due MTC error" CURVE 0x68924 _REC_CUR_20_u1_u1 8160. _CNV_A_R_LINEAR_____15_CM 0. 8160. FORMAT "%4.0"
 /begin AXIS_DESCR COM_AXIS PV_AV _CNV_A_R_LINEAR_____16_CM 4 0. 99.609375 FORMAT "%5.2" AXIS_PTS_REF ldp_pv_av__n_max_mtc_cur_off /end AXIS_DESCR
/end CHARACTERISTIC
/begin CHARACTERISTIC C_VS_MAX "Vehicle speed limitation threshold" VALUE 0x68928 _REC_VAL_20_u1 255. _CNV_A_R_LINEAR_____43_CM 0. 255. FORMAT "%3.0" /end CHARACTERISTIC
/begin CHARACTERISTIC C_N_MAX_THD_MIN "Minimum allowed engine speed threshold" VALUE 0x68929 _REC_VAL_20_u1 8160. _CNV_A_R_LINEAR_____15_CM 0. 8160. FORMAT "%4.0" /end CHARACTERISTIC
/begin CHARACTERISTIC C_CRLC_N_GRD "Filter correlation constant" VALUE 0x67f22 _REC_VAL_20_u1 0.9960940000000002 _CNV_A_R_LINEAR_____8_CM 0. 0.996094 FORMAT "%5.3" /end CHARACTERISTIC
/begin CHARACTERISTIC ID_FAC_P_D_DT_IS "Weighting factor for IP_P_D_DT_IS" CURVE 0x65064 _REC_CUR_20_u2_u1 1.99996948 _CNV_A_R_LINEAR_____5_CM 0. 1.99996948 FORMAT "%7.5"
 /begin AXIS_DESCR COM_AXIS GR_MT _CNV_A_R_LINEAR_____13_CM 13 0. 255. FORMAT "%3.0" AXIS_PTS_REF ldpm_gr_mt_2 /end AXIS_DESCR
/end CHARACTERISTIC
/begin CHARACTERISTIC C_V_PVS_OFS_1 "Offset of the pedal value 1" VALUE 0x68861 _REC_VAL_20_u1 1.24511719 _CNV_A_R_LINEAR_____39_CM 0. 1.24511719 FORMAT "%5.3" /end CHARACTERISTIC
/begin CHARACTERISTIC C_V_PVS_OFS_2 "Offset of the pedal value 2" VALUE 0x68862 _REC_VAL_20_u1 1.24511719 _CNV_A_R_LINEAR_____39_CM 0. 1.24511719 FORMAT "%5.3" /end CHARACTERISTIC
/begin CHARACTERISTIC IP_N_SP_IS "Nominal idle speed without additional load on the engine" CURVE 0x68866 _REC_CUR_20_u2_u1 8160. _CNV_A_R_LINEAR_____0_CM 0. 8160. FORMAT "%4.0"
 /begin AXIS_DESCR COM_AXIS TCO _CNV_A_R_LINEAR_____22_CM 6 -48. 142.5 FORMAT "%5.1" AXIS_PTS_REF ldpm_tco_4 /end AXIS_DESCR
/end CHARACTERISTIC
/begin CHARACTERISTIC IP_FAC_P_D_FAST_TCO_IS "TCO depending factor foe fast-path of torque coordination" CURVE 0x69116 _REC_CUR_20_u2_u1 1.99996948 _CNV_A_R_LINEAR_____5_CM 0. 1.99996948 FORMAT "%7.5"
 /begin AXIS_DESCR COM_AXIS TCO _CNV_A_R_LINEAR_____22_CM 8 -48. 142.5 FORMAT "%5.1" AXIS_PTS_REF ldpm_tco_is_1 /end AXIS_DESCR
/end CHARACTERISTIC
/begin CHARACTERISTIC IP_FAC_P_D_SLOW_TCO_IS "TCO depending factor foe slow-path of torque coordination" CURVE 0x69126 _REC_CUR_20_u2_u1 1.99996948 _CNV_A_R_LINEAR_____5_CM 0. 1.99996948 FORMAT "%7.5"
 /begin AXIS_DESCR COM_AXIS TCO _CNV_A_R_LINEAR_____22_CM 8 -48. 142.5 FORMAT "%5.1" AXIS_PTS_REF ldpm_tco_is_1 /end AXIS_DESCR
/end CHARACTERISTIC
/begin MEASUREMENT TEG_PCAT_DOWN_1 "exhaust gas temperature of precat" UWORD _CNV_A_R_LINEAR_____25_CM 1 100. 0. 1023.984375 ECU_ADDRESS 0x3fcea4 FORMAT "%6.1" /end MEASUREMENT
/begin MEASUREMENT TEG_PCAT_DOWN_2 "exhaust gas temperature of precat" UWORD _CNV_A_R_LINEAR_____25_CM 1 100. 0. 1023.984375 ECU_ADDRESS 0x3fcea8 FORMAT "%6.1" /end MEASUREMENT
/begin MEASUREMENT TEG_PCAT_DOWN_RAW_2 "exhaust gas temperature of precat,raw value i.e. not replaced by substitde value" UWORD _CNV_A_R_LINEAR_____25_CM 1 100. 0. 1023.984375 ECU_ADDRESS 0x3fceaa FORMAT "%6.1" /end MEASUREMENT
/begin MEASUREMENT TEG_PCAT_DOWN_RAW_1 "exhaust gas temperature of precat,raw value i.e. not replaced by substitde value" UWORD _CNV_A_R_LINEAR_____25_CM 1 100. 0. 1023.984375 ECU_ADDRESS 0x3fcea6 FORMAT "%6.1" /end MEASUREMENT
/begin CHARACTERISTIC IP_TEG__V_TEG "convertion table of exhaust gas temperature" CURVE 0x672c6 _REC_CUR_20_u2_u2 1023.984375 _CNV_A_R_LINEAR_____25_CM 0. 1023.984375 FORMAT "%6.1"
 /begin AXIS_DESCR COM_AXIS ONLINE_DUMMY _CNV_A_R_LINEAR_____38_CM 16 0. 4.99511719 FORMAT "%5.3" AXIS_PTS_REF ldp_v_teg__teg /end AXIS_DESCR
/end CHARACTERISTIC
/begin AXIS_PTS ldp_v_teg__teg "" 0x61a66 V_TEG _REC_AXS_20_u2 4.99511719 _CNV_A_R_LINEAR_____38_CM 16 0. 4.99511719 FORMAT "%5.3" /end AXIS_PTS
/begin MEASUREMENT TQ_DIF_IS_AD "Basic ISC adaptation" SWORD _CNV_A_R_LINEAR_____37_CM 1 100. -1024. 1023.96875 ECU_ADDRESS 0x3fc8f0 FORMAT "%6.2" /end MEASUREMENT
/begin MEASUREMENT TQ_DIF_IS_AD_INTER "Basic ISC adaptation, inetmediate value with high resolution (long signed word)" SLONG _CNV_A_R_LINEAR_____82_CM 1 100. -1024. 1023.99999952 ECU_ADDRESS 0x3fc8f8 FORMAT "%12.7" /end MEASUREMENT
/begin MEASUREMENT TQ_DIF_IS_AD_ACC_1_INTER "Torque ACC adaptation, inetmediate value with high resolution (long signed word)" SLONG _CNV_A_R_LINEAR_____82_CM 1 100. -1024. 1023.99999952 ECU_ADDRESS 0x3fc8fc FORMAT "%12.7" /end MEASUREMENT
/begin MEASUREMENT TQ_DIF_IS_AD_ACC_CONV_INTER "ACC and torque adaptation, inetmediate value with high resolution (long signed word)" SLONG _CNV_A_R_LINEAR_____82_CM 1 100. -1024. 1023.99999952 ECU_ADDRESS 0x3fc900 FORMAT "%12.7" /end MEASUREMENT
/begin MEASUREMENT LV_IS_AD_CND "Adaptation Condition" UBYTE _CNV_S_2_RANGE______74_CM 1 100. 0. 1. ECU_ADDRESS 0x3fd4ba BIT_MASK 0x1 /end MEASUREMENT
/begin MEASUREMENT LV_TCO_AD_CND_IS "Logical bit \"Coolant temperature in operating range\"" UBYTE _CNV_S_2_RANGE______74_CM 1 100. 0. 1. ECU_ADDRESS 0x3fd4bb /end MEASUREMENT
/begin MEASUREMENT LV_DLY_AD_IS "Logical bit \"Idle speed has settled for a given time delay\"" UBYTE _CNV_S_2_RANGE______74_CM 1 100. 0. 1. ECU_ADDRESS 0x3fd4bc /end MEASUREMENT
/begin MEASUREMENT N_DIF_PRED "Predicted idle speed control variable" SWORD _CNV_A_R_LINEAR_____0_CM 1 100. -32768. 32767. ECU_ADDRESS 0x3fc934 FORMAT "%6.0" /end MEASUREMENT
/begin MEASUREMENT TQ_ADD_IS_BOL "Torque reserve ad idle due to deviation of engine speed to set point at idle" UWORD _CNV_A_R_LINEAR_____37_CM 1 100. 0. 1023.96875 ECU_ADDRESS 0x3fc930 FORMAT "%7.2" /end MEASUREMENT
/begin MEASUREMENT TQ_DIF_ADD_IS_TOL "Idle speed torque reserve limitation for stabilization the ISC at high torque reserves" UWORD _CNV_A_R_LINEAR_____37_CM 1 100. 0. 1023.96875 ECU_ADDRESS 0x3fc932 FORMAT "%7.2" /end MEASUREMENT
/begin AXIS_PTS ldp_n_dif_pred_tq_add_is_bol "" 0x62056 N_DIF_PREF _REC_AXS_20_u2 65535. _CNV_A_R_LINEAR_____53_CM 8 -32768. 32767. FORMAT "%6.0" /end AXIS_PTS
/begin CHARACTERISTIC IP_TQ_ADD_IS_BOL__N_DIF_PRED "Torque reserve at idle due to a deviation of engine speed to set point at idle" CURVE 0x69158 _REC_CUR_20_u2_u2 1023.96875 _CNV_A_R_LINEAR_____37_CM 0. 1023.96875 FORMAT "%7.2"
 /begin AXIS_DESCR COM_AXIS N_DIF_PRED _CNV_A_R_LINEAR_____53_CM 8 -32768. 32767. FORMAT "%6.0" AXIS_PTS_REF ldp_n_dif_pred_tq_add_is_bol /end AXIS_DESCR
/end CHARACTERISTIC
/begin CHARACTERISTIC C_TQ_ADD_IS_BOL_CRLC "Filter constant for torque reserve" VALUE 0x69168 _REC_VAL_20_u1 0.9960940000000002 _CNV_A_R_LINEAR_____8_CM 0. 0.996094 FORMAT "%5.3" /end CHARACTERISTIC
/begin CHARACTERISTIC C_TQ_DIF_ADD_IS_TOL "Idle speed torque reserve limitation for stabilizing the ISC at high torque reserve" VALUE 0x6916a _REC_VAL_20_u2 1023.96875 _CNV_A_R_LINEAR_____37_CM 0. 1023.96875 FORMAT "%7.2" /end CHARACTERISTIC
/begin MEASUREMENT VB "battery voltage" UBYTE _CNV_A_R_LINEAR_____42_CM 1 100. 0. 25.8984 ECU_ADDRESS 0x3fd9a1 FORMAT "%3.1" /end MEASUREMENT
/begin MEASUREMENT LV_CDN_VB_OBD1 "Boolean for battery voltage condition fullfilled for OBD-I diagnosis" UBYTE _CNV_S_2_RANGE______74_CM 1 100. 0. 1. ECU_ADDRESS 0x3fd58d /end MEASUREMENT
/begin MEASUREMENT LV_CDN_VB_OBD2 "Boolean for battery voltage condition fullfilled for OBD-II diagnosis" UBYTE _CNV_S_2_RANGE______74_CM 1 100. 0. 1. ECU_ADDRESS 0x3fd58e /end MEASUREMENT
/begin MEASUREMENT LV_CDN_VB_MIN_DIAG "Boolean for battery voltage condition fullfilled for remaining diagnosis" UBYTE _CNV_S_2_RANGE______74_CM 1 100. 0. 1. ECU_ADDRESS 0x3fd58f /end MEASUREMENT
/begin CHARACTERISTIC C_VB_MIN_JUMP "Battery voltage threshold for over voltage detection" VALUE 0x67d5b _REC_VAL_20_u1 7.76952 _CNV_A_R_LINEAR_____42_CM 0. 25.8984 FORMAT "%3.1" /end CHARACTERISTIC
/begin CHARACTERISTIC C_VB_MIN_OBD1 "Battery voltage threshold for low voltage detection for OBD-I Variante" VALUE 0x6917e _REC_VAL_20_u1 3.291 _CNV_A_R_LINEAR_____195_CM 0. 10.97 FORMAT "%4.1" /end CHARACTERISTIC
/begin CHARACTERISTIC C_VB_MIN_OBD2 "Battery voltage threshold for low voltage detection for OBD-II Variante" VALUE 0x6917f _REC_VAL_20_u1 3.291 _CNV_A_R_LINEAR_____195_CM 0. 10.97 FORMAT "%4.1" /end CHARACTERISTIC
/begin CHARACTERISTIC C_VB_MIN_DIAG "Battery voltage threshold for low voltage detection for remaining diagnosis" VALUE 0x69180 _REC_VAL_20_u1 3.291 _CNV_A_R_LINEAR_____195_CM 0. 10.97 FORMAT "%4.1" /end CHARACTERISTIC
/begin CHARACTERISTIC IP_TCO__V_TCO "Conversion table for linearization of TCO value acquisition" CURVE 0x67292 _REC_CUR_20_u1_u2 28.575 _CNV_A_R_LINEAR_____22_CM -48. 142.5 FORMAT "%5.1"
 /begin AXIS_DESCR COM_AXIS ONLINE_DUMMY _CNV_A_R_LINEAR_____196_CM 16 7.8125e-002 4.99511719 FORMAT "%5.3" AXIS_PTS_REF ldp_v_tco__tco /end AXIS_DESCR
/end CHARACTERISTIC
/begin AXIS_PTS ldp_v_tco__tco "" 0x61a44 V_TCO _REC_AXS_20_u2 4.425292971 _CNV_A_R_LINEAR_____196_CM 16 7.8125e-002 4.99511719 FORMAT "%5.3" /end AXIS_PTS
/begin AXIS_PTS ldp_maf_kgh__tco_sub_inc "" 0x62070 MAF_KGH _REC_AXS_20_u2 2047.96875 _CNV_A_R_LINEAR_____52_CM 4 0. 2047.96875 FORMAT "%7.2" /end AXIS_PTS
/begin CHARACTERISTIC C_T_MAX_RIS "Maximum time delay for ISC request activation" VALUE 0x67c60 _REC_VAL_20_u2 655.35 _CNV_A_R_LINEAR_____21_CM 0. 655.35 FORMAT "%6.2" /end CHARACTERISTIC
/begin CHARACTERISTIC C_FAC_TQ_IS_AD "Calibration parameter, LV_ACC=0, LV_DRI=0" VALUE 0x67b88 _REC_VAL_20_u2 0.99998474 _CNV_A_R_LINEAR_____2_CM 0. 0.99998474 FORMAT "%7.5" /end CHARACTERISTIC
/begin MEASUREMENT LV_DC "driving cycle status flag" UBYTE _CNV_S_2_RANGE______202_CM 1 100. 0. 1. ECU_ADDRESS 0x3fd353 BIT_MASK 0x1 /end MEASUREMENT
/begin MEASUREMENT LV_WUP_CYC "warm-up cycle status flag" UBYTE _CNV_S_2_RANGE______74_CM 1 100. 0. 1. ECU_ADDRESS 0x3fd61b BIT_MASK 0x1 /end MEASUREMENT
/begin MEASUREMENT LV_STATE_WUP "TCO state for exceeding the warm-up cycle tco threshold" UBYTE _CNV_S_2_RANGE______74_CM 1 100. 0. 1. ECU_ADDRESS 0x3fd61a BIT_MASK 0x1 /end MEASUREMENT
/begin CHARACTERISTIC C_DLY_IS_AD "time delay for ISC adaptation" VALUE 0x67b74 _REC_VAL_20_u1 255. _CNV_A_R_LINEAR_____13_CM 0. 255. FORMAT "%3.0" /end CHARACTERISTIC
/begin CHARACTERISTIC C_DLY_DC "delay for driving cycle valid" VALUE 0x69240 _REC_VAL_20_u2 6553.5 _CNV_A_R_LINEAR_____18_CM 0. 6553.5 FORMAT "%6.1" /end CHARACTERISTIC
/begin CHARACTERISTIC C_TCO_WUP_THD "OBD II required at least 72 °C for GS and 60 °C for DS engines EOBD required at least 70 °C for DS and GS engines" VALUE 0x69242 _REC_VAL_20_u1 190.5 _CNV_A_R_LINEAR_____22_CM -48. 142.5 FORMAT "%5.1" /end CHARACTERISTIC
/begin CHARACTERISTIC C_TCO_WUP_INC "OBDII required at least 23 °C for GS and DS engines EOBD required at least 22 °C for GS and DS engines" VALUE 0x69243 _REC_VAL_20_u1 190.5 _CNV_A_R_LINEAR_____22_CM -48. 142.5 FORMAT "%5.1" /end CHARACTERISTIC
/begin CHARACTERISTIC C_CTR_MAX_WUP_CYC "Initialization value for the warm-up cycle of diagnostics" VALUE 0x69244 _REC_VAL_20_u1 255. _CNV_A_R_LINEAR_____13_CM 0. 255. FORMAT "%3.0" /end CHARACTERISTIC
/begin MEASUREMENT TCO "coolant temperature" UBYTE _CNV_A_R_LINEAR_____22_CM 1 100. -48. 142.5 ECU_ADDRESS 0x3fd970 FORMAT "%5.1" /end MEASUREMENT
/begin MEASUREMENT TCO_MES "measured coolant temperature" UBYTE _CNV_A_R_LINEAR_____22_CM 1 100. -48. 142.5 ECU_ADDRESS 0x3fd974 FORMAT "%5.1" /end MEASUREMENT
/begin MEASUREMENT VS "vehicle speed" UBYTE _CNV_A_R_LINEAR_____43_CM 1 100. 0. 255. ECU_ADDRESS 0x3fd9a4 FORMAT "%3.0" /end MEASUREMENT
/begin MEASUREMENT PV_AV "Global degree of activation of the accelerator pedal" UBYTE _CNV_A_R_LINEAR_____16_CM 1 100. 0. 99.609375 ECU_ADDRESS 0x3fd95f FORMAT "%3.1" /end MEASUREMENT
/begin MEASUREMENT PV_MAX "Maximum selection of pedal value interpretation" UBYTE _CNV_A_R_LINEAR_____16_CM 1 100. 0. 99.609375 ECU_ADDRESS 0x3fd960 FORMAT "%3.1" /end MEASUREMENT
/begin MEASUREMENT BIOS_EOI_0 "end of injection in °crk before BIOS_EOI_LIM" UWORD _CNV_A_R_LINEAR_____117_CM 1 100. 0. 720. ECU_ADDRESS 0x3fc640 FORMAT "%6.2" /end MEASUREMENT
/begin MEASUREMENT BIOS_EOI_1 "end of injection in °crk before BIOS_EOI_LIM" UWORD _CNV_A_R_LINEAR_____117_CM 1 100. 0. 720. ECU_ADDRESS 0x3fc642 FORMAT "%6.2" /end MEASUREMENT
/begin MEASUREMENT BIOS_EOI_2 "end of injection in °crk before BIOS_EOI_LIM" UWORD _CNV_A_R_LINEAR_____117_CM 1 100. 0. 720. ECU_ADDRESS 0x3fc644 FORMAT "%6.2" /end MEASUREMENT
/begin MEASUREMENT BIOS_EOI_3 "end of injection in °crk before BIOS_EOI_LIM" UWORD _CNV_A_R_LINEAR_____117_CM 1 100. 0. 720. ECU_ADDRESS 0x3fc646 FORMAT "%6.2" /end MEASUREMENT
/begin MEASUREMENT BIOS_EOI_4 "end of injection in °crk before BIOS_EOI_LIM" UWORD _CNV_A_R_LINEAR_____117_CM 1 100. 0. 720. ECU_ADDRESS 0x3fc648 FORMAT "%6.2" /end MEASUREMENT
/begin MEASUREMENT BIOS_EOI_5 "end of injection in °crk before BIOS_EOI_LIM" UWORD _CNV_A_R_LINEAR_____117_CM 1 100. 0. 720. ECU_ADDRESS 0x3fc64a FORMAT "%6.2" /end MEASUREMENT
/begin AXIS_PTS ldp_cl_mmv "" 0x61496 CL_MMV _REC_AXS_20_u2 7.99987793 _CNV_A_R_LINEAR_____104_CM 6 0. 7.99987793 FORMAT "%6.4" /end AXIS_PTS
/begin CHARACTERISTIC LC_ISC_ACT_OLD_AS "Logical variable for ISC_activation with LV_IS -default value at initialisation = 0" VALUE 0x67d85 _REC_VAL_20_u1 1. _CNV_A_R_LINEAR_____13_CM 0. 1. FORMAT "%1.0" /end CHARACTERISTIC
/begin MEASUREMENT N_DIF "Engine speed deviation N_SP_IS_N" SWORD _CNV_A_R_LINEAR_____0_CM 1 100. -4096. 4064. ECU_ADDRESS 0x3fcdec FORMAT "%4.0" /end MEASUREMENT
/begin MEASUREMENT N_DLY_720 "Delayed N for calculation of engine roughness threshold" UWORD _CNV_A_R_LINEAR_____0_CM 1 100. 0. 8160. ECU_ADDRESS 0x3fce48 FORMAT "%4.0" /end MEASUREMENT
/begin MEASUREMENT TQI_AV_DLY_720 "Delayed TQI_AV for calculation of engine roughness threshold" SWORD _CNV_A_R_LINEAR_____37_CM 1 100. -1024. 1023.96875 ECU_ADDRESS 0x3fce46 FORMAT "%7.1" /end MEASUREMENT
/begin MEASUREMENT FAC_THD_AD_ER "Engine roughness threshold correction factor during segment adaptation learning process." UWORD _CNV_A_R_LINEAR_____207_CM 1 100. 0. 0.1875 ECU_ADDRESS 0x3fce4c FORMAT "%7.5" /end MEASUREMENT
/begin MEASUREMENT LV_SEG_AD_STATE "Boolean for state of segment adaptation:  (1 = adaptation finished)" UBYTE _CNV_S_2_RANGE______74_CM 1 100. 0. 1. ECU_ADDRESS 0x3fd512 BIT_MASK 0x1 /end MEASUREMENT
/begin AXIS_PTS ldp_tco__fac_thd_er "" 0x620f2 TCO _REC_AXS_20_u1 190.5 _CNV_A_R_LINEAR_____22_CM 8 -48. 142.5 FORMAT "%5.1" /end AXIS_PTS
/begin MEASUREMENT THD_ER_AV "Engine roughness threshold value for evaluated segment (with 720° delay)" SWORD _CNV_A_R_LINEAR_____165_CM 1 100. -32768. 32767. ECU_ADDRESS 0x3fce4a FORMAT "%6.0" /end MEASUREMENT
/begin MEASUREMENT MIS_SUM_ER_0 "Counter for cylinder-individual detected misfire by engine roughness method." UWORD _CNV_A_R_LINEAR_____17_CM 1 100. 0. 65535. ECU_ADDRESS 0x3fce66 FORMAT "%5.0" /end MEASUREMENT
/begin MEASUREMENT MIS_SUM_ER_1 "Counter for cylinder-individual detected misfire by engine roughness method." UWORD _CNV_A_R_LINEAR_____17_CM 1 100. 0. 65535. ECU_ADDRESS 0x3fce68 FORMAT "%5.0" /end MEASUREMENT
/begin MEASUREMENT MIS_SUM_ER_2 "Counter for cylinder-individual detected misfire by engine roughness method." UWORD _CNV_A_R_LINEAR_____17_CM 1 100. 0. 65535. ECU_ADDRESS 0x3fce6a FORMAT "%5.0" /end MEASUREMENT
/begin MEASUREMENT MIS_SUM_ER_3 "Counter for cylinder-individual detected misfire by engine roughness method." UWORD _CNV_A_R_LINEAR_____17_CM 1 100. 0. 65535. ECU_ADDRESS 0x3fce6c FORMAT "%5.0" /end MEASUREMENT
/begin MEASUREMENT MIS_SUM_ER_4 "Counter for cylinder-individual detected misfire by engine roughness method." UWORD _CNV_A_R_LINEAR_____17_CM 1 100. 0. 65535. ECU_ADDRESS 0x3fce6e FORMAT "%5.0" /end MEASUREMENT
/begin MEASUREMENT MIS_SUM_ER_5 "Counter for cylinder-individual detected misfire by engine roughness method." UWORD _CNV_A_R_LINEAR_____17_CM 1 100. 0. 65535. ECU_ADDRESS 0x3fce70 FORMAT "%5.0" /end MEASUREMENT
/begin MEASUREMENT MIS_NR_TDC_ER "Counter for monitored segments by ER-method" ULONG _CNV_A_R_LINEAR_____13_CM 1 100. 0. 4294967295. ECU_ADDRESS 0x3fc1a8 FORMAT "%11.0" /end MEASUREMENT
/begin AXIS_PTS ldpm_n__thd_er "" 0x62114 N _REC_AXS_20_u2 8159. _CNV_A_R_LINEAR_____0_CM 10 1. 8160. FORMAT "%4.0" /end AXIS_PTS
/begin MEASUREMENT LV_CMB_TRA_ER "Boolean for engine roughness fade out condition due to transient combustion state" UBYTE _CNV_S_2_RANGE______74_CM 1 100. 0. 1. ECU_ADDRESS 0x3fd511 /end MEASUREMENT
/begin CHARACTERISTIC IP_THD_ER_MPL_CHK_AT "engine roughness threshold for confirmation multiple misfire  / AT-vehicle (compared to ER_AV)" MAP 0x693ec _REC_MAP_20_u2_u2_u2 32767. _CNV_A_R_LINEAR_____208_CM -32768. -1. FORMAT "%7.0"
 /begin AXIS_DESCR COM_AXIS N _CNV_A_R_LINEAR_____0_CM 10 1. 8160. FORMAT "%4.0" AXIS_PTS_REF ldpm_n__thd_er /end AXIS_DESCR
 /begin AXIS_DESCR COM_AXIS TQI_AV _CNV_A_R_LINEAR_____37_CM 6 0. 1023.96875 FORMAT "%7.2" AXIS_PTS_REF ldpm_tqi_av__thd_er /end AXIS_DESCR
/end CHARACTERISTIC
/begin AXIS_PTS ldpm_tco__tqi_av_min_er "" 0x62131 TCO _REC_AXS_20_u1 190.5 _CNV_A_R_LINEAR_____22_CM 6 -48. 142.5 FORMAT "%5.1" /end AXIS_PTS
/begin CHARACTERISTIC IP_TQI_AV_MIN_ER_MT "Positive torque curve (zero load), MT vehicles" MAP 0x69464 _REC_MAP_20_u2_u1_u1 1023.96875 _CNV_A_R_LINEAR_____37_CM 0. 1023.96875 FORMAT "%7.2"
 /begin AXIS_DESCR COM_AXIS N_32 _CNV_A_R_LINEAR_____15_CM 6 0. 8160. FORMAT "%4.0" AXIS_PTS_REF ldpm_n_32__tqi_av_min_er /end AXIS_DESCR
 /begin AXIS_DESCR COM_AXIS TCO _CNV_A_R_LINEAR_____22_CM 6 -48. 142.5 FORMAT "%5.1" AXIS_PTS_REF ldpm_tco__tqi_av_min_er /end AXIS_DESCR
/end CHARACTERISTIC
/begin CHARACTERISTIC C_N_MIN_ER "Minimum engine speed for engine roughness determination." VALUE 0x694f4 _REC_VAL_20_u1 7680. _CNV_A_R_LINEAR_____15_CM 480. 8160. FORMAT "%5.0" /end CHARACTERISTIC
/begin CHARACTERISTIC C_NR_TDC_CMB_TRA_ER "Number of TDC for disable mfd after a transient combustion mode " VALUE 0x694f6 _REC_VAL_20_u1 255. _CNV_A_R_LINEAR_____13_CM 0. 255. FORMAT "%3.0" /end CHARACTERISTIC
/begin AXIS_PTS ldpm_n_32__tqi_av_min_er "" 0x6212a N_32 _REC_AXS_20_u1 8160. _CNV_A_R_LINEAR_____15_CM 6 0. 8160. FORMAT "%4.0" /end AXIS_PTS
/begin AXIS_PTS ldpm_n_32__fac_er "" 0x62138 N_32 _REC_AXS_20_u1 8160. _CNV_A_R_LINEAR_____15_CM 8 0. 8160. FORMAT "%4.0" /end AXIS_PTS
/begin CHARACTERISTIC IP_TQI_AV_MIN_ER_AT "Positive torque curve (zero load), AT vehicles" MAP 0x694ac _REC_MAP_20_u2_u1_u1 1023.96875 _CNV_A_R_LINEAR_____37_CM 0. 1023.96875 FORMAT "%7.2"
 /begin AXIS_DESCR COM_AXIS N_32 _CNV_A_R_LINEAR_____15_CM 6 0. 8160. FORMAT "%4.0" AXIS_PTS_REF ldpm_n_32__tqi_av_min_er /end AXIS_DESCR
 /begin AXIS_DESCR COM_AXIS TCO _CNV_A_R_LINEAR_____22_CM 6 -48. 142.5 FORMAT "%5.1" AXIS_PTS_REF ldpm_tco__tqi_av_min_er /end AXIS_DESCR
/end CHARACTERISTIC
/begin AXIS_PTS ldpm_tqi_av__fac_er "" 0x62142 TQI_AV _REC_AXS_20_u2 1023.96875 _CNV_A_R_LINEAR_____37_CM 8 0. 1023.96875 FORMAT "%7.2" /end AXIS_PTS
/begin CHARACTERISTIC ID_FAC_ER "Weighting factor for irregular engine operation (engine roughness method), init-value = 1." MAP 0x694f7 _REC_MAP_20_u1_u1_u2 2. _CNV_A_R_LINEAR_____209_CM 0. 2. FORMAT "%4.2"
 /begin AXIS_DESCR COM_AXIS N_32 _CNV_A_R_LINEAR_____15_CM 8 0. 8160. FORMAT "%4.0" AXIS_PTS_REF ldpm_n_32__fac_er /end AXIS_DESCR
 /begin AXIS_DESCR COM_AXIS TQI_AV _CNV_A_R_LINEAR_____37_CM 8 0. 1023.96875 FORMAT "%7.2" AXIS_PTS_REF ldpm_tqi_av__fac_er /end AXIS_DESCR
/end CHARACTERISTIC
/begin CHARACTERISTIC ID_FAC_IGC_DUR "Weighting factor for ignition diagnosis (ignition failure detected);  only necessary if configured !" MAP 0x69537 _REC_MAP_20_u1_u1_u2 2. _CNV_A_R_LINEAR_____209_CM 0. 2. FORMAT "%4.2"
 /begin AXIS_DESCR COM_AXIS N_32 _CNV_A_R_LINEAR_____15_CM 8 0. 8160. FORMAT "%4.0" AXIS_PTS_REF ldpm_n_32__fac_er /end AXIS_DESCR
 /begin AXIS_DESCR COM_AXIS TQI_AV _CNV_A_R_LINEAR_____37_CM 8 0. 1023.96875 FORMAT "%7.2" AXIS_PTS_REF ldpm_tqi_av__fac_er /end AXIS_DESCR
/end CHARACTERISTIC
/begin MEASUREMENT ER_IGC_DUR_IV_SUM "Sum of the weighting factor from diagnosis combinations for final misfire decision." UBYTE _CNV_A_R_LINEAR_____209_CM 1 100. 0. 5.1 ECU_ADDRESS 0x3fd94f FORMAT "%4.2" /end MEASUREMENT
/begin CHARACTERISTIC IP_THD_ER_MPL_CHK_MT "engine roughness threshold for confirmation of multiple misfire  / MT-vehicle (compared to ER_AV)" MAP 0x69374 _REC_MAP_20_u2_u2_u2 32767. _CNV_A_R_LINEAR_____208_CM -32768. -1. FORMAT "%7.0"
 /begin AXIS_DESCR COM_AXIS N _CNV_A_R_LINEAR_____0_CM 10 1. 8160. FORMAT "%4.0" AXIS_PTS_REF ldpm_n__thd_er /end AXIS_DESCR
 /begin AXIS_DESCR COM_AXIS TQI_AV _CNV_A_R_LINEAR_____37_CM 6 0. 1023.96875 FORMAT "%7.2" AXIS_PTS_REF ldpm_tqi_av__thd_er /end AXIS_DESCR
/end CHARACTERISTIC
/begin MEASUREMENT THD_ER_BAS "Basic engine roughness threshold value for evaluated segment (with 720° delay) single misfire" SWORD _CNV_A_R_LINEAR_____165_CM 1 100. -32768. 32767. ECU_ADDRESS 0x3fcdbc FORMAT "%6.0" /end MEASUREMENT
/begin MEASUREMENT LV_ER_FDOUT "Boolean for engine roughness fade out condition" UBYTE _CNV_S_2_RANGE______74_CM 1 100. 0. 1. ECU_ADDRESS 0x3fd510 /end MEASUREMENT
/begin CHARACTERISTIC IP_THD_ER_AFS_MT "Basic engine roughness threshold for misfire detection / Combustion mode AFS. MT-vehicle" MAP 0x69578 _REC_MAP_20_u2_u2_u2 32767. _CNV_A_R_LINEAR_____208_CM -32768. -1. FORMAT "%7.0"
 /begin AXIS_DESCR COM_AXIS N _CNV_A_R_LINEAR_____0_CM 10 1. 8160. FORMAT "%4.0" AXIS_PTS_REF ldpm_n__thd_er /end AXIS_DESCR
 /begin AXIS_DESCR COM_AXIS TQI_AV _CNV_A_R_LINEAR_____37_CM 6 0. 1023.96875 FORMAT "%7.2" AXIS_PTS_REF ldpm_tqi_av__thd_er /end AXIS_DESCR
/end CHARACTERISTIC
/begin CHARACTERISTIC IP_THD_ER_MPL_AFS_MT "Basic engine roughness threshold for multiple misfire detection / Combustion mode AFS. MT-vehicle" MAP 0x69848 _REC_MAP_20_u2_u2_u2 32767. _CNV_A_R_LINEAR_____208_CM -32768. -1. FORMAT "%7.0"
 /begin AXIS_DESCR COM_AXIS N _CNV_A_R_LINEAR_____0_CM 10 1. 8160. FORMAT "%4.0" AXIS_PTS_REF ldpm_n__thd_er /end AXIS_DESCR
 /begin AXIS_DESCR COM_AXIS TQI_AV _CNV_A_R_LINEAR_____37_CM 6 0. 1023.96875 FORMAT "%7.2" AXIS_PTS_REF ldpm_tqi_av__thd_er /end AXIS_DESCR
/end CHARACTERISTIC
/begin CHARACTERISTIC IP_THD_ER_AFL_MT "Basic engine roughness threshold for misfire detection / Combustion mode AFL. MT-vehicle" MAP 0x695f0 _REC_MAP_20_u2_u2_u2 32767. _CNV_A_R_LINEAR_____208_CM -32768. -1. FORMAT "%7.0"
 /begin AXIS_DESCR COM_AXIS N _CNV_A_R_LINEAR_____0_CM 10 1. 8160. FORMAT "%4.0" AXIS_PTS_REF ldpm_n__thd_er /end AXIS_DESCR
 /begin AXIS_DESCR COM_AXIS TQI_AV _CNV_A_R_LINEAR_____37_CM 6 0. 1023.96875 FORMAT "%7.2" AXIS_PTS_REF ldpm_tqi_av__thd_er /end AXIS_DESCR
/end CHARACTERISTIC
/begin CHARACTERISTIC IP_THD_ER_MPL_AFL_MT "Basic engine roughness threshold for multiple misfire detection / Combustion mode AFL. MT-vehicle" MAP 0x698c0 _REC_MAP_20_u2_u2_u2 32767. _CNV_A_R_LINEAR_____208_CM -32768. -1. FORMAT "%7.0"
 /begin AXIS_DESCR COM_AXIS N _CNV_A_R_LINEAR_____0_CM 10 1. 8160. FORMAT "%4.0" AXIS_PTS_REF ldpm_n__thd_er /end AXIS_DESCR
 /begin AXIS_DESCR COM_AXIS TQI_AV _CNV_A_R_LINEAR_____37_CM 6 0. 1023.96875 FORMAT "%7.2" AXIS_PTS_REF ldpm_tqi_av__thd_er /end AXIS_DESCR
/end CHARACTERISTIC
/begin CHARACTERISTIC IP_THD_ER_S_MT "Basic engine roughness threshold for misfire detection / Combustion mode stratified. MT-vehicle" MAP 0x69668 _REC_MAP_20_u2_u2_u2 32767. _CNV_A_R_LINEAR_____208_CM -32768. -1. FORMAT "%7.0"
 /begin AXIS_DESCR COM_AXIS N _CNV_A_R_LINEAR_____0_CM 10 1. 8160. FORMAT "%4.0" AXIS_PTS_REF ldpm_n__thd_er /end AXIS_DESCR
 /begin AXIS_DESCR COM_AXIS TQI_AV _CNV_A_R_LINEAR_____37_CM 6 0. 1023.96875 FORMAT "%7.2" AXIS_PTS_REF ldpm_tqi_av__thd_er /end AXIS_DESCR
/end CHARACTERISTIC
/begin CHARACTERISTIC IP_THD_ER_MPL_S_MT "Basic engine roughness threshold for multiple misfire detection / Combustion mode stratified. MT-vehicle" MAP 0x69938 _REC_MAP_20_u2_u2_u2 32767. _CNV_A_R_LINEAR_____208_CM -32768. -1. FORMAT "%7.0"
 /begin AXIS_DESCR COM_AXIS N _CNV_A_R_LINEAR_____0_CM 10 1. 8160. FORMAT "%4.0" AXIS_PTS_REF ldpm_n__thd_er /end AXIS_DESCR
 /begin AXIS_DESCR COM_AXIS TQI_AV _CNV_A_R_LINEAR_____37_CM 6 0. 1023.96875 FORMAT "%7.2" AXIS_PTS_REF ldpm_tqi_av__thd_er /end AXIS_DESCR
/end CHARACTERISTIC
/begin CHARACTERISTIC IP_THD_ER_AFS_AT "Basic engine roughness threshold for misfire detection / Combustion mode AFS. AT-vehicle" MAP 0x697d0 _REC_MAP_20_u2_u2_u2 32767. _CNV_A_R_LINEAR_____208_CM -32768. -1. FORMAT "%7.0"
 /begin AXIS_DESCR COM_AXIS N _CNV_A_R_LINEAR_____0_CM 10 1. 8160. FORMAT "%4.0" AXIS_PTS_REF ldpm_n__thd_er /end AXIS_DESCR
 /begin AXIS_DESCR COM_AXIS TQI_AV _CNV_A_R_LINEAR_____37_CM 6 0. 1023.96875 FORMAT "%7.2" AXIS_PTS_REF ldpm_tqi_av__thd_er /end AXIS_DESCR
/end CHARACTERISTIC
/begin CHARACTERISTIC IP_THD_ER_MPL_AFS_AT "Basic engine roughness threshold for multiple misfire detection / Combustion mode AFS. AT-vehicle" MAP 0x699b0 _REC_MAP_20_u2_u2_u2 32767. _CNV_A_R_LINEAR_____208_CM -32768. -1. FORMAT "%7.0"
 /begin AXIS_DESCR COM_AXIS N _CNV_A_R_LINEAR_____0_CM 10 1. 8160. FORMAT "%4.0" AXIS_PTS_REF ldpm_n__thd_er /end AXIS_DESCR
 /begin AXIS_DESCR COM_AXIS TQI_AV _CNV_A_R_LINEAR_____37_CM 6 0. 1023.96875 FORMAT "%7.2" AXIS_PTS_REF ldpm_tqi_av__thd_er /end AXIS_DESCR
/end CHARACTERISTIC
/begin CHARACTERISTIC IP_THD_ER_AFL_AT "Basic engine roughness threshold for misfire detection / Combustion mode AFL. AT-vehicle" MAP 0x69758 _REC_MAP_20_u2_u2_u2 32767. _CNV_A_R_LINEAR_____208_CM -32768. -1. FORMAT "%7.0"
 /begin AXIS_DESCR COM_AXIS N _CNV_A_R_LINEAR_____0_CM 10 1. 8160. FORMAT "%4.0" AXIS_PTS_REF ldpm_n__thd_er /end AXIS_DESCR
 /begin AXIS_DESCR COM_AXIS TQI_AV _CNV_A_R_LINEAR_____37_CM 6 0. 1023.96875 FORMAT "%7.2" AXIS_PTS_REF ldpm_tqi_av__thd_er /end AXIS_DESCR
/end CHARACTERISTIC
/begin CHARACTERISTIC IP_THD_ER_MPL_AFL_AT "Basic engine roughness threshold for multiple misfire detection / Combustion mode AFL. AT-vehicle" MAP 0x69a28 _REC_MAP_20_u2_u2_u2 32767. _CNV_A_R_LINEAR_____208_CM -32768. -1. FORMAT "%7.0"
 /begin AXIS_DESCR COM_AXIS N _CNV_A_R_LINEAR_____0_CM 10 1. 8160. FORMAT "%4.0" AXIS_PTS_REF ldpm_n__thd_er /end AXIS_DESCR
 /begin AXIS_DESCR COM_AXIS TQI_AV _CNV_A_R_LINEAR_____37_CM 6 0. 1023.96875 FORMAT "%7.2" AXIS_PTS_REF ldpm_tqi_av__thd_er /end AXIS_DESCR
/end CHARACTERISTIC
/begin CHARACTERISTIC IP_THD_ER_MPL_S_AT "Basic engine roughness threshold for multiple misfire detection / Combustion mode statified. AT-vehicle" MAP 0x69aa0 _REC_MAP_20_u2_u2_u2 32767. _CNV_A_R_LINEAR_____208_CM -32768. -1. FORMAT "%7.0"
 /begin AXIS_DESCR COM_AXIS N _CNV_A_R_LINEAR_____0_CM 10 1. 8160. FORMAT "%4.0" AXIS_PTS_REF ldpm_n__thd_er /end AXIS_DESCR
 /begin AXIS_DESCR COM_AXIS TQI_AV _CNV_A_R_LINEAR_____37_CM 6 0. 1023.96875 FORMAT "%7.2" AXIS_PTS_REF ldpm_tqi_av__thd_er /end AXIS_DESCR
/end CHARACTERISTIC
/begin MEASUREMENT LV_INH_THD_ER "Boolean for Engine roughness inhibitation by project specific conditions" UBYTE _CNV_S_2_RANGE______74_CM 1 100. 0. 1. ECU_ADDRESS 0x3fd501 /end MEASUREMENT
/begin MEASUREMENT LV_STATE_RR "Boolean for state of rough road detection (No : Yes)." UBYTE _CNV_S_2_RANGE______74_CM 1 100. 0. 1. ECU_ADDRESS 0x3fd52b /end MEASUREMENT
/begin MEASUREMENT SEG_T_MES_0_RR "Actual segment time measurement from the wheel speed signal." ULONG _CNV_A_R_LINEAR_____210_CM 1 100. 0. 4294967288. ECU_ADDRESS 0x3fc1ac FORMAT "%10.0" /end MEASUREMENT
/begin MEASUREMENT SEG_T_MES_1_RR "Previous segment time measurement from the wheel speed signal." ULONG _CNV_A_R_LINEAR_____210_CM 1 100. 0. 4294967288. ECU_ADDRESS 0x3fc1b0 FORMAT "%10.0" /end MEASUREMENT
/begin MEASUREMENT WHEEL_GRD_MMV "Rough road value." UWORD _CNV_A_R_LINEAR_____211_CM 1 100. 0. 999.985 ECU_ADDRESS 0x3fce78 FORMAT "%6.2" /end MEASUREMENT
/begin MEASUREMENT WHEEL_GRD_MMV_THD "Threshold for rough road value" UWORD _CNV_A_R_LINEAR_____211_CM 1 100. 0. 999.985 ECU_ADDRESS 0x3fce7a FORMAT "%6.2" /end MEASUREMENT
/begin MEASUREMENT SUM_RR "Counter of rough road detection events." UWORD _CNV_A_R_LINEAR_____17_CM 1 100. 0. 65535. ECU_ADDRESS 0x3fce7c FORMAT "%5.0" /end MEASUREMENT
/begin CHARACTERISTIC C_VS_MIN_RR "Minimum vehicle speed for rough road detection." VALUE 0x69b18 _REC_VAL_20_u1 255. _CNV_A_R_LINEAR_____13_CM 0. 255. FORMAT "%3.0" /end CHARACTERISTIC
/begin CHARACTERISTIC C_VS_MAX_RR "Maximum vehicle speed for rough road detection." VALUE 0x69b19 _REC_VAL_20_u1 254. _CNV_A_R_LINEAR_____17_CM 1. 255. FORMAT "%3.0" /end CHARACTERISTIC
/begin CHARACTERISTIC C_WHEEL_GRD_CRLC_RR "Correlation factor for floating averaging of the rough road raw values" VALUE 0x69b1a _REC_VAL_20_u2 0.99998474 _CNV_A_R_LINEAR_____2_CM 0. 0.99998474 FORMAT "%7.5" /end CHARACTERISTIC
/begin CHARACTERISTIC C_DLY_ER_RR "Fade out time for engine roughness after rough road detection" VALUE 0x69b1c _REC_VAL_20_u2 655350. _CNV_A_R_LINEAR_____3_CM 0. 655350. FORMAT "%6.0" /end CHARACTERISTIC
/begin CHARACTERISTIC C_N_MAX_ER "Maximum engine speed for engine roughness determination." VALUE 0x694f5 _REC_VAL_20_u1 7680. _CNV_A_R_LINEAR_____15_CM 480. 8160. FORMAT "%5.0" /end CHARACTERISTIC
/begin AXIS_PTS ldpm_vs_wheel_grd_mmv_thd "" 0x62154 VS _REC_AXS_20_u1 255. _CNV_A_R_LINEAR_____43_CM 9 0. 255. FORMAT "%3.0" /end AXIS_PTS
/begin CHARACTERISTIC IP_WHEEL_GRD_MMV_THD_AT__VS "Threshold versus vehicle speed for rough road detection, automatic tzransmission" CURVE 0x69b52 _REC_CUR_20_u2_u1 255. _CNV_A_R_LINEAR_____214_CM 0. 255. FORMAT "%6.2"
 /begin AXIS_DESCR COM_AXIS VS _CNV_A_R_LINEAR_____43_CM 9 0. 255. FORMAT "%3.0" AXIS_PTS_REF ldpm_vs_wheel_grd_mmv_thd /end AXIS_DESCR
/end CHARACTERISTIC
/begin CHARACTERISTIC IP_WHEEL_GRD_MMV_THD_MT__VS "Threshold versus vehicle speed for rough road detection, manual transmission" CURVE 0x69b64 _REC_CUR_20_u2_u1 255. _CNV_A_R_LINEAR_____214_CM 0. 255. FORMAT "%6.2"
 /begin AXIS_DESCR COM_AXIS VS _CNV_A_R_LINEAR_____43_CM 9 0. 255. FORMAT "%3.0" AXIS_PTS_REF ldpm_vs_wheel_grd_mmv_thd /end AXIS_DESCR
/end CHARACTERISTIC
/begin CHARACTERISTIC C_MIS_A_IND_THD "Threshold for detection of misfire status CARB A, each cycle" VALUE 0x69b78 _REC_VAL_20_u2 65535. _CNV_A_R_LINEAR_____17_CM 0. 65535. FORMAT "%5.0" /end CHARACTERISTIC
/begin CHARACTERISTIC C_MIS_MAX_NR_OFF_IV "Maximum number of allowed cylinder to be shut-off after detection of the misfire status CARB A." VALUE 0x69b7c _REC_VAL_20_u1 4. _CNV_A_R_LINEAR_____215_CM 0. 4. /end CHARACTERISTIC
/begin CHARACTERISTIC C_ABC_MAX_SEG_T_AD "Maximum value of the anti - bounce counter for segment period measurement diagnosis." VALUE 0x69b76 _REC_VAL_20_u1 254. _CNV_A_R_LINEAR_____17_CM 1. 255. FORMAT "%3.0" /end CHARACTERISTIC
/begin CHARACTERISTIC C_ABC_INC_SEG_T_AD "Increment value of the anti - bounce counter for segment period measurement diagnosis." VALUE 0x69b77 _REC_VAL_20_u1 255. _CNV_A_R_LINEAR_____13_CM 0. 255. FORMAT "%3.0" /end CHARACTERISTIC
/begin CHARACTERISTIC C_MIS_SUM_A_THD "Threshold for detection of misfire status CARB A, end of monitoring interval" VALUE 0x69b7a _REC_VAL_20_u2 65535. _CNV_A_R_LINEAR_____17_CM 0. 65535. FORMAT "%5.0" /end CHARACTERISTIC
/begin CHARACTERISTIC C_MIS_SUM_B1_THD_MT "Threshold for detection of misfire status CARB B1, LV_AT = 0" VALUE 0x69b80 _REC_VAL_20_u2 65535. _CNV_A_R_LINEAR_____17_CM 0. 65535. FORMAT "%5.0" /end CHARACTERISTIC
/begin CHARACTERISTIC C_MIS_SUM_B4_THD_MT "Threshold for detection of misfire status CARB B4, LV_AT = 0" VALUE 0x69b84 _REC_VAL_20_u2 65535. _CNV_A_R_LINEAR_____17_CM 0. 65535. FORMAT "%5.0" /end CHARACTERISTIC
/begin CHARACTERISTIC C_MIS_SUM_B1_THD_AT "Threshold for detection of misfire status CARB B1, LV_AT = 1" VALUE 0x69b82 _REC_VAL_20_u2 65535. _CNV_A_R_LINEAR_____17_CM 0. 65535. FORMAT "%5.0" /end CHARACTERISTIC
/begin CHARACTERISTIC C_MIS_SUM_B4_THD_AT "Threshold for detection of misfire status CARB B4, LV_AT = 1" VALUE 0x69b86 _REC_VAL_20_u2 65535. _CNV_A_R_LINEAR_____17_CM 0. 65535. FORMAT "%5.0" /end CHARACTERISTIC
/begin CHARACTERISTIC C_MIS_B_MIN_NR "Minimum value of the misfiring event counter before storage" VALUE 0x69b88 _REC_VAL_20_u1 255. _CNV_A_R_LINEAR_____13_CM 0. 255. FORMAT "%3.0" /end CHARACTERISTIC
/begin CHARACTERISTIC C_ABC_MAX_MIS_A "Maximum value of the anti - bounce counter" VALUE 0x69b7d _REC_VAL_20_u1 254. _CNV_A_R_LINEAR_____17_CM 1. 255. FORMAT "%3.0" /end CHARACTERISTIC
/begin CHARACTERISTIC C_ABC_INC_MIS_A "Increment value of the anti - bounce counter" VALUE 0x69b7e _REC_VAL_20_u1 255. _CNV_A_R_LINEAR_____13_CM 0. 255. FORMAT "%3.0" /end CHARACTERISTIC
/begin CHARACTERISTIC C_ABC_MAX_MIS_B "Maximum value of the anti - bounce counter" VALUE 0x69b89 _REC_VAL_20_u1 254. _CNV_A_R_LINEAR_____17_CM 1. 255. FORMAT "%3.0" /end CHARACTERISTIC
/begin CHARACTERISTIC C_ABC_MAX_MIS_MPL "Maximum value of the anti - bounce counter" VALUE 0x69b8b _REC_VAL_20_u1 254. _CNV_A_R_LINEAR_____17_CM 1. 255. FORMAT "%3.0" /end CHARACTERISTIC
/begin CHARACTERISTIC C_ABC_INC_MIS_B "Increment value of the anti - bounce counter" VALUE 0x69b8a _REC_VAL_20_u1 255. _CNV_A_R_LINEAR_____13_CM 0. 255. FORMAT "%3.0" /end CHARACTERISTIC
/begin CHARACTERISTIC C_ABC_INC_MIS_MPL "Increment value of the anti - bounce counter" VALUE 0x69b8c _REC_VAL_20_u1 255. _CNV_A_R_LINEAR_____13_CM 0. 255. FORMAT "%3.0" /end CHARACTERISTIC
/begin MEASUREMENT LV_ERR_MIS_A_1 "Boolean indicating for cylinder individual misfire Carb A" UBYTE _CNV_S_2_RANGE______77_R_CM 1 100. 0. 255. ECU_ADDRESS 0x3fd3c7 /end MEASUREMENT
/begin MEASUREMENT LV_ERR_MIS_A_2 "Boolean indicating for cylinder individual misfire Carb A" UBYTE _CNV_S_2_RANGE______77_R_CM 1 100. 0. 255. ECU_ADDRESS 0x3fd3c8 /end MEASUREMENT
/begin MEASUREMENT LV_ERR_MIS_A_3 "Boolean indicating for cylinder individual misfire Carb A" UBYTE _CNV_S_2_RANGE______77_R_CM 1 100. 0. 255. ECU_ADDRESS 0x3fd3c9 /end MEASUREMENT
/begin MEASUREMENT LV_ERR_MIS_A_4 "Boolean indicating for cylinder individual misfire Carb A" UBYTE _CNV_S_2_RANGE______77_R_CM 1 100. 0. 255. ECU_ADDRESS 0x3fd3ca /end MEASUREMENT
/begin MEASUREMENT LV_ERR_MIS_A_5 "Boolean indicating for cylinder individual misfire Carb A" UBYTE _CNV_S_2_RANGE______77_R_CM 1 100. 0. 255. ECU_ADDRESS 0x3fd3cb /end MEASUREMENT
/begin MEASUREMENT INH_IV_MIS "Idendification of Cylinders shut off by Misfire Carb A" UBYTE _CNV_A_R_LINEAR_____17_CM 1 100. 0. 15. ECU_ADDRESS 0x3fd93c FORMAT "%2.0" /end MEASUREMENT
/begin MEASUREMENT LV_ERR_MIS_A_0 "Boolean indicating for cylinder individual misfire Carb A" UBYTE _CNV_S_2_RANGE______77_R_CM 1 100. 0. 255. ECU_ADDRESS 0x3fd3c6 /end MEASUREMENT
/begin MEASUREMENT LV_ERR_MIS_B_1 "Boolean indicating for cylinder individual misfire Carb B" UBYTE _CNV_S_2_RANGE______77_R_CM 1 100. 0. 255. ECU_ADDRESS 0x3fd3cd /end MEASUREMENT
/begin MEASUREMENT LV_ERR_MIS_B_2 "Boolean indicating for cylinder individual misfire Carb B" UBYTE _CNV_S_2_RANGE______77_R_CM 1 100. 0. 255. ECU_ADDRESS 0x3fd3ce /end MEASUREMENT
/begin MEASUREMENT LV_ERR_MIS_B_3 "Boolean indicating for cylinder individual misfire Carb B" UBYTE _CNV_S_2_RANGE______77_R_CM 1 100. 0. 255. ECU_ADDRESS 0x3fd3cf /end MEASUREMENT
/begin MEASUREMENT LV_ERR_MIS_B_4 "Boolean indicating for cylinder individual misfire Carb B" UBYTE _CNV_S_2_RANGE______77_R_CM 1 100. 0. 255. ECU_ADDRESS 0x3fd3d0 /end MEASUREMENT
/begin MEASUREMENT LV_ERR_MIS_B_5 "Boolean indicating for cylinder individual misfire Carb B" UBYTE _CNV_S_2_RANGE______77_R_CM 1 100. 0. 255. ECU_ADDRESS 0x3fd3d1 /end MEASUREMENT
/begin MEASUREMENT MIS_NR_TDC_A "Segment counter CARB A window (200 crankshaft revolutions)." UWORD _CNV_A_R_LINEAR_____17_CM 1 100. 0. 65535. ECU_ADDRESS 0x3fcda6 FORMAT "%5.0" /end MEASUREMENT
/begin MEASUREMENT MIS_NR_TDC_B "Segment counter CARB B window (200 crankshaft revolutions)." UWORD _CNV_A_R_LINEAR_____17_CM 1 100. 0. 65535. ECU_ADDRESS 0x3fcdb6 FORMAT "%5.0" /end MEASUREMENT
/begin MEASUREMENT MIS_SUM_A "Misfire sum at the end of monitoring interval" UWORD _CNV_A_R_LINEAR_____17_CM 1 100. 0. 65535. ECU_ADDRESS 0x3fcda8 FORMAT "%5.0" /end MEASUREMENT
/begin MEASUREMENT MIS_SUM_B "Misfire sum at the end of monitoring interval" UWORD _CNV_A_R_LINEAR_____17_CM 1 100. 0. 65535. ECU_ADDRESS 0x3fcdb8 FORMAT "%5.0" /end MEASUREMENT
/begin MEASUREMENT LV_ERR_SEG_T_AD "Boolean for error currently present during segment period measurement" UBYTE _CNV_S_2_RANGE______77_R_CM 1 100. 0. 255. ECU_ADDRESS 0x3fd3c5 /end MEASUREMENT
/begin MEASUREMENT LV_MIS_CARB_B4 "Boolean for misfire detection CARB B4 active" UBYTE _CNV_S_2_RANGE______74_CM 1 100. 0. 1. ECU_ADDRESS 0x3fd500 /end MEASUREMENT
/begin MEASUREMENT MIS_B4_OBD_CTR "Counter for misfire detection CARB B4" UBYTE _CNV_A_R_LINEAR_____13_CM 1 100. 0. 255. ECU_ADDRESS 0x3fd93e FORMAT "%3.0" /end MEASUREMENT
/begin MEASUREMENT LV_ERR_MIS_B_0 "Boolean indicating for cylinder individual misfire Carb B" UBYTE _CNV_S_2_RANGE______77_R_CM 1 100. 0. 255. ECU_ADDRESS 0x3fd3cc /end MEASUREMENT
/begin MEASUREMENT LV_ERR_MIS_MPL "Boolean for Multiple cylinder misfire" UBYTE _CNV_S_2_RANGE______77_R_CM 1 100. 0. 255. ECU_ADDRESS 0x3fd3d2 /end MEASUREMENT
/begin AXIS_PTS ldp_n_32__mis_fac_thd_iv_er "" 0x620fb N_32 _REC_AXS_20_u1 8160. _CNV_A_R_LINEAR_____15_CM 10 0. 8160. FORMAT "%4.0" /end AXIS_PTS
/begin AXIS_PTS ldp_n_32__mis__a_fac "" 0x6215e N_32 _REC_AXS_20_u1 8160. _CNV_A_R_LINEAR_____15_CM 6 0. 8160. FORMAT "%4.0" /end AXIS_PTS
/begin AXIS_PTS ldp_tqi_av__mis_fac_thd_iv_er "" 0x62106 TQI_AV _REC_AXS_20_u2 1023.96875 _CNV_A_R_LINEAR_____37_CM 6 0. 1023.96875 FORMAT "%7.2" /end AXIS_PTS
/begin AXIS_PTS ldp_tqi_av__mis_a_fac "" 0x62166 TQI_AV _REC_AXS_20_u2 2047.96875 _CNV_A_R_LINEAR_____65_CM 6 -1024. 1023.96875 FORMAT "%6.2" /end AXIS_PTS
/begin CHARACTERISTIC IP_MIS_A_FAC__N__TQI_AV "Weighting factor to cylinder specific counter when misfire is detected (status CARB A)." MAP 0x69ba0 _REC_MAP_20_u1_u1_u2 100. _CNV_A_R_LINEAR_____17_CM 0. 100. FORMAT "%3.0"
 /begin AXIS_DESCR COM_AXIS N_32 _CNV_A_R_LINEAR_____15_CM 6 0. 8160. FORMAT "%4.0" AXIS_PTS_REF ldp_n_32__mis__a_fac /end AXIS_DESCR
 /begin AXIS_DESCR COM_AXIS TQI_AV _CNV_A_R_LINEAR_____65_CM 6 -1024. 1023.96875 FORMAT "%6.2" AXIS_PTS_REF ldp_tqi_av__mis_a_fac /end AXIS_DESCR
/end CHARACTERISTIC
/begin CHARACTERISTIC IP_THD_ER_S_AT "Basic engine roughness threshold for misfire detection / Combustion mode stratified. AT-vehicle" MAP 0x696e0 _REC_MAP_20_u2_u2_u2 32767. _CNV_A_R_LINEAR_____208_CM -32768. -1. FORMAT "%7.0"
 /begin AXIS_DESCR COM_AXIS N _CNV_A_R_LINEAR_____0_CM 10 1. 8160. FORMAT "%4.0" AXIS_PTS_REF ldpm_n__thd_er /end AXIS_DESCR
 /begin AXIS_DESCR COM_AXIS TQI_AV _CNV_A_R_LINEAR_____37_CM 6 0. 1023.96875 FORMAT "%7.2" AXIS_PTS_REF ldpm_tqi_av__thd_er /end AXIS_DESCR
/end CHARACTERISTIC
/begin CHARACTERISTIC IP_FAC_THD_ER__TCO "Weighting factor for determination of the engine roughness threshold for compensation TCO influence; init = 1.0" CURVE 0x692f3 _REC_CUR_20_u1_u1 1.99220002 _CNV_A_R_LINEAR_____64_CM 0. 1.99220002 FORMAT "%5.3"
 /begin AXIS_DESCR COM_AXIS TCO _CNV_A_R_LINEAR_____22_CM 8 -48. 142.5 FORMAT "%5.1" AXIS_PTS_REF ldp_tco__fac_thd_er /end AXIS_DESCR
/end CHARACTERISTIC
/begin MEASUREMENT N_SP_IS_POW "Active nominal idle speed setpoint by power management active" UWORD _CNV_A_R_LINEAR_____0_CM 1 100. 0. 8160. ECU_ADDRESS 0x3fcdf8 FORMAT "%4.0" /end MEASUREMENT
/begin MEASUREMENT MIS_STATE_ER "Status of actual detected misfire by engine roughness - 1 bit / cylinder." UBYTE _CNV_A_R_LINEAR_____13_CM 1 100. 0. 255. ECU_ADDRESS 0x3fd951 FORMAT "%3.0" /end MEASUREMENT
/begin MEASUREMENT MIS_STATE_B "Identification of cylinders shut off by misfire carb b" UBYTE _CNV_A_R_LINEAR_____13_CM 1 100. 0. 255. ECU_ADDRESS 0x3fd93d FORMAT "%3.0" /end MEASUREMENT
/begin MEASUREMENT MIS_CTR_B_0 "Misfire sum (cylinder individual) after combination and weighting in CARB B window." UWORD _CNV_A_R_LINEAR_____17_CM 1 100. 0. 65535. ECU_ADDRESS 0x3fcdaa FORMAT "%5.0" /end MEASUREMENT
/begin MEASUREMENT MIS_CTR_B_1 "Misfire sum (cylinder individual) after combination and weighting in CARB B window." UWORD _CNV_A_R_LINEAR_____17_CM 1 100. 0. 65535. ECU_ADDRESS 0x3fcdac FORMAT "%5.0" /end MEASUREMENT
/begin MEASUREMENT MIS_CTR_B_2 "Misfire sum (cylinder individual) after combination and weighting in CARB B window." UWORD _CNV_A_R_LINEAR_____17_CM 1 100. 0. 65535. ECU_ADDRESS 0x3fcdae FORMAT "%5.0" /end MEASUREMENT
/begin MEASUREMENT MIS_CTR_B_3 "Misfire sum (cylinder individual) after combination and weighting in CARB B window." UWORD _CNV_A_R_LINEAR_____17_CM 1 100. 0. 65535. ECU_ADDRESS 0x3fcdb0 FORMAT "%5.0" /end MEASUREMENT
/begin MEASUREMENT MIS_CTR_B_4 "Misfire sum (cylinder individual) after combination and weighting in CARB B window." UWORD _CNV_A_R_LINEAR_____17_CM 1 100. 0. 65535. ECU_ADDRESS 0x3fcdb2 FORMAT "%5.0" /end MEASUREMENT
/begin MEASUREMENT MIS_CTR_B_5 "Misfire sum (cylinder individual) after combination and weighting in CARB B window." UWORD _CNV_A_R_LINEAR_____17_CM 1 100. 0. 65535. ECU_ADDRESS 0x3fcdb4 FORMAT "%5.0" /end MEASUREMENT
/begin MEASUREMENT MIS_CTR_A_0 "Misfire sum (cylinder individual) after combination and weighting in CARB A window." UWORD _CNV_A_R_LINEAR_____17_CM 1 100. 0. 65535. ECU_ADDRESS 0x3fcd9a FORMAT "%5.0" /end MEASUREMENT
/begin MEASUREMENT MIS_CTR_A_1 "Misfire sum (cylinder individual) after combination and weighting in CARB A window." UWORD _CNV_A_R_LINEAR_____17_CM 1 100. 0. 65535. ECU_ADDRESS 0x3fcd9c FORMAT "%5.0" /end MEASUREMENT
/begin MEASUREMENT MIS_CTR_A_2 "Misfire sum (cylinder individual) after combination and weighting in CARB A window." UWORD _CNV_A_R_LINEAR_____17_CM 1 100. 0. 65535. ECU_ADDRESS 0x3fcd9e FORMAT "%5.0" /end MEASUREMENT
/begin MEASUREMENT MIS_CTR_A_3 "Misfire sum (cylinder individual) after combination and weighting in CARB A window." UWORD _CNV_A_R_LINEAR_____17_CM 1 100. 0. 65535. ECU_ADDRESS 0x3fcda0 FORMAT "%5.0" /end MEASUREMENT
/begin MEASUREMENT MIS_CTR_A_4 "Misfire sum (cylinder individual) after combination and weighting in CARB A window." UWORD _CNV_A_R_LINEAR_____17_CM 1 100. 0. 65535. ECU_ADDRESS 0x3fcda2 FORMAT "%5.0" /end MEASUREMENT
/begin MEASUREMENT MIS_CTR_A_5 "Misfire sum (cylinder individual) after combination and weighting in CARB A window." UWORD _CNV_A_R_LINEAR_____17_CM 1 100. 0. 65535. ECU_ADDRESS 0x3fcda4 FORMAT "%5.0" /end MEASUREMENT
/begin MEASUREMENT SAF_KGH_MES "Secondary mass air flow per segment measured" UWORD _CNV_A_R_LINEAR_____52_CM 1 100. 0. 2047.96875 ECU_ADDRESS 0x3fce92 FORMAT "%7.2" /end MEASUREMENT
/begin CHARACTERISTIC C_TCO_AD_MAX_IS "temperature top limit for ISC adaptation" VALUE 0x67c98 _REC_VAL_20_u1 28.575 _CNV_A_R_LINEAR_____22_CM -48. 142.5 FORMAT "%5.1" /end CHARACTERISTIC
/begin CHARACTERISTIC IP_MIS_FAC_THD_IV_ER__N "Weighting factor for determination of the engine roughness threshold with injector(s) shut-off." MAP 0x692fc _REC_MAP_20_u2_u1_u2 0.99998474 _CNV_A_R_LINEAR_____2_CM 0. 0.99998474 FORMAT "%7.5"
 /begin AXIS_DESCR COM_AXIS N_32 _CNV_A_R_LINEAR_____15_CM 10 0. 8160. FORMAT "%4.0" AXIS_PTS_REF ldp_n_32__mis_fac_thd_iv_er /end AXIS_DESCR
 /begin AXIS_DESCR COM_AXIS TQI_AV _CNV_A_R_LINEAR_____37_CM 6 0. 1023.96875 FORMAT "%7.2" AXIS_PTS_REF ldp_tqi_av__mis_fac_thd_iv_er /end AXIS_DESCR
/end CHARACTERISTIC
/begin MEASUREMENT N_SP_IS "Nominal idle speed" UWORD _CNV_A_R_LINEAR_____0_CM 1 100. 0. 8160. ECU_ADDRESS 0x3fcdea FORMAT "%4.0" /end MEASUREMENT
/begin MEASUREMENT N_SP_IS_RAW "Nominal idle speed setpoint before intervention of power management" UWORD _CNV_A_R_LINEAR_____0_CM 1 100. 0. 8160. ECU_ADDRESS 0x3fcdf6 FORMAT "%4.0" /end MEASUREMENT
/begin MEASUREMENT LV_VLS_NOT_VLD_UP_1 "Boolean flag indicating that VLS_UP_i signal not valid, i.e. masked due to Ri determination" UBYTE _CNV_S_2_RANGE______74_CM 1 100. 0. 1. ECU_ADDRESS 0x3fa9e5 BIT_MASK 0x1 /end MEASUREMENT
/begin MEASUREMENT LV_VLS_NOT_VLD_UP_2 "Boolean flag indicating that VLS_UP_i signal not valid, i.e. masked due to Ri determination" UBYTE _CNV_S_2_RANGE______74_CM 1 100. 0. 1. ECU_ADDRESS 0x3fa9f9 BIT_MASK 0x1 /end MEASUREMENT
/begin MEASUREMENT VLS_CUR_ON_VLS_UP_1 "Upstream oxygen sensor voltage C_T_CUR_ON_LS_UP after switching on pump current switch" UWORD _CNV_A_R_LINEAR_____38_CM 1 100. 0. 4.99511719 ECU_ADDRESS 0x3fa9de FORMAT "%5.3" /end MEASUREMENT
/begin MEASUREMENT VLS_CUR_ON_VLS_UP_2 "Upstream oxygen sensor voltage C_T_CUR_ON_LS_UP after switching on pump current switch" UWORD _CNV_A_R_LINEAR_____38_CM 1 100. 0. 4.99511719 ECU_ADDRESS 0x3fa9f4 FORMAT "%5.3" /end MEASUREMENT
/begin MEASUREMENT VLS_CUR_OFF_VLS_UP_2 "Upstream oxygen sensor voltage prior to switching on pump current switch" UWORD _CNV_A_R_LINEAR_____38_CM 1 100. 0. 4.99511719 ECU_ADDRESS 0x3fa9f6 FORMAT "%5.3" /end MEASUREMENT
/begin MEASUREMENT VLS_CUR_OFF_VLS_UP_1 "Upstream oxygen sensor voltage prior to switching on pump current switch" UWORD _CNV_A_R_LINEAR_____38_CM 1 100. 0. 4.99511719 ECU_ADDRESS 0x3fa9e0 FORMAT "%5.3" /end MEASUREMENT
/begin CHARACTERISTIC LC_INH_R_UP_LS_VLD "Boolean flag inhibiting internal resistance determination validity function" VALUE 0x63074 _REC_VAL_20_u1 1. _CNV_A_R_LINEAR_____13_CM 0. 1. FORMAT "%1.0" /end CHARACTERISTIC
/begin AXIS_PTS ldpm_t_vls_cyc_afl_hld "" 0x60d8c T_VLS_CYC_AFL_HLD _REC_AXS_20_u1 2.55 _CNV_A_R_LINEAR_____21_CM 8 0. 2.55 FORMAT "%4.2" /end AXIS_PTS
/begin MEASUREMENT VLS_CUR_ON_VLS_DOWN_1 "Downstream oxygen sensor voltage C_T_CUR_ON_LS_DOWN after switching on pump current switch" UWORD _CNV_A_R_LINEAR_____38_CM 1 100. 0. 4.99511719 ECU_ADDRESS 0x3fa9ea FORMAT "%5.3" /end MEASUREMENT
/begin MEASUREMENT VLS_CUR_ON_VLS_DOWN_2 "Downstream oxygen sensor voltage C_T_CUR_ON_LS_DOWN after switching on pump current switch" UWORD _CNV_A_R_LINEAR_____38_CM 1 100. 0. 4.99511719 ECU_ADDRESS 0x3fa9fe FORMAT "%5.3" /end MEASUREMENT
/begin MEASUREMENT VLS_CUR_OFF_VLS_DOWN_2 "Downstream oxygen sensor voltage prior to switching on pump current switch" UWORD _CNV_A_R_LINEAR_____38_CM 1 100. 0. 4.99511719 ECU_ADDRESS 0x3faa00 FORMAT "%5.3" /end MEASUREMENT
/begin MEASUREMENT VLS_CUR_OFF_VLS_DOWN_1 "Downstream oxygen sensor voltage prior to switching on pump current switch" UWORD _CNV_A_R_LINEAR_____38_CM 1 100. 0. 4.99511719 ECU_ADDRESS 0x3fa9ec FORMAT "%5.3" /end MEASUREMENT
/begin MEASUREMENT LV_VLS_NOT_VLD_DOWN_1 "Boolean flag indicating that VLS_DOWN_i signal not valid, i.e. masked due to Ri determination" UBYTE _CNV_S_2_RANGE______74_CM 1 100. 0. 1. ECU_ADDRESS 0x3fa9ee /end MEASUREMENT
/begin MEASUREMENT LV_VLS_NOT_VLD_DOWN_2 "Boolean flag indicating that VLS_DOWN_i signal not valid, i.e. masked due to Ri determination" UBYTE _CNV_S_2_RANGE______74_CM 1 100. 0. 1. ECU_ADDRESS 0x3faa02 /end MEASUREMENT
/begin CHARACTERISTIC C_TEMP_CUR_ON_LS_UP "Temperature threshold for the activation of sensor pumping" VALUE 0x62fba _REC_VAL_20_u2 2047. _CNV_A_R_LINEAR_____94_CM 0. 2047. FORMAT "%7.2" /end CHARACTERISTIC
/begin CHARACTERISTIC C_TEMP_CUR_ON_LS_DOWN "Temperature threshold for the activation of sensor pumping" VALUE 0x630a2 _REC_VAL_20_u2 2047. _CNV_A_R_LINEAR_____94_CM 0. 2047. FORMAT "%7.2" /end CHARACTERISTIC
/begin CHARACTERISTIC C_T_CUR_ON_LS_DOWN "Duration for pump current active" VALUE 0x630a4 _REC_VAL_20_u1 8.e-003 _CNV_A_R_LINEAR_____251_CM 0. 8.e-003 FORMAT "%4.3" /end CHARACTERISTIC
/begin CHARACTERISTIC C_T_CUR_OFF_LS_DOWN "Minimum delay between consecutive pump current activation" VALUE 0x630a6 _REC_VAL_20_u2 655.35 _CNV_A_R_LINEAR_____21_CM 0. 655.35 FORMAT "%6.2" /end CHARACTERISTIC
/begin CHARACTERISTIC C_T_CUR_DLY_LS_DOWN "Duration in which VLS_DOWN_i signal masked directly after Ri determination" VALUE 0x630a8 _REC_VAL_20_u1 0.255 _CNV_A_R_LINEAR_____251_CM 0. 0.255 FORMAT "%5.3" /end CHARACTERISTIC
/begin CHARACTERISTIC C_VLS_MMV_MIN_RNG_TOL_LS_DOWN "Permitted range of VLS_DOWN_i above VLS_DOWN_MMV_MIN_i at low gradient for Ri determination" VALUE 0x630aa _REC_VAL_20_u2 4.99992371 _CNV_A_R_LINEAR_____99_CM 0. 4.99992371 FORMAT "%7.5" /end CHARACTERISTIC
/begin CHARACTERISTIC C_VLS_MMV_MIN_RNG_BOL_LS_DOWN "Permitted range of VLS_DOWN_i below VLS_DOWN_MMV_MIN_i at low gradient for Ri determination" VALUE 0x630ac _REC_VAL_20_u2 4.99992371 _CNV_A_R_LINEAR_____99_CM 0. 4.99992371 FORMAT "%7.5" /end CHARACTERISTIC
/begin CHARACTERISTIC C_DRV1_VLS_DOWN_MMV_THD_MIN "Minimum threshold for mean 1st derivative of VLS_DOWN_i signal for Ri determination" VALUE 0x630ae _REC_VAL_20_s2 4.9999 _CNV_A_R_LINEAR_____252_CM -2.5 2.4999 FORMAT "%7.4" /end CHARACTERISTIC
/begin CHARACTERISTIC C_DRV1_VLS_DOWN_MMV_THD_MAX "Maximum threshold for mean 1st derivative of VLS_DOWN_i signal for Ri determination" VALUE 0x630b0 _REC_VAL_20_s2 4.9999 _CNV_A_R_LINEAR_____252_CM -2.5 2.4999 FORMAT "%7.4" /end CHARACTERISTIC
/begin CHARACTERISTIC C_DRV1_VLS_DOWN_MMV_ABS_MAX "Threshold for absolute maximum 1st derivative of VLS_DOWN_i signal for Ri determination" VALUE 0x630b2 _REC_VAL_20_u2 4.9999237 _CNV_A_R_LINEAR_____256_CM 0. 4.9999237 FORMAT "%6.4" /end CHARACTERISTIC
/begin CHARACTERISTIC C_FAC_STK_DRV1_VLS_DOWN_MMV "Multiplicative factor used to weight gradient thresholds dependent on VLS_DOWN_MMV_xxx_i amplitude" VALUE 0x630b4 _REC_VAL_20_u1 1.99220002 _CNV_A_R_LINEAR_____64_CM 0. 1.99220002 FORMAT "%5.3" /end CHARACTERISTIC
/begin CHARACTERISTIC C_FAC_DRV1_VLS_DOWN_MMV_MIN "Hysteresis factor of DRV1_VLS_DOWN_MMV_MIN governing limiting of DRV1_VLS_DOWN_MMV_MIN_THD" VALUE 0x630b5 _REC_VAL_20_u1 0.99610001 _CNV_A_R_LINEAR_____68_CM 0. 0.99610001 FORMAT "%5.3" /end CHARACTERISTIC
/begin CHARACTERISTIC C_DRV1_VLS_DOWN_ABS_MAX "Threshold for absolute maximum 1st derivative of VLS_DOWN_i signal for Ri determination" VALUE 0x630b6 _REC_VAL_20_u2 4.9999237 _CNV_A_R_LINEAR_____256_CM 0. 4.9999237 FORMAT "%6.4" /end CHARACTERISTIC
/begin CHARACTERISTIC C_CTR_VLS_AFL_CYC_R_DOWN_LS "Min. no. AF cycles post lambda controller activation to permit use of T_VLS_CYC_AFL_HLD dependency" VALUE 0x630b8 _REC_VAL_20_u2 65535. _CNV_A_R_LINEAR_____17_CM 0. 65535. FORMAT "%5.0" /end CHARACTERISTIC
/begin CHARACTERISTIC C_MAF_KGH_R_DOWN_LS "Maximum MAF_KGH threshold for activation of internal resistance determination" VALUE 0x630ba _REC_VAL_20_u2 2047.96875 _CNV_A_R_LINEAR_____52_CM 0. 2047.96875 FORMAT "%7.2" /end CHARACTERISTIC
/begin CHARACTERISTIC C_FAC_ERR_POS_R_DOWN_LS "Internal resistance measurement positive error (i.e. 0% to 100%)" VALUE 0x630bc _REC_VAL_20_u1 0.9960940000000002 _CNV_A_R_LINEAR_____8_CM 0. 0.996094 FORMAT "%5.3" /end CHARACTERISTIC
/begin CHARACTERISTIC C_FAC_ERR_NEG_R_DOWN_LS "Internal resistance measurement negative error (i.e. 100% to 0%)" VALUE 0x630bd _REC_VAL_20_u1 0.9960940000000002 _CNV_A_R_LINEAR_____8_CM 0. 0.996094 FORMAT "%5.3" /end CHARACTERISTIC
/begin CHARACTERISTIC C_CRLC_TTIP_FALL_R_DOWN_LS "Correlation (filter) constant for falling ceramic temperature, limit calculation" VALUE 0x630be _REC_VAL_20_u1 0.99610001 _CNV_A_R_LINEAR_____253_CM 0. 0.99610001 FORMAT "%5.3" /end CHARACTERISTIC
/begin CHARACTERISTIC C_CRLC_TTIP_RISE_R_DOWN_LS "Correlation (filter) constant for rising ceramic temperature, limit calculation" VALUE 0x630bf _REC_VAL_20_u1 0.99610001 _CNV_A_R_LINEAR_____253_CM 0. 0.99610001 FORMAT "%5.3" /end CHARACTERISTIC
/begin CHARACTERISTIC LC_INH_R_DOWN_LS_VLD "Boolean flag inhibiting internal resistance determination validity function" VALUE 0x630c0 _REC_VAL_20_u1 1. _CNV_A_R_LINEAR_____17_CM 0. 1. FORMAT "%2.0" /end CHARACTERISTIC
/begin AXIS_PTS ldp_r_up_ls_ip_ttip_ls_up "" 0x60d96 R_UP_LS _REC_AXS_20_u2 65535. _CNV_A_R_LINEAR_____163_CM 8 0. 65535. FORMAT "%5.0" /end AXIS_PTS
/begin AXIS_PTS ldp_r_down_ls_ip_ttip_ls_down "" 0x60da8 R_DOWN_LS _REC_AXS_20_u2 65535. _CNV_A_R_LINEAR_____163_CM 8 0. 65535. FORMAT "%5.0" /end AXIS_PTS
/begin CHARACTERISTIC IP_FAC_T_DRV1_VLS_UP_MMV "Multiplicative factor modifies DRV1_VLS_UP_MMV_MIN_THD dependent on T_VLS_CYC_AFL_HLD" CURVE 0x63076 _REC_CUR_20_u1_u1 51. _CNV_A_R_LINEAR_____257_CM 0. 51. FORMAT "%4.1"
 /begin AXIS_DESCR COM_AXIS LAM_BANK_1.LS_UP_STRUCT.T_VLS_CYC_AFL_HLD _CNV_A_R_LINEAR_____21_CM 8 0. 2.55 FORMAT "%4.2" AXIS_PTS_REF ldpm_t_vls_cyc_afl_hld /end AXIS_DESCR
/end CHARACTERISTIC
/begin CHARACTERISTIC IP_FAC_T_DRV1_VLS_UP_ABS "Multiplicative factor modifies C_DRV1_VLS_UP_ABS_MAX dependent on T_VLS_CYC_AFL_HLD" CURVE 0x6307e _REC_CUR_20_u1_u1 12.75 _CNV_A_R_LINEAR_____258_CM 0. 12.75 FORMAT "%5.2"
 /begin AXIS_DESCR COM_AXIS LAM_BANK_1.LS_UP_STRUCT.T_VLS_CYC_AFL_HLD _CNV_A_R_LINEAR_____21_CM 8 0. 2.55 FORMAT "%4.2" AXIS_PTS_REF ldpm_t_vls_cyc_afl_hld /end AXIS_DESCR
/end CHARACTERISTIC
/begin CHARACTERISTIC IP_FAC_T_DRV1_VLS_DOWN_ABS "Multiplicative factor modifies C_DRV1_VLS_DOWN_ABS_MAX dependent on T_VLS_CYC_AFL_HLD" CURVE 0x630c9 _REC_CUR_20_u1_u1 12.75 _CNV_A_R_LINEAR_____258_CM 0. 12.75 FORMAT "%5.2"
 /begin AXIS_DESCR COM_AXIS LAM_BANK_1.LS_UP_STRUCT.T_VLS_CYC_AFL_HLD _CNV_A_R_LINEAR_____21_CM 8 0. 2.55 FORMAT "%4.2" AXIS_PTS_REF ldpm_t_vls_cyc_afl_hld /end AXIS_DESCR
/end CHARACTERISTIC
/begin CHARACTERISTIC IP_TTIP_LS_UP "Oxygen sensor temperature vs. internal resistance characteristic" CURVE 0x63086 _REC_CUR_20_u2_u2 2047.96875 _CNV_A_R_LINEAR_____110_CM 0. 2047.96875 FORMAT "%7.2"
 /begin AXIS_DESCR COM_AXIS LAM_BANK_1.LS_UP_CUR_STRUCT.R_UP_LS _CNV_A_R_LINEAR_____163_CM 8 0. 65535. FORMAT "%5.0" AXIS_PTS_REF ldp_r_up_ls_ip_ttip_ls_up /end AXIS_DESCR
/end CHARACTERISTIC
/begin CHARACTERISTIC IP_TTIP_LS_DOWN "Oxygen sensor temperature vs. internal resistance characteristic" CURVE 0x630d2 _REC_CUR_20_u2_u2 2047.96875 _CNV_A_R_LINEAR_____110_CM 0. 2047.96875 FORMAT "%7.2"
 /begin AXIS_DESCR COM_AXIS LAM_BANK_1.LS_DOWN_CUR_STRUCT.R_DOWN_LS _CNV_A_R_LINEAR_____163_CM 8 0. 65535. FORMAT "%5.0" AXIS_PTS_REF ldp_r_down_ls_ip_ttip_ls_down /end AXIS_DESCR
/end CHARACTERISTIC
/begin CHARACTERISTIC IP_FAC_T_DRV1_VLS_DOWN_MMV "Multiplicative factor modifies DRV1_VLS_DOWN_MMV_MIN_THD dependent on T_VLS_CYC_AFL_HLD" CURVE 0x630c1 _REC_CUR_20_u1_u1 51. _CNV_A_R_LINEAR_____257_CM 0. 51. FORMAT "%4.1"
 /begin AXIS_DESCR COM_AXIS LAM_BANK_1.LS_UP_STRUCT.T_VLS_CYC_AFL_HLD _CNV_A_R_LINEAR_____21_CM 8 0. 2.55 FORMAT "%4.2" AXIS_PTS_REF ldpm_t_vls_cyc_afl_hld /end AXIS_DESCR
/end CHARACTERISTIC
/begin MEASUREMENT LV_CAT_PURGE_SA_1 "logical value 'secondary air was active'" UWORD _CNV_S_2_RANGE______74_CM 1 100. 0. 1. ECU_ADDRESS 0x3fca10 BIT_MASK 0x1 /end MEASUREMENT
/begin MEASUREMENT LV_MAF_INT_LSCL_DLY_SA_1 "logical value 'blocking of lambda controller active'" UWORD _CNV_S_2_RANGE______74_CM 1 100. 0. 1. ECU_ADDRESS 0x3fca10 BIT_MASK 0x2 /end MEASUREMENT
/begin MEASUREMENT LV_ACT_INT_PUC_1 "status of catalyst purge activation  " UWORD _CNV_S_2_RANGE______74_CM 1 100. 0. 1. ECU_ADDRESS 0x3fca10 BIT_MASK 0x8 /end MEASUREMENT
/begin MEASUREMENT LV_ACT_CAT_PURGE_MAIN_HST_1 "state of the enrichment function for main-catalyst" UWORD _CNV_S_2_RANGE______74_CM 1 100. 0. 1. ECU_ADDRESS 0x3fca10 BIT_MASK 0x20 /end MEASUREMENT
/begin MEASUREMENT LV_ACT_CAT_PURGE_HST_1 "state of the enrichment function for pre-catalyst" UWORD _CNV_S_2_RANGE______74_CM 1 100. 0. 1. ECU_ADDRESS 0x3fca10 BIT_MASK 0x40 /end MEASUREMENT
/begin MEASUREMENT LV_ACT_CAT_PURGE_MAIN_CH_1 "state of the enrichment function for pre-catalyst" UWORD _CNV_S_2_RANGE______74_CM 1 100. 0. 1. ECU_ADDRESS 0x3fca10 BIT_MASK 0x100 /end MEASUREMENT
/begin MEASUREMENT LV_ACT_CAT_PURGE_CH_1 "state of the enrichment function for pre-catalyst" UWORD _CNV_S_2_RANGE______74_CM 1 100. 0. 1. ECU_ADDRESS 0x3fca10 BIT_MASK 0x200 /end MEASUREMENT
/begin MEASUREMENT LV_ACT_CAT_PURGE_MAIN_PUC_1 "state of the enrichment function for main-catalyst" UWORD _CNV_S_2_RANGE______74_CM 1 100. 0. 1. ECU_ADDRESS 0x3fca10 BIT_MASK 0x4000 /end MEASUREMENT
/begin MEASUREMENT LV_ACT_CAT_PURGE_PUC_1 "state of the enrichment function for pre-catalyst" UWORD _CNV_S_2_RANGE______74_CM 1 100. 0. 1. ECU_ADDRESS 0x3fca10 BIT_MASK 0x8000 /end MEASUREMENT
/begin MEASUREMENT T_DLY_PUC_1 "LAM-P-jump delay time of the catalyst purge function" UWORD _CNV_A_R_LINEAR_____242_CM 1 100. 0. 1279.9 ECU_ADDRESS 0x3fca2c FORMAT "%6.1" /end MEASUREMENT
/begin MEASUREMENT MAF_INT_CAT_PURGE_1 "value of the mass air flow integral for the function deactivation" UWORD _CNV_A_R_LINEAR_____98_CM 1 100. 0. 1820.398 ECU_ADDRESS 0x3fca14 FORMAT "%7.2" /end MEASUREMENT
/begin MEASUREMENT MAF_INT_CAT_LOAD_1 "integral of mass air flow while active pre-cat purge" UWORD _CNV_A_R_LINEAR_____98_CM 1 100. 0. 1820.398 ECU_ADDRESS 0x3fca18 FORMAT "%7.2" /end MEASUREMENT
/begin MEASUREMENT MAF_INT_CAT_LOAD_MAIN_1 "integral of mass air flow while active main-cat purge" UWORD _CNV_A_R_LINEAR_____98_CM 1 100. 0. 1820.398 ECU_ADDRESS 0x3fca1a FORMAT "%7.2" /end MEASUREMENT
/begin MEASUREMENT DELTA_LAMB_SP_PUC_1 "lambda controller setpoint shift" UWORD _CNV_A_R_LINEAR_____250_CM 1 100. 0. 0.125 ECU_ADDRESS 0x3fca1e FORMAT "%5.3" /end MEASUREMENT
/begin MEASUREMENT MAF_INT_CAT_LOAD_CH_1 "integral of mass air flow while active pre-cat purge" UWORD _CNV_A_R_LINEAR_____98_CM 1 100. 0. 1820.398 ECU_ADDRESS 0x3fca20 FORMAT "%7.2" /end MEASUREMENT
/begin MEASUREMENT MAF_INT_CAT_LOAD_MAIN_CH_1 "integral of mass air flow while active main-cat purge" UWORD _CNV_A_R_LINEAR_____98_CM 1 100. 0. 1820.398 ECU_ADDRESS 0x3fca22 FORMAT "%7.2" /end MEASUREMENT
/begin MEASUREMENT MAF_INT_CAT_LOAD_HST_1 "integral of mass air flow while active pre-cat purge" UWORD _CNV_A_R_LINEAR_____98_CM 1 100. 0. 1820.398 ECU_ADDRESS 0x3fca24 FORMAT "%7.2" /end MEASUREMENT
/begin MEASUREMENT MAF_INT_CAT_LOAD_MAIN_HST_1 "integral of mass air flow while active main-cat purge" UWORD _CNV_A_R_LINEAR_____98_CM 1 100. 0. 1820.398 ECU_ADDRESS 0x3fca26 FORMAT "%7.2" /end MEASUREMENT
/begin MEASUREMENT MAF_INT_LSCL_DLY_SA_1 "value of mass air flow integral for activation of lambda controller" UWORD _CNV_A_R_LINEAR_____98_CM 1 100. 0. 1820.398 ECU_ADDRESS 0x3fca1c FORMAT "%7.2" /end MEASUREMENT
/begin MEASUREMENT LV_R_DOWN_LS_DET_1 "Boolean flag indicating that resistance has already been determined in current lean phase(lock out)" UWORD _CNV_S_2_RANGE______74_CM 1 100. 0. 1. ECU_ADDRESS 0x3fcab4 BIT_MASK 0x4 /end MEASUREMENT
/begin MEASUREMENT LV_R_DOWN_LS_DRV1_VLS_CDN_1 "Boolean flag indicating that low gradient condition met" UWORD _CNV_S_2_RANGE______74_CM 1 100. 0. 1. ECU_ADDRESS 0x3fcab4 BIT_MASK 0x20 /end MEASUREMENT
/begin MEASUREMENT LV_R_DOWN_LS_ENA_1 "Boolean flag indicating that conditions have been met and resistance determination requested" UWORD _CNV_S_2_RANGE______74_CM 1 100. 0. 1. ECU_ADDRESS 0x3fcab4 BIT_MASK 0x8 /end MEASUREMENT
/begin MEASUREMENT LV_R_DOWN_LS_VLS_RNG_CDN_1 "Boolean flag indicating that VLS_DOWN at low gradient condition met" UWORD _CNV_S_2_RANGE______74_CM 1 100. 0. 1. ECU_ADDRESS 0x3fcab4 BIT_MASK 0x10 /end MEASUREMENT
/begin MEASUREMENT CTR_CYCNR_R_DOWN_LS_1 "Handshake counter indicating the number of valid resistance values determined since initial activation" UWORD _CNV_A_R_LINEAR_____17_CM 1 100. 0. 65535. ECU_ADDRESS 0x3fcac0 FORMAT "%5.0" /end MEASUREMENT
/begin MEASUREMENT DRV1_VLS_DOWN_MMV_THD_MAX_1 "Upper variable VLS_DOWN gradient threshold" SWORD _CNV_A_R_LINEAR_____252_CM 1 100. -2.5 2.4999 ECU_ADDRESS 0x3fcaca FORMAT "%7.4" /end MEASUREMENT
/begin MEASUREMENT DRV1_VLS_DOWN_MMV_THD_MIN_1 "Lower variable VLS_DOWN gradient threshold" SWORD _CNV_A_R_LINEAR_____252_CM 1 100. -2.5 2.4999 ECU_ADDRESS 0x3fcacc FORMAT "%7.4" /end MEASUREMENT
/begin MEASUREMENT FAC_T_DRV1_VLS_DOWN_ABS_1 "Multiplicative factor modifies C_DRV1_VLS_DOWN_ABS_MAX dependent on T_VLS_CYC_AFL_HLD" UBYTE _CNV_A_R_LINEAR_____258_CM 1 100. 0. 12.75 ECU_ADDRESS 0x3fcabc FORMAT "%5.2" /end MEASUREMENT
/begin MEASUREMENT FAC_T_DRV1_VLS_DOWN_MMV_1 "Multiplicative factor modifies DRV1_VLS_DOWN_MMV_MIN_THD dependent on T_VLS_CYC_AFL_HLD" UBYTE _CNV_A_R_LINEAR_____257_CM 1 100. 0. 51. ECU_ADDRESS 0x3fcabd FORMAT "%4.1" /end MEASUREMENT
/begin MEASUREMENT R_DOWN_LS_MES_1 "Internal resistance of downstream oxygen sensor (Measured)" UWORD _CNV_A_R_LINEAR_____163_CM 1 100. 0. 65535. ECU_ADDRESS 0x3fcac4 FORMAT "%5.0" /end MEASUREMENT
/begin MEASUREMENT T_SAMPLE_R_DOWN_LS_1 "Time measured between internal resistance samples" UWORD _CNV_A_R_LINEAR_____21_CM 1 100. 0. 655.35 ECU_ADDRESS 0x3fcac8 FORMAT "%6.2" /end MEASUREMENT
/begin MEASUREMENT T_VLS_CYC_AFL_HLD_R_DOWN_LS_1 "Lean mixture cycle time (measured upstream), held until next threshold crossing downstream" UBYTE _CNV_A_R_LINEAR_____21_CM 1 100. 0. 2.55 ECU_ADDRESS 0x3fcabe FORMAT "%4.2" /end MEASUREMENT
/begin MEASUREMENT TTIP_LS_DOWN_MES_1 "Downstream oxygen sensor ceramic temperature" SWORD _CNV_A_R_LINEAR_____260_CM 1 100. -2048. 2047.938 ECU_ADDRESS 0x3fcace FORMAT "%8.2" /end MEASUREMENT
/begin MEASUREMENT TTIP_LS_DOWN_MES_BOL_1 "Downstream oxygen sensor ceramic temperature, Lower limit, Unfiltered" SWORD _CNV_A_R_LINEAR_____260_CM 1 100. -2048. 2047.938 ECU_ADDRESS 0x3fcad2 FORMAT "%8.2" /end MEASUREMENT
/begin MEASUREMENT TTIP_LS_DOWN_MES_BOL_MMV_1 "Downstream oxygen sensor ceramic temperature, Lower limit, Filtered" SWORD _CNV_A_R_LINEAR_____260_CM 1 100. -2048. 2047.938 ECU_ADDRESS 0x3fcad8 FORMAT "%8.2" /end MEASUREMENT
/begin MEASUREMENT TTIP_LS_DOWN_MES_TOL_1 "Downstream oxygen sensor ceramic temperature, Upper limit, Unfiltered" SWORD _CNV_A_R_LINEAR_____260_CM 1 100. -2048. 2047.938 ECU_ADDRESS 0x3fcad0 FORMAT "%8.2" /end MEASUREMENT
/begin MEASUREMENT TTIP_LS_DOWN_MES_TOL_MMV_1 "Downstream oxygen sensor ceramic temperature, Upper limit, Filtered" SWORD _CNV_A_R_LINEAR_____260_CM 1 100. -2048. 2047.938 ECU_ADDRESS 0x3fcad4 FORMAT "%8.2" /end MEASUREMENT
/begin MEASUREMENT LV_INH_R_UP_LS_1 "Boolean flag indicating that upstrem sensor internal resistance determination shall be inhibited when set" UWORD _CNV_S_2_RANGE______74_CM 1 100. 0. 1. ECU_ADDRESS 0x3fca8c BIT_MASK 0x1 /end MEASUREMENT
/begin MEASUREMENT LV_R_UP_LS_DET_1 "Boolean flag indicating that resistance has already been determined in current lean phase(lock out)" UWORD _CNV_S_2_RANGE______74_CM 1 100. 0. 1. ECU_ADDRESS 0x3fca8c BIT_MASK 0x4 /end MEASUREMENT
/begin MEASUREMENT LV_R_UP_LS_DRV1_VLS_CDN_1 "Boolean flag indicating that VLS_UP at low gradient condition met" UWORD _CNV_S_2_RANGE______74_CM 1 100. 0. 1. ECU_ADDRESS 0x3fca8c BIT_MASK 0x20 /end MEASUREMENT
/begin MEASUREMENT LV_R_UP_LS_ENA_1 "Boolean flag indicating that application conditions have been met" UWORD _CNV_S_2_RANGE______74_CM 1 100. 0. 1. ECU_ADDRESS 0x3fca8c BIT_MASK 0x8 /end MEASUREMENT
/begin MEASUREMENT LV_R_UP_LS_VLS_RNG_CDN_1 "Boolean flag indicating that VLS_UP at low gradient condition met" UWORD _CNV_S_2_RANGE______74_CM 1 100. 0. 1. ECU_ADDRESS 0x3fca8c BIT_MASK 0x10 /end MEASUREMENT
/begin MEASUREMENT CTR_CYCNR_R_UP_LS_1 "Handshake counter indicating the number of valid resistance values determined since initial activation" UWORD _CNV_A_R_LINEAR_____17_CM 1 100. 0. 65535. ECU_ADDRESS 0x3fca96 FORMAT "%5.0" /end MEASUREMENT
/begin MEASUREMENT DRV1_VLS_UP_MMV_THD_MAX_1 "Upper variable VLS_UP gradient threshold" SWORD _CNV_A_R_LINEAR_____252_CM 1 100. -2.5 2.4999 ECU_ADDRESS 0x3fcaa0 FORMAT "%7.4" /end MEASUREMENT
/begin MEASUREMENT DRV1_VLS_UP_MMV_THD_MIN_1 "Lower variable VLS_UP gradient threshold" SWORD _CNV_A_R_LINEAR_____252_CM 1 100. -2.5 2.4999 ECU_ADDRESS 0x3fcaa2 FORMAT "%7.4" /end MEASUREMENT
/begin MEASUREMENT FAC_T_DRV1_VLS_UP_ABS_1 "Multiplicative factor modifies C_DRV1_VLS_UP_ABS_MAX dependent on T_VLS_CYC_AFL_HLD" UBYTE _CNV_A_R_LINEAR_____258_CM 1 100. 0. 12.75 ECU_ADDRESS 0x3fca94 FORMAT "%5.2" /end MEASUREMENT
/begin MEASUREMENT FAC_T_DRV1_VLS_UP_MMV_1 "Multiplicative factor modifies DRV1_VLS_UP_MMV_MIN_THD dependent on T_VLS_CYC_AFL_HLD" UBYTE _CNV_A_R_LINEAR_____257_CM 1 100. 0. 51. ECU_ADDRESS 0x3fca95 FORMAT "%4.1" /end MEASUREMENT
/begin MEASUREMENT R_UP_LS_1 "Internal resistance of upstream oxygen sensor, cylinder bank i" UWORD _CNV_A_R_LINEAR_____163_CM 1 100. 0. 65535. ECU_ADDRESS 0x3fca98 FORMAT "%5.0" /end MEASUREMENT
/begin MEASUREMENT R_UP_LS_MES_1 "Internal resistance of upstream oxygen sensor (Measured)" UWORD _CNV_A_R_LINEAR_____163_CM 1 100. 0. 65535. ECU_ADDRESS 0x3fca9a FORMAT "%5.0" /end MEASUREMENT
/begin MEASUREMENT T_SAMPLE_R_UP_LS_1 "Time measured between internal resistance samples" UWORD _CNV_A_R_LINEAR_____21_CM 1 100. 0. 655.35 ECU_ADDRESS 0x3fca9e FORMAT "%6.2" /end MEASUREMENT
/begin MEASUREMENT TTIP_LS_UP_MES_1 "Upstream oxygen sensor ceramic temperature" SWORD _CNV_A_R_LINEAR_____260_CM 1 100. -2048. 2047.938 ECU_ADDRESS 0x3fcaa4 FORMAT "%8.2" /end MEASUREMENT
/begin MEASUREMENT TTIP_LS_UP_MES_BOL_1 "Upstream oxygen sensor ceramic temperature, Lower limit, Unfiltered" SWORD _CNV_A_R_LINEAR_____260_CM 1 100. -2048. 2047.938 ECU_ADDRESS 0x3fcaa8 FORMAT "%8.2" /end MEASUREMENT
/begin MEASUREMENT TTIP_LS_UP_MES_BOL_MMV_1 "Upstream oxygen sensor ceramic temperature, Lower limit, Unfiltered" SWORD _CNV_A_R_LINEAR_____260_CM 1 100. -2048. 2047.938 ECU_ADDRESS 0x3fcaae FORMAT "%8.2" /end MEASUREMENT
/begin MEASUREMENT TTIP_LS_UP_MES_TOL_1 "Downstream oxygen sensor ceramic temperature, Upper limit, Unfiltered" SWORD _CNV_A_R_LINEAR_____260_CM 1 100. -2048. 2047.938 ECU_ADDRESS 0x3fcaa6 FORMAT "%8.2" /end MEASUREMENT
/begin MEASUREMENT TTIP_LS_UP_MES_TOL_MMV_1 "Upstream oxygen sensor ceramic temperature, Lower limit, Unfiltered" SWORD _CNV_A_R_LINEAR_____260_CM 1 100. -2048. 2047.938 ECU_ADDRESS 0x3fcaaa FORMAT "%8.2" /end MEASUREMENT
/begin MEASUREMENT LV_CAT_PURGE_SA_2 "logical value 'secondary air was active'" UWORD _CNV_S_2_RANGE______74_CM 1 100. 0. 1. ECU_ADDRESS 0x3fcb7c BIT_MASK 0x1 /end MEASUREMENT
/begin MEASUREMENT LV_MAF_INT_LSCL_DLY_SA_2 "logical value 'blocking of lambda controller active'" UWORD _CNV_S_2_RANGE______74_CM 1 100. 0. 1. ECU_ADDRESS 0x3fcb7c BIT_MASK 0x2 /end MEASUREMENT
/begin MEASUREMENT LV_ACT_INT_PUC_2 "status of catalyst purge activation  " UWORD _CNV_S_2_RANGE______74_CM 1 100. 0. 1. ECU_ADDRESS 0x3fcb7c BIT_MASK 0x8 /end MEASUREMENT
/begin MEASUREMENT LV_ACT_CAT_PURGE_MAIN_HST_2 "state of the enrichment function for main-catalyst" UWORD _CNV_S_2_RANGE______74_CM 1 100. 0. 1. ECU_ADDRESS 0x3fcb7c BIT_MASK 0x20 /end MEASUREMENT
/begin MEASUREMENT LV_ACT_CAT_PURGE_HST_2 "state of the enrichment function for pre-catalyst" UWORD _CNV_S_2_RANGE______74_CM 1 100. 0. 1. ECU_ADDRESS 0x3fcb7c BIT_MASK 0x40 /end MEASUREMENT
/begin MEASUREMENT LV_ACT_CAT_PURGE_MAIN_CH_2 "state of the enrichment function for pre-catalyst" UWORD _CNV_S_2_RANGE______74_CM 1 100. 0. 1. ECU_ADDRESS 0x3fcb7c BIT_MASK 0x100 /end MEASUREMENT
/begin MEASUREMENT LV_ACT_CAT_PURGE_CH_2 "state of the enrichment function for pre-catalyst" UWORD _CNV_S_2_RANGE______74_CM 1 100. 0. 1. ECU_ADDRESS 0x3fcb7c BIT_MASK 0x200 /end MEASUREMENT
/begin MEASUREMENT LV_ACT_CAT_PURGE_MAIN_PUC_2 "state of the enrichment function for main-catalyst" UWORD _CNV_S_2_RANGE______74_CM 1 100. 0. 1. ECU_ADDRESS 0x3fcb7c BIT_MASK 0x4000 /end MEASUREMENT
/begin MEASUREMENT LV_ACT_CAT_PURGE_PUC_2 "state of the enrichment function for pre-catalyst" UWORD _CNV_S_2_RANGE______74_CM 1 100. 0. 1. ECU_ADDRESS 0x3fcb7c BIT_MASK 0x8000 /end MEASUREMENT
/begin MEASUREMENT T_DLY_PUC_2 "LAM-P-jump delay time of the catalyst purge function" UWORD _CNV_A_R_LINEAR_____242_CM 1 100. 0. 1279.9 ECU_ADDRESS 0x3fcb98 FORMAT "%6.1" /end MEASUREMENT
/begin MEASUREMENT MAF_INT_CAT_PURGE_2 "value of the mass air flow integral for the function deactivation" UWORD _CNV_A_R_LINEAR_____98_CM 1 100. 0. 1820.398 ECU_ADDRESS 0x3fcb80 FORMAT "%7.2" /end MEASUREMENT
/begin MEASUREMENT MAF_INT_CAT_LOAD_2 "integral of mass air flow while active pre-cat purge" UWORD _CNV_A_R_LINEAR_____98_CM 1 100. 0. 1820.398 ECU_ADDRESS 0x3fcb84 FORMAT "%7.2" /end MEASUREMENT
/begin MEASUREMENT MAF_INT_CAT_LOAD_MAIN_2 "integral of mass air flow while active main-cat purge" UWORD _CNV_A_R_LINEAR_____98_CM 1 100. 0. 1820.398 ECU_ADDRESS 0x3fcb86 FORMAT "%7.2" /end MEASUREMENT
/begin MEASUREMENT DELTA_LAMB_SP_PUC_2 "lambda controller setpoint shift" UWORD _CNV_A_R_LINEAR_____250_CM 1 100. 0. 0.125 ECU_ADDRESS 0x3fcb8a FORMAT "%5.3" /end MEASUREMENT
/begin MEASUREMENT MAF_INT_CAT_LOAD_CH_2 "integral of mass air flow while active pre-cat purge" UWORD _CNV_A_R_LINEAR_____98_CM 1 100. 0. 1820.398 ECU_ADDRESS 0x3fcb8c FORMAT "%7.2" /end MEASUREMENT
/begin MEASUREMENT MAF_INT_CAT_LOAD_MAIN_CH_2 "integral of mass air flow while active main-cat purge" UWORD _CNV_A_R_LINEAR_____98_CM 1 100. 0. 1820.398 ECU_ADDRESS 0x3fcb8e FORMAT "%7.2" /end MEASUREMENT
/begin MEASUREMENT MAF_INT_CAT_LOAD_HST_2 "integral of mass air flow while active pre-cat purge" UWORD _CNV_A_R_LINEAR_____98_CM 1 100. 0. 1820.398 ECU_ADDRESS 0x3fcb90 FORMAT "%7.2" /end MEASUREMENT
/begin MEASUREMENT MAF_INT_CAT_LOAD_MAIN_HST_2 "integral of mass air flow while active main-cat purge" UWORD _CNV_A_R_LINEAR_____98_CM 1 100. 0. 1820.398 ECU_ADDRESS 0x3fcb92 FORMAT "%7.2" /end MEASUREMENT
/begin MEASUREMENT MAF_INT_LSCL_DLY_SA_2 "value of mass air flow integral for activation of lambda controller" UWORD _CNV_A_R_LINEAR_____98_CM 1 100. 0. 1820.398 ECU_ADDRESS 0x3fcb88 FORMAT "%7.2" /end MEASUREMENT
/begin MEASUREMENT LV_R_DOWN_LS_DET_2 "Boolean flag indicating that resistance has already been determined in current lean phase(lock out)" UWORD _CNV_S_2_RANGE______74_CM 1 100. 0. 1. ECU_ADDRESS 0x3fcc20 BIT_MASK 0x4 /end MEASUREMENT
/begin MEASUREMENT LV_R_DOWN_LS_DRV1_VLS_CDN_2 "Boolean flag indicating that low gradient condition met" UWORD _CNV_S_2_RANGE______74_CM 1 100. 0. 1. ECU_ADDRESS 0x3fcc20 BIT_MASK 0x20 /end MEASUREMENT
/begin MEASUREMENT LV_R_DOWN_LS_ENA_2 "Boolean flag indicating that conditions have been met and resistance determination requested" UWORD _CNV_S_2_RANGE______74_CM 1 100. 0. 1. ECU_ADDRESS 0x3fcc20 BIT_MASK 0x8 /end MEASUREMENT
/begin MEASUREMENT LV_R_DOWN_LS_VLS_RNG_CDN_2 "Boolean flag indicating that VLS_DOWN at low gradient condition met" UWORD _CNV_S_2_RANGE______74_CM 1 100. 0. 1. ECU_ADDRESS 0x3fcc20 BIT_MASK 0x10 /end MEASUREMENT
/begin MEASUREMENT CTR_CYCNR_R_DOWN_LS_2 "Handshake counter indicating the number of valid resistance values determined since initial activation" UWORD _CNV_A_R_LINEAR_____17_CM 1 100. 0. 65535. ECU_ADDRESS 0x3fcc2c FORMAT "%5.0" /end MEASUREMENT
/begin MEASUREMENT DRV1_VLS_DOWN_MMV_THD_MAX_2 "Upper variable VLS_DOWN gradient threshold" SWORD _CNV_A_R_LINEAR_____252_CM 1 100. -2.5 2.4999 ECU_ADDRESS 0x3fcc36 FORMAT "%7.4" /end MEASUREMENT
/begin MEASUREMENT DRV1_VLS_DOWN_MMV_THD_MIN_2 "Lower variable VLS_DOWN gradient threshold" SWORD _CNV_A_R_LINEAR_____252_CM 1 100. -2.5 2.4999 ECU_ADDRESS 0x3fcc38 FORMAT "%7.4" /end MEASUREMENT
/begin MEASUREMENT FAC_T_DRV1_VLS_DOWN_ABS_2 "Multiplicative factor modifies C_DRV1_VLS_DOWN_ABS_MAX dependent on T_VLS_CYC_AFL_HLD" UBYTE _CNV_A_R_LINEAR_____258_CM 1 100. 0. 12.75 ECU_ADDRESS 0x3fcc28 FORMAT "%5.2" /end MEASUREMENT
/begin MEASUREMENT FAC_T_DRV1_VLS_DOWN_MMV_2 "Multiplicative factor modifies DRV1_VLS_DOWN_MMV_MIN_THD dependent on T_VLS_CYC_AFL_HLD" UBYTE _CNV_A_R_LINEAR_____257_CM 1 100. 0. 51. ECU_ADDRESS 0x3fcc29 FORMAT "%4.1" /end MEASUREMENT
/begin MEASUREMENT R_DOWN_LS_MES_2 "Internal resistance of downstream oxygen sensor (Measured)" UWORD _CNV_A_R_LINEAR_____163_CM 1 100. 0. 65535. ECU_ADDRESS 0x3fcc30 FORMAT "%5.0" /end MEASUREMENT
/begin MEASUREMENT T_SAMPLE_R_DOWN_LS_2 "Time measured between internal resistance samples" UWORD _CNV_A_R_LINEAR_____21_CM 1 100. 0. 655.35 ECU_ADDRESS 0x3fcc34 FORMAT "%6.2" /end MEASUREMENT
/begin MEASUREMENT T_VLS_CYC_AFL_HLD_R_DOWN_LS_2 "Lean mixture cycle time (measured upstream), held until next threshold crossing downstream" UBYTE _CNV_A_R_LINEAR_____21_CM 1 100. 0. 2.55 ECU_ADDRESS 0x3fcc2a FORMAT "%4.2" /end MEASUREMENT
/begin MEASUREMENT TTIP_LS_DOWN_MES_2 "Downstream oxygen sensor ceramic temperature" SWORD _CNV_A_R_LINEAR_____260_CM 1 100. -2048. 2047.938 ECU_ADDRESS 0x3fcc3a FORMAT "%8.2" /end MEASUREMENT
/begin MEASUREMENT TTIP_LS_DOWN_MES_BOL_2 "Downstream oxygen sensor ceramic temperature, Lower limit, Unfiltered" SWORD _CNV_A_R_LINEAR_____260_CM 1 100. -2048. 2047.938 ECU_ADDRESS 0x3fcc3e FORMAT "%8.2" /end MEASUREMENT
/begin MEASUREMENT TTIP_LS_DOWN_MES_BOL_MMV_2 "Downstream oxygen sensor ceramic temperature, Lower limit, Filtered" SWORD _CNV_A_R_LINEAR_____260_CM 1 100. -2048. 2047.938 ECU_ADDRESS 0x3fcc44 FORMAT "%8.2" /end MEASUREMENT
/begin MEASUREMENT TTIP_LS_DOWN_MES_TOL_2 "Downstream oxygen sensor ceramic temperature, Upper limit, Unfiltered" SWORD _CNV_A_R_LINEAR_____260_CM 1 100. -2048. 2047.938 ECU_ADDRESS 0x3fcc3c FORMAT "%8.2" /end MEASUREMENT
/begin MEASUREMENT TTIP_LS_DOWN_MES_TOL_MMV_2 "Downstream oxygen sensor ceramic temperature, Upper limit, Filtered" SWORD _CNV_A_R_LINEAR_____260_CM 1 100. -2048. 2047.938 ECU_ADDRESS 0x3fcc40 FORMAT "%8.2" /end MEASUREMENT
/begin MEASUREMENT LV_INH_R_UP_LS_2 "Boolean flag indicating that upstrem sensor internal resistance determination shall be inhibited when set" UWORD _CNV_S_2_RANGE______74_CM 1 100. 0. 1. ECU_ADDRESS 0x3fcbf8 BIT_MASK 0x1 /end MEASUREMENT
/begin MEASUREMENT LV_R_UP_LS_DET_2 "Boolean flag indicating that resistance has already been determined in current lean phase(lock out)" UWORD _CNV_S_2_RANGE______74_CM 1 100. 0. 1. ECU_ADDRESS 0x3fcbf8 BIT_MASK 0x4 /end MEASUREMENT
/begin MEASUREMENT LV_R_UP_LS_DRV1_VLS_CDN_2 "Boolean flag indicating that VLS_UP at low gradient condition met" UWORD _CNV_S_2_RANGE______74_CM 1 100. 0. 1. ECU_ADDRESS 0x3fcbf8 BIT_MASK 0x20 /end MEASUREMENT
/begin MEASUREMENT LV_R_UP_LS_ENA_2 "Boolean flag indicating that application conditions have been met" UWORD _CNV_S_2_RANGE______74_CM 1 100. 0. 1. ECU_ADDRESS 0x3fcbf8 BIT_MASK 0x8 /end MEASUREMENT
/begin MEASUREMENT LV_R_UP_LS_VLS_RNG_CDN_2 "Boolean flag indicating that VLS_UP at low gradient condition met" UWORD _CNV_S_2_RANGE______74_CM 1 100. 0. 1. ECU_ADDRESS 0x3fcbf8 BIT_MASK 0x10 /end MEASUREMENT
/begin MEASUREMENT CTR_CYCNR_R_UP_LS_2 "Handshake counter indicating the number of valid resistance values determined since initial activation" UWORD _CNV_A_R_LINEAR_____17_CM 1 100. 0. 65535. ECU_ADDRESS 0x3fcc02 FORMAT "%5.0" /end MEASUREMENT
/begin MEASUREMENT DRV1_VLS_UP_MMV_THD_MAX_2 "Upper variable VLS_UP gradient threshold" SWORD _CNV_A_R_LINEAR_____252_CM 1 100. -2.5 2.4999 ECU_ADDRESS 0x3fcc0c FORMAT "%7.4" /end MEASUREMENT
/begin MEASUREMENT DRV1_VLS_UP_MMV_THD_MIN_2 "Lower variable VLS_UP gradient threshold" SWORD _CNV_A_R_LINEAR_____252_CM 1 100. -2.5 2.4999 ECU_ADDRESS 0x3fcc0e FORMAT "%7.4" /end MEASUREMENT
/begin MEASUREMENT FAC_T_DRV1_VLS_UP_ABS_2 "Multiplicative factor modifies C_DRV1_VLS_UP_ABS_MAX dependent on T_VLS_CYC_AFL_HLD" UBYTE _CNV_A_R_LINEAR_____258_CM 1 100. 0. 12.75 ECU_ADDRESS 0x3fcc00 FORMAT "%5.2" /end MEASUREMENT
/begin MEASUREMENT FAC_T_DRV1_VLS_UP_MMV_2 "Multiplicative factor modifies DRV1_VLS_UP_MMV_MIN_THD dependent on T_VLS_CYC_AFL_HLD" UBYTE _CNV_A_R_LINEAR_____257_CM 1 100. 0. 51. ECU_ADDRESS 0x3fcc01 FORMAT "%4.1" /end MEASUREMENT
/begin MEASUREMENT R_UP_LS_2 "Internal resistance of upstream oxygen sensor, cylinder bank i" UWORD _CNV_A_R_LINEAR_____163_CM 1 100. 0. 65535. ECU_ADDRESS 0x3fcc04 FORMAT "%5.0" /end MEASUREMENT
/begin MEASUREMENT R_UP_LS_MES_2 "Internal resistance of upstream oxygen sensor (Measured)" UWORD _CNV_A_R_LINEAR_____163_CM 1 100. 0. 65535. ECU_ADDRESS 0x3fcc06 FORMAT "%5.0" /end MEASUREMENT
/begin MEASUREMENT T_SAMPLE_R_UP_LS_2 "Time measured between internal resistance samples" UWORD _CNV_A_R_LINEAR_____21_CM 1 100. 0. 655.35 ECU_ADDRESS 0x3fcc0a FORMAT "%6.2" /end MEASUREMENT
/begin MEASUREMENT TTIP_LS_UP_MES_2 "Upstream oxygen sensor ceramic temperature" SWORD _CNV_A_R_LINEAR_____260_CM 1 100. -2048. 2047.938 ECU_ADDRESS 0x3fcc10 FORMAT "%8.2" /end MEASUREMENT
/begin MEASUREMENT TTIP_LS_UP_MES_BOL_2 "Upstream oxygen sensor ceramic temperature, Lower limit, Unfiltered" SWORD _CNV_A_R_LINEAR_____260_CM 1 100. -2048. 2047.938 ECU_ADDRESS 0x3fcc14 FORMAT "%8.2" /end MEASUREMENT
/begin MEASUREMENT TTIP_LS_UP_MES_BOL_MMV_2 "Upstream oxygen sensor ceramic temperature, Lower limit, Unfiltered" SWORD _CNV_A_R_LINEAR_____260_CM 1 100. -2048. 2047.938 ECU_ADDRESS 0x3fcc1a FORMAT "%8.2" /end MEASUREMENT
/begin MEASUREMENT TTIP_LS_UP_MES_TOL_2 "Downstream oxygen sensor ceramic temperature, Upper limit, Unfiltered" SWORD _CNV_A_R_LINEAR_____260_CM 1 100. -2048. 2047.938 ECU_ADDRESS 0x3fcc12 FORMAT "%8.2" /end MEASUREMENT
/begin MEASUREMENT TTIP_LS_UP_MES_TOL_MMV_2 "Upstream oxygen sensor ceramic temperature, Lower limit, Unfiltered" SWORD _CNV_A_R_LINEAR_____260_CM 1 100. -2048. 2047.938 ECU_ADDRESS 0x3fcc16 FORMAT "%8.2" /end MEASUREMENT
/begin CHARACTERISTIC C_TCO_MIN_CAT_PURGE_PUC "min. TCO threshold for activation " VALUE 0x630f3 _REC_VAL_20_u1 28.575 _CNV_A_R_LINEAR_____22_CM -48. 142.5 FORMAT "%5.1" /end CHARACTERISTIC
/begin CHARACTERISTIC C_T_DLY_VLS_DOWN_ACT_PUC "minimum time before activating VLS_DOWN observation" VALUE 0x630f5 _REC_VAL_20_u1 25.5 _CNV_A_R_LINEAR_____18_CM 0. 25.5 FORMAT "%4.1" /end CHARACTERISTIC
/begin CHARACTERISTIC C_MAF_INT_MAX_CAT_PURGE "upper limit for MAF_INT_CAT_PURGE" VALUE 0x630f6 _REC_VAL_20_u2 1820.398 _CNV_A_R_LINEAR_____98_CM 0. 1820.398 FORMAT "%7.2" /end CHARACTERISTIC
/begin CHARACTERISTIC C_MAF_MAX_CAT_PURGE "upper load limit of for deactivation" VALUE 0x630f8 _REC_VAL_20_u2 2047.96875 _CNV_A_R_LINEAR_____52_CM 0. 2047.96875 FORMAT "%7.2" /end CHARACTERISTIC
/begin CHARACTERISTIC C_VLS_DOWN_MAX_CAT_PURGE_ "max. VLS_DOWN value for deactivation " VALUE 0x630fa _REC_VAL_20_u1 1.275 _CNV_A_R_LINEAR_____262_CM 0. 1.275 FORMAT "%5.3" /end CHARACTERISTIC
/begin CHARACTERISTIC C_TCO_MIN_MAIN_CAT_PURGE "min. TCO threshold for main-catalyst purge " VALUE 0x630fb _REC_VAL_20_u1 190.5 _CNV_A_R_LINEAR_____22_CM -48. 142.5 /end CHARACTERISTIC
/begin CHARACTERISTIC C_DELTA_LAMB_SP_PUC_DEC "decrement lambda setpoint offset" VALUE 0x630fc _REC_VAL_20_u1 0.125 _CNV_A_R_LINEAR_____250_CM 0. 0.125 FORMAT "%5.3" /end CHARACTERISTIC
/begin AXIS_PTS ldp_maf_int_puc__1 "" 0x60dba MAF_INT_PUC _REC_AXS_20_u2 1820.398 _CNV_A_R_LINEAR_____98_CM 6 0. 1820.398 FORMAT "%7.2" /end AXIS_PTS
/begin AXIS_PTS ldp_cat_diag__fac_cat_eff_puc "" 0x60dc8 CAT_DIAG _REC_AXS_20_u1 1.9968 _CNV_A_R_LINEAR_____70_CM 6 0. 1.9968 FORMAT "%4.2" /end AXIS_PTS
/begin CHARACTERISTIC IP_MAF_INT_CAT_PURGE_MAX "Initial value for the mass air flow integral for deactivation" CURVE 0x630fe _REC_CUR_20_u2_u2 1820.398 _CNV_A_R_LINEAR_____98_CM 0. 1820.398 FORMAT "%7.2"
 /begin AXIS_DESCR COM_AXIS MAF_INT_PUC _CNV_A_R_LINEAR_____98_CM 6 0. 1820.398 FORMAT "%7.2" AXIS_PTS_REF ldp_maf_int_puc__1 /end AXIS_DESCR
/end CHARACTERISTIC
/begin CHARACTERISTIC IP_FAC_CAT_EFF_PUC "weighting factor for the lambda shift depending on the result of the catalyst diagnosis" CURVE 0x6310a _REC_CUR_20_u1_u1 0.9960940000000002 _CNV_A_R_LINEAR_____8_CM 0. 0.996094 FORMAT "%5.3"
 /begin AXIS_DESCR COM_AXIS ONLINE_DUMMY _CNV_A_R_LINEAR_____70_CM 6 0. 1.9968 FORMAT "%4.2" AXIS_PTS_REF ldp_cat_diag__fac_cat_eff_puc /end AXIS_DESCR
/end CHARACTERISTIC
/begin AXIS_PTS ldp_maf_cyl__delta_lamb_sp_puc "" 0x60dd0 MAF_CYL _REC_AXS_20_u2 2047.96875 _CNV_A_R_LINEAR_____52_CM 6 0. 2047.96875 FORMAT "%7.2" /end AXIS_PTS
/begin CHARACTERISTIC IP_DELTA_LAMB_SP_PUC "basic value for lambda controller setpoint shift" CURVE 0x63116 _REC_CUR_20_u1_u2 0.125 _CNV_A_R_LINEAR_____250_CM 0. 0.125 FORMAT "%5.3"
 /begin AXIS_DESCR COM_AXIS MAF_CYL _CNV_A_R_LINEAR_____52_CM 6 0. 2047.96875 FORMAT "%7.2" AXIS_PTS_REF ldp_maf_cyl__delta_lamb_sp_puc /end AXIS_DESCR
/end CHARACTERISTIC
/begin MEASUREMENT MAF_INT_PUC "integral of mass air flow while active PUC" UWORD _CNV_A_R_LINEAR_____98_CM 1 100. 0. 1820.398 ECU_ADDRESS 0x3fc9a8 FORMAT "%7.2" /end MEASUREMENT
/begin CHARACTERISTIC C_T_MIN_PUC_CAT_PURGE "minimum time in PUC before cat purge" VALUE 0x630f4 _REC_VAL_20_u1 25.5 _CNV_A_R_LINEAR_____18_CM 0. 25.5 FORMAT "%4.1" /end CHARACTERISTIC
/begin CHARACTERISTIC C_T_MAX_WAIT_SA "maximum time between end of SA and begin cat purge due to SA" VALUE 0x6311c _REC_VAL_20_u1 25.5 _CNV_A_R_LINEAR_____18_CM 0. 25.5 FORMAT "%4.1" /end CHARACTERISTIC
/begin CHARACTERISTIC C_MAF_INT_LSCL_DLY_SA "MAF integral for postpone of lambda control" VALUE 0x63120 _REC_VAL_20_u2 1820.398 _CNV_A_R_LINEAR_____98_CM 0. 1820.398 FORMAT "%7.2" /end CHARACTERISTIC
/begin CHARACTERISTIC C_MAF_INT_MAX_CAT_LOAD_CH "upper limit for MAF_INT_CAT_LOAD_CH" VALUE 0x6311e _REC_VAL_20_u2 1820.398 _CNV_A_R_LINEAR_____98_CM 0. 1820.398 FORMAT "%7.2" /end CHARACTERISTIC
/begin CHARACTERISTIC C_MAF_INT_MAX_CAT_LOAD_HST "upper limit for MAF_INT_CAT_LOAD_HST" VALUE 0x63122 _REC_VAL_20_u2 1820.398 _CNV_A_R_LINEAR_____98_CM 0. 1820.398 FORMAT "%7.2" /end CHARACTERISTIC
/begin AXIS_PTS ldpm_temp_cat_fac_pcat_main_cat "" 0x60dde TEMP_CAT _REC_AXS_20_u2 1023.984375 _CNV_A_R_LINEAR_____95_CM 6 -33. 990.984375 FORMAT "%6.2" /end AXIS_PTS
/begin CHARACTERISTIC IP_FAC_PCAT_MAIN_CAT_PUC "weighting factor containing volume ratio pre-/main-cat" CURVE 0x63110 _REC_CUR_20_u1_u2 3.984375 _CNV_A_R_LINEAR_____113_CM 0. 3.984375 FORMAT "%4.2"
 /begin AXIS_DESCR COM_AXIS TEMP_CAT _CNV_A_R_LINEAR_____95_CM 6 -33. 990.984375 FORMAT "%6.2" AXIS_PTS_REF ldpm_temp_cat_fac_pcat_main_cat /end AXIS_DESCR
/end CHARACTERISTIC
/begin CHARACTERISTIC IP_FAC_PCAT_MAIN_CAT_HC "weighting factor containing volume ratio pre-/main-cat" CURVE 0x63124 _REC_CUR_20_u1_u2 3.984375 _CNV_A_R_LINEAR_____113_CM 0. 3.984375 FORMAT "%4.2"
 /begin AXIS_DESCR COM_AXIS TEMP_CAT _CNV_A_R_LINEAR_____95_CM 6 -33. 990.984375 FORMAT "%6.2" AXIS_PTS_REF ldpm_temp_cat_fac_pcat_main_cat /end AXIS_DESCR
/end CHARACTERISTIC
/begin CHARACTERISTIC IP_FAC_PCAT_MAIN_CAT_HST "weighting factor containing volume ratio pre-/main-cat" CURVE 0x6312a _REC_CUR_20_u1_u2 3.984375 _CNV_A_R_LINEAR_____113_CM 0. 3.984375 FORMAT "%4.2"
 /begin AXIS_DESCR COM_AXIS TEMP_CAT _CNV_A_R_LINEAR_____95_CM 6 -33. 990.984375 FORMAT "%6.2" AXIS_PTS_REF ldpm_temp_cat_fac_pcat_main_cat /end AXIS_DESCR
/end CHARACTERISTIC
/begin MEASUREMENT MAF "Air mass (predicted) for calculation of basic fuel injection" UWORD _CNV_A_R_LINEAR_____56_CM 1 100. 0. 1389. ECU_ADDRESS 0x3fccd8 FORMAT "%6.2" /end MEASUREMENT
/begin MEASUREMENT MAF_CYL_STK "Air mass flow out of the intake manifold per stroke" UWORD _CNV_A_R_LINEAR_____56_CM 1 100. 0. 1389. ECU_ADDRESS 0x3fcce0 FORMAT "%6.2" /end MEASUREMENT
/begin MEASUREMENT MAF_KGH_CLC "Calculated value of MAF_KGH out of manifold model" UWORD _CNV_A_R_LINEAR_____52_CM 1 100. 0. 2047.96875 ECU_ADDRESS 0x3fccda FORMAT "%7.2" /end MEASUREMENT
/begin MEASUREMENT MAP_EGR "Residual gas partial pressure in the manifold" UWORD _CNV_A_R_LINEAR_____1_CM 1 100. 0. 5434. ECU_ADDRESS 0x3fccee FORMAT "%7.2" /end MEASUREMENT
/begin MEASUREMENT MAP_EGR_PRED "Predicted residual gas partial manifold air pressure" UWORD _CNV_A_R_LINEAR_____1_CM 1 100. 0. 5434. ECU_ADDRESS 0x3fcd18 FORMAT "%7.2" /end MEASUREMENT
/begin MEASUREMENT MAP_FG_PRED "Predicted fresh gas partial manifold air pressure" UWORD _CNV_A_R_LINEAR_____1_CM 1 100. 0. 5434. ECU_ADDRESS 0x3fcd1a FORMAT "%7.2" /end MEASUREMENT
/begin MEASUREMENT MAP_PRED "Predicted manifold air pressure" UWORD _CNV_A_R_LINEAR_____1_CM 1 100. 0. 5434. ECU_ADDRESS 0x3fcd16 FORMAT "%7.2" /end MEASUREMENT
/begin MEASUREMENT MAP_FG "Fresh gas partial pressure in the manifold" UWORD _CNV_A_R_LINEAR_____1_CM 1 100. 0. 5434. ECU_ADDRESS 0x3fccf8 FORMAT "%7.2" /end MEASUREMENT
/begin MEASUREMENT PQ "Pressure quotient at the throttle" UWORD _CNV_A_R_LINEAR_____2_CM 1 100. 0. 0.99998474 ECU_ADDRESS 0x3fccf6 FORMAT "%7.5" /end MEASUREMENT
/begin MEASUREMENT PQ_EGR "Pressure quotient at the EGR - valve" UWORD _CNV_A_R_LINEAR_____2_CM 1 100. 0. 0.99998474 ECU_ADDRESS 0x3fccf0 FORMAT "%7.5" /end MEASUREMENT
/begin MEASUREMENT EGR_RATIO "MAF_EGR/MAF_CYL" UWORD _CNV_A_R_LINEAR_____144_CM 1 100. 0. 99.99847412 ECU_ADDRESS 0x3fccea /end MEASUREMENT
/begin MEASUREMENT PQ_ESTIM "Estimated pressure quotient at the throttle" UWORD _CNV_A_R_LINEAR_____2_CM 1 100. 0. 0.99998474 ECU_ADDRESS 0x3fcd1c FORMAT "%7.5" /end MEASUREMENT
/begin MEASUREMENT PQ_EGR_ESTIM "Estimated pressure quotient at the EGR - valve" UWORD _CNV_A_R_LINEAR_____2_CM 1 100. 0. 0.99998474 ECU_ADDRESS 0x3fcd1e FORMAT "%7.5" /end MEASUREMENT
/begin MEASUREMENT MAF_THR "Air mass flow at the throttle" UWORD _CNV_A_R_LINEAR_____52_CM 1 100. 0. 2047.96875 ECU_ADDRESS 0x3fccdc FORMAT "%7.2" /end MEASUREMENT
/begin MEASUREMENT MAF_EGR "Air mass flow at the EGR -valve" UWORD _CNV_A_R_LINEAR_____52_CM 1 100. 0. 2047.96875 ECU_ADDRESS 0x3fccec FORMAT "%7.2" /end MEASUREMENT
/begin MEASUREMENT MAP_DRV1 "First derivative of  intake  manifold pressure " SWORD _CNV_A_R_LINEAR_____283_CM 1 100. -82.91625999999999 82.91377 ECU_ADDRESS 0x3fccfc FORMAT "%5.3" /end MEASUREMENT
/begin MEASUREMENT MAP_EGR_DRV1 "First derivative of  intake  manifold residual gas pressure " SWORD _CNV_A_R_LINEAR_____283_CM 1 100. -82.91625999999999 82.91377 ECU_ADDRESS 0x3fcd14 FORMAT "%5.3" /end MEASUREMENT
/begin MEASUREMENT MAF_EGR_CON_1 "sqrt(2x/((x-1)*RA*TEG_EGR)) with x = kappa = 1.4" UWORD _CNV_A_R_LINEAR_____284_CM 1 100. 0. 2.06019e-002 ECU_ADDRESS 0x3fcce4 FORMAT "%8.7" /end MEASUREMENT
/begin MEASUREMENT MAF_MDL_CON_1 "sqrt(2x/((x-1)*RA*TIA)) with x = kappa = 1.4" UWORD _CNV_A_R_LINEAR_____284_CM 1 100. 0. 2.06019e-002 ECU_ADDRESS 0x3fcce2 FORMAT "%8.7" /end MEASUREMENT
/begin MEASUREMENT MAF_FAC_OFS "Offset of the air flow equation for the throttle air mass flow" UWORD _CNV_A_R_LINEAR_____285_CM 1 100. 0. 8.880330000000001 ECU_ADDRESS 0x3fccf2 FORMAT "%5.4" /end MEASUREMENT
/begin MEASUREMENT MAF_FAC_OFS_EGR "Offset of the air flow equation for the EGR air mass flow" UWORD _CNV_A_R_LINEAR_____285_CM 1 100. 0. 8.880330000000001 ECU_ADDRESS 0x3fcce6 FORMAT "%5.4" /end MEASUREMENT
/begin MEASUREMENT MAF_FAC_SLOP "Slope of the air flow equation for the throttle air mass flow" UWORD _CNV_A_R_LINEAR_____285_CM 1 100. 0. 8.880330000000001 ECU_ADDRESS 0x3fccf4 FORMAT "%5.4" /end MEASUREMENT
/begin CHARACTERISTIC IP_MAF_MDL_CON_1__TIA "Temperature influence air flow function at the throttle" CURVE 0x639dc _REC_CUR_20_u2_u1 2.06019e-002 _CNV_A_R_LINEAR_____284_CM 0. 2.06019e-002 FORMAT "%8.7"
 /begin AXIS_DESCR COM_AXIS TIA _CNV_A_R_LINEAR_____22_CM 8 -48. 142.5 FORMAT "%5.1" AXIS_PTS_REF ldpm_tia_maf_mdl_con_1 /end AXIS_DESCR
/end CHARACTERISTIC
/begin CHARACTERISTIC IP_MAF_EGR_CON_1__TEG_EGR "Temperature influence air flow function at the EGR-Valve" CURVE 0x639ec _REC_CUR_20_u2_u2 2.06019e-002 _CNV_A_R_LINEAR_____284_CM 0. 2.06019e-002 FORMAT "%8.7"
 /begin AXIS_DESCR COM_AXIS TEG_EGR _CNV_A_R_LINEAR_____94_CM 8 0. 2047. FORMAT "%7.2" AXIS_PTS_REF ldp_teg_egr_maf_egr_con_1 /end AXIS_DESCR
/end CHARACTERISTIC
/begin CHARACTERISTIC C_RA_VOL_IM "General gas constants divided by intake manifold volume" VALUE 0x63a62 _REC_VAL_20_u2 140307.6445 _CNV_A_R_LINEAR_____287_CM 0. 140307.6445 FORMAT "%6.0" /end CHARACTERISTIC
/begin CHARACTERISTIC C_PQ_THD "Calculation threshold for manifold pressure; typical value 0,9900 (FD70H)" VALUE 0x63a64 _REC_VAL_20_u2 0.99998474 _CNV_A_R_LINEAR_____2_CM 0. 0.99998474 FORMAT "%7.5" /end CHARACTERISTIC
/begin MEASUREMENT EFF_VOL_SLOP "slope of the volumetric efficiency" UWORD _CNV_A_R_LINEAR_____297_CM 1 100. 0. 12.05964 ECU_ADDRESS 0x3fcd86 FORMAT "%6.4" /end MEASUREMENT
/begin MEASUREMENT EFF_VOL_OFS "offset of the volumetric efficiency" UWORD _CNV_A_R_LINEAR_____52_CM 1 100. 0. 2047.96875 ECU_ADDRESS 0x3fcd84 FORMAT "%7.2" /end MEASUREMENT
/begin CHARACTERISTIC IP_EFF_VOL_OFS "Offset cylinder air mass flow including valve overlapping influences" MAP 0x63bbc _REC_MAP_20_u2_u2_u1 2047.96875 _CNV_A_R_LINEAR_____52_CM 0. 2047.96875 FORMAT "%6.2"
 /begin AXIS_DESCR COM_AXIS N _CNV_A_R_LINEAR_____0_CM 12 0. 8160. FORMAT "%4.0" AXIS_PTS_REF ldpm_n_eff_vol /end AXIS_DESCR
 /begin AXIS_DESCR COM_AXIS VO _CNV_A_R_LINEAR_____6_CM 8 0. 95.625 FORMAT "%5.2" AXIS_PTS_REF ldpm_vo__eff_vol /end AXIS_DESCR
/end CHARACTERISTIC
/begin AXIS_PTS ldpm_n_eff_vol "" 0x61028 N _REC_AXS_20_u2 8160. _CNV_A_R_LINEAR_____0_CM 12 0. 8160. FORMAT "%4.0" /end AXIS_PTS
/begin CHARACTERISTIC IP_EFF_VOL_OFS_AMP "Ambient pressure correction of the offset cylinder mass air flow" CURVE 0x63cbc _REC_CUR_20_u2_u2 1.99996948 _CNV_A_R_LINEAR_____5_CM 0. 1.99996948 FORMAT "%7.5"
 /begin AXIS_DESCR COM_AXIS AMP _CNV_A_R_LINEAR_____1_CM 6 0. 5434. FORMAT "%7.2" AXIS_PTS_REF ldpm_amp__eff_vol_ofs_amp /end AXIS_DESCR
/end CHARACTERISTIC
/begin AXIS_PTS ldpm_amp__eff_vol_ofs_amp "" 0x61042 AMP _REC_AXS_20_u2 5434. _CNV_A_R_LINEAR_____1_CM 6 0. 5434. FORMAT "%7.2" /end AXIS_PTS
/begin CHARACTERISTIC IP_EFF_VOL_SLOP_AMP "Ambient pressure correction of the slope cylinder mass air flow" CURVE 0x63cc8 _REC_CUR_20_u2_u2 1.99996948 _CNV_A_R_LINEAR_____5_CM 0. 1.99996948 FORMAT "%7.5"
 /begin AXIS_DESCR COM_AXIS AMP _CNV_A_R_LINEAR_____1_CM 6 0. 5434. FORMAT "%7.2" AXIS_PTS_REF ldpm_amp__eff_vol_ofs_amp /end AXIS_DESCR
/end CHARACTERISTIC
/begin CHARACTERISTIC IP_EFF_VOL_SLOP_VIM "" MAP 0x63cd4 _REC_MAP_20_u2_u2_u2 12.058 _CNV_A_R_LINEAR_____298_CM -6.029 6.029
 /begin AXIS_DESCR COM_AXIS N _CNV_A_R_LINEAR_____0_CM 12 0. 8160. FORMAT "%4.0" AXIS_PTS_REF ldpm_n_eff_vol /end AXIS_DESCR
 /begin AXIS_DESCR COM_AXIS DISA_IST _CNV_A_R_LINEAR_____299_CM 8 0. 199.9969 FORMAT "%7.3" AXIS_PTS_REF ldpm_disa_ist__eff_vol /end AXIS_DESCR
/end CHARACTERISTIC
/begin MEASUREMENT LV_AMP_AD_STOP "Adaptation of ambient pressure is stopped" UBYTE _CNV_S_2_RANGE______74_CM 1 100. 0. 1. ECU_ADDRESS 0x3fd4f7 BIT_MASK 0x1 /end MEASUREMENT
/begin MEASUREMENT LV_AMP_AD_RST "Adaptation of ambient pressure is reseted to \"0\"" UBYTE _CNV_S_2_RANGE______74_CM 1 100. 0. 1. ECU_ADDRESS 0x3fd4f8 BIT_MASK 0x1 /end MEASUREMENT
/begin MEASUREMENT LV_AMP_CTL_STOP "Ambient pressure controller is stopped" UBYTE _CNV_S_2_RANGE______74_CM 1 100. 0. 1. ECU_ADDRESS 0x3fd4f3 BIT_MASK 0x1 /end MEASUREMENT
/begin MEASUREMENT LV_AMP_CTL_RST "Ambient pressure controller is reseted to \"0\"" UBYTE _CNV_S_2_RANGE______74_CM 1 100. 0. 1. ECU_ADDRESS 0x3fd4f4 BIT_MASK 0x1 /end MEASUREMENT
/begin MEASUREMENT LV_AR_RED_AD_RST "Adaptation of reduced area is reseted to \"0\"" UBYTE _CNV_S_2_RANGE______74_CM 1 100. 0. 1. ECU_ADDRESS 0x3fd4fa BIT_MASK 0x1 /end MEASUREMENT
/begin MEASUREMENT LV_AR_RED_AD_STOP "Adaptation of reduced area is stopped" UBYTE _CNV_S_2_RANGE______74_CM 1 100. 0. 1. ECU_ADDRESS 0x3fd4f9 BIT_MASK 0x1 /end MEASUREMENT
/begin MEASUREMENT LV_AR_RED_CTL_STOP "Reduced area controller is stopped" UBYTE _CNV_S_2_RANGE______74_CM 1 100. 0. 1. ECU_ADDRESS 0x3fd4f5 BIT_MASK 0x1 /end MEASUREMENT
/begin MEASUREMENT LV_AR_RED_CTL_RST "Reduced area controller is reseted to \"0\"" UBYTE _CNV_S_2_RANGE______74_CM 1 100. 0. 1. ECU_ADDRESS 0x3fd4f6 BIT_MASK 0x1 /end MEASUREMENT
/begin MEASUREMENT LV_MAP_CTL "MAP controlled system" UBYTE _CNV_S_2_RANGE______74_CM 1 100. 0. 1. ECU_ADDRESS 0x3fd4fc BIT_MASK 0x1 /end MEASUREMENT
/begin MEASUREMENT LV_MAF_CTL "MAF controlled system" UBYTE _CNV_S_2_RANGE______74_CM 1 100. 0. 1. ECU_ADDRESS 0x3fd4fb BIT_MASK 0x1 /end MEASUREMENT
/begin MEASUREMENT MAF_KGH_MES_FAC "Correction factor for MAF_KGH_MES" UBYTE _CNV_A_R_LINEAR_____64_CM 1 100. 0. 1.99220002 ECU_ADDRESS 0x3fd93b FORMAT "%5.3" /end MEASUREMENT
/begin MEASUREMENT MAF_KGH_MES_BAS "Raw air-mass flow measured (without correction, to be used for diagnosis only)" UWORD _CNV_A_R_LINEAR_____52_CM 1 100. 0. 2047.96875 ECU_ADDRESS 0x3fccd4 FORMAT "%7.2" /end MEASUREMENT
/begin MEASUREMENT MAF_MES "Mass air flow per segment" UWORD _CNV_A_R_LINEAR_____56_CM 1 100. 0. 1389. ECU_ADDRESS 0x3fccd6 FORMAT "%6.2" /end MEASUREMENT
/begin AXIS_PTS ldp_teg_egr_maf_egr_con_1 "" 0x6100c TEG_EGR _REC_AXS_20_u2 2047. _CNV_A_R_LINEAR_____94_CM 8 0. 2047. FORMAT "%7.2" /end AXIS_PTS
/begin AXIS_PTS ldp_maf_cyl_amp_dec "" 0x61050 MAF_CYL _REC_AXS_20_u2 2047.96875 _CNV_A_R_LINEAR_____52_CM 4 0. 2047.96875 FORMAT "%6.2" /end AXIS_PTS
/begin CHARACTERISTIC IP_AMP_DEC__MAF_CYL "pressure decrease in the air cleaner ( max. Value 100 hPa)" CURVE 0x63e54 _REC_CUR_20_u2_u2 5434. _CNV_A_R_LINEAR_____1_CM 0. 5434. FORMAT "%7.2"
 /begin AXIS_DESCR COM_AXIS MAF_CYL _CNV_A_R_LINEAR_____52_CM 4 0. 2047.96875 FORMAT "%6.2" AXIS_PTS_REF ldp_maf_cyl_amp_dec /end AXIS_DESCR
/end CHARACTERISTIC
/begin MEASUREMENT MAF_KGH "Mass air flow per segment" UWORD _CNV_A_R_LINEAR_____52_CM 1 100. 0. 2047.96875 ECU_ADDRESS 0x3fcd00 FORMAT "%7.2" /end MEASUREMENT
/begin MEASUREMENT MAF_MMV "MAF moving mean value" UWORD _CNV_A_R_LINEAR_____56_CM 1 100. 0. 1389. ECU_ADDRESS 0x3fcd02 FORMAT "%6.2" /end MEASUREMENT
/begin AXIS_PTS ldpm_vo__eff_vol "" 0x6101e VO _REC_AXS_20_u1 95.625 _CNV_A_R_LINEAR_____6_CM 8 0. 95.625 FORMAT "%5.2" /end AXIS_PTS
/begin CHARACTERISTIC IP_PRED_FAC__N "Prediction factor" CURVE 0x63a5c _REC_CUR_20_u1_u1 7.96875 _CNV_A_R_LINEAR_____118_CM 0. 7.96875 FORMAT "%4.2"
 /begin AXIS_DESCR COM_AXIS N_32 _CNV_A_R_LINEAR_____15_CM 6 0. 8160. FORMAT "%4.0" AXIS_PTS_REF ldpm_n_32_ar_red /end AXIS_DESCR
/end CHARACTERISTIC
/begin CHARACTERISTIC IP_FAC_MAF_KGH_COR "Correction for MAF_KGH_MES depending on MAF_KGH_MES_BAS" CURVE 0x63fd7 _REC_CUR_20_u1_u2 1.9921875 _CNV_A_R_LINEAR_____67_CM 0. 1.9921875 FORMAT "%5.3"
 /begin AXIS_DESCR COM_AXIS MAF_KGH_MES_BAS _CNV_A_R_LINEAR_____52_CM 16 0. 2047.96875 FORMAT "%7.2" AXIS_PTS_REF ldp_maf_kgh_mes_bas /end AXIS_DESCR
/end CHARACTERISTIC
/begin MEASUREMENT MAF_FG_CYL "Fresh air mass flow in the cylinder" UWORD _CNV_A_R_LINEAR_____52_CM 1 100. 0. 2047.96875 ECU_ADDRESS 0x3fcd04 FORMAT "%7.2" /end MEASUREMENT
/begin MEASUREMENT MAF_FG_CYL_STK "Fresh air mass flow in the cylinder per stroke" UWORD _CNV_A_R_LINEAR_____56_CM 1 100. 0. 1389. ECU_ADDRESS 0x3fcd06 FORMAT "%7.2" /end MEASUREMENT
/begin MEASUREMENT FAC_MAF_MAX "Ratio between MAF und MAX_COR" UWORD _CNV_A_R_LINEAR_____5_CM 1 100. 0. 1.99996948 ECU_ADDRESS 0x3fcd0a FORMAT "%7.5" /end MEASUREMENT
/begin AXIS_PTS ldpm_disa_ist__eff_vol "" 0x6114a DISA_IST _REC_AXS_20_u2 199.9969 _CNV_A_R_LINEAR_____299_CM 8 0. 199.9969 FORMAT "%7.3" /end AXIS_PTS
/begin AXIS_PTS ldpm_fac_port_deac__eff_vol "" 0x6115c FAC_PORT_DEAC _REC_AXS_20_u2 0.99998474 _CNV_A_R_LINEAR_____2_CM 8 0. 0.99998474 FORMAT "%7.5" /end AXIS_PTS
/begin AXIS_PTS ldpm_exc_av_rel__eff_vol "" 0x6116e EXV_AV_REL _REC_AXS_20_u2 99.99847412 _CNV_A_R_LINEAR_____144_CM 8 0. 99.99847412 /end AXIS_PTS
/begin MEASUREMENT EXC_AV_REL "" UWORD _CNV_A_R_LINEAR_____144_CM 1 100. 0. 99.99847412 ECU_ADDRESS 0x3fc5d6 /end MEASUREMENT
/begin CHARACTERISTIC IP_EFF_VOL_OFS_VIM "additive correction of the offset cylinder air mass flow with VIM active" MAP 0x63d94 _REC_MAP_20_u2_u2_u2 2047.96875 _CNV_A_R_LINEAR_____302_CM -1024. 1023.96875 FORMAT "%8.2"
 /begin AXIS_DESCR COM_AXIS N _CNV_A_R_LINEAR_____0_CM 12 0. 8160. FORMAT "%4.0" AXIS_PTS_REF ldpm_n_eff_vol /end AXIS_DESCR
 /begin AXIS_DESCR COM_AXIS DISA_IST _CNV_A_R_LINEAR_____299_CM 8 0. 199.9969 FORMAT "%7.3" AXIS_PTS_REF ldpm_disa_ist__eff_vol /end AXIS_DESCR
/end CHARACTERISTIC
/begin CHARACTERISTIC IP_EFF_VOL_OFS_PORT "correction factor of the offset cylinder air mass flow due to port deactivation" MAP 0x63fe8 _REC_MAP_20_u2_u2_u2 1.99996948 _CNV_A_R_LINEAR_____5_CM 0. 1.99996948 FORMAT "%7.5"
 /begin AXIS_DESCR COM_AXIS N _CNV_A_R_LINEAR_____0_CM 12 0. 8160. FORMAT "%4.0" AXIS_PTS_REF ldpm_n_eff_vol /end AXIS_DESCR
 /begin AXIS_DESCR COM_AXIS FAC_PORT_DEAC _CNV_A_R_LINEAR_____2_CM 8 0. 0.99998474 FORMAT "%7.5" AXIS_PTS_REF ldpm_fac_port_deac__eff_vol /end AXIS_DESCR
/end CHARACTERISTIC
/begin CHARACTERISTIC IP_EFF_VOL_OFS_VVL_SWI "correction factor of the offset cylinder air mass flow due to port deactivation with variable valve lift" MAP 0x640a8 _REC_MAP_20_u2_u2_u2 1.99996948 _CNV_A_R_LINEAR_____5_CM 0. 1.99996948 FORMAT "%7.5"
 /begin AXIS_DESCR COM_AXIS N _CNV_A_R_LINEAR_____0_CM 12 0. 8160. FORMAT "%4.0" AXIS_PTS_REF ldpm_n_eff_vol /end AXIS_DESCR
 /begin AXIS_DESCR COM_AXIS EXC_AV_REL _CNV_A_R_LINEAR_____144_CM 8 0. 99.99847412 AXIS_PTS_REF ldpm_exc_av_rel__eff_vol /end AXIS_DESCR
/end CHARACTERISTIC
/begin CHARACTERISTIC IP_EFF_VOL_SLOP_PORT "correction factor of the slope cylinder air mass flow due to port deactivation with port flap" MAP 0x64168 _REC_MAP_20_u2_u2_u2 1.99996948 _CNV_A_R_LINEAR_____5_CM 0. 1.99996948 FORMAT "%7.5"
 /begin AXIS_DESCR COM_AXIS N _CNV_A_R_LINEAR_____0_CM 12 0. 8160. FORMAT "%4.0" AXIS_PTS_REF ldpm_n_eff_vol /end AXIS_DESCR
 /begin AXIS_DESCR COM_AXIS FAC_PORT_DEAC _CNV_A_R_LINEAR_____2_CM 8 0. 0.99998474 FORMAT "%7.5" AXIS_PTS_REF ldpm_fac_port_deac__eff_vol /end AXIS_DESCR
/end CHARACTERISTIC
/begin CHARACTERISTIC IP_EFF_VOL_SLOP_VVL_SWI "correction factor of the slope cylinder air mass flow due to port deactivation with variable valve lift" MAP 0x64228 _REC_MAP_20_u2_u2_u2 1.99996948 _CNV_A_R_LINEAR_____5_CM 0. 1.99996948 FORMAT "%7.5"
 /begin AXIS_DESCR COM_AXIS N _CNV_A_R_LINEAR_____0_CM 12 0. 8160. FORMAT "%4.0" AXIS_PTS_REF ldpm_n_eff_vol /end AXIS_DESCR
 /begin AXIS_DESCR COM_AXIS EXC_AV_REL _CNV_A_R_LINEAR_____144_CM 8 0. 99.99847412 AXIS_PTS_REF ldpm_exc_av_rel__eff_vol /end AXIS_DESCR
/end CHARACTERISTIC
/begin CHARACTERISTIC LC_AMP_INP_ENA "Default logical variable enabled for the input of the airfilter" VALUE 0x642e8 _REC_VAL_20_u1 1. _CNV_S_2_RANGE______74_CM 0. 1. /end CHARACTERISTIC
/begin MEASUREMENT PRS_UP_THR "Pressure upstream the throttle" UWORD _CNV_A_R_LINEAR_____1_CM 1 100. 0. 5434. ECU_ADDRESS 0x3fcd80 FORMAT "%7.2" /end MEASUREMENT
/begin MEASUREMENT PRS_UP_THR_MAX "Maximum pressure upstream the throttle" UWORD _CNV_A_R_LINEAR_____1_CM 1 100. 0. 5434. ECU_ADDRESS 0x3fcd82 FORMAT "%7.2" /end MEASUREMENT
/begin AXIS_PTS ldpm_n_32_ar_red "" 0x60f9d N_32 _REC_AXS_20_u1 816. _CNV_A_R_LINEAR_____15_CM 6 0. 8160. FORMAT "%4.0" /end AXIS_PTS
/begin MEASUREMENT MAP "Manifold air pressure" UWORD _CNV_A_R_LINEAR_____1_CM 1 100. 0. 5434. ECU_ADDRESS 0x3fccfa FORMAT "%7.2" /end MEASUREMENT
/begin AXIS_PTS ldp_maf_kgh_mes_bas "" 0x61128 MAF_KGH_MES_BAS _REC_AXS_20_u2 2047.96875 _CNV_A_R_LINEAR_____52_CM 16 0. 2047.96875 FORMAT "%7.2" /end AXIS_PTS
/begin CHARACTERISTIC C_MAF_MMV_DIF_CRLC "MAF moving mean value filtering factor" VALUE 0x63ef4 _REC_VAL_20_u1 9.960940000000002e-002 _CNV_A_R_LINEAR_____8_CM 0. 0.996094 FORMAT "%5.3" /end CHARACTERISTIC
/begin CHARACTERISTIC C_MAF_MMV_HYS "Threshold for detecting raising MAF_MMV" VALUE 0x642ee _REC_VAL_20_u2 694.5 _CNV_A_R_LINEAR_____303_CM 0. 694.5 FORMAT "%6.2" /end CHARACTERISTIC
/begin MEASUREMENT MAF_FAC_SLOP_EGR "Slope of the air flow equation for the EGR mass air flow" UWORD _CNV_A_R_LINEAR_____285_CM 1 100. 0. 8.880330000000001 ECU_ADDRESS 0x3fcce8 FORMAT "%5.4" /end MEASUREMENT
/begin MEASUREMENT MAF_KGH_MES "Mass air flow per segment measured" UWORD _CNV_A_R_LINEAR_____52_CM 1 100. 0. 2047.96875 ECU_ADDRESS 0x3fccd2 FORMAT "%7.2" /end MEASUREMENT
/begin MEASUREMENT EFF_VOL_COR "temperature correction of the volumetric efficiency (typical range 0,9 ... 1,1)" UWORD _CNV_A_R_LINEAR_____5_CM 1 100. 0. 1.99996948 ECU_ADDRESS 0x3fcd8e FORMAT "%7.5" /end MEASUREMENT
/begin MEASUREMENT EFF_VOL_COR_MMV "filtered volumetric efficiency correction" UWORD _CNV_A_R_LINEAR_____5_CM 1 100. 0. 1.99996948 ECU_ADDRESS 0x3fcd90 FORMAT "%7.5" /end MEASUREMENT
/begin AXIS_PTS ldpm_n_32__eff_vol_cor "" 0x61186 N_32 _REC_AXS_20_u1 8160. _CNV_A_R_LINEAR_____15_CM 8 0. 8160. FORMAT "%4.0" /end AXIS_PTS
/begin AXIS_PTS ldpm_maf__eff_vol_cor "" 0x61190 MAF _REC_AXS_20_u2 1389. _CNV_A_R_LINEAR_____56_CM 8 0. 1389. FORMAT "%7.2" /end AXIS_PTS
/begin AXIS_PTS ldp_n_32__crlc_eff_vol_cor "" 0x611a2 N_32 _REC_AXS_20_u1 8160. _CNV_A_R_LINEAR_____15_CM 6 0. 8160. FORMAT "%4.0" /end AXIS_PTS
/begin CHARACTERISTIC IP_EFF_TCO_FAC__N_32__MAF "Volumetric efficiency weighting factor versus cooling temperature" MAP 0x63c7c _REC_MAP_20_u1_u1_u2 0.9960940000000002 _CNV_A_R_LINEAR_____8_CM 0. 0.996094 FORMAT "%5.3"
 /begin AXIS_DESCR COM_AXIS N_32 _CNV_A_R_LINEAR_____15_CM 8 0. 8160. FORMAT "%4.0" AXIS_PTS_REF ldpm_n_32__eff_vol_cor /end AXIS_DESCR
 /begin AXIS_DESCR COM_AXIS MAF _CNV_A_R_LINEAR_____56_CM 8 0. 1389. FORMAT "%7.2" AXIS_PTS_REF ldpm_maf__eff_vol_cor /end AXIS_DESCR
/end CHARACTERISTIC
/begin CHARACTERISTIC IP_CRLC_EFF_VOL_COR__N_32 "Volumetric efficiency filtering" CURVE 0x64333 _REC_CUR_20_u1_u1 0.9960940000000002 _CNV_A_R_LINEAR_____8_CM 0. 0.996094 FORMAT "%5.3"
 /begin AXIS_DESCR COM_AXIS N_32 _CNV_A_R_LINEAR_____15_CM 6 0. 8160. FORMAT "%4.0" AXIS_PTS_REF ldp_n_32__crlc_eff_vol_cor /end AXIS_DESCR
/end CHARACTERISTIC
/begin CHARACTERISTIC C_TCYL_STND "standard temperature in cylinder" VALUE 0x64339 _REC_VAL_20_u1 28.575 _CNV_A_R_LINEAR_____22_CM -48. 142.5 FORMAT "%5.1" /end CHARACTERISTIC
/begin CHARACTERISTIC C_TCO_STND "standard coolant temperature" VALUE 0x6433a _REC_VAL_20_u1 28.575 _CNV_A_R_LINEAR_____22_CM -48. 142.5 FORMAT "%5.1" /end CHARACTERISTIC
/begin CHARACTERISTIC C_TIA_IM_STND "standard intake air temperature" VALUE 0x6433b _REC_VAL_20_u1 28.575 _CNV_A_R_LINEAR_____22_CM -48. 142.5 FORMAT "%5.1" /end CHARACTERISTIC
/begin CHARACTERISTIC IP_EFF_TIA_IM_FAC__N_32__MAF "Volumetric effiency weighting factor versus intake manifold gas temperature" MAP 0x642f3 _REC_MAP_20_u1_u1_u2 0.9960940000000002 _CNV_A_R_LINEAR_____8_CM 0. 0.996094 FORMAT "%5.3"
 /begin AXIS_DESCR COM_AXIS N_32 _CNV_A_R_LINEAR_____15_CM 8 0. 8160. FORMAT "%4.0" AXIS_PTS_REF ldpm_n_32__eff_vol_cor /end AXIS_DESCR
 /begin AXIS_DESCR COM_AXIS MAF _CNV_A_R_LINEAR_____56_CM 8 0. 1389. FORMAT "%7.2" AXIS_PTS_REF ldpm_maf__eff_vol_cor /end AXIS_DESCR
/end CHARACTERISTIC
/begin MEASUREMENT CTR_ERR_DYN_NR "" UBYTE _CNV_A_R_LINEAR_____13_CM 1 100. 0. 255. ECU_ADDRESS 0x3fd619 FORMAT "%3.0" /end MEASUREMENT
/begin MEASUREMENT CTR_ERR_HIS_NR "Number of failures in the history memory" UBYTE _CNV_A_R_LINEAR_____13_CM 1 100. 0. 255. ECU_ADDRESS 0x3fd7c2 FORMAT "%3.0" /end MEASUREMENT
/begin CHARACTERISTIC LC_CLR_HIS_FMY "Clearing the history memory" VALUE 0x69df8 _REC_VAL_20_u1 1. _CNV_A_R_LINEAR_____17_CM 0. 1. FORMAT "%2.0" /end CHARACTERISTIC
/begin MEASUREMENT ERR_DTC_CUS_HIS_0 "Memorised specific customer code of the failure N in the history memory" UWORD _CNV_A_R_LINEAR_____17_CM 1 100. 0. 65535. ECU_ADDRESS 0x3fd74a FORMAT "%5.0" /end MEASUREMENT
/begin MEASUREMENT ERR_DTC_CUS_HIS_1 "Memorised specific customer code of the failure N in the history memory" UWORD _CNV_A_R_LINEAR_____17_CM 1 100. 0. 65535. ECU_ADDRESS 0x3fd756 FORMAT "%5.0" /end MEASUREMENT
/begin MEASUREMENT ERR_DTC_CUS_HIS_2 "Memorised specific customer code of the failure N in the history memory" UWORD _CNV_A_R_LINEAR_____17_CM 1 100. 0. 65535. ECU_ADDRESS 0x3fd762 FORMAT "%5.0" /end MEASUREMENT
/begin MEASUREMENT ERR_DTC_CUS_HIS_3 "Memorised specific customer code of the failure N in the history memory" UWORD _CNV_A_R_LINEAR_____17_CM 1 100. 0. 65535. ECU_ADDRESS 0x3fd76e FORMAT "%5.0" /end MEASUREMENT
/begin MEASUREMENT ERR_DTC_CUS_HIS_4 "Memorised specific customer code of the failure N in the history memory" UWORD _CNV_A_R_LINEAR_____17_CM 1 100. 0. 65535. ECU_ADDRESS 0x3fd77a FORMAT "%5.0" /end MEASUREMENT
/begin MEASUREMENT ERR_DTC_CUS_HIS_5 "Memorised specific customer code of the failure N in the history memory" UWORD _CNV_A_R_LINEAR_____17_CM 1 100. 0. 65535. ECU_ADDRESS 0x3fd786 FORMAT "%5.0" /end MEASUREMENT
/begin MEASUREMENT ERR_DTC_CUS_HIS_6 "Memorised specific customer code of the failure N in the history memory" UWORD _CNV_A_R_LINEAR_____17_CM 1 100. 0. 65535. ECU_ADDRESS 0x3fd792 FORMAT "%5.0" /end MEASUREMENT
/begin MEASUREMENT ERR_DTC_CUS_HIS_7 "Memorised specific customer code of the failure N in the history memory" UWORD _CNV_A_R_LINEAR_____17_CM 1 100. 0. 65535. ECU_ADDRESS 0x3fd79e FORMAT "%5.0" /end MEASUREMENT
/begin MEASUREMENT ERR_DTC_CUS_HIS_8 "Memorised specific customer code of the failure N in the history memory" UWORD _CNV_A_R_LINEAR_____17_CM 1 100. 0. 65535. ECU_ADDRESS 0x3fd7aa FORMAT "%5.0" /end MEASUREMENT
/begin MEASUREMENT ERR_DTC_CUS_HIS_9 "Memorised specific customer code of the failure N in the history memory" UWORD _CNV_A_R_LINEAR_____17_CM 1 100. 0. 65535. ECU_ADDRESS 0x3fd7b6 FORMAT "%5.0" /end MEASUREMENT
/begin MEASUREMENT MAF_ISA_FAC_OFS "offset of the air flow equation for the throttle air mass flow for ISA" UWORD _CNV_A_R_LINEAR_____285_CM 1 100. 0. 8.880330000000001 ECU_ADDRESS 0x3fcd0c FORMAT "%5.4" /end MEASUREMENT
/begin MEASUREMENT MAF_ISA_FAC_SLOP "slope of the air flow equation for the throttle air mass flow for ISA" UWORD _CNV_A_R_LINEAR_____285_CM 1 100. 0. 8.880330000000001 ECU_ADDRESS 0x3fcd0e FORMAT "%5.4" /end MEASUREMENT
/begin MEASUREMENT MAF_THR_ISA_TOT "total air mass flow at the throttle and ISA valve" UWORD _CNV_A_R_LINEAR_____52_CM 1 100. 0. 2047.96875 ECU_ADDRESS 0x3fcd12 FORMAT "%7.2" /end MEASUREMENT
/begin MEASUREMENT MAF_ISA "air mass flow at the ISA valve" UWORD _CNV_A_R_LINEAR_____52_CM 1 100. 0. 2047.96875 ECU_ADDRESS 0x3fcd10 FORMAT "%7.2" /end MEASUREMENT
/begin COMPU_METHOD _CNV_A_R_LINEAR_____0_CM "" RAT_FUNC "%6.3" "rpm" COEFFS 0 1. 0. 0 0 1 /end COMPU_METHOD
/begin COMPU_METHOD _CNV_A_R_LINEAR_____1_CM "" RAT_FUNC "%6.3" "hPa" COEFFS 0 12.06017666543982 0. 0 0 1 /end COMPU_METHOD
/begin COMPU_METHOD _CNV_A_R_LINEAR_____2_CM "" RAT_FUNC "%6.3" "-" COEFFS 0 65536.00007936121 0. 0 0 1 /end COMPU_METHOD
/begin COMPU_METHOD _CNV_A_R_LINEAR_____3_CM "" RAT_FUNC "%6.3" "ms" COEFFS 0 0.1 0. 0 0 1 /end COMPU_METHOD
/begin COMPU_METHOD _CNV_A_R_LINEAR_____5_CM "" RAT_FUNC "%6.3" "-" COEFFS 0 32768.00003968061 0. 0 0 1 /end COMPU_METHOD
/begin COMPU_METHOD _CNV_A_R_LINEAR_____6_CM "" RAT_FUNC "%6.3" "°CRK" COEFFS 0 2.666666666666667 0. 0 0 1 /end COMPU_METHOD
/begin COMPU_METHOD _CNV_A_R_LINEAR_____7_CM "" RAT_FUNC "%6.3" "Nm/rpm*rpm" COEFFS 0 134216023.5930204 -0.5 0 0 1 /end COMPU_METHOD
/begin COMPU_METHOD _CNV_A_R_LINEAR_____8_CM "" RAT_FUNC "%6.3" "[-]" COEFFS 0 255.9999357490357 0. 0 0 1 /end COMPU_METHOD
/begin COMPU_METHOD _CNV_A_R_LINEAR_____13_CM "" RAT_FUNC "%6.3" "[-]" COEFFS 0 1. 0. 0 0 1 /end COMPU_METHOD
/begin COMPU_METHOD _CNV_A_R_LINEAR_____14_CM "" RAT_FUNC "%6.3" "rpm/s" COEFFS 0 3.125e-002 0. 0 0 1 /end COMPU_METHOD
/begin COMPU_METHOD _CNV_A_R_LINEAR_____15_CM "" RAT_FUNC "%6.3" "rpm" COEFFS 0 3.125e-002 0. 0 0 1 /end COMPU_METHOD
/begin COMPU_METHOD _CNV_A_R_LINEAR_____16_CM "" RAT_FUNC "%6.3" "%" COEFFS 0 2.56 0. 0 0 1 /end COMPU_METHOD
/begin COMPU_METHOD _CNV_A_R_LINEAR_____17_CM "" RAT_FUNC "%6.3" "-" COEFFS 0 1. 0. 0 0 1 /end COMPU_METHOD
/begin COMPU_METHOD _CNV_A_R_LINEAR_____18_CM "" RAT_FUNC "%6.3" "s" COEFFS 0 10. 0. 0 0 1 /end COMPU_METHOD
/begin COMPU_METHOD _CNV_A_R_LINEAR_____20_CM "" RAT_FUNC "%6.3" "s" COEFFS 0 1. 0. 0 0 1 /end COMPU_METHOD
/begin COMPU_METHOD _CNV_A_R_LINEAR_____21_CM "" RAT_FUNC "%6.3" "s" COEFFS 0 100. 0. 0 0 1 /end COMPU_METHOD
/begin COMPU_METHOD _CNV_A_R_LINEAR_____22_CM "" RAT_FUNC "%6.3" "°C" COEFFS 0 1.333333333333333 64. 0 0 1 /end COMPU_METHOD
/begin COMPU_METHOD _CNV_A_R_LINEAR_____24_CM "" RAT_FUNC "%6.3" "ms" COEFFS 0 250. 0. 0 0 1 /end COMPU_METHOD
/begin COMPU_METHOD _CNV_A_R_LINEAR_____25_CM "" RAT_FUNC "%6.3" "°C" COEFFS 0 64. 0. 0 0 1 /end COMPU_METHOD
/begin COMPU_METHOD _CNV_A_R_LINEAR_____26_CM "" RAT_FUNC "%6.3" "°C" COEFFS 0 0.25 8.25 0 0 1 /end COMPU_METHOD
/begin COMPU_METHOD _CNV_A_R_LINEAR_____29_CM "" RAT_FUNC "%6.3" "°C/500ms" COEFFS 0 1.333333333333333 0. 0 0 1 /end COMPU_METHOD
/begin COMPU_METHOD _CNV_A_R_LINEAR_____37_CM "" RAT_FUNC "%6.3" "Nm" COEFFS 0 32. 0. 0 0 1 /end COMPU_METHOD
/begin COMPU_METHOD _CNV_A_R_LINEAR_____38_CM "" RAT_FUNC "%6.3" "V" COEFFS 0 204.7999998974999 0. 0 0 1 /end COMPU_METHOD
/begin COMPU_METHOD _CNV_A_R_LINEAR_____39_CM "" RAT_FUNC "%6.3" "V" COEFFS 0 204.7999995887937 0. 0 0 1 /end COMPU_METHOD
/begin COMPU_METHOD _CNV_A_R_LINEAR_____40_CM "" RAT_FUNC "%6.3" "V" COEFFS 0 51.2 0. 0 0 1 /end COMPU_METHOD
/begin COMPU_METHOD _CNV_A_R_LINEAR_____42_CM "" RAT_FUNC "%6.3" "V" COEFFS 0 9.846168103048838 0. 0 0 1 /end COMPU_METHOD
/begin COMPU_METHOD _CNV_A_R_LINEAR_____43_CM "" RAT_FUNC "%6.3" "km/h" COEFFS 0 1. 0. 0 0 1 /end COMPU_METHOD
/begin COMPU_METHOD _CNV_A_R_LINEAR_____52_CM "" RAT_FUNC "%6.3" "kg/h" COEFFS 0 32. 0. 0 0 1 /end COMPU_METHOD
/begin COMPU_METHOD _CNV_A_R_LINEAR_____53_CM "" RAT_FUNC "%6.3" "rpm" COEFFS 0 1. 32768. 0 0 1 /end COMPU_METHOD
/begin COMPU_METHOD _CNV_A_R_LINEAR_____54_CM "" RAT_FUNC "%6.3" "rpm/s" COEFFS 0 3.125e-002 128. 0 0 1 /end COMPU_METHOD
/begin COMPU_METHOD _CNV_A_R_LINEAR_____56_CM "" RAT_FUNC "%6.3" "mg/stk" COEFFS 0 47.18142548596112 0. 0 0 1 /end COMPU_METHOD
/begin COMPU_METHOD _CNV_A_R_LINEAR_____64_CM "" RAT_FUNC "%6.3" "-" COEFFS 0 127.9991955827809 0. 0 0 1 /end COMPU_METHOD
/begin COMPU_METHOD _CNV_A_R_LINEAR_____65_CM "" RAT_FUNC "%6.3" "Nm" COEFFS 0 32. 32768. 0 0 1 /end COMPU_METHOD
/begin COMPU_METHOD _CNV_A_R_LINEAR_____66_CM "" RAT_FUNC "%6.3" "°C/10s" COEFFS 0 1.333333333333333 0. 0 0 1 /end COMPU_METHOD
/begin COMPU_METHOD _CNV_A_R_LINEAR_____67_CM "" RAT_FUNC "%6.3" "[-]" COEFFS 0 128. 0. 0 0 1 /end COMPU_METHOD
/begin COMPU_METHOD _CNV_A_R_LINEAR_____68_CM "" RAT_FUNC "%6.3" "-" COEFFS 0 255.9983911655618 0. 0 0 1 /end COMPU_METHOD
/begin COMPU_METHOD _CNV_A_R_LINEAR_____70_CM "" RAT_FUNC "%6.3" "-" COEFFS 0 63.60176282051283 0. 0 0 1 /end COMPU_METHOD
/begin COMPU_METHOD _CNV_A_R_LINEAR_____71_CM "" RAT_FUNC "%6.3" "Nm" COEFFS 0 8191.999999679995 32767.99999871998 0 0 1 /end COMPU_METHOD
/begin COMPU_METHOD _CNV_A_R_LINEAR_____73_CM "" RAT_FUNC "%6.3" "Nm/rpm*rpm" COEFFS 0 134213975.5877775 -1. 0 0 1 /end COMPU_METHOD
/begin COMPU_METHOD _CNV_S_2_RANGE______74_CM "" TAB_VERB "%6.3" "[-]" COMPU_TAB_REF _CNV_S_2_RANGE______74 /end COMPU_METHOD
/begin COMPU_VTAB _CNV_S_2_RANGE______74 "" TAB_VERB 2 0 "0" 1 "1" /end COMPU_VTAB
/begin COMPU_METHOD _CNV_S_2_RANGE______76_CM "" TAB_VERB "%6.3" "-" COMPU_TAB_REF _CNV_S_2_RANGE______76 /end COMPU_METHOD
/begin COMPU_VTAB _CNV_S_2_RANGE______76 "" TAB_VERB 2 0 "0" 1 "1" /end COMPU_VTAB
/begin COMPU_METHOD _CNV_S_2_RANGE______77_R_CM "" TAB_VERB "%6.3" "[-]" COMPU_TAB_REF _CNV_S_2_RANGE______77_R /end COMPU_METHOD
/begin COMPU_VTAB_RANGE _CNV_S_2_RANGE______77_R "" 2 0 0 "0" 1 255 "1" /end COMPU_VTAB_RANGE
/begin COMPU_METHOD _CNV_A_R_LINEAR_____80_CM "" RAT_FUNC "%6.3" "s" COEFFS 0 32. 0. 0 0 1 /end COMPU_METHOD
/begin COMPU_METHOD _CNV_A_R_LINEAR_____82_CM "" RAT_FUNC "%6.3" "Nm" COEFFS 0 2097152.000003239 3.316402435302734e-003 0 0 1 /end COMPU_METHOD
/begin COMPU_METHOD _CNV_A_R_LINEAR_____94_CM "" RAT_FUNC "%6.3" "°C" COEFFS 0 16. 0. 0 0 1 /end COMPU_METHOD
/begin COMPU_METHOD _CNV_A_R_LINEAR_____95_CM "" RAT_FUNC "%6.3" "°C" COEFFS 0 64. 2112. 0 0 1 /end COMPU_METHOD
/begin COMPU_METHOD _CNV_A_R_LINEAR_____98_CM "" RAT_FUNC "%6.3" "g" COEFFS 0 36.00036915004301 0. 0 0 1 /end COMPU_METHOD
/begin COMPU_METHOD _CNV_A_R_LINEAR_____99_CM "" RAT_FUNC "%6.3" "V" COEFFS 0 13107.19998965744 0. 0 0 1 /end COMPU_METHOD
/begin COMPU_METHOD _CNV_A_R_LINEAR_____104_CM "" RAT_FUNC "%6.3" "-" COEFFS 0 8191.999999679995 0. 0 0 1 /end COMPU_METHOD
/begin COMPU_METHOD _CNV_A_R_LINEAR_____110_CM "" RAT_FUNC "%6.3" "°C" COEFFS 0 15.99975585564965 0. 0 0 1 /end COMPU_METHOD
/begin COMPU_METHOD _CNV_A_R_LINEAR_____113_CM "" RAT_FUNC "%6.3" "[-]" COEFFS 0 64. 0. 0 0 1 /end COMPU_METHOD
/begin COMPU_METHOD _CNV_A_R_LINEAR_____117_CM "" RAT_FUNC "%6.3" "°CRK" COEFFS 0 42.66666666666666 0. 0 0 1 /end COMPU_METHOD
/begin COMPU_METHOD _CNV_A_R_LINEAR_____118_CM "" RAT_FUNC "%6.3" "-" COEFFS 0 32. 0. 0 0 1 /end COMPU_METHOD
/begin COMPU_METHOD _CNV_S_3_STATE_REQ__135_CM "" TAB_VERB "%6.3" "[-]" COMPU_TAB_REF _CNV_S_3_STATE_REQ__135 /end COMPU_METHOD
/begin COMPU_VTAB _CNV_S_3_STATE_REQ__135 "" TAB_VERB 3 0 "ISC_request_Case_0" 1 "ISC_request_Case_1" 2 "ISC_request_Case_2" /end COMPU_VTAB
/begin COMPU_METHOD _CNV_A_R_LINEAR_____136_CM "" RAT_FUNC "%6.3" "s" COEFFS 0 255.9999357490357 0. 0 0 1 /end COMPU_METHOD
/begin COMPU_METHOD _CNV_A_R_LINEAR_____137_CM "" RAT_FUNC "%6.3" "1/rpm²" COEFFS 0 134293032.7868853 0. 0 0 1 /end COMPU_METHOD
/begin COMPU_METHOD _CNV_A_R_LINEAR_____144_CM "" RAT_FUNC "%6.3" "%" COEFFS 0 655.3600000071681 0. 0 0 1 /end COMPU_METHOD
/begin COMPU_METHOD _CNV_A_R_LINEAR_____147_CM "" RAT_FUNC "%6.3" "[-]" COEFFS 0 5434.241818163727 0. 0 0 1 /end COMPU_METHOD
/begin COMPU_METHOD _CNV_A_R_LINEAR_____152_CM "" RAT_FUNC "%6.3" "ms" COEFFS 0 125. 0. 0 0 1 /end COMPU_METHOD
/begin COMPU_METHOD _CNV_A_R_LINEAR_____153_CM "" RAT_FUNC "%6.3" "km/h" COEFFS 0 128.0000018750286 0. 0 0 1 /end COMPU_METHOD
/begin COMPU_METHOD _CNV_A_R_LINEAR_____154_CM "" RAT_FUNC "%6.3" "(km/h)/10ms" COEFFS 0 128. 0. 0 0 1 /end COMPU_METHOD
/begin COMPU_METHOD _CNV_A_R_LINEAR_____157_CM "" RAT_FUNC "%6.3" "V" COEFFS 0 8.854166666666666 0. 0 0 1 /end COMPU_METHOD
/begin COMPU_METHOD _CNV_A_R_LINEAR_____163_CM "" RAT_FUNC "%6.3" "ohm" COEFFS 0 1. 0. 0 0 1 /end COMPU_METHOD
/begin COMPU_METHOD _CNV_A_R_LINEAR_____165_CM "" RAT_FUNC "%6.3" "µs" COEFFS 0 1. 0. 0 0 1 /end COMPU_METHOD
/begin COMPU_METHOD _CNV_A_R_LINEAR_____169_CM "" RAT_FUNC "%6.3" "m" COEFFS 0 57600021.97266463 0. 0 0 1 /end COMPU_METHOD
/begin COMPU_METHOD _CNV_A_R_LINEAR_____172_CM "" RAT_FUNC "%6.3" "%/V" COEFFS 0 3.2 0. 0 0 1 /end COMPU_METHOD
/begin COMPU_METHOD _CNV_A_R_LINEAR_____173_CM "" RAT_FUNC "%6.3" "rpm" COEFFS 0 4. 0. 0 0 1 /end COMPU_METHOD
/begin COMPU_METHOD _CNV_A_R_LINEAR_____174_CM "" RAT_FUNC "%6.3" "rpm/10ms" COEFFS 0 4. 0. 0 0 1 /end COMPU_METHOD
/begin COMPU_METHOD _CNV_A_R_LINEAR_____195_CM "" RAT_FUNC "%6.3" "V" COEFFS 0 9.845031905195988 0. 0 0 1 /end COMPU_METHOD
/begin COMPU_METHOD _CNV_A_R_LINEAR_____196_CM "" RAT_FUNC "%6.3" "V" COEFFS 0 204.7999998958713 8.135057072422569e-009 0 0 1 /end COMPU_METHOD
/begin COMPU_METHOD _CNV_S_2_RANGE______202_CM "" TAB_VERB "%6.3" "[-]" COMPU_TAB_REF _CNV_S_2_RANGE______202 /end COMPU_METHOD
/begin COMPU_VTAB _CNV_S_2_RANGE______202 "" TAB_VERB 2 0 "PASSIVE" 1 "ACTIVE" /end COMPU_VTAB
/begin COMPU_METHOD _CNV_A_R_LINEAR_____207_CM "" RAT_FUNC "%6.3" "[-]" COEFFS 0 65408. 0. 0 0 1 /end COMPU_METHOD
/begin COMPU_METHOD _CNV_A_R_LINEAR_____208_CM "" RAT_FUNC "%6.3" "µs" COEFFS 0 1. 65536. 0 0 1 /end COMPU_METHOD
/begin COMPU_METHOD _CNV_A_R_LINEAR_____209_CM "" RAT_FUNC "%6.3" "[-]" COEFFS 0 50. 0. 0 0 1 /end COMPU_METHOD
/begin COMPU_METHOD _CNV_A_R_LINEAR_____210_CM "" RAT_FUNC "%6.3" "µs" COEFFS 0 0.125 0. 0 0 1 /end COMPU_METHOD
/begin COMPU_METHOD _CNV_A_R_LINEAR_____211_CM "" RAT_FUNC "%6.3" "%." COEFFS 0 65.5359830397456 0. 0 0 1 /end COMPU_METHOD
/begin COMPU_METHOD _CNV_A_R_LINEAR_____214_CM "" RAT_FUNC "%6.3" "%." COEFFS 0 65.77254901960784 0. 0 0 1 /end COMPU_METHOD
/begin COMPU_METHOD _CNV_A_R_LINEAR_____215_CM "" RAT_FUNC "%6.3" "cyl" COEFFS 0 1. 0. 0 0 1 /end COMPU_METHOD
/begin COMPU_METHOD _CNV_A_R_LINEAR_____242_CM "" RAT_FUNC "%6.3" "ms" COEFFS 0 51.20321900148448 0. 0 0 1 /end COMPU_METHOD
/begin COMPU_METHOD _CNV_A_R_LINEAR_____250_CM "" RAT_FUNC "%6.3" "-" COEFFS 0 1024. 0. 0 0 1 /end COMPU_METHOD
/begin COMPU_METHOD _CNV_A_R_LINEAR_____251_CM "" RAT_FUNC "%6.3" "s" COEFFS 0 1000. 0. 0 0 1 /end COMPU_METHOD
/begin COMPU_METHOD _CNV_A_R_LINEAR_____252_CM "" RAT_FUNC "%6.3" "V/10ms" COEFFS 0 13107.26214524291 0.1553631072602002 0 0 1 /end COMPU_METHOD
/begin COMPU_METHOD _CNV_A_R_LINEAR_____253_CM "" RAT_FUNC "%6.3" "1/s" COEFFS 0 255.9983911655618 0. 0 0 1 /end COMPU_METHOD
/begin COMPU_METHOD _CNV_A_R_LINEAR_____256_CM "" RAT_FUNC "%6.3" "V/10ms" COEFFS 0 13107.20001587224 0. 0 0 1 /end COMPU_METHOD
/begin COMPU_METHOD _CNV_A_R_LINEAR_____257_CM "" RAT_FUNC "%6.3" "-" COEFFS 0 5. 0. 0 0 1 /end COMPU_METHOD
/begin COMPU_METHOD _CNV_A_R_LINEAR_____258_CM "" RAT_FUNC "%6.3" "-" COEFFS 0 20. 0. 0 0 1 /end COMPU_METHOD
/begin COMPU_METHOD _CNV_A_R_LINEAR_____260_CM "" RAT_FUNC "%6.3" "°C" COEFFS 0 15.99999804684544 -4.000060547696194e-003 0 0 1 /end COMPU_METHOD
/begin COMPU_METHOD _CNV_A_R_LINEAR_____262_CM "" RAT_FUNC "%6.3" "V" COEFFS 0 200. 0. 0 0 1 /end COMPU_METHOD
/begin COMPU_METHOD _CNV_A_R_LINEAR_____283_CM "" RAT_FUNC "%6.3" "hPa/ms" COEFFS 0 395.1938017499002 -7.983716819580877e-003 0 0 1 /end COMPU_METHOD
/begin COMPU_METHOD _CNV_A_R_LINEAR_____284_CM "" RAT_FUNC "%6.3" "s/m" COEFFS 0 3181017.284813537 0. 0 0 1 /end COMPU_METHOD
/begin COMPU_METHOD _CNV_A_R_LINEAR_____285_CM "" RAT_FUNC "%6.3" "-" COEFFS 0 7379.793318491542 0. 0 0 1 /end COMPU_METHOD
/begin COMPU_METHOD _CNV_A_R_LINEAR_____287_CM "" RAT_FUNC "%6.3" "N/(kg*K*m²)" COEFFS 0 0.2158257314340417 0. 0 0 1 /end COMPU_METHOD
/begin COMPU_METHOD _CNV_A_R_LINEAR_____297_CM "" RAT_FUNC "%6.3" "kg/(h*hPa)" COEFFS 0 5434.241818163727 0. 0 0 1 /end COMPU_METHOD
/begin COMPU_METHOD _CNV_A_R_LINEAR_____298_CM "" RAT_FUNC "%6.3" "kg/h" COEFFS 0 5434.980925526622 32767.5 0 0 1 /end COMPU_METHOD
/begin COMPU_METHOD _CNV_A_R_LINEAR_____299_CM "" RAT_FUNC "%6.3" "%" COEFFS 0 327.6800790412251 0. 0 0 1 /end COMPU_METHOD
/begin COMPU_METHOD _CNV_A_R_LINEAR_____302_CM "" RAT_FUNC "%6.3" "kg/h" COEFFS 0 32. 32768. 0 0 1 /end COMPU_METHOD
/begin COMPU_METHOD _CNV_A_R_LINEAR_____303_CM "" RAT_FUNC "%6.3" "mg/stk" COEFFS 0 47.18070554355651 0. 0 0 1 /end COMPU_METHOD
/begin RECORD_LAYOUT _REC_VAL_20_u2 FNC_VALUES 1 UWORD COLUMN_DIR DIRECT /end RECORD_LAYOUT
/begin RECORD_LAYOUT _REC_VAL_20_s2 FNC_VALUES 1 SWORD COLUMN_DIR DIRECT /end RECORD_LAYOUT
/begin RECORD_LAYOUT _REC_VAL_20_u1 FNC_VALUES 1 UBYTE COLUMN_DIR DIRECT /end RECORD_LAYOUT
/begin RECORD_LAYOUT _REC_AXS_20_u2 NO_AXIS_PTS_X 1 UWORD AXIS_PTS_X 2 UWORD INDEX_INCR DIRECT /end RECORD_LAYOUT
/begin RECORD_LAYOUT _REC_AXS_20_u1 NO_AXIS_PTS_X 1 UBYTE AXIS_PTS_X 2 UBYTE INDEX_INCR DIRECT /end RECORD_LAYOUT
/begin RECORD_LAYOUT _REC_CUR_20_u2_u2 FNC_VALUES 1 UWORD COLUMN_DIR DIRECT /end RECORD_LAYOUT
/begin RECORD_LAYOUT _REC_CUR_20_u2_u1 FNC_VALUES 1 UWORD COLUMN_DIR DIRECT /end RECORD_LAYOUT
/begin RECORD_LAYOUT _REC_CUR_20_u1_u1 FNC_VALUES 1 UBYTE COLUMN_DIR DIRECT /end RECORD_LAYOUT
/begin RECORD_LAYOUT _REC_CUR_20_u1_u2 FNC_VALUES 1 UBYTE COLUMN_DIR DIRECT /end RECORD_LAYOUT
/begin RECORD_LAYOUT _REC_MAP_20_u1_u1_u2 FNC_VALUES 1 UBYTE COLUMN_DIR DIRECT /end RECORD_LAYOUT
/begin RECORD_LAYOUT _REC_MAP_20_u2_u1_u1 FNC_VALUES 1 UWORD COLUMN_DIR DIRECT /end RECORD_LAYOUT
/begin RECORD_LAYOUT _REC_MAP_20_u2_u2_u1 FNC_VALUES 1 UWORD COLUMN_DIR DIRECT /end RECORD_LAYOUT
/begin RECORD_LAYOUT _REC_MAP_20_u2_u1_u2 FNC_VALUES 1 UWORD COLUMN_DIR DIRECT /end RECORD_LAYOUT
/begin RECORD_LAYOUT _REC_VAL_20_u4 FNC_VALUES 1 ULONG COLUMN_DIR DIRECT /end RECORD_LAYOUT
/begin RECORD_LAYOUT _REC_MAP_20_u2_u2_u2 FNC_VALUES 1 UWORD COLUMN_DIR DIRECT /end RECORD_LAYOUT
/begin FUNCTION INJ_Transformation_layer_for_bas "_Transformation layer for basic software" /begin DEF_CHARACTERISTIC C_TI_MIN_POST_PULSE LC_POST_PULS_INJ_ENA /end DEF_CHARACTERISTIC
 /begin OUT_MEASUREMENT BIOS_TI_OFS BIOS_TI_MIN_POST_PULSE_INJ BIOS_EOI_LIM BIOS_LV_POST_PULS_INJ BIOS_EOI_0 BIOS_EOI_1 BIOS_EOI_2 BIOS_EOI_3 BIOS_EOI_4 BIOS_EOI_5 /end OUT_MEASUREMENT
/end FUNCTION
/begin FUNCTION INJ_Upstream_oxygen_sensor_inter "_Upstream oxygen sensor internal resistance determination"
 /begin DEF_CHARACTERISTIC LC_INH_R_UP_LS_VLD C_TEMP_CUR_ON_LS_UP IP_FAC_T_DRV1_VLS_UP_MMV IP_FAC_T_DRV1_VLS_UP_ABS IP_TTIP_LS_UP /end DEF_CHARACTERISTIC
 /begin OUT_MEASUREMENT LV_VLS_NOT_VLD_UP_1 LV_VLS_NOT_VLD_UP_2 VLS_CUR_ON_VLS_UP_1 VLS_CUR_ON_VLS_UP_2 VLS_CUR_OFF_VLS_UP_2 VLS_CUR_OFF_VLS_UP_1 LV_INH_R_UP_LS_1 LV_R_UP_LS_DET_1 LV_R_UP_LS_DRV1_VLS_CDN_1 LV_R_UP_LS_ENA_1 LV_R_UP_LS_VLS_RNG_CDN_1 LV_VLS_NOT_VLD_UP_1 CTR_CYCNR_R_UP_LS_1 DRV1_VLS_UP_MMV_THD_MAX_1 DRV1_VLS_UP_MMV_THD_MIN_1 FAC_T_DRV1_VLS_UP_ABS_1 FAC_T_DRV1_VLS_UP_MMV_1 R_UP_LS_1 R_UP_LS_MES_1 T_SAMPLE_R_UP_LS_1 TTIP_LS_UP_MES_1 TTIP_LS_UP_MES_BOL_1 TTIP_LS_UP_MES_BOL_MMV_1 TTIP_LS_UP_MES_TOL_MMV_1 LV_INH_R_UP_LS_2 LV_R_UP_LS_DET_2 LV_R_UP_LS_DRV1_VLS_CDN_2 LV_R_UP_LS_ENA_2 LV_R_UP_LS_VLS_RNG_CDN_2 LV_VLS_NOT_VLD_UP_2 CTR_CYCNR_R_UP_LS_2 DRV1_VLS_UP_MMV_THD_MAX_2 DRV1_VLS_UP_MMV_THD_MIN_2 FAC_T_DRV1_VLS_UP_ABS_2 FAC_T_DRV1_VLS_UP_MMV_2 R_UP_LS_2 R_UP_LS_MES_2 T_SAMPLE_R_UP_LS_2 TTIP_LS_UP_MES_2 TTIP_LS_UP_MES_BOL_2 TTIP_LS_UP_MES_BOL_MMV_2 TTIP_LS_UP_MES_TOL_MMV_2 /end OUT_MEASUREMENT
/end FUNCTION
/begin FUNCTION INJ_Downstream_oxygen_sensor_int "_Downstream oxygen sensor internal resistance determination"
 /begin DEF_CHARACTERISTIC C_TEMP_CUR_ON_LS_DOWN C_T_CUR_ON_LS_DOWN C_T_CUR_OFF_LS_DOWN C_T_CUR_DLY_LS_DOWN C_VLS_MMV_MIN_RNG_TOL_LS_DOWN C_VLS_MMV_MIN_RNG_BOL_LS_DOWN C_DRV1_VLS_DOWN_MMV_THD_MIN C_DRV1_VLS_DOWN_MMV_THD_MAX C_DRV1_VLS_DOWN_MMV_ABS_MAX C_FAC_STK_DRV1_VLS_DOWN_MMV C_FAC_DRV1_VLS_DOWN_MMV_MIN C_DRV1_VLS_DOWN_ABS_MAX C_CTR_VLS_AFL_CYC_R_DOWN_LS C_MAF_KGH_R_DOWN_LS C_FAC_ERR_POS_R_DOWN_LS C_FAC_ERR_NEG_R_DOWN_LS C_CRLC_TTIP_FALL_R_DOWN_LS C_CRLC_TTIP_RISE_R_DOWN_LS LC_INH_R_DOWN_LS_VLD IP_FAC_T_DRV1_VLS_DOWN_ABS IP_TTIP_LS_DOWN IP_FAC_T_DRV1_VLS_DOWN_MMV /end DEF_CHARACTERISTIC
 /begin OUT_MEASUREMENT VLS_CUR_ON_VLS_DOWN_1 VLS_CUR_ON_VLS_DOWN_2 VLS_CUR_OFF_VLS_DOWN_2 VLS_CUR_OFF_VLS_DOWN_1 LV_VLS_NOT_VLD_DOWN_1 LV_VLS_NOT_VLD_DOWN_2 LV_R_DOWN_LS_DET_1 LV_R_DOWN_LS_DRV1_VLS_CDN_1 LV_R_DOWN_LS_ENA_1 LV_R_DOWN_LS_VLS_RNG_CDN_1 LV_VLS_NOT_VLD_DOWN_1 CTR_CYCNR_R_DOWN_LS_1 DRV1_VLS_DOWN_MMV_THD_MAX_1 DRV1_VLS_DOWN_MMV_THD_MIN_1 FAC_T_DRV1_VLS_DOWN_ABS_1 FAC_T_DRV1_VLS_DOWN_MMV_1 R_DOWN_LS_MES_1 T_SAMPLE_R_DOWN_LS_1 T_VLS_CYC_AFL_HLD_R_DOWN_LS_1 TTIP_LS_DOWN_MES_1 TTIP_LS_DOWN_MES_BOL_1 TTIP_LS_DOWN_MES_BOL_MMV_1 TTIP_LS_DOWN_MES_TOL_1 TTIP_LS_DOWN_MES_TOL_MMV_1 TTIP_LS_UP_MES_TOL_1 LV_R_DOWN_LS_DET_2 LV_R_DOWN_LS_DRV1_VLS_CDN_2 LV_R_DOWN_LS_ENA_2 LV_R_DOWN_LS_VLS_RNG_CDN_2 LV_VLS_NOT_VLD_DOWN_2 CTR_CYCNR_R_DOWN_LS_2 DRV1_VLS_DOWN_MMV_THD_MAX_2 DRV1_VLS_DOWN_MMV_THD_MIN_2 FAC_T_DRV1_VLS_DOWN_ABS_2 FAC_T_DRV1_VLS_DOWN_MMV_2 R_DOWN_LS_MES_2 T_SAMPLE_R_DOWN_LS_2 T_VLS_CYC_AFL_HLD_R_DOWN_LS_2 TTIP_LS_DOWN_MES_2 TTIP_LS_DOWN_MES_BOL_2 TTIP_LS_DOWN_MES_BOL_MMV_2 TTIP_LS_DOWN_MES_TOL_2 TTIP_LS_DOWN_MES_TOL_MMV_2 TTIP_LS_UP_MES_TOL_2 /end OUT_MEASUREMENT
/end FUNCTION
/begin FUNCTION INJ_Cat_enrichment_fct_after_puc "_Cat enrichment fct after puc"
 /begin DEF_CHARACTERISTIC C_TCO_MIN_CAT_PURGE_PUC C_T_DLY_VLS_DOWN_ACT_PUC C_MAF_INT_MAX_CAT_PURGE C_MAF_MAX_CAT_PURGE C_VLS_DOWN_MAX_CAT_PURGE_ C_TCO_MIN_MAIN_CAT_PURGE C_DELTA_LAMB_SP_PUC_DEC IP_MAF_INT_CAT_PURGE_MAX IP_FAC_CAT_EFF_PUC IP_DELTA_LAMB_SP_PUC C_T_MIN_PUC_CAT_PURGE IP_FAC_PCAT_MAIN_CAT_PUC /end DEF_CHARACTERISTIC
 /begin OUT_MEASUREMENT LV_ACT_INT_PUC_1 LV_ACT_CAT_PURGE_MAIN_PUC_1 LV_ACT_CAT_PURGE_PUC_1 T_DLY_PUC_1 MAF_INT_CAT_PURGE_1 MAF_INT_CAT_LOAD_1 MAF_INT_CAT_LOAD_MAIN_1 DELTA_LAMB_SP_PUC_1 LV_ACT_INT_PUC_2 LV_ACT_CAT_PURGE_MAIN_PUC_2 LV_ACT_CAT_PURGE_PUC_2 T_DLY_PUC_2 MAF_INT_CAT_PURGE_2 MAF_INT_CAT_LOAD_2 MAF_INT_CAT_LOAD_MAIN_2 DELTA_LAMB_SP_PUC_2 MAF_INT_PUC /end OUT_MEASUREMENT
/end FUNCTION
/begin FUNCTION INJ_Cat_enrichment_fct_after_ch_ "_Cat enrichment fct after ch or sa"
 /begin DEF_CHARACTERISTIC C_T_MAX_WAIT_SA C_MAF_INT_LSCL_DLY_SA C_MAF_INT_MAX_CAT_LOAD_CH IP_FAC_PCAT_MAIN_CAT_HC /end DEF_CHARACTERISTIC
 /begin OUT_MEASUREMENT LV_CAT_PURGE_SA_1 LV_MAF_INT_LSCL_DLY_SA_1 LV_ACT_CAT_PURGE_MAIN_CH_1 LV_ACT_CAT_PURGE_CH_1 MAF_INT_CAT_LOAD_CH_1 MAF_INT_CAT_LOAD_MAIN_CH_1 MAF_INT_LSCL_DLY_SA_1 LV_CAT_PURGE_SA_2 LV_MAF_INT_LSCL_DLY_SA_2 LV_ACT_CAT_PURGE_MAIN_CH_2 LV_ACT_CAT_PURGE_CH_2 MAF_INT_CAT_LOAD_CH_2 MAF_INT_CAT_LOAD_MAIN_CH_2 MAF_INT_LSCL_DLY_SA_2 /end OUT_MEASUREMENT
/end FUNCTION
/begin FUNCTION INJ_Cat_enrichment_fct_after_hst "_Cat enrichment fct after hst" /begin DEF_CHARACTERISTIC C_MAF_INT_MAX_CAT_LOAD_HST IP_FAC_PCAT_MAIN_CAT_HST /end DEF_CHARACTERISTIC
 /begin OUT_MEASUREMENT LV_ACT_CAT_PURGE_MAIN_HST_1 LV_ACT_CAT_PURGE_HST_1 MAF_INT_CAT_LOAD_HST_1 MAF_INT_CAT_LOAD_MAIN_HST_1 LV_ACT_CAT_PURGE_MAIN_HST_2 LV_ACT_CAT_PURGE_HST_2 MAF_INT_CAT_LOAD_HST_2 MAF_INT_CAT_LOAD_MAIN_HST_2 /end OUT_MEASUREMENT
/end FUNCTION
/begin FUNCTION ISC_Idle_Speed_Control_Adaption "ISC"
 /begin SUB_FUNCTION ISC_Idle_speed_control ISC_Idle_speed_adaption ISC_Idle_speed_torque_reserve ISC_Application_Incidence ISC_Adaptation_Condition ISC__Adaptation_Algorithm ISC_Torque_Reserve_for_canister_ /end SUB_FUNCTION
/end FUNCTION
/begin FUNCTION ISC_Idle_speed_control "_Idle speed control"
 /begin DEF_CHARACTERISTIC C_T_RAMP_LIM_I_DT_IS C_T_RAMP_LIM_I_IS C_T_RAMP_LIM_P_D_DT_IS C_T_RAMP_LIM_P_D_IS C_TQ_BOL_I_DT_IS C_TQ_BOL_I_IS C_TQ_PAS_I_ACC_IS C_TQ_PAS_I_IS C_TQ_TOL_I_DT_IS C_TQ_TOL_I_IS IP_P_D_DT_IS__N_DIF_COR__N_GRD IP_P_D_IS__N_DIF_COR__N_GRD IP_TQ_I_DT_IS IP_TQ_I_IS__N_DIF_COR__N_GRD ldp_t_ast__fac_n_grd_is ldp_tco__fac_n_grd_is IP_FAC_N_GRD_IS LC_TQ_DIF_I_INH_AS LC_TQ_DIF_P_D_INH_AS C_CRLC_TQ_ADD_CP C_N_DIF_RIS_MIN C_T_N_DIF_RIS C_T_N_DIF_SAMPLE LC_TQ_P_D_SLOW_INH_AS LC_N_GRD_FIL_P_D_INH_AS LC_N_GRD_FIL_I_INH_AS C_CRLC_N_GRD ID_FAC_P_D_DT_IS IP_FAC_P_D_FAST_TCO_IS IP_FAC_P_D_SLOW_TCO_IS C_T_MAX_RIS LC_ISC_ACT_OLD_AS /end DEF_CHARACTERISTIC
 /begin OUT_MEASUREMENT LV_TQ_P_D_ACT LV_TQ_P_D_DT_ACT TQ_DIF_P_D_DT_IS_1 TQ_DIF_P_D_SLOW_IS TQ_DIF_P_D_IS TQ_DIF_P_D_FAST_IS TQ_DIF_I_IS TQ_ADD_I_IS LV_REQ_ISC STATE_REQ_ISC N_DIF_SAMPLE N_DIF_RIS LV_N_DIF_SAMPLE FAC_P_D_SLOW_TCO_IS FAC_P_D_FAST_TCO_IS FAC_N_GRD_IS N_GRD_FIL_IS N_GRD_P_D_IS N_GRD_I_IS LV_PAS_RAMP_ACT_IS /end OUT_MEASUREMENT
/end FUNCTION
/begin FUNCTION ISC_Idle_speed_adaption "_Idle speed adaption"
 /begin DEF_CHARACTERISTIC C_FAC_TQ_IS_AD_CONV_MAX C_FAC_TQ_IS_AD_CONV_MIN C_N_DELTA C_TQ_IS_AD_ACC_MIN C_TQ_IS_AD_MAX C_TQ_IS_AD_MIN C_FAC_TQ_IS_AD_ACC C_FAC_TQ_IS_AD_CONV C_FAC_TQ_IS_AD_ACC_CONV C_TQ_IS_AD_ACC_MAX C_TQ_IS_AD_ACC_CONV_MAX C_TQ_IS_AD_ACC_CONV_MIN C_CRLC_TQ_DIF_IS_AD_ACC C_TCO_AD_MIN_IS C_FAC_TQ_IS_AD C_DLY_IS_AD C_TCO_AD_MAX_IS /end DEF_CHARACTERISTIC
/end FUNCTION
/begin FUNCTION ISC_Idle_speed_torque_reserve "_Idle speed torque reserve"
 /begin DEF_CHARACTERISTIC IP_T_N_DIF_OFS_PRED__N IP_TQ_ADD_IS_BOL__N_DIF_PRED C_TQ_ADD_IS_BOL_CRLC C_TQ_DIF_ADD_IS_TOL /end DEF_CHARACTERISTIC
 /begin OUT_MEASUREMENT N_DIF_OFS_PRED T_N_DIF_OFS_PRED N_DIF_PRED TQ_ADD_IS_BOL TQ_DIF_ADD_IS_TOL /end OUT_MEASUREMENT
/end FUNCTION
/begin FUNCTION ISC_Application_Incidence "_Application Incidence" /begin OUT_MEASUREMENT LV_IS_AD_INH_OBD /end OUT_MEASUREMENT /end FUNCTION
/begin FUNCTION ISC_Adaptation_Condition "_Adaptation Condition" /begin OUT_MEASUREMENT LV_IS_AD_CND LV_TCO_AD_CND_IS LV_DLY_AD_IS /end OUT_MEASUREMENT /end FUNCTION
/begin FUNCTION ISC__Adaptation_Algorithm "_ Adaptation Algorithm"
 /begin OUT_MEASUREMENT FAC_TQ_IS_AD_CONV TQ_DIF_IS_AD_ACC_1 TQ_DIF_IS_AD_ACC TQ_DIF_IS_AD_ACC_CONV TQ_DIF_IS_AD TQ_DIF_IS_AD_INTER TQ_DIF_IS_AD_ACC_1_INTER TQ_DIF_IS_AD_ACC_CONV_INTER /end OUT_MEASUREMENT
/end FUNCTION
/begin FUNCTION ISC_Torque_Reserve_for_canister_ "_Torque Reserve for canister purge at idle" /begin DEF_CHARACTERISTIC LC_TQ_ADD_CP_ENA IP_TQ_ADD_CP /end DEF_CHARACTERISTIC /begin OUT_MEASUREMENT TQ_ADD_CP /end OUT_MEASUREMENT /end FUNCTION
/begin FUNCTION OBD_OBD_II_Function "OBD"
 /begin SUB_FUNCTION OBD_Computation_of_catalyst_temp OBD_Load___TPS_Rationality_Check OBD_Dynamic_Error_management OBD_Misfire_detection OBD_Application_incidences_for_M OBD_Rough_road_detection OBD_Misfire_rate_determination_a OBD_History_memory /end SUB_FUNCTION
/end FUNCTION
/begin FUNCTION OBD_Computation_of_catalyst_temp "_Computation of catalyst temperature for catalyst efficiency diagnosis"
 /begin DEF_CHARACTERISTIC C_TEMP_SUB_CAT_PUC ID_CRLC_DEC_CAT__MAF_KGH ID_CRLC_INC_CAT__MAF_KGH ID_TEMP_MMV_INI_CAT__TCO_ST IP_TEMP_SUB_CAT__MAF_KGH /end DEF_CHARACTERISTIC
 /begin OUT_MEASUREMENT TEMP_CAT /end OUT_MEASUREMENT
/end FUNCTION
/begin FUNCTION OBD_Load___TPS_Rationality_Check "_Load - TPS Rationality Check" /end FUNCTION
/begin FUNCTION OBD_Dynamic_Error_management "_Dynamic Error management" /begin DEF_CHARACTERISTIC C_DLY_DC C_TCO_WUP_THD C_TCO_WUP_INC C_CTR_MAX_WUP_CYC /end DEF_CHARACTERISTIC /begin OUT_MEASUREMENT LV_DC LV_WUP_CYC LV_STATE_WUP CTR_ERR_DYN_NR /end OUT_MEASUREMENT /end FUNCTION
/begin FUNCTION OBD_Misfire_detection "_Misfire detection"
 /begin DEF_CHARACTERISTIC IP_THD_ER_MPL_CHK_AT IP_TQI_AV_MIN_ER_MT C_N_MIN_ER C_NR_TDC_CMB_TRA_ER IP_TQI_AV_MIN_ER_AT ID_FAC_ER ID_FAC_IGC_DUR IP_THD_ER_MPL_CHK_MT C_N_MAX_ER IP_FAC_THD_ER__TCO IP_MIS_FAC_THD_IV_ER__N /end DEF_CHARACTERISTIC
 /begin OUT_MEASUREMENT N_DLY_720 TQI_AV_DLY_720 FAC_THD_AD_ER LV_SEG_AD_STATE THD_ER_AV MIS_SUM_ER_0 MIS_SUM_ER_1 MIS_SUM_ER_2 MIS_SUM_ER_3 MIS_SUM_ER_4 MIS_SUM_ER_5 MIS_NR_TDC_ER LV_CMB_TRA_ER ER_IGC_DUR_IV_SUM LV_ER_FDOUT MIS_STATE_ER /end OUT_MEASUREMENT
/end FUNCTION
/begin FUNCTION OBD_Application_incidences_for_M "_Application incidences for Misfire detection"
 /begin DEF_CHARACTERISTIC IP_THD_ER_AFS_MT IP_THD_ER_MPL_AFS_MT IP_THD_ER_AFL_MT IP_THD_ER_MPL_AFL_MT IP_THD_ER_S_MT IP_THD_ER_MPL_S_MT IP_THD_ER_AFS_AT IP_THD_ER_MPL_AFS_AT IP_THD_ER_AFL_AT IP_THD_ER_MPL_AFL_AT IP_THD_ER_MPL_S_AT IP_THD_ER_S_AT /end DEF_CHARACTERISTIC
 /begin OUT_MEASUREMENT THD_ER_BAS LV_INH_THD_ER /end OUT_MEASUREMENT
/end FUNCTION
/begin FUNCTION OBD_Rough_road_detection "_Rough road detection"
 /begin DEF_CHARACTERISTIC C_VS_MIN_RR C_VS_MAX_RR C_WHEEL_GRD_CRLC_RR C_DLY_ER_RR IP_WHEEL_GRD_MMV_THD_AT__VS IP_WHEEL_GRD_MMV_THD_MT__VS /end DEF_CHARACTERISTIC
 /begin OUT_MEASUREMENT LV_STATE_RR SEG_T_MES_0_RR SEG_T_MES_1_RR WHEEL_GRD_MMV WHEEL_GRD_MMV_THD SUM_RR /end OUT_MEASUREMENT
/end FUNCTION
/begin FUNCTION OBD_Misfire_rate_determination_a "_Misfire rate determination and specific error management"
 /begin DEF_CHARACTERISTIC C_MIS_A_IND_THD C_MIS_MAX_NR_OFF_IV C_ABC_MAX_SEG_T_AD C_ABC_INC_SEG_T_AD C_MIS_SUM_A_THD C_MIS_SUM_B1_THD_MT C_MIS_SUM_B4_THD_MT C_MIS_SUM_B1_THD_AT C_MIS_SUM_B4_THD_AT C_MIS_B_MIN_NR C_ABC_MAX_MIS_A C_ABC_INC_MIS_A C_ABC_MAX_MIS_B C_ABC_MAX_MIS_MPL C_ABC_INC_MIS_B C_ABC_INC_MIS_MPL IP_MIS_A_FAC__N__TQI_AV /end DEF_CHARACTERISTIC
 /begin OUT_MEASUREMENT LV_ERR_MIS_A_1 LV_ERR_MIS_A_2 LV_ERR_MIS_A_3 LV_ERR_MIS_A_4 LV_ERR_MIS_A_5 INH_IV_MIS LV_ERR_MIS_A_0 LV_ERR_MIS_B_1 LV_ERR_MIS_B_2 LV_ERR_MIS_B_3 LV_ERR_MIS_B_4 LV_ERR_MIS_B_5 MIS_NR_TDC_A MIS_NR_TDC_B MIS_SUM_A MIS_SUM_B LV_ERR_SEG_T_AD LV_MIS_CARB_B4 MIS_B4_OBD_CTR LV_ERR_MIS_B_0 LV_ERR_MIS_MPL MIS_STATE_B MIS_CTR_B_0 MIS_CTR_B_1 MIS_CTR_B_2 MIS_CTR_B_3 MIS_CTR_B_4 MIS_CTR_B_5 MIS_CTR_A_0 MIS_CTR_A_1 MIS_CTR_A_2 MIS_CTR_A_3 MIS_CTR_A_4 MIS_CTR_A_5 /end OUT_MEASUREMENT
/end FUNCTION
/begin FUNCTION OBD_History_memory "_History memory" /begin DEF_CHARACTERISTIC LC_CLR_HIS_FMY /end DEF_CHARACTERISTIC
 /begin OUT_MEASUREMENT CTR_ERR_HIS_NR ERR_DTC_CUS_HIS_0 ERR_DTC_CUS_HIS_1 ERR_DTC_CUS_HIS_2 ERR_DTC_CUS_HIS_3 ERR_DTC_CUS_HIS_4 ERR_DTC_CUS_HIS_5 ERR_DTC_CUS_HIS_6 ERR_DTC_CUS_HIS_7 ERR_DTC_CUS_HIS_8 ERR_DTC_CUS_HIS_9 /end OUT_MEASUREMENT
/end FUNCTION
/begin FUNCTION SYS_System_Variables "SYS"
 /begin SUB_FUNCTION SYS_Engine_speed_setpoint_calcul SYS_Engine_speed_limit_coordinat SYS_Mass_airflow_variables SYS_Intake_manifold_model SYS_Pressure_decrease_in_the_air SYS_Calculation_of_the_volumetri SYS_Vehicle_speed_variables SYS_Battery_voltage SYS_Coolant_temperature SYS_Air_temperature SYS_Exhaust_temperature_variable SYS_Determination_of_accelerator SYS_IVVT_Variables SYS_Gear_ratio_detection SYS_Drive_train_engaged SYS_Clutch_switch_detection SYS_Input_messages SYS_Oil_temperature SYS_Ambient_pressure_variables SYS_System_variables_for_custome SYS_System_variables_in_the_exha SYS_Reduced_area_controller SYS_Ambient_Pressure_Control SYS_Engine_roughness_calculation SYS_Engine_speed_calculation SYS_Fuel_pressure_acquisition SYS_Detection_of_Driver_Passive SYS_System_variables_for_and_fro SYS_ECU_state SYS_Pressure_Variables SYS_Engine_off_duration SYS_Calculation_of_the_basic_red /end SUB_FUNCTION
/end FUNCTION
/begin FUNCTION SYS_Engine_speed_setpoint_calcul "_Engine speed setpoint calculation"
 /begin DEF_CHARACTERISTIC C_N_DIF_CRLC C_N_DIF_MIN_MMV C_N_DIF_FAC IP_ACIN_N_SP_IS IP_DRI_ACIN_N_SP_IS IP_N_SP_ADD_CAT IP_DRI_N_SP_IS C_DRI_VS_MIN_VB IP_N_SP_IS_RNG_L IP_DRI_N_SP_IS_RNG_L IP_ACIN_N_SP_IS_RNG_L IP_DRI_ACIN_N_SP_IS_RNG_L IP_DRI_N_SP_VB_RNG_L_ IP_N_SP_MIN_VB_RNG_L_ IP_N_SP_IS_LIH IP_DRI_N_SP_IS_LIH C_N_SP_LGRD_IS IP_DRI_N_SP_MIN_VB__VB_MMV IP_N_SP_MIN_VB__VB_MMV C_DRI_VS_MIN_VB_RNG_L IP_N_SP_IS /end DEF_CHARACTERISTIC
 /begin OUT_MEASUREMENT N_DIF_COR N_DIF_MMV N_MAX_TOL_ST N_DIF_ST N_SP_IS_RATIO N_DIF N_SP_IS_POW N_SP_IS N_SP_IS_RAW /end OUT_MEASUREMENT
/end FUNCTION
/begin FUNCTION SYS_Engine_speed_limit_coordinat "_Engine speed limit coordination"
 /begin DEF_CHARACTERISTIC C_N_MAX_MTC_LIH C_N_MAX C_GR_MT C_N_MAX_MT C_VS_MIN_MT C_VS_MIN_AT_1 C_VS_MIN_AT_2 C_N_MAX_GR C_N_MAX_AT IP_N_MAX_MTC_CUR_OFF__PV_AV C_VS_MAX C_N_MAX_THD_MIN /end DEF_CHARACTERISTIC
 /begin OUT_MEASUREMENT N_MAX_THD LV_N_MAX_MT LV_N_MAX_AT LV_N_MAX_GR /end OUT_MEASUREMENT
/end FUNCTION
/begin FUNCTION SYS_Mass_airflow_variables "_Mass airflow variables" /begin DEF_CHARACTERISTIC C_MAF_MMV_DIF_CRLC C_MAF_MMV_HYS /end DEF_CHARACTERISTIC
 /begin OUT_MEASUREMENT SAF_KGH_MES MAF_KGH_MES_BAS MAF_MES MAF_KGH MAF_MMV MAF_KGH_MES /end OUT_MEASUREMENT
/end FUNCTION
/begin FUNCTION SYS_Intake_manifold_model "_Intake manifold model"
 /begin DEF_CHARACTERISTIC IP_MAF_MDL_CON_1__TIA IP_MAF_EGR_CON_1__TEG_EGR C_RA_VOL_IM C_PQ_THD IP_PRED_FAC__N IP_FAC_MAF_KGH_COR /end DEF_CHARACTERISTIC
 /begin OUT_MEASUREMENT MAF MAF_CYL_STK MAF_KGH_CLC MAP_EGR MAP_EGR_PRED MAP_FG_PRED MAP_PRED MAP_FG PQ PQ_EGR EGR_RATIO PQ_ESTIM PQ_EGR_ESTIM MAF_THR MAF_EGR MAP_DRV1 MAP_EGR_DRV1 MAF_EGR_CON_1 MAF_MDL_CON_1 MAF_FAC_OFS MAF_FAC_OFS_EGR MAF_FAC_SLOP LV_AMP_AD_STOP LV_AMP_AD_RST LV_AMP_CTL_STOP LV_AMP_CTL_RST LV_AR_RED_AD_RST LV_AR_RED_AD_STOP LV_AR_RED_CTL_STOP LV_AR_RED_CTL_RST LV_MAP_CTL LV_MAF_CTL MAF_KGH_MES_FAC MAF_FG_CYL MAF_FG_CYL_STK FAC_MAF_MAX MAP MAF_FAC_SLOP_EGR MAF_ISA_FAC_OFS MAF_ISA_FAC_SLOP MAF_THR_ISA_TOT MAF_ISA /end OUT_MEASUREMENT
/end FUNCTION
/begin FUNCTION SYS_Pressure_decrease_in_the_air "_Pressure decrease in the air filter" /begin DEF_CHARACTERISTIC IP_AMP_DEC__MAF_CYL LC_AMP_INP_ENA /end DEF_CHARACTERISTIC /begin OUT_MEASUREMENT PRS_UP_THR PRS_UP_THR_MAX /end OUT_MEASUREMENT /end FUNCTION
/begin FUNCTION SYS_Calculation_of_the_volumetri "_Calculation of the volumetric efficiency"
 /begin DEF_CHARACTERISTIC IP_EFF_VOL_SLOP IP_EFF_VOL_OFS IP_EFF_VOL_OFS_AMP IP_EFF_VOL_SLOP_AMP IP_EFF_VOL_SLOP_VIM IP_EFF_VOL_OFS_VIM IP_EFF_VOL_OFS_PORT IP_EFF_VOL_OFS_VVL_SWI IP_EFF_VOL_SLOP_PORT IP_EFF_VOL_SLOP_VVL_SWI IP_EFF_TCO_FAC__N_32__MAF IP_CRLC_EFF_VOL_COR__N_32 C_TCYL_STND C_TCO_STND C_TIA_IM_STND IP_EFF_TIA_IM_FAC__N_32__MAF /end DEF_CHARACTERISTIC
 /begin OUT_MEASUREMENT EFF_VOL_SLOP EFF_VOL_OFS EXC_AV_REL EFF_VOL_COR EFF_VOL_COR_MMV /end OUT_MEASUREMENT
/end FUNCTION
/begin FUNCTION SYS_Vehicle_speed_variables "_Vehicle speed variables" /begin DEF_CHARACTERISTIC C_VS_MIN_RUN C_T_VST C_VS_EDGE_SUM_MIN C_VS_FAC /end DEF_CHARACTERISTIC
 /begin OUT_MEASUREMENT LV_VS_RUN VS_EDGE_CTR_AV VS_EDGE_T_AV VS_SENS VS_SENS_GRD LV_VST VS /end OUT_MEASUREMENT
/end FUNCTION
/begin FUNCTION SYS_Battery_voltage "_Battery voltage"
 /begin DEF_CHARACTERISTIC C_CRLC_VB C_VB_MIN_JUMP C_VB_MIN_OBD1 C_VB_MIN_OBD2 C_VB_MIN_DIAG /end DEF_CHARACTERISTIC
 /begin OUT_MEASUREMENT LV_VB_JUMP LV_IGK VB_MMV VB LV_CDN_VB_OBD1 LV_CDN_VB_OBD2 LV_CDN_VB_MIN_DIAG /end OUT_MEASUREMENT
/end FUNCTION
/begin FUNCTION SYS_Coolant_temperature "_Coolant temperature"
 /begin DEF_CHARACTERISTIC C_T_TCO_SUB_IS_1 C_T_TCO_SUB_IS_2 C_T_TCO_SUB_PUC C_TCO_SUB_BOL_2 C_TCO_SUB_TOL C_TIA_DIAG IP_TCO_SUB_INC__MAF_KGH C_TCO_EX_DIF_DIAG C_TCO_SUB_BOL_1 IP_TCO__V_TCO /end DEF_CHARACTERISTIC
 /begin OUT_MEASUREMENT TCO_ST TCO_EX TCO_SUB TCO_STOP TCO TCO_MES /end OUT_MEASUREMENT
/end FUNCTION
/begin FUNCTION SYS_Air_temperature "_Air temperature" /begin DEF_CHARACTERISTIC C_TIA_GRD_MAX_DIAG IP_TIA__V_TIA /end DEF_CHARACTERISTIC /begin OUT_MEASUREMENT TIA /end OUT_MEASUREMENT /end FUNCTION
/begin FUNCTION SYS_Exhaust_temperature_variable "_Exhaust temperature variables" /begin DEF_CHARACTERISTIC IP_TEG__V_TEG /end DEF_CHARACTERISTIC
 /begin OUT_MEASUREMENT TEG_PCAT_DOWN_1 TEG_PCAT_DOWN_2 TEG_PCAT_DOWN_RAW_2 TEG_PCAT_DOWN_RAW_1 /end OUT_MEASUREMENT
/end FUNCTION
/begin FUNCTION SYS_Determination_of_accelerator "_Determination of accelerator pedal value"
 /begin DEF_CHARACTERISTIC C_PV_GRD_LIH_MAX C_PV_LIH_MAX C_V_PVS_HYS_FIL C_V_PVS_THD_KD_1 C_PVS_SLOP_1 C_PVS_SLOP_2 C_V_PVS_THD_KD_2 C_V_PVS_THD_KD_HYS_2 C_V_PVS_THD_KD_HYS_1 C_V_PVS_OFS_1 C_V_PVS_OFS_2 /end DEF_CHARACTERISTIC
 /begin OUT_MEASUREMENT PV_AV_1 PV_AV_2 V_PVS_FIL_1 V_PVS_FIL_2 LV_KD PV_AV PV_MAX /end OUT_MEASUREMENT
/end FUNCTION
/end MODULE
/end PROJECT
