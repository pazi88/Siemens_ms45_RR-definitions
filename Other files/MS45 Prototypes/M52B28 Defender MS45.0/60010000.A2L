ASAP2_VERSION 1 31
/begin PROJECT MS45 "Rover Motorsteuerung V6"
/begin HEADER "_default_HeaderComment" PROJECT_NO _50 /end HEADER
/begin MODULE _default_ModuleName "_default_ModuleLongIdentifier"
/begin MOD_COMMON "_default_ModCommonComment" DEPOSIT ABSOLUTE BYTE_ORDER MSB_FIRST ALIGNMENT_BYTE 1 ALIGNMENT_WORD 2 ALIGNMENT_LONG 4 ALIGNMENT_FLOAT32_IEEE 4 ALIGNMENT_FLOAT64_IEEE 8 /end MOD_COMMON
/begin CHARACTERISTIC C_T_DYW_TPS_LIH_CHK "Time period for Dynamic window around Limp Home" VALUE 0x67c4c _REC_VAL_20_u1 1.275 _CNV_A_R_LINEAR_____19_CM 0. 1.275 FORMAT "%4.3" /end CHARACTERISTIC
/begin CHARACTERISTIC C_T_MAX_ECU "time delay to switch off the ECU" VALUE 0x67c5a _REC_VAL_20_u2 6553.5 _CNV_A_R_LINEAR_____20_CM 0. 65535. FORMAT "%5.0" /end CHARACTERISTIC
/begin CHARACTERISTIC C_T_MAX_TPS_AD "Maximum time for adaptation of the LIH and BOL position" VALUE 0x67c62 _REC_VAL_20_u1 1.275 _CNV_A_R_LINEAR_____19_CM 0. 1.275 FORMAT "%4.3" /end CHARACTERISTIC
/begin CHARACTERISTIC C_T_MAX_TPS_LIH_CHK "Maximum time for Limp Home recognition" VALUE 0x67c63 _REC_VAL_20_u1 1.275 _CNV_A_R_LINEAR_____19_CM 0. 1.275 FORMAT "%4.3" /end CHARACTERISTIC
/begin CHARACTERISTIC C_T_MAX_TPS_SP_RST_CHK "Maximum time to reach the position C_TPS_SP_RST_CHK" VALUE 0x67c64 _REC_VAL_20_u1 1.275 _CNV_A_R_LINEAR_____19_CM 0. 1.275 FORMAT "%4.3" /end CHARACTERISTIC
/begin CHARACTERISTIC C_T_TIA_TCO_DIAG "Time condition - TIA diagnosis" VALUE 0x67c88 _REC_VAL_20_u2 65534. _CNV_A_R_LINEAR_____20_CM 1. 65535. FORMAT "%5.0" /end CHARACTERISTIC
/begin CHARACTERISTIC C_T_TPS_AD_HYS "Time period for hysteresis band to adaptation" VALUE 0x67c8c _REC_VAL_20_u1 1.275 _CNV_A_R_LINEAR_____19_CM 0. 1.275 FORMAT "%4.3" /end CHARACTERISTIC
/begin CHARACTERISTIC C_TCO_GRD_MAX_DIAG "Maximum allowed gradient for the coolant temperature signal" VALUE 0x67ca2 _REC_VAL_20_u1 38.1 _CNV_A_R_LINEAR_____23_CM 0. 190.5 FORMAT "%5.1" /end CHARACTERISTIC
/begin CHARACTERISTIC C_TCO_MAX_DIAG "maximum permissible coolant temperature" VALUE 0x67ca4 _REC_VAL_20_u1 28.575 _CNV_A_R_LINEAR_____22_CM -48. 142.5 FORMAT "%5.1" /end CHARACTERISTIC
/begin CHARACTERISTIC C_TCO_MIN_DIAG "minimum permissible coolant temperature" VALUE 0x67ca9 _REC_VAL_20_u1 28.575 _CNV_A_R_LINEAR_____22_CM -48. 142.5 FORMAT "%5.1" /end CHARACTERISTIC
/begin CHARACTERISTIC C_TPS_SP_BOL_LGRD "Change limitation for stopping the lower position" VALUE 0x67cf2 _REC_VAL_20_u1 1.85271285 _CNV_A_R_LINEAR_____35_CM 7.29415e-003 1.860007 FORMAT "%4.3" /end CHARACTERISTIC
/begin CHARACTERISTIC C_TPS_SP_RST_CHK "TPS_SP for testing the retracting spring" VALUE 0x67cf4 _REC_VAL_20_u2 119.5 _CNV_A_R_LINEAR_____34_CM 0. 119.5 /end CHARACTERISTIC
/begin CHARACTERISTIC C_TPS_SP_RST_CHK_BAS "TPS_SP for testing the retracting spring" VALUE 0x67cf6 _REC_VAL_20_u2 119.5 _CNV_A_R_LINEAR_____34_CM 0. 119.5 /end CHARACTERISTIC
/begin CHARACTERISTIC C_TPS_SP_RST_CHK_HYS "Hysteresis of C_TPS_SP_RST_CHK" VALUE 0x67cf8 _REC_VAL_20_u1 1.85271285 _CNV_A_R_LINEAR_____36_CM 7.29415e-003 1.860007 FORMAT "%4.3" /end CHARACTERISTIC
/begin CHARACTERISTIC C_TPS_SP_RST_CHK_LGRD "Change limitation for stopping the position C_TPS_SP_RST_CHK" VALUE 0x67cf9 _REC_VAL_20_u1 1.85271285 _CNV_A_R_LINEAR_____35_CM 7.29415e-003 1.860007 FORMAT "%4.3" /end CHARACTERISTIC
/begin CHARACTERISTIC C_V_TPS_AD_BOL_INI_1 "Start value for the adaptation value lower start (Poti 1)" VALUE 0x67d4f _REC_VAL_20_u1 4.98046875 _CNV_A_R_LINEAR_____40_CM 0. 4.98046875 FORMAT "%3.2" /end CHARACTERISTIC
/begin CHARACTERISTIC C_V_TPS_AD_BOL_INI_2 "Start value for the adaptation value lower start (Poti 2)" VALUE 0x67d50 _REC_VAL_20_u1 4.98046875 _CNV_A_R_LINEAR_____40_CM 0. 4.98046875 FORMAT "%3.2" /end CHARACTERISTIC
/begin CHARACTERISTIC C_V_TPS_AD_HYS "Hysteresis band for adaptation value determination" VALUE 0x67d51 _REC_VAL_20_u1 1.24511719 _CNV_A_R_LINEAR_____39_CM 0. 1.24511719 FORMAT "%4.3" /end CHARACTERISTIC
/begin CHARACTERISTIC C_V_TPS_AD_WIN_LIH "Adaptation window size (+/-) for adaptation of the Limp Home position" VALUE 0x67d53 _REC_VAL_20_u1 2.49023438 _CNV_A_R_LINEAR_____41_CM 0. 2.49023438 FORMAT "%4.3" /end CHARACTERISTIC
/begin CHARACTERISTIC C_V_TPS_LIH_CHK_HYS "Voltage window around Limp Home position for recognizing a correct MTC" VALUE 0x67d55 _REC_VAL_20_u1 1.24511719 _CNV_A_R_LINEAR_____39_CM 0. 1.24511719 FORMAT "%4.3" /end CHARACTERISTIC
/begin CHARACTERISTIC C_V_TPS_SP_LIH_1 "Nominal value of the TPS-voltage in Limp Home for Poti 1" VALUE 0x67d58 _REC_VAL_20_u1 4.98046875 _CNV_A_R_LINEAR_____40_CM 0. 4.98046875 FORMAT "%3.2" /end CHARACTERISTIC
/begin CHARACTERISTIC C_V_TPS_SP_LIH_2 "Nominal value of the TPS-voltage in Limp Home for Poti 1" VALUE 0x67d59 _REC_VAL_20_u1 4.98046875 _CNV_A_R_LINEAR_____40_CM 0. 4.98046875 FORMAT "%3.2" /end CHARACTERISTIC
/begin MEASUREMENT LV_ERR_LSH_DOWN_1 "Boolean error flag, fault currently present on upstream oxygen sensor heater circuit 1" UBYTE _CNV_S_2_RANGE______75_R_CM 1 100. 0. 255. ECU_ADDRESS 0x3fd36a /end MEASUREMENT
/begin MEASUREMENT LV_ERR_LSH_DOWN_2 "Boolean error flag, fault currently present on upstream oxygen sensor heater circuit 2" UBYTE _CNV_S_2_RANGE______75_R_CM 1 100. 0. 255. ECU_ADDRESS 0x3fd36c /end MEASUREMENT
/begin MEASUREMENT LV_ERR_LSH_UP_1 "Boolean error flag, fault currently present on upstream oxygen sensor heater circuit 1" UBYTE _CNV_S_2_RANGE______75_R_CM 1 100. 0. 255. ECU_ADDRESS 0x3fd369 /end MEASUREMENT
/begin MEASUREMENT LV_ERR_LSH_UP_2 "Boolean error flag, fault currently present on upstream oxygen sensor heater circuit 2" UBYTE _CNV_S_2_RANGE______75_R_CM 1 100. 0. 255. ECU_ADDRESS 0x3fd36b /end MEASUREMENT
/begin MEASUREMENT LV_N_LIM_TPS_AD "Demand security trailing throttle fuel cut off (SAS)" UBYTE _CNV_S_2_RANGE______74_CM 1 100. 0. 1. ECU_ADDRESS 0x3fd550 BIT_MASK 0x1 /end MEASUREMENT
/begin MEASUREMENT LV_TPS_AD_CUR_OFF "Demand ETC Limp Home" UBYTE _CNV_S_2_RANGE______74_CM 1 100. 0. 1. ECU_ADDRESS 0x3fd54e BIT_MASK 0x1 /end MEASUREMENT
/begin MEASUREMENT LV_TPS_AD_DIAG_CUR_OFF "Demand ETC LIMP HOME" UBYTE _CNV_S_2_RANGE______74_CM 1 100. 0. 1. ECU_ADDRESS 0x3fd54f BIT_MASK 0x1 /end MEASUREMENT
/begin MEASUREMENT TPS_AV_1 "Opening angle of the throttle valve of TPS-Poti 1" UWORD _CNV_A_R_LINEAR_____34_CM 1 100. 0. 119.5 ECU_ADDRESS 0x3fcfd6 FORMAT "%7.3" /end MEASUREMENT
/begin MEASUREMENT TPS_AV_2 "Opening angle of the throttle valve of TPS-Poti 2" UWORD _CNV_A_R_LINEAR_____34_CM 1 100. 0. 119.5 ECU_ADDRESS 0x3fcfd8 FORMAT "%7.3" /end MEASUREMENT
/begin MEASUREMENT TPS_GRD "Throttle position gradient, absolute value" UBYTE _CNV_A_R_LINEAR_____81_CM 1 100. 0. 2987.5 ECU_ADDRESS 0x3fd982 FORMAT "%4.0" /end MEASUREMENT
/begin MEASUREMENT TPS_SP_AD "Throttle position setpoint during adaption" UWORD _CNV_A_R_LINEAR_____34_CM 1 100. 0. 119.5 ECU_ADDRESS 0x3fcffe FORMAT "%7.3" /end MEASUREMENT
/begin MEASUREMENT V_TPS_AD_BOL_2 "Adaptation value for the lower mechanical stop, TPS-channel 2" UWORD _CNV_A_R_LINEAR_____38_CM 1 100. 0. 4.99511719 ECU_ADDRESS 0x3fcffc FORMAT "%5.3" /end MEASUREMENT
/begin MEASUREMENT V_TPS_AD_EL_BOL_1 "Adaptation value for the lower electronic stop, TPS-channel 1" UWORD _CNV_A_R_LINEAR_____38_CM 1 100. 0. 4.99511719 ECU_ADDRESS 0x3fd000 FORMAT "%5.3" /end MEASUREMENT
/begin MEASUREMENT V_TPS_AD_EL_BOL_2 "Adaptation value for the lower electronic stop, TPS-channel 2" UWORD _CNV_A_R_LINEAR_____38_CM 1 100. 0. 4.99511719 ECU_ADDRESS 0x3fd002 FORMAT "%5.3" /end MEASUREMENT
/begin MEASUREMENT V_TPS_AD_LIH_1 "Adaptation value for the limp home position, TPS-channel 1" UWORD _CNV_A_R_LINEAR_____38_CM 1 100. 0. 4.99511719 ECU_ADDRESS 0x3fcff6 FORMAT "%5.3" /end MEASUREMENT
/begin MEASUREMENT V_TPS_AD_LIH_2 "Adaptation value for the limp home position, TPS-channel 2" UWORD _CNV_A_R_LINEAR_____38_CM 1 100. 0. 4.99511719 ECU_ADDRESS 0x3fcff8 FORMAT "%5.3" /end MEASUREMENT
/begin MEASUREMENT LV_ES "Engine operating state \"Engine stopped\"" UBYTE _CNV_S_2_RANGE______74_CM 1 100. 0. 1. ECU_ADDRESS 0x3fd47c BIT_MASK 0x1 /end MEASUREMENT
/begin MEASUREMENT LV_TPS_MTC_N_LIM "LV limp home request TPS" UBYTE _CNV_S_2_RANGE______74_CM 1 100. 0. 1. ECU_ADDRESS 0x3fd558 BIT_MASK 0x1 /end MEASUREMENT
/begin CHARACTERISTIC C_ABC_MAX_CPS "Debounce counter maximum value - CPS diagnosis" VALUE 0x67b40 _REC_VAL_20_u1 254. _CNV_A_R_LINEAR_____17_CM 1. 255. FORMAT "%3.0" /end CHARACTERISTIC
/begin CHARACTERISTIC C_TIA_TCO_DIAG "TIA condition - TCO_EX diagnosis" VALUE 0x67ce3 _REC_VAL_20_u1 190.5 _CNV_A_R_LINEAR_____22_CM -48. 142.5 FORMAT "%5.1" /end CHARACTERISTIC
/begin MEASUREMENT LV_ERR_CPS "???" UBYTE _CNV_S_2_RANGE______77_R_CM 1 100. 0. 255. ECU_ADDRESS 0x3fd364 /end MEASUREMENT
/begin AXIS_PTS ldpm_tco_9 "" 0x61d1d TCO _REC_AXS_20_u1 28.575 _CNV_A_R_LINEAR_____22_CM 9 -48. 142.5 FORMAT "%5.1" /end AXIS_PTS
/begin MEASUREMENT TPS_SEG "Segment synchronous measured throttle valve position" UWORD _CNV_A_R_LINEAR_____34_CM 1 100. 0. 119.5 ECU_ADDRESS 0x3fcfde FORMAT "%7.3" /end MEASUREMENT
/begin MEASUREMENT TPS_SEG_1 "Segment synchronous measured throttle valve position channel 1" UWORD _CNV_A_R_LINEAR_____34_CM 1 100. 0. 119.5 ECU_ADDRESS 0x3fcfe0 FORMAT "%7.3" /end MEASUREMENT
/begin MEASUREMENT TPS_SEG_2 "Segment synchronous measured throttle valve position channel 2" UWORD _CNV_A_R_LINEAR_____34_CM 1 100. 0. 119.5 ECU_ADDRESS 0x3fcfe2 FORMAT "%7.3" /end MEASUREMENT
/begin MEASUREMENT LV_ERR_CRK "logical variable global crankshaft signal error (debounced error = 1)" UBYTE _CNV_S_2_RANGE______77_R_CM 1 100. 0. 255. ECU_ADDRESS 0x3fd46a /end MEASUREMENT
/begin MEASUREMENT LV_TPS_AD_ACT "TPS diagnosis/adaptation condition is fulfilled" UBYTE _CNV_S_2_RANGE______74_CM 1 100. 0. 1. ECU_ADDRESS 0x3fd551 BIT_MASK 0x1 /end MEASUREMENT
/begin CHARACTERISTIC C_ABC_INC_MTC_DR "Debounce counter increment,MTC driver diagnosis" VALUE 0x67d98 _REC_VAL_20_u1 255. _CNV_A_R_LINEAR_____13_CM 0. 255. FORMAT "%3.0" /end CHARACTERISTIC
/begin CHARACTERISTIC C_ABC_MAX_MTC_DR "Debounce counter maximum value, MTC driver diagnosis" VALUE 0x67d99 _REC_VAL_20_u1 254. _CNV_A_R_LINEAR_____17_CM 1. 255. FORMAT "%3.0" /end CHARACTERISTIC
/begin MEASUREMENT TPS_AD_SLOP_GAIN_1 "Adaptation value of the amplification factor of amplified poti 1" UWORD _CNV_A_R_LINEAR_____104_CM 1 100. 0. 7.99987793 ECU_ADDRESS 0x3fd006 FORMAT "%6.4" /end MEASUREMENT
/begin MEASUREMENT TPS_AD_OFS_GAIN_1 "Adaptation value of the amplification offset of  of amplified poti 1" SWORD _CNV_A_R_LINEAR_____158_CM 1 100. -2.5 2.5 ECU_ADDRESS 0x3fd008 /end MEASUREMENT
/begin MEASUREMENT TPS_SEG_GAIN_1 "Segment synchronous measured throttle valve position amplified channel 1" UWORD _CNV_A_R_LINEAR_____34_CM 1 100. 0. 119.5 ECU_ADDRESS 0x3fcfe4 FORMAT "%7.3" /end MEASUREMENT
/begin MEASUREMENT V_TPS_GAIN_1 "Actual value of amplified TPS-channel 1" UWORD _CNV_A_R_LINEAR_____38_CM 1 100. 0. 4.99511719 ECU_ADDRESS 0x3fa8fc FORMAT "%5.3" /end MEASUREMENT
/begin MEASUREMENT TPS_AV_GAIN_1 "Opening angle of the throttle valve of amplified TPS-Poti 1" UWORD _CNV_A_R_LINEAR_____34_CM 1 100. 0. 119.5 ECU_ADDRESS 0x3fcfea FORMAT "%7.3" /end MEASUREMENT
/begin MEASUREMENT TPS_LIH_1 "Limp home position of the throttle valve of TPS-Poti 1" UWORD _CNV_A_R_LINEAR_____34_CM 1 100. 0. 119.5 ECU_ADDRESS 0x3fd00e FORMAT "%7.3" /end MEASUREMENT
/begin MEASUREMENT TPS_LIH_2 "Limp home position  of the throttle valve of TPS-Poti 2" UWORD _CNV_A_R_LINEAR_____34_CM 1 100. 0. 119.5 ECU_ADDRESS 0x3fd010 FORMAT "%7.3" /end MEASUREMENT
/begin MEASUREMENT LV_TPS_AD_REQ "Demand TPS-adaptation" UBYTE _CNV_S_2_RANGE______74_CM 1 100. 0. 1. ECU_ADDRESS 0x3fd54d BIT_MASK 0x1 /end MEASUREMENT
/begin MEASUREMENT LV_TPS_GAIN_ACT_1 "Logical variable for TPS_AV based on amplified TPS 1 " UBYTE _CNV_S_2_RANGE______74_CM 1 100. 0. 1. ECU_ADDRESS 0x3fd549 BIT_MASK 0x1 /end MEASUREMENT
/begin MEASUREMENT V_TPS_GAIN_TOL_ENA_1 "TPS1-voltage to switch from amplified to non-amplified sensor signal" UWORD _CNV_A_R_LINEAR_____38_CM 1 100. 0. 4.99511719 ECU_ADDRESS 0x3fcfec FORMAT "%5.3" /end MEASUREMENT
/begin MEASUREMENT V_TPS_GAIN_BOL_ENA_1 "TPS1-voltage to switch from non-amplified to amplified sensor signal" UWORD _CNV_A_R_LINEAR_____38_CM 1 100. 0. 4.99511719 ECU_ADDRESS 0x3fcfee FORMAT "%5.3" /end MEASUREMENT
/begin MEASUREMENT LV_ERR_TPS_ST_CHK_1 "TPS-error-bit (Return spring test)" UBYTE _CNV_S_2_RANGE______75_R_CM 1 100. 0. 255. ECU_ADDRESS 0x3fd3a5 /end MEASUREMENT
/begin MEASUREMENT LV_ERR_TPS_ST_CHK_2 "TPS-error-bit (Return spring test)" UBYTE _CNV_S_2_RANGE______75_R_CM 1 100. 0. 255. ECU_ADDRESS 0x3fd3a6 /end MEASUREMENT
/begin MEASUREMENT LV_ERR_MTC_CTL_1 "Logical variable (set. if a MTCPWM error is present)" UBYTE _CNV_S_2_RANGE______77_R_CM 1 100. 0. 255. ECU_ADDRESS 0x3fd3a1 /end MEASUREMENT
/begin MEASUREMENT LV_ERR_MTC_CTL_2 "Logical variable (set. if a MTCPWM error is present)" UBYTE _CNV_S_2_RANGE______75_R_CM 1 100. 0. 255. ECU_ADDRESS 0x3fd3a2 /end MEASUREMENT
/begin MEASUREMENT LV_ERR_MTC_CTL_3 "Logical variable (set. if a MTCPWM error is present)" UBYTE _CNV_S_2_RANGE______75_R_CM 1 100. 0. 255. ECU_ADDRESS 0x3fd3a3 /end MEASUREMENT
/begin CHARACTERISTIC C_MTCPWM_PI_MAX_DIAG "Diagnosis threshold for MTCPWM" VALUE 0x67f3a _REC_VAL_20_u2 99.99694824000001 _CNV_A_R_LINEAR_____159_CM 0. 99.99694824 /end CHARACTERISTIC
/begin CHARACTERISTIC C_TPS_DIF_MAX_DIAG "Maximum permissible control variance" VALUE 0x67f3c _REC_VAL_20_u2 119.5 _CNV_A_R_LINEAR_____34_CM 0. 119.5 FORMAT "%7.3" /end CHARACTERISTIC
/begin CHARACTERISTIC C_T_TPS_DIF_DIAG "Tolerance time control variance" VALUE 0x67f3f _REC_VAL_20_u1 2.55 _CNV_A_R_LINEAR_____21_CM 0. 2.55 FORMAT "%4.2" /end CHARACTERISTIC
/begin CHARACTERISTIC C_T_MTCPWM_PI_DIAG_CUR_OFF "Time threshold for end \"break-away\"" VALUE 0x67f40 _REC_VAL_20_u1 2.55 _CNV_A_R_LINEAR_____21_CM 0. 2.55 FORMAT "%4.2" /end CHARACTERISTIC
/begin CHARACTERISTIC C_V_TPS_DIF_BOL "Voltage difference between mechanical and electrical lower stop" VALUE 0x67d54 _REC_VAL_20_u1 1.24511719 _CNV_A_R_LINEAR_____39_CM 0. 1.24511719 FORMAT "%4.3" /end CHARACTERISTIC
/begin CHARACTERISTIC C_V_TPS_GRD_MAX "" VALUE 0x67f42 _REC_VAL_20_u2 4.99511719 _CNV_A_R_LINEAR_____38_CM 0. 4.99511719 FORMAT "%5.3" /end CHARACTERISTIC
/begin CHARACTERISTIC C_V_TPS_SWI_GAIN_1 "" VALUE 0x67f44 _REC_VAL_20_u2 4.99511719 _CNV_A_R_LINEAR_____38_CM 0. 4.99511719 FORMAT "%5.3" /end CHARACTERISTIC
/begin CHARACTERISTIC C_V_TPS_HYS_GAIN_1 "" VALUE 0x67f46 _REC_VAL_20_u2 4.99511719 _CNV_A_R_LINEAR_____38_CM 0. 4.99511719 FORMAT "%5.3" /end CHARACTERISTIC
/begin CHARACTERISTIC C_TPS_AD_SLOP_GAIN_INI_1 "" VALUE 0x67f48 _REC_VAL_20_u2 7.99987793 _CNV_A_R_LINEAR_____104_CM 0. 7.99987793 FORMAT "%6.4" /end CHARACTERISTIC
/begin CHARACTERISTIC C_TPS_AD_OFS_GAIN_INI_1 "" VALUE 0x67f4a _REC_VAL_20_s2 5. _CNV_A_R_LINEAR_____158_CM -2.5 2.5 /end CHARACTERISTIC
/begin MEASUREMENT LV_ERR_TPS_AD "TPS-error-bit (Adaptation)" UBYTE _CNV_S_2_RANGE______75_R_CM 1 100. 0. 255. ECU_ADDRESS 0x3fd3a4 /end MEASUREMENT
/begin CHARACTERISTIC C_ABC_INC_CPS "Debounce counter increment - CPS diagnosis" VALUE 0x67b33 _REC_VAL_20_u1 255. _CNV_A_R_LINEAR_____13_CM 0. 255. FORMAT "%3.0" /end CHARACTERISTIC
/begin MEASUREMENT TPS_AD_STEP "Steps of throttle adaptation" ULONG _CNV_S_11_RANGE_TPS__160_CM 1 100. 0. 10. ECU_ADDRESS 0x3fc1bc /end MEASUREMENT
/begin CHARACTERISTIC C_TPS_SLOP "" VALUE 0x67f4c _REC_VAL_20_u2 48. _CNV_A_R_LINEAR_____161_CM 0. 48. FORMAT "%7.4" /end CHARACTERISTIC
/begin MEASUREMENT LV_MTC_LIH_CUR_OFF "ETC-Limp home is activ" UBYTE _CNV_S_2_RANGE______74_CM 1 100. 0. 1. ECU_ADDRESS 0x3fd556 BIT_MASK 0x1 /end MEASUREMENT
/begin AXIS_PTS ldpm_tia_1 "" 0x61e38 TIA _REC_AXS_20_u1 190.5 _CNV_A_R_LINEAR_____22_CM 6 -48. 142.5 FORMAT "%5.1" /end AXIS_PTS
/begin MEASUREMENT LV_ERR_MTC_DR "MTC_DR-error is present" UBYTE _CNV_S_2_RANGE______77_R_CM 1 100. 0. 255. ECU_ADDRESS 0x3fd3a0 /end MEASUREMENT
/begin MEASUREMENT TPS_LIH "Limp home position of the throttle valve" UWORD _CNV_A_R_LINEAR_____34_CM 1 100. 0. 119.5 ECU_ADDRESS 0x3fcfdc FORMAT "%7.3" /end MEASUREMENT
/begin MEASUREMENT TPS_LIH_INI "" UWORD _CNV_A_R_LINEAR_____34_CM 1 100. 0. 119.5 ECU_ADDRESS 0x3fd012 FORMAT "%7.3" /end MEASUREMENT
/begin CHARACTERISTIC IP_N_MAX_TOL_ST "upper engine speed limit for ST" CURVE 0x669ea _REC_CUR_20_u1_u1 8160. _CNV_A_R_LINEAR_____15_CM 0. 8160. FORMAT "%4.0"
 /begin AXIS_DESCR COM_AXIS TCO _CNV_A_R_LINEAR_____22_CM 9 -48. 142.5 FORMAT "%5.1" AXIS_PTS_REF ldpm_tco_9 /end AXIS_DESCR
/end CHARACTERISTIC
/begin CHARACTERISTIC C_ABC_INC_VIM_DIAG "Anti - Debounce counter increment for VIM driver diagnosis" VALUE 0x689a0 _REC_VAL_20_u1 10.2 _CNV_A_R_LINEAR_____13_CM 0. 255. FORMAT "%3.0" /end CHARACTERISTIC
/begin CHARACTERISTIC C_ABC_MAX_VIM_DIAG "Maximum value of anti - Debounce counter increment for VIM driver diagnosis" VALUE 0x689a1 _REC_VAL_20_u1 10.16 _CNV_A_R_LINEAR_____17_CM 1. 255. FORMAT "%3.0" /end CHARACTERISTIC
/begin MEASUREMENT LV_ERR_VIM "Boolean for error currently present on intake manifold drive (after debounce)" UBYTE _CNV_S_2_RANGE______77_R_CM 1 100. 0. 255. ECU_ADDRESS 0x3fd3a8 /end MEASUREMENT
/begin MEASUREMENT V_TPS_AD_BOL_1 "Adaptation value for the lower mechanical stop, TPS-channel 1" UWORD _CNV_A_R_LINEAR_____38_CM 1 100. 0. 4.99511719 ECU_ADDRESS 0x3fcffa FORMAT "%5.3" /end MEASUREMENT
/begin MEASUREMENT V_TPS_AD_BOL_GAIN_1 "Adaptation value for the lower mechanical stop of the amplification poti 1" UWORD _CNV_A_R_LINEAR_____38_CM 1 100. 0. 4.99511719 ECU_ADDRESS 0x3fd004 FORMAT "%5.3" /end MEASUREMENT
/begin MEASUREMENT V_TPS_AD_TOL_1 "Non-amplified upper value for the adaptation of amplified of TPS-channel 1" UWORD _CNV_A_R_LINEAR_____38_CM 1 100. 0. 4.99511719 ECU_ADDRESS 0x3fd00c FORMAT "%5.3" /end MEASUREMENT
/begin MEASUREMENT V_TPS_AD_TOL_GAIN_1 "Amplified upper value for the adaptation of amplified of TPS-channel 1" UWORD _CNV_A_R_LINEAR_____38_CM 1 100. 0. 4.99511719 ECU_ADDRESS 0x3fd00a FORMAT "%5.3" /end MEASUREMENT
/begin CHARACTERISTIC C_ABC_INC_GEN "Increment debounce counter - Generator error" VALUE 0x690de _REC_VAL_20_u1 255. _CNV_A_R_LINEAR_____13_CM 0. 255. FORMAT "%3.0" /end CHARACTERISTIC
/begin CHARACTERISTIC C_ABC_MAX_GEN "Maximum value debounce counter - Generator error" VALUE 0x690df _REC_VAL_20_u1 254. _CNV_A_R_LINEAR_____17_CM 1. 255. FORMAT "%3.0" /end CHARACTERISTIC
/begin CHARACTERISTIC C_ABC_INC_ENG_PSN_PREV_SYN "anti-bounce counter increment engine position error previous engine synchronization" VALUE 0x690e1 _REC_VAL_20_u1 255. _CNV_A_R_LINEAR_____13_CM 0. 255. FORMAT "%3.0" /end CHARACTERISTIC
/begin CHARACTERISTIC C_ABC_INC_ENG_PSN_DUR_ST "anti-bounce counter increment engine position error during start" VALUE 0x690e2 _REC_VAL_20_u1 255. _CNV_A_R_LINEAR_____13_CM 0. 255. FORMAT "%3.0" /end CHARACTERISTIC
/begin CHARACTERISTIC C_ABC_MAX_ENG_PSN "maximum value of the anti-bounce counter for engine position error" VALUE 0x690e4 _REC_VAL_20_u1 254. _CNV_A_R_LINEAR_____17_CM 1. 255. FORMAT "%3.0" /end CHARACTERISTIC
/begin MEASUREMENT LV_ERR_ENG_PSN "logical variable engine position error (debounced error = 1)" UBYTE _CNV_S_2_RANGE______77_R_CM 1 100. 0. 255. ECU_ADDRESS 0x3fd3a9 /end MEASUREMENT
/begin MEASUREMENT ERR_ABC_ENG_PSN "engine position error debounce counter" UBYTE _CNV_A_R_LINEAR_____13_CM 1 100. 0. 255. ECU_ADDRESS 0x3fd831 FORMAT "%3.0" /end MEASUREMENT
/begin CHARACTERISTIC C_ABC_INC_ENG_PSN_AST "anti-bounce counter increment engine position error after start" VALUE 0x690e3 _REC_VAL_20_u1 255. _CNV_A_R_LINEAR_____13_CM 0. 255. FORMAT "%3.0" /end CHARACTERISTIC
/begin CHARACTERISTIC C_ABC_INC_TOOTH_PER_PREV_SYN "anti-bounce counter increment tooth period error previous engine synchronization" VALUE 0x690e5 _REC_VAL_20_u1 255. _CNV_A_R_LINEAR_____13_CM 0. 255. FORMAT "%3.0" /end CHARACTERISTIC
/begin CHARACTERISTIC C_ABC_INC_TOOTH_PER_AST "anti-bounce counter increment tooth period error after start" VALUE 0x690e7 _REC_VAL_20_u1 255. _CNV_A_R_LINEAR_____13_CM 0. 255. FORMAT "%3.0" /end CHARACTERISTIC
/begin CHARACTERISTIC C_ABC_MAX_TOOTH_PER "maximum value of the anti-bounce counter for tooth period error" VALUE 0x690e8 _REC_VAL_20_u1 254. _CNV_A_R_LINEAR_____17_CM 1. 255. FORMAT "%3.0" /end CHARACTERISTIC
/begin MEASUREMENT LV_ERR_TOOTH_PER "logical variable tooth period error (debounced error = 1)" UBYTE _CNV_S_2_RANGE______77_R_CM 1 100. 0. 255. ECU_ADDRESS 0x3fd3aa /end MEASUREMENT
/begin MEASUREMENT ERR_ABC_TOOTH_PER "tooth period error debounce counter" UBYTE _CNV_A_R_LINEAR_____13_CM 1 100. 0. 255. ECU_ADDRESS 0x3fd832 FORMAT "%3.0" /end MEASUREMENT
/begin CHARACTERISTIC C_ABC_INC_TOOTH_PER_DUR_ST "anti-bounce counter increment tooth period error during start" VALUE 0x690e6 _REC_VAL_20_u1 255. _CNV_A_R_LINEAR_____13_CM 0. 255. FORMAT "%3.0" /end CHARACTERISTIC
/begin CHARACTERISTIC C_ABC_INC_TPU_SYN_PREV_SYN "anti-bounce counter increment TPU synchronization error previous engine synchronization" VALUE 0x690e9 _REC_VAL_20_u1 255. _CNV_A_R_LINEAR_____13_CM 0. 255. FORMAT "%3.0" /end CHARACTERISTIC
/begin CHARACTERISTIC C_ABC_INC_TPU_SYN_DUR_ST "anti-bounce counter increment TPU synchronization error during start" VALUE 0x690ea _REC_VAL_20_u1 255. _CNV_A_R_LINEAR_____13_CM 0. 255. FORMAT "%3.0" /end CHARACTERISTIC
/begin CHARACTERISTIC C_ABC_MAX_TPU_SYN "maximum value of the anti-bounce counter for TPU synchronization error" VALUE 0x690ec _REC_VAL_20_u1 254. _CNV_A_R_LINEAR_____17_CM 1. 255. FORMAT "%3.0" /end CHARACTERISTIC
/begin MEASUREMENT LV_ERR_TPU_SYN "logical variable TPU synchronization error (debounced error = 1)" UBYTE _CNV_S_2_RANGE______77_R_CM 1 100. 0. 255. ECU_ADDRESS 0x3fd3ab /end MEASUREMENT
/begin MEASUREMENT LV_ERR_GEN "Boolean for error currently present on Generator" UBYTE _CNV_S_2_RANGE______77_R_CM 1 100. 0. 255. ECU_ADDRESS 0x3fd3a7 /end MEASUREMENT
/begin MEASUREMENT LV_ERR_CAM_0 "logical variable camshaft signal error CAM_0 (error debounced = 1) " UBYTE _CNV_S_2_RANGE______77_R_CM 1 100. 0. 255. ECU_ADDRESS 0x3fd42f /end MEASUREMENT
/begin MEASUREMENT LV_ERR_CAM_1 "logical variable camshaft signal error CAM_1 (error debounced = 1) " UBYTE _CNV_S_2_RANGE______77_R_CM 1 100. 0. 255. ECU_ADDRESS 0x3fd430 /end MEASUREMENT
/begin MEASUREMENT LV_ERR_CAM_PER_0 "logical variable camshaft signal period error CAM_0 (debounced error = 1)" UBYTE _CNV_S_2_RANGE______77_R_CM 1 100. 0. 255. ECU_ADDRESS 0x3fd3ac /end MEASUREMENT
/begin MEASUREMENT ERR_ABC_TPU_SYN "TPU synchronization error debounce counter" UBYTE _CNV_A_R_LINEAR_____13_CM 1 100. 0. 255. ECU_ADDRESS 0x3fd833 FORMAT "%3.0" /end MEASUREMENT
/begin MEASUREMENT ERR_ABC_CAM_PER_0 "camshaft signal period error debounce counter CAM_0" UBYTE _CNV_A_R_LINEAR_____13_CM 1 100. 0. 255. ECU_ADDRESS 0x3fd802 FORMAT "%3.0" /end MEASUREMENT
/begin MEASUREMENT CAM_EDGE_NR_0 "identifier of  actual edge CAM_0" UBYTE _CNV_A_R_LINEAR_____13_CM 1 100. 0. 255. ECU_ADDRESS 0x3fd806 FORMAT "%3.0" /end MEASUREMENT
/begin MEASUREMENT CAM_EDGE_NR_1 "identifier of  actual edge CAM_1" UBYTE _CNV_A_R_LINEAR_____13_CM 1 100. 0. 255. ECU_ADDRESS 0x3fd807 FORMAT "%3.0" /end MEASUREMENT
/begin MEASUREMENT CAM_EDGE_CTR_1 "Free counting camshaft edge counter CAM_1" UWORD _CNV_A_R_LINEAR_____17_CM 1 100. 0. 65535. ECU_ADDRESS 0x3fc70e FORMAT "%5.0" /end MEASUREMENT
/begin AXIS_PTS ldpm_cam_edge_nr_0__win_chk "" 0x62045 CAM_EDGE_NR_0 _REC_AXS_20_u1 3. _CNV_A_R_LINEAR_____17_CM 4 0. 3. FORMAT "%2.0" /end AXIS_PTS
/begin AXIS_PTS ldpm_cam_edge_nr_1__win_chk "" 0x6204a CAM_EDGE_NR_1 _REC_AXS_20_u1 3. _CNV_A_R_LINEAR_____17_CM 4 0. 3. FORMAT "%2.0" /end AXIS_PTS
/begin CHARACTERISTIC ID_WIN_BOL_CHK_CAM_0 "camshaft and edge specific start angle of check window CAM_0" CURVE 0x690ee _REC_CUR_20_u2_u1 720. _CNV_A_R_LINEAR_____6_CM 0. 720. FORMAT "%6.2"
 /begin AXIS_DESCR COM_AXIS CAM_EDGE_NR_0 _CNV_A_R_LINEAR_____17_CM 4 0. 3. FORMAT "%2.0" AXIS_PTS_REF ldpm_cam_edge_nr_0__win_chk /end AXIS_DESCR
/end CHARACTERISTIC
/begin CHARACTERISTIC ID_WIN_BOL_CHK_CAM_1 "camshaft and edge specific start angle of check window CAM_1" CURVE 0x690f6 _REC_CUR_20_u2_u1 720. _CNV_A_R_LINEAR_____6_CM 0. 720. FORMAT "%6.2"
 /begin AXIS_DESCR COM_AXIS CAM_EDGE_NR_1 _CNV_A_R_LINEAR_____17_CM 4 0. 3. FORMAT "%2.0" AXIS_PTS_REF ldpm_cam_edge_nr_1__win_chk /end AXIS_DESCR
/end CHARACTERISTIC
/begin CHARACTERISTIC ID_WIN_TOL_CHK_CAM_1 "camshaft and edge specific end angle of check window CAM_1" CURVE 0x690fe _REC_CUR_20_u2_u1 720. _CNV_A_R_LINEAR_____6_CM 0. 720. FORMAT "%6.2"
 /begin AXIS_DESCR COM_AXIS CAM_EDGE_NR_1 _CNV_A_R_LINEAR_____17_CM 4 0. 3. FORMAT "%2.0" AXIS_PTS_REF ldpm_cam_edge_nr_1__win_chk /end AXIS_DESCR
/end CHARACTERISTIC
/begin CHARACTERISTIC ID_WIN_TOL_CHK_CAM_0 "camshaft and edge specific end angle of check window CAM_0" CURVE 0x69106 _REC_CUR_20_u2_u1 720. _CNV_A_R_LINEAR_____6_CM 0. 720. FORMAT "%6.2"
 /begin AXIS_DESCR COM_AXIS CAM_EDGE_NR_0 _CNV_A_R_LINEAR_____17_CM 4 0. 3. FORMAT "%2.0" AXIS_PTS_REF ldpm_cam_edge_nr_0__win_chk /end AXIS_DESCR
/end CHARACTERISTIC
/begin CHARACTERISTIC C_ABC_INC_TPU_SYN_AST "anti-bounce counter increment TPU synchronization error after start" VALUE 0x690eb _REC_VAL_20_u1 255. _CNV_A_R_LINEAR_____13_CM 0. 255. FORMAT "%3.0" /end CHARACTERISTIC
/begin CHARACTERISTIC C_ABC_INC_CAM_PER_0 "anti-bounce counter increment for CAM_0 camshaft period error diagnosis" VALUE 0x6910e _REC_VAL_20_u1 255. _CNV_A_R_LINEAR_____13_CM 0. 255. FORMAT "%3.0" /end CHARACTERISTIC
/begin CHARACTERISTIC C_ABC_INC_CAM_PER_1 "anti-bounce counter increment for CAM_1 camshaft period error diagnosis" VALUE 0x6910f _REC_VAL_20_u1 255. _CNV_A_R_LINEAR_____13_CM 0. 255. FORMAT "%3.0" /end CHARACTERISTIC
/begin CHARACTERISTIC C_ABC_MAX_CAM_PER_1 "maximum value of the anti-bounce counter for CAM_1 camshaft period error diagnosis" VALUE 0x69110 _REC_VAL_20_u1 254. _CNV_A_R_LINEAR_____17_CM 1. 255. FORMAT "%3.0" /end CHARACTERISTIC
/begin CHARACTERISTIC C_ABC_MAX_CAM_PER_0 "maximum value of the anti-bounce counter for CAM_0 camshaft period error diagnosis" VALUE 0x69111 _REC_VAL_20_u1 254. _CNV_A_R_LINEAR_____17_CM 1. 255. FORMAT "%3.0" /end CHARACTERISTIC
/begin CHARACTERISTIC C_ABC_INC_CAM_PSN_0 "anti-bounce counter increment for CAM_0 camshaft position diagnosis" VALUE 0x69112 _REC_VAL_20_u1 255. _CNV_A_R_LINEAR_____13_CM 0. 255. FORMAT "%3.0" /end CHARACTERISTIC
/begin CHARACTERISTIC C_ABC_INC_CAM_PSN_1 "anti-bounce counter increment for CAM_1 camshaft position diagnosis" VALUE 0x69113 _REC_VAL_20_u1 255. _CNV_A_R_LINEAR_____13_CM 0. 255. FORMAT "%3.0" /end CHARACTERISTIC
/begin CHARACTERISTIC C_ABC_MAX_CAM_PSN_0 "maximum value of the anti-bounce counter for CAM_0 camshaft position diagnosis" VALUE 0x69114 _REC_VAL_20_u1 254. _CNV_A_R_LINEAR_____17_CM 1. 255. FORMAT "%3.0" /end CHARACTERISTIC
/begin CHARACTERISTIC C_ABC_MAX_CAM_PSN_1 "maximum value of the anti-bounce counter for CAM_1 camshaft position diagnosis" VALUE 0x69115 _REC_VAL_20_u1 254. _CNV_A_R_LINEAR_____17_CM 1. 255. FORMAT "%3.0" /end CHARACTERISTIC
/begin MEASUREMENT LV_ERR_CAM_PER_1 "logical variable camshaft signal period error CAM_1 (debounced error = 1)" UBYTE _CNV_S_2_RANGE______77_R_CM 1 100. 0. 255. ECU_ADDRESS 0x3fd3ad /end MEASUREMENT
/begin MEASUREMENT LV_ERR_CAM_PSN_1 "logical variable camshaft position error CAM_1 (debounced error = 1)" UBYTE _CNV_S_2_RANGE______77_R_CM 1 100. 0. 255. ECU_ADDRESS 0x3fd3af /end MEASUREMENT
/begin MEASUREMENT LV_ERR_CAM_PSN_0 "logical variable camshaft position error CAM_0 (debounced error = 1)" UBYTE _CNV_S_2_RANGE______77_R_CM 1 100. 0. 255. ECU_ADDRESS 0x3fd3ae /end MEASUREMENT
/begin MEASUREMENT ERR_ABC_CAM_PER_1 "camshaft signal period error debounce counter CAM_1" UBYTE _CNV_A_R_LINEAR_____13_CM 1 100. 0. 255. ECU_ADDRESS 0x3fd803 FORMAT "%3.0" /end MEASUREMENT
/begin MEASUREMENT ERR_ABC_CAM_PSN_1 "camshaft signal position debounce counter CAM_1" UBYTE _CNV_A_R_LINEAR_____13_CM 1 100. 0. 255. ECU_ADDRESS 0x3fd805 FORMAT "%3.0" /end MEASUREMENT
/begin MEASUREMENT ERR_ABC_CAM_PSN_0 "camshaft signal position debounce counter CAM_0" UBYTE _CNV_A_R_LINEAR_____13_CM 1 100. 0. 255. ECU_ADDRESS 0x3fd804 FORMAT "%3.0" /end MEASUREMENT
/begin MEASUREMENT CAM_EDGE_CTR_0 "Free counting camshaft edge counter CAM_0" UWORD _CNV_A_R_LINEAR_____17_CM 1 100. 0. 65535. ECU_ADDRESS 0x3fc70c FORMAT "%5.0" /end MEASUREMENT
/begin MEASUREMENT CAM_EDGE_0 "Camshaft edge specific angle CAM_0" UWORD _CNV_A_R_LINEAR_____6_CM 1 100. 0. 720. ECU_ADDRESS 0x3fa9bc FORMAT "%6.2" /end MEASUREMENT
/begin MEASUREMENT CAM_EDGE_1 "Camshaft edge specific angle CAM_1" UWORD _CNV_A_R_LINEAR_____6_CM 1 100. 0. 720. ECU_ADDRESS 0x3fa9be FORMAT "%6.2" /end MEASUREMENT
/begin MEASUREMENT CRK_STATE_DIAG "Crankshaft diagnosis state" UBYTE _CNV_A_R_LINEAR_____17_CM 1 100. 0. 15. ECU_ADDRESS 0x3fa9ae FORMAT "%2.0" /end MEASUREMENT
/begin MEASUREMENT INH_IV_TPS_AD "logical variable to inhibit injection and ignition during TPS adaption" UBYTE _CNV_S_2_RANGE______77_R_CM 1 100. 0. 255. ECU_ADDRESS 0x3fd988 /end MEASUREMENT
/begin MEASUREMENT CRK_STATE_SYN "Crankshaft synchronization state" UBYTE _CNV_S_10_RANGE_CRK__189_CM 1 100. 0. 9. ECU_ADDRESS 0x3fa9af /end MEASUREMENT
/begin MEASUREMENT STATE_CAM_EDGE_CTR_0 "State of camshaft signal position at actual recurrence for CAM_0" UBYTE _CNV_S_4_RANGE_STAT_190_CM 1 100. 0. 4. ECU_ADDRESS 0x3fd800 /end MEASUREMENT
/begin MEASUREMENT STATE_CAM_EDGE_CTR_1 "State of camshaft signal position at actual recurrence for CAM_1" UBYTE _CNV_S_4_RANGE_STAT_190_CM 1 100. 0. 4. ECU_ADDRESS 0x3fd801 /end MEASUREMENT
/begin MEASUREMENT LV_ERR_TPS "Error currently present on at least one throttle position sensor" UBYTE _CNV_S_2_RANGE______77_R_CM 1 100. 0. 255. ECU_ADDRESS 0x3fd554 /end MEASUREMENT
/begin CHARACTERISTIC C_V_TPS_AD_WIN_BOL "Adaptation window size (+/-) for adaptation of lower stop" VALUE 0x67d52 _REC_VAL_20_u1 2.49023438 _CNV_A_R_LINEAR_____41_CM 0. 2.49023438 FORMAT "%4.3" /end CHARACTERISTIC
/begin MEASUREMENT LV_ERR_SAV "Boolean for errorcurrently present on secondary air valve command signal" UBYTE _CNV_S_2_RANGE______77_R_CM 1 100. 0. 255. ECU_ADDRESS 0x3fd3b2 /end MEASUREMENT
/begin MEASUREMENT LV_ERR_ECF "Boolean for errorcurrently present on ECF signal" UBYTE _CNV_S_2_RANGE______77_R_CM 1 100. 0. 255. ECU_ADDRESS 0x3fd3b4 /end MEASUREMENT
/begin MEASUREMENT LV_ERR_RLY_ACCOUT "Status air condition compressor relay diagnosis" UBYTE _CNV_S_2_RANGE______77_R_CM 1 100. 0. 255. ECU_ADDRESS 0x3fd3b1 /end MEASUREMENT
/begin MEASUREMENT LV_ERR_RLY_MAIN "Boolean for error detected at the main relay" UBYTE _CNV_S_2_RANGE______77_R_CM 1 100. 0. 255. ECU_ADDRESS 0x3fd3b0 /end MEASUREMENT
/begin MEASUREMENT T_RLY_MAIN_DIAG "Time window to perform the main relay diagnosis" UBYTE _CNV_A_R_LINEAR_____3_CM 1 100. 0. 2550. ECU_ADDRESS 0x3fd96a FORMAT "%4.0" /end MEASUREMENT
/begin CHARACTERISTIC C_ABC_INC_SAV "Debounce counter increment- SAV diagnosis" VALUE 0x6916c _REC_VAL_20_u1 25.5 _CNV_A_R_LINEAR_____13_CM 0. 255. FORMAT "%3.0" /end CHARACTERISTIC
/begin CHARACTERISTIC C_ABC_MAX_SAV "Debounce counter maximum value - SAV diagnosis" VALUE 0x6916d _REC_VAL_20_u1 254. _CNV_A_R_LINEAR_____17_CM 1. 255. FORMAT "%3.0" /end CHARACTERISTIC
/begin CHARACTERISTIC C_ABC_INC_SAP "Debounce counter increment- SAP diagnosis" VALUE 0x69172 _REC_VAL_20_u1 25.5 _CNV_A_R_LINEAR_____13_CM 0. 255. FORMAT "%3.0" /end CHARACTERISTIC
/begin CHARACTERISTIC C_ABC_INC_RLY_ACCOUT "Debounce counter increment- RLY_ACCOUT diagnosis" VALUE 0x69174 _REC_VAL_20_u1 25.5 _CNV_A_R_LINEAR_____13_CM 0. 255. FORMAT "%3.0" /end CHARACTERISTIC
/begin CHARACTERISTIC C_ABC_MAX_RLY_ACCOUT "Debounce counter maximum value - RLY_ACCOUT diagnosis" VALUE 0x69175 _REC_VAL_20_u1 254. _CNV_A_R_LINEAR_____17_CM 1. 255. FORMAT "%3.0" /end CHARACTERISTIC
/begin CHARACTERISTIC C_T_DLY_RLY_MAIN_DIAG "Delay time for the diagnosis to allow switching of the relay" VALUE 0x69176 _REC_VAL_20_u1 2550. _CNV_A_R_LINEAR_____3_CM 0. 2550. FORMAT "%4.0" /end CHARACTERISTIC
/begin CHARACTERISTIC C_T_RLY_MAIN_DIAG "Time window to perform the main relay diagnosis" VALUE 0x69177 _REC_VAL_20_u1 2550. _CNV_A_R_LINEAR_____3_CM 0. 2550. FORMAT "%4.0" /end CHARACTERISTIC
/begin CHARACTERISTIC C_VB_RLY_MAIN_DIAG "Voltage threshold for detection of battery voltage present" VALUE 0x69178 _REC_VAL_20_u1 25.8984 _CNV_A_R_LINEAR_____42_CM 0. 25.8984 FORMAT "%3.1" /end CHARACTERISTIC
/begin CHARACTERISTIC C_V_IGK_RLY_MAIN_DIAG "Voltage threshold for detection of main relay on" VALUE 0x6917a _REC_VAL_20_u2 25.9746 _CNV_A_R_LINEAR_____89_CM 0. 25.9746 FORMAT "%5.2" /end CHARACTERISTIC
/begin CHARACTERISTIC C_ABC_INC_ECF "Debounce counter increment- ECF diagnosis" VALUE 0x69170 _REC_VAL_20_u1 25.5 _CNV_A_R_LINEAR_____13_CM 0. 255. FORMAT "%3.0" /end CHARACTERISTIC
/begin CHARACTERISTIC C_ABC_INC_RLY_MAIN "Debounce counter increment - RLY_MAIN diagnosis" VALUE 0x6917c _REC_VAL_20_u1 25.5 _CNV_A_R_LINEAR_____13_CM 0. 255. FORMAT "%3.0" /end CHARACTERISTIC
/begin CHARACTERISTIC C_ABC_MAX_ECF "Debounce counter maximum value - ECF diagnosis" VALUE 0x69171 _REC_VAL_20_u1 254. _CNV_A_R_LINEAR_____17_CM 1. 255. FORMAT "%3.0" /end CHARACTERISTIC
/begin MEASUREMENT LV_N_LIM_ETC_LIH "LV safety cut off" UBYTE _CNV_S_2_RANGE______74_CM 1 100. 0. 1. ECU_ADDRESS 0x3fd557 BIT_MASK 0x1 /end MEASUREMENT
/begin MEASUREMENT LV_N_LIM_ETC_LIH_REV "ETC-LIMP-HOME-3  (Reversible)" UBYTE _CNV_S_2_RANGE______74_CM 1 100. 0. 1. ECU_ADDRESS 0x3fd55a BIT_MASK 0x1 /end MEASUREMENT
/begin MEASUREMENT STATE_TPS_DIAG "Status TPS Diagnosis" UBYTE _CNV_S_5_RANGE_STAT_193_CM 1 100. 0. 8. ECU_ADDRESS 0x3fd98d /end MEASUREMENT
/begin MEASUREMENT STATE_ETC_LIH "Status ETC Limp-Home" UBYTE _CNV_S_5_RANGE_STAT_194_CM 1 100. 0. 8. ECU_ADDRESS 0x3fd98e /end MEASUREMENT
/begin CHARACTERISTIC C_ABC_MAX_RLY_MAIN "Debounce counter maximum value - RLY_MAIN diagnosis" VALUE 0x6917d _REC_VAL_20_u1 254. _CNV_A_R_LINEAR_____17_CM 1. 255. FORMAT "%3.0" /end CHARACTERISTIC
/begin MEASUREMENT LV_ERR_TCO_EL "TCO Signal range error active/passive" UBYTE _CNV_S_2_RANGE______75_R_CM 1 100. 0. 255. ECU_ADDRESS 0x3fd3b5 /end MEASUREMENT
/begin MEASUREMENT LV_ERR_TCO_STUCK "TCO Stuck signal detected" UBYTE _CNV_S_2_RANGE______75_R_CM 1 100. 0. 255. ECU_ADDRESS 0x3fd3b6 /end MEASUREMENT
/begin MEASUREMENT TCO_DIF_DIAG "Difference between minimum and maximum measured coolant temperature value." UBYTE _CNV_A_R_LINEAR_____23_CM 1 100. 0. 190.5 ECU_ADDRESS 0x3fd975 FORMAT "%5.1" /end MEASUREMENT
/begin MEASUREMENT TCO_MIN_DIAG "Measured coolant temperature minimum value." UBYTE _CNV_A_R_LINEAR_____22_CM 1 100. -48. 142.5 ECU_ADDRESS 0x3fd976 FORMAT "%5.1" /end MEASUREMENT
/begin MEASUREMENT TCO_MAX_DIAG "Measured coolant temperature maximum value." UBYTE _CNV_A_R_LINEAR_____22_CM 1 100. -48. 142.5 ECU_ADDRESS 0x3fd977 FORMAT "%5.1" /end MEASUREMENT
/begin MEASUREMENT TCO_SUB_DIF_DIAG "Difference between minimum and maximum substitute coolant temperature value." UBYTE _CNV_A_R_LINEAR_____23_CM 1 100. 0. 190.5 ECU_ADDRESS 0x3fd978 FORMAT "%5.1" /end MEASUREMENT
/begin MEASUREMENT TCO_SUB_MIN_DIAG "Substitute coolant temperature minimum value." UBYTE _CNV_A_R_LINEAR_____22_CM 1 100. -48. 142.5 ECU_ADDRESS 0x3fd979 FORMAT "%5.1" /end MEASUREMENT
/begin MEASUREMENT TCO_SUB_MAX_DIAG "Substitute coolant temperature maximum value." UBYTE _CNV_A_R_LINEAR_____22_CM 1 100. -48. 142.5 ECU_ADDRESS 0x3fd97a FORMAT "%5.1" /end MEASUREMENT
/begin AXIS_PTS ldpm_tco_st__tco_dif_diag "" 0x62068 TCO_ST _REC_AXS_20_u1 190.5 _CNV_A_R_LINEAR_____22_CM 6 -48. 142.5 FORMAT "%5.1" /end AXIS_PTS
/begin CHARACTERISTIC IP_TCO_SUB_DIF_MIN_DIAG__TCO_ST "Minimum substitute coolant temperature increase to perform stuck signal diagnosis" CURVE 0x69181 _REC_CUR_20_u1_u1 190.5 _CNV_A_R_LINEAR_____23_CM 0. 190.5 FORMAT "%5.1"
 /begin AXIS_DESCR COM_AXIS TCO_ST _CNV_A_R_LINEAR_____22_CM 6 -48. 142.5 FORMAT "%5.1" AXIS_PTS_REF ldpm_tco_st__tco_dif_diag /end AXIS_DESCR
/end CHARACTERISTIC
/begin CHARACTERISTIC IP_TCO_MES_DIF_MIN_DIAG__TCO_ST "Minimum measured coolant temperature increase to detect a stuck signal" CURVE 0x69187 _REC_CUR_20_u1_u1 190.5 _CNV_A_R_LINEAR_____23_CM 0. 190.5 FORMAT "%5.1"
 /begin AXIS_DESCR COM_AXIS TCO_ST _CNV_A_R_LINEAR_____22_CM 6 -48. 142.5 FORMAT "%5.1" AXIS_PTS_REF ldpm_tco_st__tco_dif_diag /end AXIS_DESCR
/end CHARACTERISTIC
/begin MEASUREMENT LV_ERR_TCO_GRD "Boolean for error currently present on coolant temperature signal (gradient of the signal implausible)." UBYTE _CNV_S_2_RANGE______75_R_CM 1 100. 0. 255. ECU_ADDRESS 0x3fd3b7 /end MEASUREMENT
/begin CHARACTERISTIC C_ABC_INC_TCO "Debounce counter increment- TCO diagnosis" VALUE 0x67b39 _REC_VAL_20_u1 25.5 _CNV_A_R_LINEAR_____13_CM 0. 255. FORMAT "%3.0" /end CHARACTERISTIC
/begin CHARACTERISTIC C_ABC_INC_TCO_GRD_DIAG "Debounce counter increment - TCO Signal gradient diagnosis" VALUE 0x6918d _REC_VAL_20_u1 255. _CNV_A_R_LINEAR_____13_CM 0. 255. FORMAT "%3.0" /end CHARACTERISTIC
/begin CHARACTERISTIC C_ABC_MAX_TCO "Debounce counter maximum value - TCO diagnosis" VALUE 0x67b47 _REC_VAL_20_u1 25.4 _CNV_A_R_LINEAR_____17_CM 1. 255. FORMAT "%3.0" /end CHARACTERISTIC
/begin CHARACTERISTIC C_ABC_MAX_TCO_GRD_DIAG "Debounce counter maximum value - TCO Signal gradient diagnosis" VALUE 0x6918e _REC_VAL_20_u1 254. _CNV_A_R_LINEAR_____17_CM 1. 255. FORMAT "%3.0" /end CHARACTERISTIC
/begin CHARACTERISTIC C_ECFPWM_MAX_DIAG "Maximum PWM threshold for ECF diagnosis" VALUE 0x6916f _REC_VAL_20_u1 99.609375 _CNV_A_R_LINEAR_____16_CM 0. 99.609375 FORMAT "%4.1" /end CHARACTERISTIC
/begin CHARACTERISTIC C_ECFPWM_MIN_DIAG "Minimum PWM threshold for ECF diagnosis" VALUE 0x6916e _REC_VAL_20_u1 99.609375 _CNV_A_R_LINEAR_____16_CM 0. 99.609375 FORMAT "%4.1" /end CHARACTERISTIC
/begin MEASUREMENT LV_ERR_TCO "TCO error detected" UBYTE _CNV_S_2_RANGE______75_R_CM 1 100. 0. 255. ECU_ADDRESS 0x3fd538 /end MEASUREMENT
/begin MEASUREMENT LV_ERR_TCO_PLAUS "Boolean for error currently present on TCO-sensor." UBYTE _CNV_S_2_RANGE______75_R_CM 1 100. 0. 255. ECU_ADDRESS 0x3fd3ba /end MEASUREMENT
/begin MEASUREMENT T_TCO_MIN "Time after start where TCO Plaus diagnosis is inhibited" UWORD _CNV_A_R_LINEAR_____20_CM 1 100. 0. 65535. ECU_ADDRESS 0x3fcea0 FORMAT "%5.0" /end MEASUREMENT
/begin MEASUREMENT LV_ERR_ISC_H "Boolean for fault memory \"Idle Control System RPM higher than expected\" " UBYTE _CNV_S_2_RANGE______77_R_CM 1 100. 0. 255. ECU_ADDRESS 0x3fd3bb /end MEASUREMENT
/begin MEASUREMENT LV_ERR_ISC_L "Boolean for fault memory \"Idle Control System RPM lower than expected\"" UBYTE _CNV_S_2_RANGE______77_R_CM 1 100. 0. 255. ECU_ADDRESS 0x3fd3bc /end MEASUREMENT
/begin MEASUREMENT ABC_N_SP_IS_DIAG_H "Anti-bounce counter for diagnosis \"Idle Control System RPM higher than expected\"" UBYTE _CNV_A_R_LINEAR_____13_CM 1 100. 0. 255. ECU_ADDRESS 0x3fd8c1 FORMAT "%3.0" /end MEASUREMENT
/begin CHARACTERISTIC C_MAF_MAX_DIAG_ISC "Minimum mass air flow to perform idle speed valve Plausibility check" VALUE 0x691a4 _REC_VAL_20_u1 1389. _CNV_A_R_LINEAR_____51_CM 0. 1389. FORMAT "%4.0" /end CHARACTERISTIC
/begin CHARACTERISTIC C_REL_FLOW_CPS_MAX_DIAG_ISC_ "Maximum canister purge valve opening to perform idle speed plausibility check" VALUE 0x691a5 _REC_VAL_20_u1 1.99220002 _CNV_A_R_LINEAR_____64_CM 0. 1.99220002 FORMAT "%5.3" /end CHARACTERISTIC
/begin CHARACTERISTIC C_N_DIF_MAX_DIAG_ISC "Maximum deviation above nominal idle speed" VALUE 0x691a6 _REC_VAL_20_u2 8160. _CNV_A_R_LINEAR_____0_CM 0. 8160. FORMAT "%4.0" /end CHARACTERISTIC
/begin CHARACTERISTIC C_N_DIF_MIN_DIAG_ISC "Minimum deviation above nominal idle speed" VALUE 0x691a8 _REC_VAL_20_u2 8160. _CNV_A_R_LINEAR_____0_CM 0. 8160. FORMAT "%4.0" /end CHARACTERISTIC
/begin CHARACTERISTIC C_ABC_INC_ISC_L "Anti-bounce counter increment for idle speed too low Plausibility check" VALUE 0x691ac _REC_VAL_20_u1 255. _CNV_A_R_LINEAR_____13_CM 0. 255. FORMAT "%3.0" /end CHARACTERISTIC
/begin CHARACTERISTIC C_ABC_MAX_ISC_H "Maximum value of the anti-bounce counter for idle speed too high Plausibility check" VALUE 0x691ab _REC_VAL_20_u1 254. _CNV_A_R_LINEAR_____17_CM 1. 255. FORMAT "%3.0" /end CHARACTERISTIC
/begin CHARACTERISTIC C_ABC_MAX_ISC_L "Maximum value of the anti-bounce counter for idle speed too low Plausibility check" VALUE 0x691ad _REC_VAL_20_u1 254. _CNV_A_R_LINEAR_____17_CM 1. 255. FORMAT "%3.0" /end CHARACTERISTIC
/begin CHARACTERISTIC C_ABC_INC_ISC_H "Anti-bounce counter increment for idle speed too high Plausibility check" VALUE 0x691aa _REC_VAL_20_u1 255. _CNV_A_R_LINEAR_____13_CM 0. 255. FORMAT "%3.0" /end CHARACTERISTIC
/begin CHARACTERISTIC C_ABC_DEC_ISC_L "Anti-bounce counter increment for idle speed too low Plausibility check" VALUE 0x691af _REC_VAL_20_u1 255. _CNV_A_R_LINEAR_____13_CM 0. 255. FORMAT "%3.0" /end CHARACTERISTIC
/begin CHARACTERISTIC C_CPPWM_MAX_DIAG_ISC "CPPWM condition - IS engine speed plausibility" VALUE 0x691b0 _REC_VAL_20_u2 99.99694824000001 _CNV_A_R_LINEAR_____159_CM 0. 99.99694824 /end CHARACTERISTIC
/begin MEASUREMENT LV_CAN_VB_VLD "logical variable for valid battery voltage for CAN message diagnosis (= 1 at valid battery voltage)" UBYTE _CNV_S_2_RANGE______74_CM 1 100. 0. 1. ECU_ADDRESS 0x3fd439 /end MEASUREMENT
/begin CHARACTERISTIC C_T_MIN_CAN_DIAG "VB time condition - diagnosis of timeout CAN messages" VALUE 0x691b5 _REC_VAL_20_u1 2550. _CNV_A_R_LINEAR_____3_CM 0. 2550. FORMAT "%4.0" /end CHARACTERISTIC
/begin CHARACTERISTIC C_VB_MIN_CAN_DIAG "VB time condition - diagnosis of timeout CAN messages" VALUE 0x691b6 _REC_VAL_20_u1 25.8984 _CNV_A_R_LINEAR_____42_CM 0. 25.8984 FORMAT "%3.1" /end CHARACTERISTIC
/begin MEASUREMENT LV_ERR_TOUT_ASR_1 "logical variable timeout error CAN message ASC1" UBYTE _CNV_S_2_RANGE______77_R_CM 1 100. 0. 255. ECU_ADDRESS 0x3fd381 /end MEASUREMENT
/begin MEASUREMENT CYC_CTR_ASR_3_DIAG "counter of not received ASC3 messages" UBYTE _CNV_A_R_LINEAR_____13_CM 1 100. 0. 255. ECU_ADDRESS 0x3fd811 FORMAT "%3.0" /end MEASUREMENT
/begin CHARACTERISTIC C_ASR_3_CYCNR_MAX "maximum number of missing ASC3 messages for error debounce counter increment" VALUE 0x691ba _REC_VAL_20_u1 254. _CNV_A_R_LINEAR_____17_CM 1. 255. FORMAT "%3.0" /end CHARACTERISTIC
/begin CHARACTERISTIC C_ABC_INC_TOUT_ASR_3 "anti bounce counter increment  - diagnosis of timeout CAN message ASC3" VALUE 0x691bb _REC_VAL_20_u1 255. _CNV_A_R_LINEAR_____13_CM 0. 255. FORMAT "%3.0" /end CHARACTERISTIC
/begin CHARACTERISTIC C_ABC_MAX_TOUT_ASR_3 "anti bounce counter maximum value  - diagnosis of timeout CAN message ASC3 " VALUE 0x691bc _REC_VAL_20_u1 254. _CNV_A_R_LINEAR_____17_CM 1. 255. FORMAT "%3.0" /end CHARACTERISTIC
/begin MEASUREMENT LV_ERR_TOUT_ASR_3 "logical variable timeout error CAN message ASC3 " UBYTE _CNV_S_2_RANGE______77_R_CM 1 100. 0. 255. ECU_ADDRESS 0x3fd382 /end MEASUREMENT
/begin MEASUREMENT CYC_CTR_ASR_1_DIAG "counter of not received ASC1 messages" UBYTE _CNV_A_R_LINEAR_____13_CM 1 100. 0. 255. ECU_ADDRESS 0x3fd810 FORMAT "%3.0" /end MEASUREMENT
/begin CHARACTERISTIC C_ASR_1_CYCNR_MAX "maximum number of missing ASC1 messages for error debounce counter increment" VALUE 0x691b7 _REC_VAL_20_u1 254. _CNV_A_R_LINEAR_____17_CM 1. 255. FORMAT "%3.0" /end CHARACTERISTIC
/begin CHARACTERISTIC C_ABC_INC_TOUT_ASR_1 "anti bounce counter increment  - diagnosis of timeout CAN message ASC1" VALUE 0x691b8 _REC_VAL_20_u1 255. _CNV_A_R_LINEAR_____13_CM 0. 255. FORMAT "%3.0" /end CHARACTERISTIC
/begin CHARACTERISTIC C_ABC_MAX_TOUT_ASR_1 "anti bounce counter maximum value  - diagnosis of timeout CAN message ASC1 " VALUE 0x691b9 _REC_VAL_20_u1 254. _CNV_A_R_LINEAR_____17_CM 1. 255. FORMAT "%3.0" /end CHARACTERISTIC
/begin MEASUREMENT LV_ERR_TOUT_ETCU_1 "logical variable timeout error CAN message EGS1" UBYTE _CNV_S_2_RANGE______77_R_CM 1 100. 0. 255. ECU_ADDRESS 0x3fd37e /end MEASUREMENT
/begin MEASUREMENT CYC_CTR_ETCU_1_DIAG "counter of not received EGS1 messages" UBYTE _CNV_A_R_LINEAR_____13_CM 1 100. 0. 255. ECU_ADDRESS 0x3fd81c FORMAT "%3.0" /end MEASUREMENT
/begin CHARACTERISTIC C_ETCU_1_CYCNR_MAX "maximum number of missing EGS1 messages for error debounce counter increment" VALUE 0x691bd _REC_VAL_20_u1 254. _CNV_A_R_LINEAR_____17_CM 1. 255. FORMAT "%3.0" /end CHARACTERISTIC
/begin CHARACTERISTIC C_ABC_INC_TOUT_ETCU_1 "anti bounce counter increment  - diagnosis of timeout CAN message EGS1" VALUE 0x691be _REC_VAL_20_u1 255. _CNV_A_R_LINEAR_____13_CM 0. 255. FORMAT "%3.0" /end CHARACTERISTIC
/begin CHARACTERISTIC C_ABC_MAX_TOUT_ETCU_1 "anti bounce counter maximum value  - diagnosis of timeout CAN message EGS1 " VALUE 0x691bf _REC_VAL_20_u1 254. _CNV_A_R_LINEAR_____17_CM 1. 255. FORMAT "%3.0" /end CHARACTERISTIC
/begin MEASUREMENT LV_ERR_TOUT_ICL_2 "logical variable timeout error CAN message INSTR2" UBYTE _CNV_S_2_RANGE______77_R_CM 1 100. 0. 255. ECU_ADDRESS 0x3fd37f /end MEASUREMENT
/begin MEASUREMENT CYC_CTR_ICL_2_DIAG "counter of not received INSTR2 messages" UBYTE _CNV_A_R_LINEAR_____13_CM 1 100. 0. 255. ECU_ADDRESS 0x3fd822 FORMAT "%3.0" /end MEASUREMENT
/begin CHARACTERISTIC C_ICL_2_CYCNR_MAX "maximum number of missing INSTR2 messages for error debounce counter increment" VALUE 0x691c0 _REC_VAL_20_u1 254. _CNV_A_R_LINEAR_____17_CM 1. 255. FORMAT "%3.0" /end CHARACTERISTIC
/begin CHARACTERISTIC C_ABC_INC_TOUT_ICL_2_ "anti bounce counter increment  - diagnosis of timeout CAN message INSTR2" VALUE 0x691c1 _REC_VAL_20_u1 255. _CNV_A_R_LINEAR_____13_CM 0. 255. FORMAT "%3.0" /end CHARACTERISTIC
/begin CHARACTERISTIC C_ABC_MAX_TOUT_ICL_2 "anti bounce counter maximum value  - diagnosis of timeout CAN message INSTR2" VALUE 0x691c2 _REC_VAL_20_u1 254. _CNV_A_R_LINEAR_____17_CM 1. 255. FORMAT "%3.0" /end CHARACTERISTIC
/begin MEASUREMENT LV_ERR_TOUT_ICL_3 "logical variable timeout error CAN message INSTR3" UBYTE _CNV_S_2_RANGE______77_R_CM 1 100. 0. 255. ECU_ADDRESS 0x3fd380 /end MEASUREMENT
/begin MEASUREMENT CYC_CTR_ICL_3_DIAG "counter of not received INSTR3 messages" UBYTE _CNV_A_R_LINEAR_____13_CM 1 100. 0. 255. ECU_ADDRESS 0x3fd823 FORMAT "%3.0" /end MEASUREMENT
/begin MEASUREMENT CYC_CTR_TXU_1_DIAG "counter of not received TXU1messages" UBYTE _CNV_A_R_LINEAR_____13_CM 1 100. 0. 255. ECU_ADDRESS 0x3fd7d9 FORMAT "%3.0" /end MEASUREMENT
/begin CHARACTERISTIC C_ICL_3_CYCNR_MAX "maximum number of missing INSTR3 messages for error debounce counter increment" VALUE 0x691c3 _REC_VAL_20_u1 254. _CNV_A_R_LINEAR_____17_CM 1. 255. FORMAT "%3.0" /end CHARACTERISTIC
/begin CHARACTERISTIC C_TXU_1_CYCNR_MAX "maximum number of missing TXU1 messages for error debounce counter increment" VALUE 0x691c6 _REC_VAL_20_u1 254. _CNV_A_R_LINEAR_____17_CM 1. 255. FORMAT "%3.0" /end CHARACTERISTIC
/begin CHARACTERISTIC C_ABC_INC_TOUT_ICL_3_ "anti bounce counter increment  - diagnosis of timeout CAN message INSTR3" VALUE 0x691c4 _REC_VAL_20_u1 255. _CNV_A_R_LINEAR_____13_CM 0. 255. FORMAT "%3.0" /end CHARACTERISTIC
/begin CHARACTERISTIC C_ABC_MAX_TOUT_ICL_3 "anti bounce counter maximum value  - diagnosis of timeout CAN message INSTR3" VALUE 0x691c5 _REC_VAL_20_u1 254. _CNV_A_R_LINEAR_____17_CM 1. 255. FORMAT "%3.0" /end CHARACTERISTIC
/begin MEASUREMENT LV_ERR_TOUT_TXU_1 "logical variable timeout error CAN message TXU1" UBYTE _CNV_S_2_RANGE______77_R_CM 1 100. 0. 255. ECU_ADDRESS 0x3fd383 /end MEASUREMENT
/begin MEASUREMENT LV_ERR_CAN_BOFF "logical variableCAN bus off in bus off mode" UBYTE _CNV_S_2_RANGE______77_R_CM 1 100. 0. 255. ECU_ADDRESS 0x3fd384 /end MEASUREMENT
/begin CHARACTERISTIC C_ABC_INC_TOUT_TXU_1 "anti bounce counter increment  - diagnosis of timeout CAN message TXU1" VALUE 0x691c7 _REC_VAL_20_u1 255. _CNV_A_R_LINEAR_____13_CM 0. 255. FORMAT "%3.0" /end CHARACTERISTIC
/begin CHARACTERISTIC C_ABC_INC_CAN_BOFF "anti bounce counter increment  - diagnosis of CAN bus on / off" VALUE 0x691c9 _REC_VAL_20_u1 255. _CNV_A_R_LINEAR_____13_CM 0. 255. FORMAT "%3.0" /end CHARACTERISTIC
/begin CHARACTERISTIC C_ABC_MAX_TOUT_TXU_1 "anti bounce counter maximum value  - diagnosis of timeout CAN message TXU1" VALUE 0x691c8 _REC_VAL_20_u1 254. _CNV_A_R_LINEAR_____17_CM 1. 255. FORMAT "%3.0" /end CHARACTERISTIC
/begin CHARACTERISTIC C_ABC_MAX_CAN_BOFF "anti bounce counter maximum value  - diagnosis of CAN bus on / off" VALUE 0x691ca _REC_VAL_20_u1 254. _CNV_A_R_LINEAR_____17_CM 1. 255. FORMAT "%3.0" /end CHARACTERISTIC
/begin CHARACTERISTIC C_T_MTCPWM_PI_DIAG "Tolerance time MTCPWM-error" VALUE 0x67f3e _REC_VAL_20_u1 2.55 _CNV_A_R_LINEAR_____21_CM 0. 2.55 FORMAT "%4.2" /end CHARACTERISTIC
/begin MEASUREMENT TPS_AV "Opening angle of the throttle valve" UWORD _CNV_A_R_LINEAR_____34_CM 1 100. 0. 119.5 ECU_ADDRESS 0x3fcfd4 FORMAT "%7.3" /end MEASUREMENT
/begin MEASUREMENT TPS_AV_CTL "Control opening angle of the throttle valve" SWORD _CNV_A_R_LINEAR_____199_CM 1 100. -119.5 119.5 ECU_ADDRESS 0x3fcfda FORMAT "%8.3" /end MEASUREMENT
/begin MEASUREMENT TPS_AV_CTL_1 "Control opening angle of the throttle valve of TPS-Poti 1" SWORD _CNV_A_R_LINEAR_____199_CM 1 100. -119.5 119.5 ECU_ADDRESS 0x3fcff0 FORMAT "%8.3" /end MEASUREMENT
/begin MEASUREMENT TPS_AV_CTL_2 "Control opening angle of the throttle valve of TPS-Poti 2" SWORD _CNV_A_R_LINEAR_____199_CM 1 100. -119.5 119.5 ECU_ADDRESS 0x3fcff2 FORMAT "%8.3" /end MEASUREMENT
/begin MEASUREMENT TPS_AV_CTL_GAIN_1 "Control opening angle of the throttle valve of amplified TPS-Poti 1" SWORD _CNV_A_R_LINEAR_____199_CM 1 100. -119.5 119.5 ECU_ADDRESS 0x3fcff4 FORMAT "%8.3" /end MEASUREMENT
/begin CHARACTERISTIC ID_T_TCO_MIN__TIA "Locking time after start for lambda activation monitoring" CURVE 0x69198 _REC_CUR_20_u2_u1 65534. _CNV_A_R_LINEAR_____20_CM 1. 65535. FORMAT "%5.0"
 /begin AXIS_DESCR COM_AXIS TIA _CNV_A_R_LINEAR_____22_CM 6 -48. 142.5 FORMAT "%5.1" AXIS_PTS_REF ldpm_tia_1 /end AXIS_DESCR
/end CHARACTERISTIC
/begin MEASUREMENT LV_BRAKE_DET "LV_IM_BLS or _BTS detected" UBYTE _CNV_S_2_RANGE______74_CM 1 100. 0. 1. ECU_ADDRESS 0x3fd429 /end MEASUREMENT
/begin MEASUREMENT CTR_PVS_BLS_BTS_PLAUS "Counter of  not plausible events" UBYTE _CNV_A_R_LINEAR_____13_CM 1 100. 0. 255. ECU_ADDRESS 0x3fd7fc FORMAT "%3.0" /end MEASUREMENT
/begin MEASUREMENT LV_PVS_BLS_BTS_NOT_PLAUS "Plausibility error PVS / Brake recognized" UBYTE _CNV_S_2_RANGE______74_CM 1 100. 0. 1. ECU_ADDRESS 0x3fd428 /end MEASUREMENT
/begin MEASUREMENT LV_PV_AV_STAT_ "Recognisation of constant pedal value" UBYTE _CNV_S_2_RANGE______74_CM 1 100. 0. 1. ECU_ADDRESS 0x3fd42c /end MEASUREMENT
/begin MEASUREMENT LV_DET_NOT_PLAUS_ACT "PV_AV / Brake signal current not plausible" UBYTE _CNV_S_2_RANGE______74_CM 1 100. 0. 1. ECU_ADDRESS 0x3fd42b /end MEASUREMENT
/begin CHARACTERISTIC C_T_BTS_PLAUS_MAX "Maximum value of the time counter for debounce  " VALUE 0x6925f _REC_VAL_20_u1 25.5 _CNV_A_R_LINEAR_____18_CM 0. 25.5 FORMAT "%4.1" /end CHARACTERISTIC
/begin CHARACTERISTIC C_N_PVS_BLS_BTS_PLAUS "Activation threshold for N  " VALUE 0x69260 _REC_VAL_20_u1 8160. _CNV_A_R_LINEAR_____15_CM 0. 8160. FORMAT "%4.0" /end CHARACTERISTIC
/begin CHARACTERISTIC C_VS_PVS_BLS_BTS_PLAUS "Activation threshold for VS  " VALUE 0x69261 _REC_VAL_20_u1 255. _CNV_A_R_LINEAR_____43_CM 0. 255. FORMAT "%3.0" /end CHARACTERISTIC
/begin CHARACTERISTIC C_PV_AV_PVS_BLS_BTS_PLAUS "Activation threshold for PV_AV" VALUE 0x69262 _REC_VAL_20_u1 99.609375 _CNV_A_R_LINEAR_____16_CM 0. 99.609375 FORMAT "%4.1" /end CHARACTERISTIC
/begin CHARACTERISTIC LC_PVS_BLS_BTS_PLAUS_ENA "Enable bit for plausibility check" VALUE 0x69263 _REC_VAL_20_u1 1. _CNV_A_R_LINEAR_____17_CM 0. 1. FORMAT "%2.0" /end CHARACTERISTIC
/begin CHARACTERISTIC C_CTR_MAX_PVS_BLS_BTS_PLAUS "PVS_BLS_BTS_PLAUS counter maximum value" VALUE 0x69264 _REC_VAL_20_u1 255. _CNV_A_R_LINEAR_____13_CM 0. 255. FORMAT "%3.0" /end CHARACTERISTIC
/begin CHARACTERISTIC C_CTR_MAX_PV_AV_CON "PV_AV_CON counter maximum value" VALUE 0x69266 _REC_VAL_20_u1 255. _CNV_A_R_LINEAR_____13_CM 0. 255. FORMAT "%3.0" /end CHARACTERISTIC
/begin CHARACTERISTIC C_PV_AV_HYS_BLS_BTS_PLAUS "Threshold for detection of a constant pedal value" VALUE 0x69265 _REC_VAL_20_u1 99.609375 _CNV_A_R_LINEAR_____16_CM 0. 99.609375 FORMAT "%4.1" /end CHARACTERISTIC
/begin CHARACTERISTIC C_PV_AV_BLS_NOT_PLAUS "Pedal position in case of an PV_AV/Brake implausibility" VALUE 0x69267 _REC_VAL_20_u1 99.609375 _CNV_A_R_LINEAR_____16_CM 0. 99.609375 FORMAT "%4.1" /end CHARACTERISTIC
/begin MEASUREMENT LV_ERR_CAM "logical variable camshaft signal error (debounced error = 1)" UBYTE _CNV_S_2_RANGE______77_R_CM 1 100. 0. 255. ECU_ADDRESS 0x3fd42e /end MEASUREMENT
/begin MEASUREMENT LV_ERR_SAP "Boolean for errorcurrently present on secondary air pump command signal" UBYTE _CNV_S_2_RANGE______77_R_CM 1 100. 0. 255. ECU_ADDRESS 0x3fd3b3 /end MEASUREMENT
/begin CHARACTERISTIC C_ABC_MAX_SAP "Debounce counter maximum value - SAP diagnosis" VALUE 0x69173 _REC_VAL_20_u1 254. _CNV_A_R_LINEAR_____17_CM 1. 255. FORMAT "%3.0" /end CHARACTERISTIC
/begin MEASUREMENT ER_MMV_IS_DIAG_0 "Filtered engine roughness value cylinder individual" SWORD _CNV_A_R_LINEAR_____90_CM 1 100. -8. 7.99975586 ECU_ADDRESS 0x3fc8aa FORMAT "%7.4" /end MEASUREMENT
/begin MEASUREMENT ER_MMV_IS_DIAG_1 "Filtered engine roughness value cylinder individual" SWORD _CNV_A_R_LINEAR_____90_CM 1 100. -8. 7.99975586 ECU_ADDRESS 0x3fc8ac FORMAT "%7.4" /end MEASUREMENT
/begin MEASUREMENT ER_MMV_IS_DIAG_2 "Filtered engine roughness value cylinder individual" SWORD _CNV_A_R_LINEAR_____90_CM 1 100. -8. 7.99975586 ECU_ADDRESS 0x3fc8ae FORMAT "%7.4" /end MEASUREMENT
/begin MEASUREMENT ER_MMV_IS_DIAG_3 "Filtered engine roughness value cylinder individual" SWORD _CNV_A_R_LINEAR_____90_CM 1 100. -8. 7.99975586 ECU_ADDRESS 0x3fc8b0 FORMAT "%7.4" /end MEASUREMENT
/begin MEASUREMENT ER_MMV_IS_DIAG_4 "Filtered engine roughness value cylinder individual" SWORD _CNV_A_R_LINEAR_____90_CM 1 100. -8. 7.99975586 ECU_ADDRESS 0x3fc8b2 FORMAT "%7.4" /end MEASUREMENT
/begin MEASUREMENT ER_MMV_IS_DIAG_5 "Filtered engine roughness value cylinder individual" SWORD _CNV_A_R_LINEAR_____90_CM 1 100. -8. 7.99975586 ECU_ADDRESS 0x3fc8b4 FORMAT "%7.4" /end MEASUREMENT
/begin AXIS_PTS ldp_maf__thd_is_er_diag "" 0x62174 MAF _REC_AXS_20_u1 1389. _CNV_A_R_LINEAR_____51_CM 4 0. 1389. FORMAT "%4.0" /end AXIS_PTS
/begin AXIS_PTS ldp_n__thd_is_er_diag "" 0x6217a N _REC_AXS_20_u2 816. _CNV_A_R_LINEAR_____0_CM 4 0. 8160. FORMAT "%4.0" /end AXIS_PTS
/begin AXIS_PTS ldp_tco__fac_thd_is_er_diag "" 0x62184 TCO _REC_AXS_20_u1 190.5 _CNV_A_R_LINEAR_____22_CM 8 -48. 142.5 FORMAT "%5.1" /end AXIS_PTS
/begin CHARACTERISTIC IP_THD_IS_ER_DIAG__N__MAF "ER reference value for ER diagnosis" MAP 0x69bc4 _REC_MAP_20_u2_u2_u1 -32766. _CNV_A_R_LINEAR_____216_CM -1. -32767. FORMAT "%7.0"
 /begin AXIS_DESCR COM_AXIS N _CNV_A_R_LINEAR_____0_CM 4 0. 8160. FORMAT "%4.0" AXIS_PTS_REF ldp_n__thd_is_er_diag /end AXIS_DESCR
 /begin AXIS_DESCR COM_AXIS MAF _CNV_A_R_LINEAR_____51_CM 4 0. 1389. FORMAT "%4.0" AXIS_PTS_REF ldp_maf__thd_is_er_diag /end AXIS_DESCR
/end CHARACTERISTIC
/begin CHARACTERISTIC IP_FAC_THD_IS_ER_DIAG__TCO "TCO-dependent reference value correction" CURVE 0x69be4 _REC_CUR_20_u1_u1 0.9922 _CNV_A_R_LINEAR_____217_CM 1. 1.9922 FORMAT "%5.3"
 /begin AXIS_DESCR COM_AXIS TCO _CNV_A_R_LINEAR_____22_CM 8 -48. 142.5 FORMAT "%5.1" AXIS_PTS_REF ldp_tco__fac_thd_is_er_diag /end AXIS_DESCR
/end CHARACTERISTIC
/begin CHARACTERISTIC C_CRLC_IS_ER_DIAG "Correlation constant for calculating the ER diagnostic values" VALUE 0x69bec _REC_VAL_20_u1 0.99610001 _CNV_A_R_LINEAR_____68_CM 0. 0.99610001 FORMAT "%5.3" /end CHARACTERISTIC
/begin MEASUREMENT ABC_N_SP_IS_DIAG_L "Anti-bounce counter for diagnosis \"Idle Control System RPM lower than expected\"" UBYTE _CNV_A_R_LINEAR_____13_CM 1 100. 0. 255. ECU_ADDRESS 0x3fd8c2 FORMAT "%3.0" /end MEASUREMENT
/begin MEASUREMENT T_ISC_DIAG "Time delay for diagnosis activation" UWORD _CNV_A_R_LINEAR_____18_CM 1 100. 0. 6553.5 ECU_ADDRESS 0x3fc924 FORMAT "%6.1" /end MEASUREMENT
/begin CHARACTERISTIC C_ABC_DEC_ISC_H "Anti-bounce counter decrement for idle speed too high Plausibility check" VALUE 0x691ae _REC_VAL_20_u1 255. _CNV_A_R_LINEAR_____13_CM 0. 255. FORMAT "%3.0" /end CHARACTERISTIC
/begin CHARACTERISTIC C_T_DLY_ISC_DIAG "Time delay for diagnosis activation" VALUE 0x69bee _REC_VAL_20_u2 6553.5 _CNV_A_R_LINEAR_____18_CM 0. 6553.5 FORMAT "%6.1" /end CHARACTERISTIC
/begin CHARACTERISTIC C_PV_AV_BLS_NOT_PLAUS_LGRD "Change limitation of pedal position in case of an PV_AV/Brake implausibility" VALUE 0x69268 _REC_VAL_20_u1 99.609375 _CNV_A_R_LINEAR_____16_CM 0. 99.609375 FORMAT "%4.1" /end CHARACTERISTIC
/begin MEASUREMENT LV_ERR_BLS_PLAUS "BLS plausibility error flag" UBYTE _CNV_S_2_RANGE______77_R_CM 1 100. 0. 255. ECU_ADDRESS 0x3fd42a /end MEASUREMENT
/begin MEASUREMENT LV_ERR_IM_BTS_PLAUS "BTS plausibility error flag" UBYTE _CNV_S_2_RANGE______77_R_CM 1 100. 0. 255. ECU_ADDRESS 0x3fd3be /end MEASUREMENT
/begin MEASUREMENT LV_ERR_IM_BLS_PLAUS "BLS plausibility error flag" UBYTE _CNV_S_2_RANGE______77_R_CM 1 100. 0. 255. ECU_ADDRESS 0x3fd3bd /end MEASUREMENT
/begin CHARACTERISTIC C_ABC_INC_IM_BTS_PLAUS "BTS debounce counter increment  " VALUE 0x6925e _REC_VAL_20_u1 255. _CNV_A_R_LINEAR_____13_CM 0. 255. FORMAT "%3.0" /end CHARACTERISTIC
/begin CHARACTERISTIC C_ABC_INC_IM_BLS_PLAUS "BLS debounce counter increment  " VALUE 0x69df9 _REC_VAL_20_u1 255. _CNV_A_R_LINEAR_____13_CM 0. 255. FORMAT "%3.0" /end CHARACTERISTIC
/begin CHARACTERISTIC C_ABC_MAX_IM_BTS_PLAUS "BTS debounce counter maximum value, error debounce" VALUE 0x6925d _REC_VAL_20_u1 254. _CNV_A_R_LINEAR_____17_CM 1. 255. FORMAT "%3.0" /end CHARACTERISTIC
/begin CHARACTERISTIC C_ABC_MAX_IM_BLS_PLAUS "BLS debounce counter maximum value" VALUE 0x6925c _REC_VAL_20_u1 254. _CNV_A_R_LINEAR_____17_CM 1. 255. FORMAT "%3.0" /end CHARACTERISTIC
/begin CHARACTERISTIC C_CPPWM_SUB_DIAG_1 "CPPWM substitute value when SCG failure" VALUE 0x62aae _REC_VAL_20_u1 99.609375 _CNV_A_R_LINEAR_____16_CM 0. 99.609375 FORMAT "%5.1" /end CHARACTERISTIC
/begin CHARACTERISTIC C_CPPWM_SUB_DIAG_2 "CPPWM substitute value when SCB or OL failure" VALUE 0x62aaf _REC_VAL_20_u1 99.609375 _CNV_A_R_LINEAR_____16_CM 0. 99.609375 FORMAT "%5.1" /end CHARACTERISTIC
/begin CHARACTERISTIC C_CPPWM_MIN_DIAG "CPS diagnosis min. CPPWM activation threshold" VALUE 0x62ab0 _REC_VAL_20_u1 99.609375 _CNV_A_R_LINEAR_____16_CM 0. 99.609375 FORMAT "%5.1" /end CHARACTERISTIC
/begin CHARACTERISTIC C_CPPWM_MAX_DIAG "CPS diagnosis max. CPPWM activation threshold" VALUE 0x62ab1 _REC_VAL_20_u1 99.609375 _CNV_A_R_LINEAR_____16_CM 0. 99.609375 FORMAT "%5.1" /end CHARACTERISTIC
/begin MEASUREMENT LV_MTC_CUR_OFF_REQ "ETC without power request" UBYTE _CNV_S_2_RANGE______74_CM 1 100. 0. 1. ECU_ADDRESS 0x3fd559 /end MEASUREMENT
/begin CHARACTERISTIC C_DC_MAX_TD_IGC_CUT_0 "" VALUE 0x6052b _REC_VAL_20_u1 255. _CNV_A_R_LINEAR_____13_CM 0. 255. FORMAT "%3.0" /end CHARACTERISTIC
/begin CHARACTERISTIC C_DC_DEC_TD_IGC_CUT_0 "" VALUE 0x6052a _REC_VAL_20_u1 255. _CNV_A_R_LINEAR_____13_CM 0. 255. FORMAT "%3.0" /end CHARACTERISTIC
/begin CHARACTERISTIC ID_ERR_DTC_TD_IGC_CUT_1 "" CURVE 0x60530 _REC_CUR_20_u2_u2 65535. _CNV_A_R_LINEAR_____17_CM 0. 65535. FORMAT "%5.0"
 /begin AXIS_DESCR COM_AXIS ONLINE_DUMMY _CNV_S_6_RANGE_FMY__320_CM 6 0. 5. AXIS_PTS_REF ldp_fmy_dtc /end AXIS_DESCR
/end CHARACTERISTIC
/begin CHARACTERISTIC ID_ERR_ENVD_TD_IGC_CUT_1 "" CURVE 0x6052c _REC_CUR_20_u1_u1 17. _CNV_S_6_RANGE_DIAG_321_CM 4. 21.
 /begin AXIS_DESCR COM_AXIS ONLINE_DUMMY _CNV_S_4_RANGE_FMY__322_CM 4 0. 3. AXIS_PTS_REF ldp_fmy_envd /end AXIS_DESCR
/end CHARACTERISTIC
/begin CHARACTERISTIC C_DIAG_CONF_TD_IGC_CUT_1 "" VALUE 0x6053c _REC_VAL_20_u1 255. _CNV_A_R_LINEAR_____13_CM 0. 255. FORMAT "%3.0" /end CHARACTERISTIC
/begin CHARACTERISTIC C_DC_INC_TD_IGC_CUT_1 "" VALUE 0x6053d _REC_VAL_20_u1 255. _CNV_A_R_LINEAR_____13_CM 0. 255. FORMAT "%3.0" /end CHARACTERISTIC
/begin CHARACTERISTIC C_DC_MAX_TD_IGC_CUT_1 "" VALUE 0x6053f _REC_VAL_20_u1 255. _CNV_A_R_LINEAR_____13_CM 0. 255. FORMAT "%3.0" /end CHARACTERISTIC
/begin CHARACTERISTIC C_DC_DEC_TD_IGC_CUT_1 "" VALUE 0x6053e _REC_VAL_20_u1 255. _CNV_A_R_LINEAR_____13_CM 0. 255. FORMAT "%3.0" /end CHARACTERISTIC
/begin CHARACTERISTIC ID_ERR_DTC_TD_IGC_CUT_2 "" CURVE 0x60544 _REC_CUR_20_u2_u2 65535. _CNV_A_R_LINEAR_____17_CM 0. 65535. FORMAT "%5.0"
 /begin AXIS_DESCR COM_AXIS ONLINE_DUMMY _CNV_S_6_RANGE_FMY__320_CM 6 0. 5. AXIS_PTS_REF ldp_fmy_dtc /end AXIS_DESCR
/end CHARACTERISTIC
/begin CHARACTERISTIC ID_ERR_ENVD_TD_IGC_CUT_2 "" CURVE 0x60540 _REC_CUR_20_u1_u1 17. _CNV_S_6_RANGE_DIAG_321_CM 4. 21.
 /begin AXIS_DESCR COM_AXIS ONLINE_DUMMY _CNV_S_4_RANGE_FMY__322_CM 4 0. 3. AXIS_PTS_REF ldp_fmy_envd /end AXIS_DESCR
/end CHARACTERISTIC
/begin CHARACTERISTIC C_DIAG_CONF_TD_IGC_CUT_2 "" VALUE 0x60550 _REC_VAL_20_u1 255. _CNV_A_R_LINEAR_____13_CM 0. 255. FORMAT "%3.0" /end CHARACTERISTIC
/begin CHARACTERISTIC C_DC_INC_TD_IGC_CUT_2 "" VALUE 0x60551 _REC_VAL_20_u1 255. _CNV_A_R_LINEAR_____13_CM 0. 255. FORMAT "%3.0" /end CHARACTERISTIC
/begin CHARACTERISTIC C_DC_MAX_TD_IGC_CUT_2 "" VALUE 0x60553 _REC_VAL_20_u1 255. _CNV_A_R_LINEAR_____13_CM 0. 255. FORMAT "%3.0" /end CHARACTERISTIC
/begin CHARACTERISTIC C_DC_DEC_TD_IGC_CUT_2 "" VALUE 0x60552 _REC_VAL_20_u1 255. _CNV_A_R_LINEAR_____13_CM 0. 255. FORMAT "%3.0" /end CHARACTERISTIC
/begin CHARACTERISTIC ID_ERR_DTC_TD_IGC_CUT_3 "" CURVE 0x60558 _REC_CUR_20_u2_u2 65535. _CNV_A_R_LINEAR_____17_CM 0. 65535. FORMAT "%5.0"
 /begin AXIS_DESCR COM_AXIS ONLINE_DUMMY _CNV_S_6_RANGE_FMY__320_CM 6 0. 5. AXIS_PTS_REF ldp_fmy_dtc /end AXIS_DESCR
/end CHARACTERISTIC
/begin CHARACTERISTIC ID_ERR_ENVD_TD_IGC_CUT_3 "" CURVE 0x60554 _REC_CUR_20_u1_u1 17. _CNV_S_6_RANGE_DIAG_321_CM 4. 21.
 /begin AXIS_DESCR COM_AXIS ONLINE_DUMMY _CNV_S_4_RANGE_FMY__322_CM 4 0. 3. AXIS_PTS_REF ldp_fmy_envd /end AXIS_DESCR
/end CHARACTERISTIC
/begin CHARACTERISTIC C_DIAG_CONF_TD_IGC_CUT_3 "" VALUE 0x60564 _REC_VAL_20_u1 255. _CNV_A_R_LINEAR_____13_CM 0. 255. FORMAT "%3.0" /end CHARACTERISTIC
/begin CHARACTERISTIC C_DC_INC_TD_IGC_CUT_3 "" VALUE 0x60565 _REC_VAL_20_u1 255. _CNV_A_R_LINEAR_____13_CM 0. 255. FORMAT "%3.0" /end CHARACTERISTIC
/begin CHARACTERISTIC C_DC_MAX_TD_IGC_CUT_3 "" VALUE 0x60567 _REC_VAL_20_u1 255. _CNV_A_R_LINEAR_____13_CM 0. 255. FORMAT "%3.0" /end CHARACTERISTIC
/begin CHARACTERISTIC C_DC_DEC_TD_IGC_CUT_3 "" VALUE 0x60566 _REC_VAL_20_u1 255. _CNV_A_R_LINEAR_____13_CM 0. 255. FORMAT "%3.0" /end CHARACTERISTIC
/begin CHARACTERISTIC ID_ERR_DTC_TD_IGC_CUT_4 "" CURVE 0x6056c _REC_CUR_20_u2_u2 65535. _CNV_A_R_LINEAR_____17_CM 0. 65535. FORMAT "%5.0"
 /begin AXIS_DESCR COM_AXIS ONLINE_DUMMY _CNV_S_6_RANGE_FMY__320_CM 6 0. 5. AXIS_PTS_REF ldp_fmy_dtc /end AXIS_DESCR
/end CHARACTERISTIC
/begin CHARACTERISTIC ID_ERR_ENVD_TD_IGC_CUT_4 "" CURVE 0x60568 _REC_CUR_20_u1_u1 17. _CNV_S_6_RANGE_DIAG_321_CM 4. 21.
 /begin AXIS_DESCR COM_AXIS ONLINE_DUMMY _CNV_S_4_RANGE_FMY__322_CM 4 0. 3. AXIS_PTS_REF ldp_fmy_envd /end AXIS_DESCR
/end CHARACTERISTIC
/begin CHARACTERISTIC C_DIAG_CONF_TD_IGC_CUT_4 "" VALUE 0x60578 _REC_VAL_20_u1 255. _CNV_A_R_LINEAR_____13_CM 0. 255. FORMAT "%3.0" /end CHARACTERISTIC
/begin CHARACTERISTIC C_DC_INC_TD_IGC_CUT_4 "" VALUE 0x60579 _REC_VAL_20_u1 255. _CNV_A_R_LINEAR_____13_CM 0. 255. FORMAT "%3.0" /end CHARACTERISTIC
/begin CHARACTERISTIC C_DC_MAX_TD_IGC_CUT_4 "" VALUE 0x6057b _REC_VAL_20_u1 255. _CNV_A_R_LINEAR_____13_CM 0. 255. FORMAT "%3.0" /end CHARACTERISTIC
/begin CHARACTERISTIC C_DC_DEC_TD_IGC_CUT_4 "" VALUE 0x6057a _REC_VAL_20_u1 255. _CNV_A_R_LINEAR_____13_CM 0. 255. FORMAT "%3.0" /end CHARACTERISTIC
/begin CHARACTERISTIC ID_ERR_DTC_TD_IGC_CUT_5 "" CURVE 0x60580 _REC_CUR_20_u2_u2 65535. _CNV_A_R_LINEAR_____17_CM 0. 65535. FORMAT "%5.0"
 /begin AXIS_DESCR COM_AXIS ONLINE_DUMMY _CNV_S_6_RANGE_FMY__320_CM 6 0. 5. AXIS_PTS_REF ldp_fmy_dtc /end AXIS_DESCR
/end CHARACTERISTIC
/begin CHARACTERISTIC ID_ERR_ENVD_TD_IGC_CUT_5 "" CURVE 0x6057c _REC_CUR_20_u1_u1 17. _CNV_S_6_RANGE_DIAG_321_CM 4. 21.
 /begin AXIS_DESCR COM_AXIS ONLINE_DUMMY _CNV_S_4_RANGE_FMY__322_CM 4 0. 3. AXIS_PTS_REF ldp_fmy_envd /end AXIS_DESCR
/end CHARACTERISTIC
/begin CHARACTERISTIC C_DIAG_CONF_TD_IGC_CUT_5 "" VALUE 0x6058c _REC_VAL_20_u1 255. _CNV_A_R_LINEAR_____13_CM 0. 255. FORMAT "%3.0" /end CHARACTERISTIC
/begin CHARACTERISTIC C_DC_INC_TD_IGC_CUT_5 "" VALUE 0x6058d _REC_VAL_20_u1 255. _CNV_A_R_LINEAR_____13_CM 0. 255. FORMAT "%3.0" /end CHARACTERISTIC
/begin CHARACTERISTIC C_DC_MAX_TD_IGC_CUT_5 "" VALUE 0x6058f _REC_VAL_20_u1 255. _CNV_A_R_LINEAR_____13_CM 0. 255. FORMAT "%3.0" /end CHARACTERISTIC
/begin CHARACTERISTIC C_DC_DEC_TD_IGC_CUT_5 "" VALUE 0x6058e _REC_VAL_20_u1 255. _CNV_A_R_LINEAR_____13_CM 0. 255. FORMAT "%3.0" /end CHARACTERISTIC
/begin CHARACTERISTIC ID_ERR_DTC_DUR_IGC_0 "" CURVE 0x60594 _REC_CUR_20_u2_u2 65535. _CNV_A_R_LINEAR_____17_CM 0. 65535. FORMAT "%5.0"
 /begin AXIS_DESCR COM_AXIS ONLINE_DUMMY _CNV_S_6_RANGE_FMY__320_CM 6 0. 5. AXIS_PTS_REF ldp_fmy_dtc /end AXIS_DESCR
/end CHARACTERISTIC
/begin CHARACTERISTIC ID_ERR_ENVD_DUR_IGC_0 "" CURVE 0x60590 _REC_CUR_20_u1_u1 17. _CNV_S_6_RANGE_DIAG_321_CM 4. 21.
 /begin AXIS_DESCR COM_AXIS ONLINE_DUMMY _CNV_S_4_RANGE_FMY__322_CM 4 0. 3. AXIS_PTS_REF ldp_fmy_envd /end AXIS_DESCR
/end CHARACTERISTIC
/begin CHARACTERISTIC C_DIAG_CONF_DUR_IGC_0 "" VALUE 0x605a0 _REC_VAL_20_u1 255. _CNV_A_R_LINEAR_____13_CM 0. 255. FORMAT "%3.0" /end CHARACTERISTIC
/begin CHARACTERISTIC C_DC_INC_DUR_IGC_0 "" VALUE 0x605a1 _REC_VAL_20_u1 255. _CNV_A_R_LINEAR_____13_CM 0. 255. FORMAT "%3.0" /end CHARACTERISTIC
/begin CHARACTERISTIC C_DC_MAX_DUR_IGC_0 "" VALUE 0x605a3 _REC_VAL_20_u1 255. _CNV_A_R_LINEAR_____13_CM 0. 255. FORMAT "%3.0" /end CHARACTERISTIC
/begin CHARACTERISTIC C_DC_DEC_DUR_IGC_0 "" VALUE 0x605a2 _REC_VAL_20_u1 255. _CNV_A_R_LINEAR_____13_CM 0. 255. FORMAT "%3.0" /end CHARACTERISTIC
/begin CHARACTERISTIC ID_ERR_DTC_DUR_IGC_1 "" CURVE 0x605a8 _REC_CUR_20_u2_u2 65535. _CNV_A_R_LINEAR_____17_CM 0. 65535. FORMAT "%5.0"
 /begin AXIS_DESCR COM_AXIS ONLINE_DUMMY _CNV_S_6_RANGE_FMY__320_CM 6 0. 5. AXIS_PTS_REF ldp_fmy_dtc /end AXIS_DESCR
/end CHARACTERISTIC
/begin CHARACTERISTIC ID_ERR_ENVD_DUR_IGC_1 "" CURVE 0x605a4 _REC_CUR_20_u1_u1 17. _CNV_S_6_RANGE_DIAG_321_CM 4. 21.
 /begin AXIS_DESCR COM_AXIS ONLINE_DUMMY _CNV_S_4_RANGE_FMY__322_CM 4 0. 3. AXIS_PTS_REF ldp_fmy_envd /end AXIS_DESCR
/end CHARACTERISTIC
/begin CHARACTERISTIC C_DIAG_CONF_DUR_IGC_1 "" VALUE 0x605b4 _REC_VAL_20_u1 255. _CNV_A_R_LINEAR_____13_CM 0. 255. FORMAT "%3.0" /end CHARACTERISTIC
/begin CHARACTERISTIC C_DC_INC_DUR_IGC_1 "" VALUE 0x605b5 _REC_VAL_20_u1 255. _CNV_A_R_LINEAR_____13_CM 0. 255. FORMAT "%3.0" /end CHARACTERISTIC
/begin CHARACTERISTIC C_DC_MAX_DUR_IGC_1 "" VALUE 0x605b7 _REC_VAL_20_u1 255. _CNV_A_R_LINEAR_____13_CM 0. 255. FORMAT "%3.0" /end CHARACTERISTIC
/begin CHARACTERISTIC C_DC_DEC_DUR_IGC_1 "" VALUE 0x605b6 _REC_VAL_20_u1 255. _CNV_A_R_LINEAR_____13_CM 0. 255. FORMAT "%3.0" /end CHARACTERISTIC
/begin CHARACTERISTIC ID_ERR_DTC_DUR_IGC_2 "" CURVE 0x605bc _REC_CUR_20_u2_u2 65535. _CNV_A_R_LINEAR_____17_CM 0. 65535. FORMAT "%5.0"
 /begin AXIS_DESCR COM_AXIS ONLINE_DUMMY _CNV_S_6_RANGE_FMY__320_CM 6 0. 5. AXIS_PTS_REF ldp_fmy_dtc /end AXIS_DESCR
/end CHARACTERISTIC
/begin CHARACTERISTIC ID_ERR_ENVD_DUR_IGC_2 "" CURVE 0x605b8 _REC_CUR_20_u1_u1 17. _CNV_S_6_RANGE_DIAG_321_CM 4. 21.
 /begin AXIS_DESCR COM_AXIS ONLINE_DUMMY _CNV_S_4_RANGE_FMY__322_CM 4 0. 3. AXIS_PTS_REF ldp_fmy_envd /end AXIS_DESCR
/end CHARACTERISTIC
/begin CHARACTERISTIC C_DIAG_CONF_DUR_IGC_2 "" VALUE 0x605c8 _REC_VAL_20_u1 255. _CNV_A_R_LINEAR_____13_CM 0. 255. FORMAT "%3.0" /end CHARACTERISTIC
/begin CHARACTERISTIC C_DC_INC_DUR_IGC_2 "" VALUE 0x605c9 _REC_VAL_20_u1 255. _CNV_A_R_LINEAR_____13_CM 0. 255. FORMAT "%3.0" /end CHARACTERISTIC
/begin CHARACTERISTIC C_DC_MAX_DUR_IGC_2 "" VALUE 0x605cb _REC_VAL_20_u1 255. _CNV_A_R_LINEAR_____13_CM 0. 255. FORMAT "%3.0" /end CHARACTERISTIC
/begin CHARACTERISTIC C_DC_DEC_DUR_IGC_2 "" VALUE 0x605ca _REC_VAL_20_u1 255. _CNV_A_R_LINEAR_____13_CM 0. 255. FORMAT "%3.0" /end CHARACTERISTIC
/begin CHARACTERISTIC ID_ERR_DTC_DUR_IGC_3 "" CURVE 0x605d0 _REC_CUR_20_u2_u2 65535. _CNV_A_R_LINEAR_____17_CM 0. 65535. FORMAT "%5.0"
 /begin AXIS_DESCR COM_AXIS ONLINE_DUMMY _CNV_S_6_RANGE_FMY__320_CM 6 0. 5. AXIS_PTS_REF ldp_fmy_dtc /end AXIS_DESCR
/end CHARACTERISTIC
/begin CHARACTERISTIC ID_ERR_ENVD_DUR_IGC_3 "" CURVE 0x605cc _REC_CUR_20_u1_u1 17. _CNV_S_6_RANGE_DIAG_321_CM 4. 21.
 /begin AXIS_DESCR COM_AXIS ONLINE_DUMMY _CNV_S_4_RANGE_FMY__322_CM 4 0. 3. AXIS_PTS_REF ldp_fmy_envd /end AXIS_DESCR
/end CHARACTERISTIC
/begin CHARACTERISTIC C_DIAG_CONF_DUR_IGC_3 "" VALUE 0x605dc _REC_VAL_20_u1 255. _CNV_A_R_LINEAR_____13_CM 0. 255. FORMAT "%3.0" /end CHARACTERISTIC
/begin CHARACTERISTIC C_DC_INC_DUR_IGC_3 "" VALUE 0x605dd _REC_VAL_20_u1 255. _CNV_A_R_LINEAR_____13_CM 0. 255. FORMAT "%3.0" /end CHARACTERISTIC
/begin CHARACTERISTIC C_DC_MAX_DUR_IGC_3 "" VALUE 0x605df _REC_VAL_20_u1 255. _CNV_A_R_LINEAR_____13_CM 0. 255. FORMAT "%3.0" /end CHARACTERISTIC
/begin CHARACTERISTIC C_DC_DEC_DUR_IGC_3 "" VALUE 0x605de _REC_VAL_20_u1 255. _CNV_A_R_LINEAR_____13_CM 0. 255. FORMAT "%3.0" /end CHARACTERISTIC
/begin CHARACTERISTIC ID_ERR_DTC_DUR_IGC_4 "" CURVE 0x605e4 _REC_CUR_20_u2_u2 65535. _CNV_A_R_LINEAR_____17_CM 0. 65535. FORMAT "%5.0"
 /begin AXIS_DESCR COM_AXIS ONLINE_DUMMY _CNV_S_6_RANGE_FMY__320_CM 6 0. 5. AXIS_PTS_REF ldp_fmy_dtc /end AXIS_DESCR
/end CHARACTERISTIC
/begin CHARACTERISTIC ID_ERR_ENVD_DUR_IGC_4 "" CURVE 0x605e0 _REC_CUR_20_u1_u1 17. _CNV_S_6_RANGE_DIAG_321_CM 4. 21.
 /begin AXIS_DESCR COM_AXIS ONLINE_DUMMY _CNV_S_4_RANGE_FMY__322_CM 4 0. 3. AXIS_PTS_REF ldp_fmy_envd /end AXIS_DESCR
/end CHARACTERISTIC
/begin CHARACTERISTIC C_DIAG_CONF_DUR_IGC_4 "" VALUE 0x605f0 _REC_VAL_20_u1 255. _CNV_A_R_LINEAR_____13_CM 0. 255. FORMAT "%3.0" /end CHARACTERISTIC
/begin CHARACTERISTIC C_DC_INC_DUR_IGC_4 "" VALUE 0x605f1 _REC_VAL_20_u1 255. _CNV_A_R_LINEAR_____13_CM 0. 255. FORMAT "%3.0" /end CHARACTERISTIC
/begin CHARACTERISTIC C_DC_MAX_DUR_IGC_4 "" VALUE 0x605f3 _REC_VAL_20_u1 255. _CNV_A_R_LINEAR_____13_CM 0. 255. FORMAT "%3.0" /end CHARACTERISTIC
/begin CHARACTERISTIC C_DC_DEC_DUR_IGC_4 "" VALUE 0x605f2 _REC_VAL_20_u1 255. _CNV_A_R_LINEAR_____13_CM 0. 255. FORMAT "%3.0" /end CHARACTERISTIC
/begin CHARACTERISTIC ID_ERR_DTC_DUR_IGC_5 "" CURVE 0x605f8 _REC_CUR_20_u2_u2 65535. _CNV_A_R_LINEAR_____17_CM 0. 65535. FORMAT "%5.0"
 /begin AXIS_DESCR COM_AXIS ONLINE_DUMMY _CNV_S_6_RANGE_FMY__320_CM 6 0. 5. AXIS_PTS_REF ldp_fmy_dtc /end AXIS_DESCR
/end CHARACTERISTIC
/begin CHARACTERISTIC ID_ERR_ENVD_DUR_IGC_5 "" CURVE 0x605f4 _REC_CUR_20_u1_u1 17. _CNV_S_6_RANGE_DIAG_321_CM 4. 21.
 /begin AXIS_DESCR COM_AXIS ONLINE_DUMMY _CNV_S_4_RANGE_FMY__322_CM 4 0. 3. AXIS_PTS_REF ldp_fmy_envd /end AXIS_DESCR
/end CHARACTERISTIC
/begin CHARACTERISTIC C_DIAG_CONF_DUR_IGC_5 "" VALUE 0x60604 _REC_VAL_20_u1 255. _CNV_A_R_LINEAR_____13_CM 0. 255. FORMAT "%3.0" /end CHARACTERISTIC
/begin CHARACTERISTIC C_DC_INC_DUR_IGC_5 "" VALUE 0x60605 _REC_VAL_20_u1 255. _CNV_A_R_LINEAR_____13_CM 0. 255. FORMAT "%3.0" /end CHARACTERISTIC
/begin CHARACTERISTIC C_DC_MAX_DUR_IGC_5 "" VALUE 0x60607 _REC_VAL_20_u1 255. _CNV_A_R_LINEAR_____13_CM 0. 255. FORMAT "%3.0" /end CHARACTERISTIC
/begin CHARACTERISTIC C_DC_DEC_DUR_IGC_5 "" VALUE 0x60606 _REC_VAL_20_u1 255. _CNV_A_R_LINEAR_____13_CM 0. 255. FORMAT "%3.0" /end CHARACTERISTIC
/begin CHARACTERISTIC ID_ERR_DTC_TPS_1 "" CURVE 0x6060c _REC_CUR_20_u2_u2 65535. _CNV_A_R_LINEAR_____17_CM 0. 65535. FORMAT "%5.0"
 /begin AXIS_DESCR COM_AXIS ONLINE_DUMMY _CNV_S_6_RANGE_FMY__320_CM 6 0. 5. AXIS_PTS_REF ldp_fmy_dtc /end AXIS_DESCR
/end CHARACTERISTIC
/begin CHARACTERISTIC ID_ERR_ENVD_TPS_1 "" CURVE 0x60608 _REC_CUR_20_u1_u1 17. _CNV_S_6_RANGE_DIAG_321_CM 4. 21.
 /begin AXIS_DESCR COM_AXIS ONLINE_DUMMY _CNV_S_4_RANGE_FMY__322_CM 4 0. 3. AXIS_PTS_REF ldp_fmy_envd /end AXIS_DESCR
/end CHARACTERISTIC
/begin CHARACTERISTIC C_DIAG_CONF_TPS_1 "" VALUE 0x60618 _REC_VAL_20_u1 255. _CNV_A_R_LINEAR_____13_CM 0. 255. FORMAT "%3.0" /end CHARACTERISTIC
/begin CHARACTERISTIC C_DC_INC_TPS_1 "" VALUE 0x60619 _REC_VAL_20_u1 255. _CNV_A_R_LINEAR_____13_CM 0. 255. FORMAT "%3.0" /end CHARACTERISTIC
/begin CHARACTERISTIC C_DC_MAX_TPS_1 "" VALUE 0x6061b _REC_VAL_20_u1 255. _CNV_A_R_LINEAR_____13_CM 0. 255. FORMAT "%3.0" /end CHARACTERISTIC
/begin CHARACTERISTIC C_DC_DEC_TPS_1 "" VALUE 0x6061a _REC_VAL_20_u1 255. _CNV_A_R_LINEAR_____13_CM 0. 255. FORMAT "%3.0" /end CHARACTERISTIC
/begin CHARACTERISTIC ID_ERR_DTC_TPS_2 "" CURVE 0x60620 _REC_CUR_20_u2_u2 65535. _CNV_A_R_LINEAR_____17_CM 0. 65535. FORMAT "%5.0"
 /begin AXIS_DESCR COM_AXIS ONLINE_DUMMY _CNV_S_6_RANGE_FMY__320_CM 6 0. 5. AXIS_PTS_REF ldp_fmy_dtc /end AXIS_DESCR
/end CHARACTERISTIC
/begin CHARACTERISTIC ID_ERR_ENVD_TPS_2 "" CURVE 0x6061c _REC_CUR_20_u1_u1 17. _CNV_S_6_RANGE_DIAG_321_CM 4. 21.
 /begin AXIS_DESCR COM_AXIS ONLINE_DUMMY _CNV_S_4_RANGE_FMY__322_CM 4 0. 3. AXIS_PTS_REF ldp_fmy_envd /end AXIS_DESCR
/end CHARACTERISTIC
/begin CHARACTERISTIC C_DIAG_CONF_TPS_2 "" VALUE 0x6062c _REC_VAL_20_u1 255. _CNV_A_R_LINEAR_____13_CM 0. 255. FORMAT "%3.0" /end CHARACTERISTIC
/begin CHARACTERISTIC C_DC_INC_TPS_2 "" VALUE 0x6062d _REC_VAL_20_u1 255. _CNV_A_R_LINEAR_____13_CM 0. 255. FORMAT "%3.0" /end CHARACTERISTIC
/begin CHARACTERISTIC C_DC_MAX_TPS_2 "" VALUE 0x6062f _REC_VAL_20_u1 255. _CNV_A_R_LINEAR_____13_CM 0. 255. FORMAT "%3.0" /end CHARACTERISTIC
/begin CHARACTERISTIC C_DC_DEC_TPS_2 "" VALUE 0x6062e _REC_VAL_20_u1 255. _CNV_A_R_LINEAR_____13_CM 0. 255. FORMAT "%3.0" /end CHARACTERISTIC
/begin CHARACTERISTIC ID_ERR_DTC_TPS_MAF_1 "" CURVE 0x60634 _REC_CUR_20_u2_u2 65535. _CNV_A_R_LINEAR_____17_CM 0. 65535. FORMAT "%5.0"
 /begin AXIS_DESCR COM_AXIS ONLINE_DUMMY _CNV_S_6_RANGE_FMY__320_CM 6 0. 5. AXIS_PTS_REF ldp_fmy_dtc /end AXIS_DESCR
/end CHARACTERISTIC
/begin CHARACTERISTIC ID_ERR_ENVD_TPS_MAF_1 "" CURVE 0x60630 _REC_CUR_20_u1_u1 17. _CNV_S_6_RANGE_DIAG_321_CM 4. 21.
 /begin AXIS_DESCR COM_AXIS ONLINE_DUMMY _CNV_S_4_RANGE_FMY__322_CM 4 0. 3. AXIS_PTS_REF ldp_fmy_envd /end AXIS_DESCR
/end CHARACTERISTIC
/begin CHARACTERISTIC C_DIAG_CONF_TPS_MAF_1 "" VALUE 0x60640 _REC_VAL_20_u1 255. _CNV_A_R_LINEAR_____13_CM 0. 255. FORMAT "%3.0" /end CHARACTERISTIC
/begin CHARACTERISTIC C_DC_INC_TPS_MAF_1 "" VALUE 0x60641 _REC_VAL_20_u1 255. _CNV_A_R_LINEAR_____13_CM 0. 255. FORMAT "%3.0" /end CHARACTERISTIC
/begin CHARACTERISTIC C_DC_MAX_TPS_MAF_1 "" VALUE 0x60643 _REC_VAL_20_u1 255. _CNV_A_R_LINEAR_____13_CM 0. 255. FORMAT "%3.0" /end CHARACTERISTIC
/begin CHARACTERISTIC C_DC_DEC_TPS_MAF_1 "" VALUE 0x60642 _REC_VAL_20_u1 255. _CNV_A_R_LINEAR_____13_CM 0. 255. FORMAT "%3.0" /end CHARACTERISTIC
/begin CHARACTERISTIC ID_ERR_DTC_TPS_MAF_2 "" CURVE 0x60648 _REC_CUR_20_u2_u2 65535. _CNV_A_R_LINEAR_____17_CM 0. 65535. FORMAT "%5.0"
 /begin AXIS_DESCR COM_AXIS ONLINE_DUMMY _CNV_S_6_RANGE_FMY__320_CM 6 0. 5. AXIS_PTS_REF ldp_fmy_dtc /end AXIS_DESCR
/end CHARACTERISTIC
/begin CHARACTERISTIC ID_ERR_ENVD_TPS_MAF_2 "" CURVE 0x60644 _REC_CUR_20_u1_u1 17. _CNV_S_6_RANGE_DIAG_321_CM 4. 21.
 /begin AXIS_DESCR COM_AXIS ONLINE_DUMMY _CNV_S_4_RANGE_FMY__322_CM 4 0. 3. AXIS_PTS_REF ldp_fmy_envd /end AXIS_DESCR
/end CHARACTERISTIC
/begin CHARACTERISTIC C_DIAG_CONF_TPS_MAF_2 "" VALUE 0x60654 _REC_VAL_20_u1 255. _CNV_A_R_LINEAR_____13_CM 0. 255. FORMAT "%3.0" /end CHARACTERISTIC
/begin CHARACTERISTIC C_DC_INC_TPS_MAF_2 "" VALUE 0x60655 _REC_VAL_20_u1 255. _CNV_A_R_LINEAR_____13_CM 0. 255. FORMAT "%3.0" /end CHARACTERISTIC
/begin CHARACTERISTIC C_DC_MAX_TPS_MAF_2 "" VALUE 0x60657 _REC_VAL_20_u1 255. _CNV_A_R_LINEAR_____13_CM 0. 255. FORMAT "%3.0" /end CHARACTERISTIC
/begin CHARACTERISTIC C_DC_DEC_TPS_MAF_2 "" VALUE 0x60656 _REC_VAL_20_u1 255. _CNV_A_R_LINEAR_____13_CM 0. 255. FORMAT "%3.0" /end CHARACTERISTIC
/begin CHARACTERISTIC ID_ERR_DTC_TD "" CURVE 0x6065c _REC_CUR_20_u2_u2 65535. _CNV_A_R_LINEAR_____17_CM 0. 65535. FORMAT "%5.0"
 /begin AXIS_DESCR COM_AXIS ONLINE_DUMMY _CNV_S_6_RANGE_FMY__320_CM 6 0. 5. AXIS_PTS_REF ldp_fmy_dtc /end AXIS_DESCR
/end CHARACTERISTIC
/begin CHARACTERISTIC ID_ERR_ENVD_TD "" CURVE 0x60658 _REC_CUR_20_u1_u1 17. _CNV_S_6_RANGE_DIAG_321_CM 4. 21.
 /begin AXIS_DESCR COM_AXIS ONLINE_DUMMY _CNV_S_4_RANGE_FMY__322_CM 4 0. 3. AXIS_PTS_REF ldp_fmy_envd /end AXIS_DESCR
/end CHARACTERISTIC
/begin CHARACTERISTIC C_DIAG_CONF_TD "" VALUE 0x60668 _REC_VAL_20_u1 255. _CNV_A_R_LINEAR_____13_CM 0. 255. FORMAT "%3.0" /end CHARACTERISTIC
/begin CHARACTERISTIC C_DC_INC_TD "" VALUE 0x60669 _REC_VAL_20_u1 255. _CNV_A_R_LINEAR_____13_CM 0. 255. FORMAT "%3.0" /end CHARACTERISTIC
/begin CHARACTERISTIC C_DC_MAX_TD "" VALUE 0x6066b _REC_VAL_20_u1 255. _CNV_A_R_LINEAR_____13_CM 0. 255. FORMAT "%3.0" /end CHARACTERISTIC
/begin CHARACTERISTIC C_DC_DEC_TD "" VALUE 0x6066a _REC_VAL_20_u1 255. _CNV_A_R_LINEAR_____13_CM 0. 255. FORMAT "%3.0" /end CHARACTERISTIC
/begin CHARACTERISTIC ID_ERR_DTC_V_REF_1 "" CURVE 0x60670 _REC_CUR_20_u2_u2 65535. _CNV_A_R_LINEAR_____17_CM 0. 65535. FORMAT "%5.0"
 /begin AXIS_DESCR COM_AXIS ONLINE_DUMMY _CNV_S_6_RANGE_FMY__320_CM 6 0. 5. AXIS_PTS_REF ldp_fmy_dtc /end AXIS_DESCR
/end CHARACTERISTIC
/begin CHARACTERISTIC ID_ERR_ENVD_V_REF_1 "" CURVE 0x6066c _REC_CUR_20_u1_u1 17. _CNV_S_6_RANGE_DIAG_321_CM 4. 21.
 /begin AXIS_DESCR COM_AXIS ONLINE_DUMMY _CNV_S_4_RANGE_FMY__322_CM 4 0. 3. AXIS_PTS_REF ldp_fmy_envd /end AXIS_DESCR
/end CHARACTERISTIC
/begin CHARACTERISTIC C_DIAG_CONF_V_REF_1 "" VALUE 0x6067c _REC_VAL_20_u1 255. _CNV_A_R_LINEAR_____13_CM 0. 255. FORMAT "%3.0" /end CHARACTERISTIC
/begin CHARACTERISTIC C_DC_INC_V_REF_1 "" VALUE 0x6067d _REC_VAL_20_u1 255. _CNV_A_R_LINEAR_____13_CM 0. 255. FORMAT "%3.0" /end CHARACTERISTIC
/begin CHARACTERISTIC C_DC_MAX_V_REF_1 "" VALUE 0x6067f _REC_VAL_20_u1 255. _CNV_A_R_LINEAR_____13_CM 0. 255. FORMAT "%3.0" /end CHARACTERISTIC
/begin CHARACTERISTIC C_DC_DEC_V_REF_1 "" VALUE 0x6067e _REC_VAL_20_u1 255. _CNV_A_R_LINEAR_____13_CM 0. 255. FORMAT "%3.0" /end CHARACTERISTIC
/begin CHARACTERISTIC ID_ERR_DTC_V_REF_2 "" CURVE 0x60684 _REC_CUR_20_u2_u2 65535. _CNV_A_R_LINEAR_____17_CM 0. 65535. FORMAT "%5.0"
 /begin AXIS_DESCR COM_AXIS ONLINE_DUMMY _CNV_S_6_RANGE_FMY__320_CM 6 0. 5. AXIS_PTS_REF ldp_fmy_dtc /end AXIS_DESCR
/end CHARACTERISTIC
/begin CHARACTERISTIC ID_ERR_ENVD_V_REF_2 "" CURVE 0x60680 _REC_CUR_20_u1_u1 17. _CNV_S_6_RANGE_DIAG_321_CM 4. 21.
 /begin AXIS_DESCR COM_AXIS ONLINE_DUMMY _CNV_S_4_RANGE_FMY__322_CM 4 0. 3. AXIS_PTS_REF ldp_fmy_envd /end AXIS_DESCR
/end CHARACTERISTIC
/begin CHARACTERISTIC C_DIAG_CONF_V_REF_2 "" VALUE 0x60690 _REC_VAL_20_u1 255. _CNV_A_R_LINEAR_____13_CM 0. 255. FORMAT "%3.0" /end CHARACTERISTIC
/begin CHARACTERISTIC C_DC_INC_V_REF_2 "" VALUE 0x60691 _REC_VAL_20_u1 255. _CNV_A_R_LINEAR_____13_CM 0. 255. FORMAT "%3.0" /end CHARACTERISTIC
/begin CHARACTERISTIC C_DC_MAX_V_REF_2 "" VALUE 0x60693 _REC_VAL_20_u1 255. _CNV_A_R_LINEAR_____13_CM 0. 255. FORMAT "%3.0" /end CHARACTERISTIC
/begin CHARACTERISTIC C_DC_DEC_V_REF_2 "" VALUE 0x60692 _REC_VAL_20_u1 255. _CNV_A_R_LINEAR_____13_CM 0. 255. FORMAT "%3.0" /end CHARACTERISTIC
/begin CHARACTERISTIC ID_ERR_DTC_PVS_1 "" CURVE 0x60698 _REC_CUR_20_u2_u2 65535. _CNV_A_R_LINEAR_____17_CM 0. 65535. FORMAT "%5.0"
 /begin AXIS_DESCR COM_AXIS ONLINE_DUMMY _CNV_S_6_RANGE_FMY__320_CM 6 0. 5. AXIS_PTS_REF ldp_fmy_dtc /end AXIS_DESCR
/end CHARACTERISTIC
/begin CHARACTERISTIC ID_ERR_ENVD_PVS_1 "" CURVE 0x60694 _REC_CUR_20_u1_u1 17. _CNV_S_6_RANGE_DIAG_321_CM 4. 21.
 /begin AXIS_DESCR COM_AXIS ONLINE_DUMMY _CNV_S_4_RANGE_FMY__322_CM 4 0. 3. AXIS_PTS_REF ldp_fmy_envd /end AXIS_DESCR
/end CHARACTERISTIC
/begin CHARACTERISTIC C_DIAG_CONF_PVS_1 "" VALUE 0x606a4 _REC_VAL_20_u1 255. _CNV_A_R_LINEAR_____13_CM 0. 255. FORMAT "%3.0" /end CHARACTERISTIC
/begin CHARACTERISTIC C_DC_INC_PVS_1 "" VALUE 0x606a5 _REC_VAL_20_u1 255. _CNV_A_R_LINEAR_____13_CM 0. 255. FORMAT "%3.0" /end CHARACTERISTIC
/begin CHARACTERISTIC C_DC_MAX_PVS_1 "" VALUE 0x606a7 _REC_VAL_20_u1 255. _CNV_A_R_LINEAR_____13_CM 0. 255. FORMAT "%3.0" /end CHARACTERISTIC
/begin CHARACTERISTIC C_DC_DEC_PVS_1 "" VALUE 0x606a6 _REC_VAL_20_u1 255. _CNV_A_R_LINEAR_____13_CM 0. 255. FORMAT "%3.0" /end CHARACTERISTIC
/begin CHARACTERISTIC ID_ERR_DTC_PVS_2 "" CURVE 0x606ac _REC_CUR_20_u2_u2 65535. _CNV_A_R_LINEAR_____17_CM 0. 65535. FORMAT "%5.0"
 /begin AXIS_DESCR COM_AXIS ONLINE_DUMMY _CNV_S_6_RANGE_FMY__320_CM 6 0. 5. AXIS_PTS_REF ldp_fmy_dtc /end AXIS_DESCR
/end CHARACTERISTIC
/begin CHARACTERISTIC ID_ERR_ENVD_PVS_2 "" CURVE 0x606a8 _REC_CUR_20_u1_u1 17. _CNV_S_6_RANGE_DIAG_321_CM 4. 21.
 /begin AXIS_DESCR COM_AXIS ONLINE_DUMMY _CNV_S_4_RANGE_FMY__322_CM 4 0. 3. AXIS_PTS_REF ldp_fmy_envd /end AXIS_DESCR
/end CHARACTERISTIC
/begin CHARACTERISTIC C_DIAG_CONF_PVS_2 "" VALUE 0x606b8 _REC_VAL_20_u1 255. _CNV_A_R_LINEAR_____13_CM 0. 255. FORMAT "%3.0" /end CHARACTERISTIC
/begin CHARACTERISTIC C_DC_INC_PVS_2 "" VALUE 0x606b9 _REC_VAL_20_u1 255. _CNV_A_R_LINEAR_____13_CM 0. 255. FORMAT "%3.0" /end CHARACTERISTIC
/begin CHARACTERISTIC C_DC_MAX_PVS_2 "" VALUE 0x606bb _REC_VAL_20_u1 255. _CNV_A_R_LINEAR_____13_CM 0. 255. FORMAT "%3.0" /end CHARACTERISTIC
/begin CHARACTERISTIC C_DC_DEC_PVS_2 "" VALUE 0x606ba _REC_VAL_20_u1 255. _CNV_A_R_LINEAR_____13_CM 0. 255. FORMAT "%3.0" /end CHARACTERISTIC
/begin CHARACTERISTIC ID_ERR_DTC_PVS_RATIO "" CURVE 0x606c0 _REC_CUR_20_u2_u2 65535. _CNV_A_R_LINEAR_____17_CM 0. 65535. FORMAT "%5.0"
 /begin AXIS_DESCR COM_AXIS ONLINE_DUMMY _CNV_S_6_RANGE_FMY__320_CM 6 0. 5. AXIS_PTS_REF ldp_fmy_dtc /end AXIS_DESCR
/end CHARACTERISTIC
/begin CHARACTERISTIC ID_ERR_ENVD_PVS_RATIO "" CURVE 0x606bc _REC_CUR_20_u1_u1 17. _CNV_S_6_RANGE_DIAG_321_CM 4. 21.
 /begin AXIS_DESCR COM_AXIS ONLINE_DUMMY _CNV_S_4_RANGE_FMY__322_CM 4 0. 3. AXIS_PTS_REF ldp_fmy_envd /end AXIS_DESCR
/end CHARACTERISTIC
/begin CHARACTERISTIC C_DIAG_CONF_PVS_RATIO "" VALUE 0x606cc _REC_VAL_20_u1 255. _CNV_A_R_LINEAR_____13_CM 0. 255. FORMAT "%3.0" /end CHARACTERISTIC
/begin CHARACTERISTIC C_DC_INC_PVS_RATIO "" VALUE 0x606cd _REC_VAL_20_u1 255. _CNV_A_R_LINEAR_____13_CM 0. 255. FORMAT "%3.0" /end CHARACTERISTIC
/begin CHARACTERISTIC C_DC_MAX_PVS_RATIO "" VALUE 0x606cf _REC_VAL_20_u1 255. _CNV_A_R_LINEAR_____13_CM 0. 255. FORMAT "%3.0" /end CHARACTERISTIC
/begin CHARACTERISTIC C_DC_DEC_PVS_RATIO "" VALUE 0x606ce _REC_VAL_20_u1 255. _CNV_A_R_LINEAR_____13_CM 0. 255. FORMAT "%3.0" /end CHARACTERISTIC
/begin CHARACTERISTIC ID_ERR_DTC_PVS_DOUBLE "" CURVE 0x606d4 _REC_CUR_20_u2_u2 65535. _CNV_A_R_LINEAR_____17_CM 0. 65535. FORMAT "%5.0"
 /begin AXIS_DESCR COM_AXIS ONLINE_DUMMY _CNV_S_6_RANGE_FMY__320_CM 6 0. 5. AXIS_PTS_REF ldp_fmy_dtc /end AXIS_DESCR
/end CHARACTERISTIC
/begin CHARACTERISTIC ID_ERR_ENVD_PVS_DOUBLE "" CURVE 0x606d0 _REC_CUR_20_u1_u1 17. _CNV_S_6_RANGE_DIAG_321_CM 4. 21.
 /begin AXIS_DESCR COM_AXIS ONLINE_DUMMY _CNV_S_4_RANGE_FMY__322_CM 4 0. 3. AXIS_PTS_REF ldp_fmy_envd /end AXIS_DESCR
/end CHARACTERISTIC
/begin CHARACTERISTIC C_DIAG_CONF_PVS_DOUBLE "" VALUE 0x606e0 _REC_VAL_20_u1 255. _CNV_A_R_LINEAR_____13_CM 0. 255. FORMAT "%3.0" /end CHARACTERISTIC
/begin CHARACTERISTIC C_DC_INC_PVS_DOUBLE "" VALUE 0x606e1 _REC_VAL_20_u1 255. _CNV_A_R_LINEAR_____13_CM 0. 255. FORMAT "%3.0" /end CHARACTERISTIC
/begin CHARACTERISTIC C_DC_MAX_PVS_DOUBLE "" VALUE 0x606e3 _REC_VAL_20_u1 255. _CNV_A_R_LINEAR_____13_CM 0. 255. FORMAT "%3.0" /end CHARACTERISTIC
/begin CHARACTERISTIC C_DC_DEC_PVS_DOUBLE "" VALUE 0x606e2 _REC_VAL_20_u1 255. _CNV_A_R_LINEAR_____13_CM 0. 255. FORMAT "%3.0" /end CHARACTERISTIC
/begin CHARACTERISTIC ID_ERR_DTC_MTC_DR "" CURVE 0x606e8 _REC_CUR_20_u2_u2 65535. _CNV_A_R_LINEAR_____17_CM 0. 65535. FORMAT "%5.0"
 /begin AXIS_DESCR COM_AXIS ONLINE_DUMMY _CNV_S_6_RANGE_FMY__320_CM 6 0. 5. AXIS_PTS_REF ldp_fmy_dtc /end AXIS_DESCR
/end CHARACTERISTIC
/begin CHARACTERISTIC ID_ERR_ENVD_MTC_DR "" CURVE 0x606e4 _REC_CUR_20_u1_u1 17. _CNV_S_6_RANGE_DIAG_321_CM 4. 21.
 /begin AXIS_DESCR COM_AXIS ONLINE_DUMMY _CNV_S_4_RANGE_FMY__322_CM 4 0. 3. AXIS_PTS_REF ldp_fmy_envd /end AXIS_DESCR
/end CHARACTERISTIC
/begin CHARACTERISTIC C_DIAG_CONF_MTC_DR "" VALUE 0x606f4 _REC_VAL_20_u1 255. _CNV_A_R_LINEAR_____13_CM 0. 255. FORMAT "%3.0" /end CHARACTERISTIC
/begin CHARACTERISTIC C_DC_INC_MTC_DR "" VALUE 0x606f5 _REC_VAL_20_u1 255. _CNV_A_R_LINEAR_____13_CM 0. 255. FORMAT "%3.0" /end CHARACTERISTIC
/begin CHARACTERISTIC C_DC_MAX_MTC_DR "" VALUE 0x606f7 _REC_VAL_20_u1 255. _CNV_A_R_LINEAR_____13_CM 0. 255. FORMAT "%3.0" /end CHARACTERISTIC
/begin CHARACTERISTIC C_DC_DEC_MTC_DR "" VALUE 0x606f6 _REC_VAL_20_u1 255. _CNV_A_R_LINEAR_____13_CM 0. 255. FORMAT "%3.0" /end CHARACTERISTIC
/begin CHARACTERISTIC ID_ERR_DTC_MTC_CTL_1 "" CURVE 0x606fc _REC_CUR_20_u2_u2 65535. _CNV_A_R_LINEAR_____17_CM 0. 65535. FORMAT "%5.0"
 /begin AXIS_DESCR COM_AXIS ONLINE_DUMMY _CNV_S_6_RANGE_FMY__320_CM 6 0. 5. AXIS_PTS_REF ldp_fmy_dtc /end AXIS_DESCR
/end CHARACTERISTIC
/begin CHARACTERISTIC ID_ERR_ENVD_MTC_CTL_1 "" CURVE 0x606f8 _REC_CUR_20_u1_u1 17. _CNV_S_6_RANGE_DIAG_321_CM 4. 21.
 /begin AXIS_DESCR COM_AXIS ONLINE_DUMMY _CNV_S_4_RANGE_FMY__322_CM 4 0. 3. AXIS_PTS_REF ldp_fmy_envd /end AXIS_DESCR
/end CHARACTERISTIC
/begin CHARACTERISTIC C_DIAG_CONF_MTC_CTL_1 "" VALUE 0x60708 _REC_VAL_20_u1 255. _CNV_A_R_LINEAR_____13_CM 0. 255. FORMAT "%3.0" /end CHARACTERISTIC
/begin CHARACTERISTIC C_DC_INC_MTC_CTL_1 "" VALUE 0x60709 _REC_VAL_20_u1 255. _CNV_A_R_LINEAR_____13_CM 0. 255. FORMAT "%3.0" /end CHARACTERISTIC
/begin CHARACTERISTIC C_DC_MAX_MTC_CTL_1 "" VALUE 0x6070b _REC_VAL_20_u1 255. _CNV_A_R_LINEAR_____13_CM 0. 255. FORMAT "%3.0" /end CHARACTERISTIC
/begin CHARACTERISTIC C_DC_DEC_MTC_CTL_1 "" VALUE 0x6070a _REC_VAL_20_u1 255. _CNV_A_R_LINEAR_____13_CM 0. 255. FORMAT "%3.0" /end CHARACTERISTIC
/begin CHARACTERISTIC ID_ERR_DTC_MTC_CTL_2 "" CURVE 0x60710 _REC_CUR_20_u2_u2 65535. _CNV_A_R_LINEAR_____17_CM 0. 65535. FORMAT "%5.0"
 /begin AXIS_DESCR COM_AXIS ONLINE_DUMMY _CNV_S_6_RANGE_FMY__320_CM 6 0. 5. AXIS_PTS_REF ldp_fmy_dtc /end AXIS_DESCR
/end CHARACTERISTIC
/begin CHARACTERISTIC ID_ERR_ENVD_MTC_CTL_2 "" CURVE 0x6070c _REC_CUR_20_u1_u1 17. _CNV_S_6_RANGE_DIAG_321_CM 4. 21.
 /begin AXIS_DESCR COM_AXIS ONLINE_DUMMY _CNV_S_4_RANGE_FMY__322_CM 4 0. 3. AXIS_PTS_REF ldp_fmy_envd /end AXIS_DESCR
/end CHARACTERISTIC
/begin CHARACTERISTIC C_DIAG_CONF_MTC_CTL_2 "" VALUE 0x6071c _REC_VAL_20_u1 255. _CNV_A_R_LINEAR_____13_CM 0. 255. FORMAT "%3.0" /end CHARACTERISTIC
/begin CHARACTERISTIC C_DC_INC_MTC_CTL_2 "" VALUE 0x6071d _REC_VAL_20_u1 255. _CNV_A_R_LINEAR_____13_CM 0. 255. FORMAT "%3.0" /end CHARACTERISTIC
/begin CHARACTERISTIC C_DC_MAX_MTC_CTL_2 "" VALUE 0x6071f _REC_VAL_20_u1 255. _CNV_A_R_LINEAR_____13_CM 0. 255. FORMAT "%3.0" /end CHARACTERISTIC
/begin CHARACTERISTIC C_DC_DEC_MTC_CTL_2 "" VALUE 0x6071e _REC_VAL_20_u1 255. _CNV_A_R_LINEAR_____13_CM 0. 255. FORMAT "%3.0" /end CHARACTERISTIC
/begin CHARACTERISTIC ID_ERR_DTC_MTC_CTL_3 "" CURVE 0x60724 _REC_CUR_20_u2_u2 65535. _CNV_A_R_LINEAR_____17_CM 0. 65535. FORMAT "%5.0"
 /begin AXIS_DESCR COM_AXIS ONLINE_DUMMY _CNV_S_6_RANGE_FMY__320_CM 6 0. 5. AXIS_PTS_REF ldp_fmy_dtc /end AXIS_DESCR
/end CHARACTERISTIC
/begin CHARACTERISTIC ID_ERR_ENVD_MTC_CTL_3 "" CURVE 0x60720 _REC_CUR_20_u1_u1 17. _CNV_S_6_RANGE_DIAG_321_CM 4. 21.
 /begin AXIS_DESCR COM_AXIS ONLINE_DUMMY _CNV_S_4_RANGE_FMY__322_CM 4 0. 3. AXIS_PTS_REF ldp_fmy_envd /end AXIS_DESCR
/end CHARACTERISTIC
/begin CHARACTERISTIC C_DIAG_CONF_MTC_CTL_3 "" VALUE 0x60730 _REC_VAL_20_u1 255. _CNV_A_R_LINEAR_____13_CM 0. 255. FORMAT "%3.0" /end CHARACTERISTIC
/begin CHARACTERISTIC C_DC_INC_MTC_CTL_3 "" VALUE 0x60731 _REC_VAL_20_u1 255. _CNV_A_R_LINEAR_____13_CM 0. 255. FORMAT "%3.0" /end CHARACTERISTIC
/begin CHARACTERISTIC C_DC_MAX_MTC_CTL_3 "" VALUE 0x60733 _REC_VAL_20_u1 255. _CNV_A_R_LINEAR_____13_CM 0. 255. FORMAT "%3.0" /end CHARACTERISTIC
/begin CHARACTERISTIC C_DC_DEC_MTC_CTL_3 "" VALUE 0x60732 _REC_VAL_20_u1 255. _CNV_A_R_LINEAR_____13_CM 0. 255. FORMAT "%3.0" /end CHARACTERISTIC
/begin CHARACTERISTIC ID_ERR_DTC_TPS_AD "" CURVE 0x60738 _REC_CUR_20_u2_u2 65535. _CNV_A_R_LINEAR_____17_CM 0. 65535. FORMAT "%5.0"
 /begin AXIS_DESCR COM_AXIS ONLINE_DUMMY _CNV_S_6_RANGE_FMY__320_CM 6 0. 5. AXIS_PTS_REF ldp_fmy_dtc /end AXIS_DESCR
/end CHARACTERISTIC
/begin CHARACTERISTIC ID_ERR_ENVD_TPS_AD "" CURVE 0x60734 _REC_CUR_20_u1_u1 17. _CNV_S_6_RANGE_DIAG_321_CM 4. 21.
 /begin AXIS_DESCR COM_AXIS ONLINE_DUMMY _CNV_S_4_RANGE_FMY__322_CM 4 0. 3. AXIS_PTS_REF ldp_fmy_envd /end AXIS_DESCR
/end CHARACTERISTIC
/begin CHARACTERISTIC C_DIAG_CONF_TPS_AD "" VALUE 0x60744 _REC_VAL_20_u1 255. _CNV_A_R_LINEAR_____13_CM 0. 255. FORMAT "%3.0" /end CHARACTERISTIC
/begin CHARACTERISTIC C_DC_INC_TPS_AD "" VALUE 0x60745 _REC_VAL_20_u1 255. _CNV_A_R_LINEAR_____13_CM 0. 255. FORMAT "%3.0" /end CHARACTERISTIC
/begin CHARACTERISTIC C_DC_MAX_TPS_AD "" VALUE 0x60747 _REC_VAL_20_u1 255. _CNV_A_R_LINEAR_____13_CM 0. 255. FORMAT "%3.0" /end CHARACTERISTIC
/begin CHARACTERISTIC C_DC_DEC_TPS_AD "" VALUE 0x60746 _REC_VAL_20_u1 255. _CNV_A_R_LINEAR_____13_CM 0. 255. FORMAT "%3.0" /end CHARACTERISTIC
/begin CHARACTERISTIC ID_ERR_DTC_TPS_ST_CHK_1 "" CURVE 0x6074c _REC_CUR_20_u2_u2 65535. _CNV_A_R_LINEAR_____17_CM 0. 65535. FORMAT "%5.0"
 /begin AXIS_DESCR COM_AXIS ONLINE_DUMMY _CNV_S_6_RANGE_FMY__320_CM 6 0. 5. AXIS_PTS_REF ldp_fmy_dtc /end AXIS_DESCR
/end CHARACTERISTIC
/begin CHARACTERISTIC ID_ERR_ENVD_TPS_ST_CHK_1 "" CURVE 0x60748 _REC_CUR_20_u1_u1 17. _CNV_S_6_RANGE_DIAG_321_CM 4. 21.
 /begin AXIS_DESCR COM_AXIS ONLINE_DUMMY _CNV_S_4_RANGE_FMY__322_CM 4 0. 3. AXIS_PTS_REF ldp_fmy_envd /end AXIS_DESCR
/end CHARACTERISTIC
/begin CHARACTERISTIC C_DIAG_CONF_TPS_ST_CHK_1 "" VALUE 0x60758 _REC_VAL_20_u1 255. _CNV_A_R_LINEAR_____13_CM 0. 255. FORMAT "%3.0" /end CHARACTERISTIC
/begin CHARACTERISTIC C_DC_INC_TPS_ST_CHK_1 "" VALUE 0x60759 _REC_VAL_20_u1 255. _CNV_A_R_LINEAR_____13_CM 0. 255. FORMAT "%3.0" /end CHARACTERISTIC
/begin CHARACTERISTIC C_DC_MAX_TPS_ST_CHK_1 "" VALUE 0x6075b _REC_VAL_20_u1 255. _CNV_A_R_LINEAR_____13_CM 0. 255. FORMAT "%3.0" /end CHARACTERISTIC
/begin CHARACTERISTIC C_DC_DEC_TPS_ST_CHK_1 "" VALUE 0x6075a _REC_VAL_20_u1 255. _CNV_A_R_LINEAR_____13_CM 0. 255. FORMAT "%3.0" /end CHARACTERISTIC
/begin CHARACTERISTIC ID_ERR_DTC_TPS_ST_CHK_2 "" CURVE 0x60760 _REC_CUR_20_u2_u2 65535. _CNV_A_R_LINEAR_____17_CM 0. 65535. FORMAT "%5.0"
 /begin AXIS_DESCR COM_AXIS ONLINE_DUMMY _CNV_S_6_RANGE_FMY__320_CM 6 0. 5. AXIS_PTS_REF ldp_fmy_dtc /end AXIS_DESCR
/end CHARACTERISTIC
/begin CHARACTERISTIC ID_ERR_ENVD_TPS_ST_CHK_2 "" CURVE 0x6075c _REC_CUR_20_u1_u1 17. _CNV_S_6_RANGE_DIAG_321_CM 4. 21.
 /begin AXIS_DESCR COM_AXIS ONLINE_DUMMY _CNV_S_4_RANGE_FMY__322_CM 4 0. 3. AXIS_PTS_REF ldp_fmy_envd /end AXIS_DESCR
/end CHARACTERISTIC
/begin CHARACTERISTIC C_DIAG_CONF_TPS_ST_CHK_2 "" VALUE 0x6076c _REC_VAL_20_u1 255. _CNV_A_R_LINEAR_____13_CM 0. 255. FORMAT "%3.0" /end CHARACTERISTIC
/begin CHARACTERISTIC C_DC_INC_TPS_ST_CHK_2 "" VALUE 0x6076d _REC_VAL_20_u1 255. _CNV_A_R_LINEAR_____13_CM 0. 255. FORMAT "%3.0" /end CHARACTERISTIC
/begin CHARACTERISTIC C_DC_MAX_TPS_ST_CHK_2 "" VALUE 0x6076f _REC_VAL_20_u1 255. _CNV_A_R_LINEAR_____13_CM 0. 255. FORMAT "%3.0" /end CHARACTERISTIC
/begin CHARACTERISTIC C_DC_DEC_TPS_ST_CHK_2 "" VALUE 0x6076e _REC_VAL_20_u1 255. _CNV_A_R_LINEAR_____13_CM 0. 255. FORMAT "%3.0" /end CHARACTERISTIC
/begin CHARACTERISTIC ID_ERR_DTC_GEN "" CURVE 0x60774 _REC_CUR_20_u2_u2 65535. _CNV_A_R_LINEAR_____17_CM 0. 65535. FORMAT "%5.0"
 /begin AXIS_DESCR COM_AXIS ONLINE_DUMMY _CNV_S_6_RANGE_FMY__320_CM 6 0. 5. AXIS_PTS_REF ldp_fmy_dtc /end AXIS_DESCR
/end CHARACTERISTIC
/begin CHARACTERISTIC ID_ERR_ENVD_GEN "" CURVE 0x60770 _REC_CUR_20_u1_u1 17. _CNV_S_6_RANGE_DIAG_321_CM 4. 21.
 /begin AXIS_DESCR COM_AXIS ONLINE_DUMMY _CNV_S_4_RANGE_FMY__322_CM 4 0. 3. AXIS_PTS_REF ldp_fmy_envd /end AXIS_DESCR
/end CHARACTERISTIC
/begin CHARACTERISTIC C_DIAG_CONF_GEN "" VALUE 0x60780 _REC_VAL_20_u1 255. _CNV_A_R_LINEAR_____13_CM 0. 255. FORMAT "%3.0" /end CHARACTERISTIC
/begin CHARACTERISTIC C_DC_INC_GEN "" VALUE 0x60781 _REC_VAL_20_u1 255. _CNV_A_R_LINEAR_____13_CM 0. 255. FORMAT "%3.0" /end CHARACTERISTIC
/begin CHARACTERISTIC C_DC_MAX_GEN "" VALUE 0x60783 _REC_VAL_20_u1 255. _CNV_A_R_LINEAR_____13_CM 0. 255. FORMAT "%3.0" /end CHARACTERISTIC
/begin CHARACTERISTIC C_DC_DEC_GEN "" VALUE 0x60782 _REC_VAL_20_u1 255. _CNV_A_R_LINEAR_____13_CM 0. 255. FORMAT "%3.0" /end CHARACTERISTIC
/begin CHARACTERISTIC ID_ERR_DTC_VIM "" CURVE 0x60788 _REC_CUR_20_u2_u2 65535. _CNV_A_R_LINEAR_____17_CM 0. 65535. FORMAT "%5.0"
 /begin AXIS_DESCR COM_AXIS ONLINE_DUMMY _CNV_S_6_RANGE_FMY__320_CM 6 0. 5. AXIS_PTS_REF ldp_fmy_dtc /end AXIS_DESCR
/end CHARACTERISTIC
/begin CHARACTERISTIC ID_ERR_ENVD_VIM "" CURVE 0x60784 _REC_CUR_20_u1_u1 17. _CNV_S_6_RANGE_DIAG_321_CM 4. 21.
 /begin AXIS_DESCR COM_AXIS ONLINE_DUMMY _CNV_S_4_RANGE_FMY__322_CM 4 0. 3. AXIS_PTS_REF ldp_fmy_envd /end AXIS_DESCR
/end CHARACTERISTIC
/begin CHARACTERISTIC C_DIAG_CONF_VIM "" VALUE 0x60794 _REC_VAL_20_u1 255. _CNV_A_R_LINEAR_____13_CM 0. 255. FORMAT "%3.0" /end CHARACTERISTIC
/begin CHARACTERISTIC C_DC_INC_VIM "" VALUE 0x60795 _REC_VAL_20_u1 255. _CNV_A_R_LINEAR_____13_CM 0. 255. FORMAT "%3.0" /end CHARACTERISTIC
/begin CHARACTERISTIC C_DC_MAX_VIM "" VALUE 0x60797 _REC_VAL_20_u1 255. _CNV_A_R_LINEAR_____13_CM 0. 255. FORMAT "%3.0" /end CHARACTERISTIC
/begin CHARACTERISTIC C_DC_DEC_VIM "" VALUE 0x60796 _REC_VAL_20_u1 255. _CNV_A_R_LINEAR_____13_CM 0. 255. FORMAT "%3.0" /end CHARACTERISTIC
/begin CHARACTERISTIC ID_ERR_DTC_ENG_PSN "" CURVE 0x6079c _REC_CUR_20_u2_u2 65535. _CNV_A_R_LINEAR_____17_CM 0. 65535. FORMAT "%5.0"
 /begin AXIS_DESCR COM_AXIS ONLINE_DUMMY _CNV_S_6_RANGE_FMY__320_CM 6 0. 5. AXIS_PTS_REF ldp_fmy_dtc /end AXIS_DESCR
/end CHARACTERISTIC
/begin CHARACTERISTIC ID_ERR_ENVD_ENG_PSN "" CURVE 0x60798 _REC_CUR_20_u1_u1 17. _CNV_S_6_RANGE_DIAG_321_CM 4. 21.
 /begin AXIS_DESCR COM_AXIS ONLINE_DUMMY _CNV_S_4_RANGE_FMY__322_CM 4 0. 3. AXIS_PTS_REF ldp_fmy_envd /end AXIS_DESCR
/end CHARACTERISTIC
/begin CHARACTERISTIC C_DIAG_CONF_ENG_PSN "" VALUE 0x607a8 _REC_VAL_20_u1 255. _CNV_A_R_LINEAR_____13_CM 0. 255. FORMAT "%3.0" /end CHARACTERISTIC
/begin CHARACTERISTIC C_DC_INC_ENG_PSN "" VALUE 0x607a9 _REC_VAL_20_u1 255. _CNV_A_R_LINEAR_____13_CM 0. 255. FORMAT "%3.0" /end CHARACTERISTIC
/begin CHARACTERISTIC C_DC_MAX_ENG_PSN "" VALUE 0x607ab _REC_VAL_20_u1 255. _CNV_A_R_LINEAR_____13_CM 0. 255. FORMAT "%3.0" /end CHARACTERISTIC
/begin CHARACTERISTIC C_DC_DEC_ENG_PSN "" VALUE 0x607aa _REC_VAL_20_u1 255. _CNV_A_R_LINEAR_____13_CM 0. 255. FORMAT "%3.0" /end CHARACTERISTIC
/begin CHARACTERISTIC ID_ERR_DTC_TOOTH_PER "" CURVE 0x607b0 _REC_CUR_20_u2_u2 65535. _CNV_A_R_LINEAR_____17_CM 0. 65535. FORMAT "%5.0"
 /begin AXIS_DESCR COM_AXIS ONLINE_DUMMY _CNV_S_6_RANGE_FMY__320_CM 6 0. 5. AXIS_PTS_REF ldp_fmy_dtc /end AXIS_DESCR
/end CHARACTERISTIC
/begin CHARACTERISTIC ID_ERR_ENVD_TOOTH_PER "" CURVE 0x607ac _REC_CUR_20_u1_u1 17. _CNV_S_6_RANGE_DIAG_321_CM 4. 21.
 /begin AXIS_DESCR COM_AXIS ONLINE_DUMMY _CNV_S_4_RANGE_FMY__322_CM 4 0. 3. AXIS_PTS_REF ldp_fmy_envd /end AXIS_DESCR
/end CHARACTERISTIC
/begin CHARACTERISTIC C_DIAG_CONF_TOOTH_PER "" VALUE 0x607bc _REC_VAL_20_u1 255. _CNV_A_R_LINEAR_____13_CM 0. 255. FORMAT "%3.0" /end CHARACTERISTIC
/begin CHARACTERISTIC C_DC_INC_TOOTH_PER "" VALUE 0x607bd _REC_VAL_20_u1 255. _CNV_A_R_LINEAR_____13_CM 0. 255. FORMAT "%3.0" /end CHARACTERISTIC
/begin CHARACTERISTIC C_DC_MAX_TOOTH_PER "" VALUE 0x607bf _REC_VAL_20_u1 255. _CNV_A_R_LINEAR_____13_CM 0. 255. FORMAT "%3.0" /end CHARACTERISTIC
/begin CHARACTERISTIC C_DC_DEC_TOOTH_PER "" VALUE 0x607be _REC_VAL_20_u1 255. _CNV_A_R_LINEAR_____13_CM 0. 255. FORMAT "%3.0" /end CHARACTERISTIC
/begin CHARACTERISTIC ID_ERR_DTC_TPU_SYN "" CURVE 0x607c4 _REC_CUR_20_u2_u2 65535. _CNV_A_R_LINEAR_____17_CM 0. 65535. FORMAT "%5.0"
 /begin AXIS_DESCR COM_AXIS ONLINE_DUMMY _CNV_S_6_RANGE_FMY__320_CM 6 0. 5. AXIS_PTS_REF ldp_fmy_dtc /end AXIS_DESCR
/end CHARACTERISTIC
/begin CHARACTERISTIC ID_ERR_ENVD_TPU_SYN "" CURVE 0x607c0 _REC_CUR_20_u1_u1 17. _CNV_S_6_RANGE_DIAG_321_CM 4. 21.
 /begin AXIS_DESCR COM_AXIS ONLINE_DUMMY _CNV_S_4_RANGE_FMY__322_CM 4 0. 3. AXIS_PTS_REF ldp_fmy_envd /end AXIS_DESCR
/end CHARACTERISTIC
/begin CHARACTERISTIC C_DIAG_CONF_TPU_SYN "" VALUE 0x607d0 _REC_VAL_20_u1 255. _CNV_A_R_LINEAR_____13_CM 0. 255. FORMAT "%3.0" /end CHARACTERISTIC
/begin CHARACTERISTIC C_DC_INC_TPU_SYN "" VALUE 0x607d1 _REC_VAL_20_u1 255. _CNV_A_R_LINEAR_____13_CM 0. 255. FORMAT "%3.0" /end CHARACTERISTIC
/begin CHARACTERISTIC C_DC_MAX_TPU_SYN "" VALUE 0x607d3 _REC_VAL_20_u1 255. _CNV_A_R_LINEAR_____13_CM 0. 255. FORMAT "%3.0" /end CHARACTERISTIC
/begin CHARACTERISTIC C_DC_DEC_TPU_SYN "" VALUE 0x607d2 _REC_VAL_20_u1 255. _CNV_A_R_LINEAR_____13_CM 0. 255. FORMAT "%3.0" /end CHARACTERISTIC
/begin CHARACTERISTIC ID_ERR_DTC_CAM_PER_0 "" CURVE 0x607d8 _REC_CUR_20_u2_u2 65535. _CNV_A_R_LINEAR_____17_CM 0. 65535. FORMAT "%5.0"
 /begin AXIS_DESCR COM_AXIS ONLINE_DUMMY _CNV_S_6_RANGE_FMY__320_CM 6 0. 5. AXIS_PTS_REF ldp_fmy_dtc /end AXIS_DESCR
/end CHARACTERISTIC
/begin CHARACTERISTIC ID_ERR_ENVD_CAM_PER_0 "" CURVE 0x607d4 _REC_CUR_20_u1_u1 17. _CNV_S_6_RANGE_DIAG_321_CM 4. 21.
 /begin AXIS_DESCR COM_AXIS ONLINE_DUMMY _CNV_S_4_RANGE_FMY__322_CM 4 0. 3. AXIS_PTS_REF ldp_fmy_envd /end AXIS_DESCR
/end CHARACTERISTIC
/begin CHARACTERISTIC C_DIAG_CONF_CAM_PER_0 "" VALUE 0x607e4 _REC_VAL_20_u1 255. _CNV_A_R_LINEAR_____13_CM 0. 255. FORMAT "%3.0" /end CHARACTERISTIC
/begin CHARACTERISTIC C_DC_INC_CAM_PER_0 "" VALUE 0x607e5 _REC_VAL_20_u1 255. _CNV_A_R_LINEAR_____13_CM 0. 255. FORMAT "%3.0" /end CHARACTERISTIC
/begin CHARACTERISTIC C_DC_MAX_CAM_PER_0 "" VALUE 0x607e7 _REC_VAL_20_u1 255. _CNV_A_R_LINEAR_____13_CM 0. 255. FORMAT "%3.0" /end CHARACTERISTIC
/begin CHARACTERISTIC C_DC_DEC_CAM_PER_0 "" VALUE 0x607e6 _REC_VAL_20_u1 255. _CNV_A_R_LINEAR_____13_CM 0. 255. FORMAT "%3.0" /end CHARACTERISTIC
/begin CHARACTERISTIC ID_ERR_DTC_CAM_PER_1 "" CURVE 0x607ec _REC_CUR_20_u2_u2 65535. _CNV_A_R_LINEAR_____17_CM 0. 65535. FORMAT "%5.0"
 /begin AXIS_DESCR COM_AXIS ONLINE_DUMMY _CNV_S_6_RANGE_FMY__320_CM 6 0. 5. AXIS_PTS_REF ldp_fmy_dtc /end AXIS_DESCR
/end CHARACTERISTIC
/begin CHARACTERISTIC ID_ERR_ENVD_CAM_PER_1 "" CURVE 0x607e8 _REC_CUR_20_u1_u1 17. _CNV_S_6_RANGE_DIAG_321_CM 4. 21.
 /begin AXIS_DESCR COM_AXIS ONLINE_DUMMY _CNV_S_4_RANGE_FMY__322_CM 4 0. 3. AXIS_PTS_REF ldp_fmy_envd /end AXIS_DESCR
/end CHARACTERISTIC
/begin CHARACTERISTIC C_DIAG_CONF_CAM_PER_1 "" VALUE 0x607f8 _REC_VAL_20_u1 255. _CNV_A_R_LINEAR_____13_CM 0. 255. FORMAT "%3.0" /end CHARACTERISTIC
/begin CHARACTERISTIC C_DC_INC_CAM_PER_1 "" VALUE 0x607f9 _REC_VAL_20_u1 255. _CNV_A_R_LINEAR_____13_CM 0. 255. FORMAT "%3.0" /end CHARACTERISTIC
/begin CHARACTERISTIC C_DC_MAX_CAM_PER_1 "" VALUE 0x607fb _REC_VAL_20_u1 255. _CNV_A_R_LINEAR_____13_CM 0. 255. FORMAT "%3.0" /end CHARACTERISTIC
/begin CHARACTERISTIC C_DC_DEC_CAM_PER_1 "" VALUE 0x607fa _REC_VAL_20_u1 255. _CNV_A_R_LINEAR_____13_CM 0. 255. FORMAT "%3.0" /end CHARACTERISTIC
/begin CHARACTERISTIC ID_ERR_DTC_CAM_PSN_0 "" CURVE 0x60800 _REC_CUR_20_u2_u2 65535. _CNV_A_R_LINEAR_____17_CM 0. 65535. FORMAT "%5.0"
 /begin AXIS_DESCR COM_AXIS ONLINE_DUMMY _CNV_S_6_RANGE_FMY__320_CM 6 0. 5. AXIS_PTS_REF ldp_fmy_dtc /end AXIS_DESCR
/end CHARACTERISTIC
/begin CHARACTERISTIC ID_ERR_ENVD_CAM_PSN_0 "" CURVE 0x607fc _REC_CUR_20_u1_u1 17. _CNV_S_6_RANGE_DIAG_321_CM 4. 21.
 /begin AXIS_DESCR COM_AXIS ONLINE_DUMMY _CNV_S_4_RANGE_FMY__322_CM 4 0. 3. AXIS_PTS_REF ldp_fmy_envd /end AXIS_DESCR
/end CHARACTERISTIC
/begin CHARACTERISTIC C_DIAG_CONF_CAM_PSN_0 "" VALUE 0x6080c _REC_VAL_20_u1 255. _CNV_A_R_LINEAR_____13_CM 0. 255. FORMAT "%3.0" /end CHARACTERISTIC
/begin CHARACTERISTIC C_DC_INC_CAM_PSN_0 "" VALUE 0x6080d _REC_VAL_20_u1 255. _CNV_A_R_LINEAR_____13_CM 0. 255. FORMAT "%3.0" /end CHARACTERISTIC
/begin CHARACTERISTIC C_DC_MAX_CAM_PSN_0 "" VALUE 0x6080f _REC_VAL_20_u1 255. _CNV_A_R_LINEAR_____13_CM 0. 255. FORMAT "%3.0" /end CHARACTERISTIC
/begin CHARACTERISTIC C_DC_DEC_CAM_PSN_0 "" VALUE 0x6080e _REC_VAL_20_u1 255. _CNV_A_R_LINEAR_____13_CM 0. 255. FORMAT "%3.0" /end CHARACTERISTIC
/begin CHARACTERISTIC ID_ERR_DTC_CAM_PSN_1 "" CURVE 0x60814 _REC_CUR_20_u2_u2 65535. _CNV_A_R_LINEAR_____17_CM 0. 65535. FORMAT "%5.0"
 /begin AXIS_DESCR COM_AXIS ONLINE_DUMMY _CNV_S_6_RANGE_FMY__320_CM 6 0. 5. AXIS_PTS_REF ldp_fmy_dtc /end AXIS_DESCR
/end CHARACTERISTIC
/begin CHARACTERISTIC ID_ERR_ENVD_CAM_PSN_1 "" CURVE 0x60810 _REC_CUR_20_u1_u1 17. _CNV_S_6_RANGE_DIAG_321_CM 4. 21.
 /begin AXIS_DESCR COM_AXIS ONLINE_DUMMY _CNV_S_4_RANGE_FMY__322_CM 4 0. 3. AXIS_PTS_REF ldp_fmy_envd /end AXIS_DESCR
/end CHARACTERISTIC
/begin CHARACTERISTIC C_DIAG_CONF_CAM_PSN_1 "" VALUE 0x60820 _REC_VAL_20_u1 255. _CNV_A_R_LINEAR_____13_CM 0. 255. FORMAT "%3.0" /end CHARACTERISTIC
/begin CHARACTERISTIC C_DC_INC_CAM_PSN_1 "" VALUE 0x60821 _REC_VAL_20_u1 255. _CNV_A_R_LINEAR_____13_CM 0. 255. FORMAT "%3.0" /end CHARACTERISTIC
/begin CHARACTERISTIC C_DC_MAX_CAM_PSN_1 "" VALUE 0x60823 _REC_VAL_20_u1 255. _CNV_A_R_LINEAR_____13_CM 0. 255. FORMAT "%3.0" /end CHARACTERISTIC
/begin CHARACTERISTIC C_DC_DEC_CAM_PSN_1 "" VALUE 0x60822 _REC_VAL_20_u1 255. _CNV_A_R_LINEAR_____13_CM 0. 255. FORMAT "%3.0" /end CHARACTERISTIC
/begin CHARACTERISTIC ID_ERR_DTC_TOUT_TXU_1 "" CURVE 0x60828 _REC_CUR_20_u2_u2 65535. _CNV_A_R_LINEAR_____17_CM 0. 65535. FORMAT "%5.0"
 /begin AXIS_DESCR COM_AXIS ONLINE_DUMMY _CNV_S_6_RANGE_FMY__320_CM 6 0. 5. AXIS_PTS_REF ldp_fmy_dtc /end AXIS_DESCR
/end CHARACTERISTIC
/begin CHARACTERISTIC ID_ERR_ENVD_TOUT_TXU_1 "" CURVE 0x60824 _REC_CUR_20_u1_u1 17. _CNV_S_6_RANGE_DIAG_321_CM 4. 21.
 /begin AXIS_DESCR COM_AXIS ONLINE_DUMMY _CNV_S_4_RANGE_FMY__322_CM 4 0. 3. AXIS_PTS_REF ldp_fmy_envd /end AXIS_DESCR
/end CHARACTERISTIC
/begin CHARACTERISTIC C_DIAG_CONF_TOUT_TXU_1 "" VALUE 0x60834 _REC_VAL_20_u1 255. _CNV_A_R_LINEAR_____13_CM 0. 255. FORMAT "%3.0" /end CHARACTERISTIC
/begin CHARACTERISTIC C_DC_INC_TOUT_TXU_1 "" VALUE 0x60835 _REC_VAL_20_u1 255. _CNV_A_R_LINEAR_____13_CM 0. 255. FORMAT "%3.0" /end CHARACTERISTIC
/begin CHARACTERISTIC C_DC_MAX_TOUT_TXU_1 "" VALUE 0x60837 _REC_VAL_20_u1 255. _CNV_A_R_LINEAR_____13_CM 0. 255. FORMAT "%3.0" /end CHARACTERISTIC
/begin CHARACTERISTIC C_DC_DEC_TOUT_TXU_1 "" VALUE 0x60836 _REC_VAL_20_u1 255. _CNV_A_R_LINEAR_____13_CM 0. 255. FORMAT "%3.0" /end CHARACTERISTIC
/begin CHARACTERISTIC ID_ERR_DTC_CAN_BOFF "" CURVE 0x6083c _REC_CUR_20_u2_u2 65535. _CNV_A_R_LINEAR_____17_CM 0. 65535. FORMAT "%5.0"
 /begin AXIS_DESCR COM_AXIS ONLINE_DUMMY _CNV_S_6_RANGE_FMY__320_CM 6 0. 5. AXIS_PTS_REF ldp_fmy_dtc /end AXIS_DESCR
/end CHARACTERISTIC
/begin CHARACTERISTIC ID_ERR_ENVD_CAN_BOFF "" CURVE 0x60838 _REC_CUR_20_u1_u1 17. _CNV_S_6_RANGE_DIAG_321_CM 4. 21.
 /begin AXIS_DESCR COM_AXIS ONLINE_DUMMY _CNV_S_4_RANGE_FMY__322_CM 4 0. 3. AXIS_PTS_REF ldp_fmy_envd /end AXIS_DESCR
/end CHARACTERISTIC
/begin CHARACTERISTIC C_DIAG_CONF_CAN_BOFF "" VALUE 0x60848 _REC_VAL_20_u1 255. _CNV_A_R_LINEAR_____13_CM 0. 255. FORMAT "%3.0" /end CHARACTERISTIC
/begin CHARACTERISTIC C_DC_INC_CAN_BOFF "" VALUE 0x60849 _REC_VAL_20_u1 255. _CNV_A_R_LINEAR_____13_CM 0. 255. FORMAT "%3.0" /end CHARACTERISTIC
/begin CHARACTERISTIC C_DC_MAX_CAN_BOFF "" VALUE 0x6084b _REC_VAL_20_u1 255. _CNV_A_R_LINEAR_____13_CM 0. 255. FORMAT "%3.0" /end CHARACTERISTIC
/begin CHARACTERISTIC C_DC_DEC_CAN_BOFF "" VALUE 0x6084a _REC_VAL_20_u1 255. _CNV_A_R_LINEAR_____13_CM 0. 255. FORMAT "%3.0" /end CHARACTERISTIC
/begin CHARACTERISTIC ID_ERR_DTC_RLY_MAIN "" CURVE 0x60850 _REC_CUR_20_u2_u2 65535. _CNV_A_R_LINEAR_____17_CM 0. 65535. FORMAT "%5.0"
 /begin AXIS_DESCR COM_AXIS ONLINE_DUMMY _CNV_S_6_RANGE_FMY__320_CM 6 0. 5. AXIS_PTS_REF ldp_fmy_dtc /end AXIS_DESCR
/end CHARACTERISTIC
/begin CHARACTERISTIC ID_ERR_ENVD_RLY_MAIN "" CURVE 0x6084c _REC_CUR_20_u1_u1 17. _CNV_S_6_RANGE_DIAG_321_CM 4. 21.
 /begin AXIS_DESCR COM_AXIS ONLINE_DUMMY _CNV_S_4_RANGE_FMY__322_CM 4 0. 3. AXIS_PTS_REF ldp_fmy_envd /end AXIS_DESCR
/end CHARACTERISTIC
/begin CHARACTERISTIC C_DIAG_CONF_RLY_MAIN "" VALUE 0x6085c _REC_VAL_20_u1 255. _CNV_A_R_LINEAR_____13_CM 0. 255. FORMAT "%3.0" /end CHARACTERISTIC
/begin CHARACTERISTIC C_DC_INC_RLY_MAIN "" VALUE 0x6085d _REC_VAL_20_u1 255. _CNV_A_R_LINEAR_____13_CM 0. 255. FORMAT "%3.0" /end CHARACTERISTIC
/begin CHARACTERISTIC C_DC_MAX_RLY_MAIN "" VALUE 0x6085f _REC_VAL_20_u1 255. _CNV_A_R_LINEAR_____13_CM 0. 255. FORMAT "%3.0" /end CHARACTERISTIC
/begin CHARACTERISTIC C_DC_DEC_RLY_MAIN "" VALUE 0x6085e _REC_VAL_20_u1 255. _CNV_A_R_LINEAR_____13_CM 0. 255. FORMAT "%3.0" /end CHARACTERISTIC
/begin CHARACTERISTIC ID_ERR_DTC_RLY_ACCOUT "" CURVE 0x60864 _REC_CUR_20_u2_u2 65535. _CNV_A_R_LINEAR_____17_CM 0. 65535. FORMAT "%5.0"
 /begin AXIS_DESCR COM_AXIS ONLINE_DUMMY _CNV_S_6_RANGE_FMY__320_CM 6 0. 5. AXIS_PTS_REF ldp_fmy_dtc /end AXIS_DESCR
/end CHARACTERISTIC
/begin CHARACTERISTIC ID_ERR_ENVD_RLY_ACCOUT "" CURVE 0x60860 _REC_CUR_20_u1_u1 17. _CNV_S_6_RANGE_DIAG_321_CM 4. 21.
 /begin AXIS_DESCR COM_AXIS ONLINE_DUMMY _CNV_S_4_RANGE_FMY__322_CM 4 0. 3. AXIS_PTS_REF ldp_fmy_envd /end AXIS_DESCR
/end CHARACTERISTIC
/begin CHARACTERISTIC C_DIAG_CONF_RLY_ACCOUT "" VALUE 0x60870 _REC_VAL_20_u1 255. _CNV_A_R_LINEAR_____13_CM 0. 255. FORMAT "%3.0" /end CHARACTERISTIC
/begin CHARACTERISTIC C_DC_INC_RLY_ACCOUT "" VALUE 0x60871 _REC_VAL_20_u1 255. _CNV_A_R_LINEAR_____13_CM 0. 255. FORMAT "%3.0" /end CHARACTERISTIC
/begin CHARACTERISTIC C_DC_MAX_RLY_ACCOUT "" VALUE 0x60873 _REC_VAL_20_u1 255. _CNV_A_R_LINEAR_____13_CM 0. 255. FORMAT "%3.0" /end CHARACTERISTIC
/begin CHARACTERISTIC C_DC_DEC_RLY_ACCOUT "" VALUE 0x60872 _REC_VAL_20_u1 255. _CNV_A_R_LINEAR_____13_CM 0. 255. FORMAT "%3.0" /end CHARACTERISTIC
/begin CHARACTERISTIC ID_ERR_DTC_SAP "" CURVE 0x60878 _REC_CUR_20_u2_u2 65535. _CNV_A_R_LINEAR_____17_CM 0. 65535. FORMAT "%5.0"
 /begin AXIS_DESCR COM_AXIS ONLINE_DUMMY _CNV_S_6_RANGE_FMY__320_CM 6 0. 5. AXIS_PTS_REF ldp_fmy_dtc /end AXIS_DESCR
/end CHARACTERISTIC
/begin CHARACTERISTIC ID_ERR_ENVD_SAP "" CURVE 0x60874 _REC_CUR_20_u1_u1 17. _CNV_S_6_RANGE_DIAG_321_CM 4. 21.
 /begin AXIS_DESCR COM_AXIS ONLINE_DUMMY _CNV_S_4_RANGE_FMY__322_CM 4 0. 3. AXIS_PTS_REF ldp_fmy_envd /end AXIS_DESCR
/end CHARACTERISTIC
/begin CHARACTERISTIC C_DIAG_CONF_SAP "" VALUE 0x60884 _REC_VAL_20_u1 255. _CNV_A_R_LINEAR_____13_CM 0. 255. FORMAT "%3.0" /end CHARACTERISTIC
/begin CHARACTERISTIC C_DC_INC_SAP "" VALUE 0x60885 _REC_VAL_20_u1 255. _CNV_A_R_LINEAR_____13_CM 0. 255. FORMAT "%3.0" /end CHARACTERISTIC
/begin CHARACTERISTIC C_DC_MAX_SAP "" VALUE 0x60887 _REC_VAL_20_u1 255. _CNV_A_R_LINEAR_____13_CM 0. 255. FORMAT "%3.0" /end CHARACTERISTIC
/begin CHARACTERISTIC C_DC_DEC_SAP "" VALUE 0x60886 _REC_VAL_20_u1 255. _CNV_A_R_LINEAR_____13_CM 0. 255. FORMAT "%3.0" /end CHARACTERISTIC
/begin CHARACTERISTIC ID_ERR_DTC_SAV "" CURVE 0x6088c _REC_CUR_20_u2_u2 65535. _CNV_A_R_LINEAR_____17_CM 0. 65535. FORMAT "%5.0"
 /begin AXIS_DESCR COM_AXIS ONLINE_DUMMY _CNV_S_6_RANGE_FMY__320_CM 6 0. 5. AXIS_PTS_REF ldp_fmy_dtc /end AXIS_DESCR
/end CHARACTERISTIC
/begin CHARACTERISTIC ID_ERR_ENVD_SAV "" CURVE 0x60888 _REC_CUR_20_u1_u1 17. _CNV_S_6_RANGE_DIAG_321_CM 4. 21.
 /begin AXIS_DESCR COM_AXIS ONLINE_DUMMY _CNV_S_4_RANGE_FMY__322_CM 4 0. 3. AXIS_PTS_REF ldp_fmy_envd /end AXIS_DESCR
/end CHARACTERISTIC
/begin CHARACTERISTIC C_DIAG_CONF_SAV "" VALUE 0x60898 _REC_VAL_20_u1 255. _CNV_A_R_LINEAR_____13_CM 0. 255. FORMAT "%3.0" /end CHARACTERISTIC
/begin CHARACTERISTIC C_DC_INC_SAV "" VALUE 0x60899 _REC_VAL_20_u1 255. _CNV_A_R_LINEAR_____13_CM 0. 255. FORMAT "%3.0" /end CHARACTERISTIC
/begin CHARACTERISTIC C_DC_MAX_SAV "" VALUE 0x6089b _REC_VAL_20_u1 255. _CNV_A_R_LINEAR_____13_CM 0. 255. FORMAT "%3.0" /end CHARACTERISTIC
/begin CHARACTERISTIC C_DC_DEC_SAV "" VALUE 0x6089a _REC_VAL_20_u1 255. _CNV_A_R_LINEAR_____13_CM 0. 255. FORMAT "%3.0" /end CHARACTERISTIC
/begin CHARACTERISTIC ID_ERR_DTC_ECF "" CURVE 0x608a0 _REC_CUR_20_u2_u2 65535. _CNV_A_R_LINEAR_____17_CM 0. 65535. FORMAT "%5.0"
 /begin AXIS_DESCR COM_AXIS ONLINE_DUMMY _CNV_S_6_RANGE_FMY__320_CM 6 0. 5. AXIS_PTS_REF ldp_fmy_dtc /end AXIS_DESCR
/end CHARACTERISTIC
/begin CHARACTERISTIC ID_ERR_ENVD_ECF "" CURVE 0x6089c _REC_CUR_20_u1_u1 17. _CNV_S_6_RANGE_DIAG_321_CM 4. 21.
 /begin AXIS_DESCR COM_AXIS ONLINE_DUMMY _CNV_S_4_RANGE_FMY__322_CM 4 0. 3. AXIS_PTS_REF ldp_fmy_envd /end AXIS_DESCR
/end CHARACTERISTIC
/begin CHARACTERISTIC C_DIAG_CONF_ECF "" VALUE 0x608ac _REC_VAL_20_u1 255. _CNV_A_R_LINEAR_____13_CM 0. 255. FORMAT "%3.0" /end CHARACTERISTIC
/begin CHARACTERISTIC C_DC_INC_ECF "" VALUE 0x608ad _REC_VAL_20_u1 255. _CNV_A_R_LINEAR_____13_CM 0. 255. FORMAT "%3.0" /end CHARACTERISTIC
/begin CHARACTERISTIC C_DC_MAX_ECF "" VALUE 0x608af _REC_VAL_20_u1 255. _CNV_A_R_LINEAR_____13_CM 0. 255. FORMAT "%3.0" /end CHARACTERISTIC
/begin CHARACTERISTIC C_DC_DEC_ECF "" VALUE 0x608ae _REC_VAL_20_u1 255. _CNV_A_R_LINEAR_____13_CM 0. 255. FORMAT "%3.0" /end CHARACTERISTIC
/begin CHARACTERISTIC ID_ERR_DTC_TCO_EL "" CURVE 0x608b4 _REC_CUR_20_u2_u2 65535. _CNV_A_R_LINEAR_____17_CM 0. 65535. FORMAT "%5.0"
 /begin AXIS_DESCR COM_AXIS ONLINE_DUMMY _CNV_S_6_RANGE_FMY__320_CM 6 0. 5. AXIS_PTS_REF ldp_fmy_dtc /end AXIS_DESCR
/end CHARACTERISTIC
/begin CHARACTERISTIC ID_ERR_ENVD_TCO_EL "" CURVE 0x608b0 _REC_CUR_20_u1_u1 17. _CNV_S_6_RANGE_DIAG_321_CM 4. 21.
 /begin AXIS_DESCR COM_AXIS ONLINE_DUMMY _CNV_S_4_RANGE_FMY__322_CM 4 0. 3. AXIS_PTS_REF ldp_fmy_envd /end AXIS_DESCR
/end CHARACTERISTIC
/begin CHARACTERISTIC C_DIAG_CONF_TCO_EL "" VALUE 0x608c0 _REC_VAL_20_u1 255. _CNV_A_R_LINEAR_____13_CM 0. 255. FORMAT "%3.0" /end CHARACTERISTIC
/begin CHARACTERISTIC C_DC_INC_TCO_EL "" VALUE 0x608c1 _REC_VAL_20_u1 255. _CNV_A_R_LINEAR_____13_CM 0. 255. FORMAT "%3.0" /end CHARACTERISTIC
/begin CHARACTERISTIC C_DC_MAX_TCO_EL "" VALUE 0x608c3 _REC_VAL_20_u1 255. _CNV_A_R_LINEAR_____13_CM 0. 255. FORMAT "%3.0" /end CHARACTERISTIC
/begin CHARACTERISTIC C_DC_DEC_TCO_EL "" VALUE 0x608c2 _REC_VAL_20_u1 255. _CNV_A_R_LINEAR_____13_CM 0. 255. FORMAT "%3.0" /end CHARACTERISTIC
/begin CHARACTERISTIC ID_ERR_DTC_TCO_STUCK "" CURVE 0x608c8 _REC_CUR_20_u2_u2 65535. _CNV_A_R_LINEAR_____17_CM 0. 65535. FORMAT "%5.0"
 /begin AXIS_DESCR COM_AXIS ONLINE_DUMMY _CNV_S_6_RANGE_FMY__320_CM 6 0. 5. AXIS_PTS_REF ldp_fmy_dtc /end AXIS_DESCR
/end CHARACTERISTIC
/begin CHARACTERISTIC ID_ERR_ENVD_TCO_STUCK "" CURVE 0x608c4 _REC_CUR_20_u1_u1 17. _CNV_S_6_RANGE_DIAG_321_CM 4. 21.
 /begin AXIS_DESCR COM_AXIS ONLINE_DUMMY _CNV_S_4_RANGE_FMY__322_CM 4 0. 3. AXIS_PTS_REF ldp_fmy_envd /end AXIS_DESCR
/end CHARACTERISTIC
/begin CHARACTERISTIC C_DIAG_CONF_TCO_STUCK "" VALUE 0x608d4 _REC_VAL_20_u1 255. _CNV_A_R_LINEAR_____13_CM 0. 255. FORMAT "%3.0" /end CHARACTERISTIC
/begin CHARACTERISTIC C_DC_INC_TCO_STUCK "" VALUE 0x608d5 _REC_VAL_20_u1 255. _CNV_A_R_LINEAR_____13_CM 0. 255. FORMAT "%3.0" /end CHARACTERISTIC
/begin CHARACTERISTIC C_DC_MAX_TCO_STUCK "" VALUE 0x608d7 _REC_VAL_20_u1 255. _CNV_A_R_LINEAR_____13_CM 0. 255. FORMAT "%3.0" /end CHARACTERISTIC
/begin CHARACTERISTIC C_DC_DEC_TCO_STUCK "" VALUE 0x608d6 _REC_VAL_20_u1 255. _CNV_A_R_LINEAR_____13_CM 0. 255. FORMAT "%3.0" /end CHARACTERISTIC
/begin CHARACTERISTIC ID_ERR_DTC_TCO_GRD "" CURVE 0x608dc _REC_CUR_20_u2_u2 65535. _CNV_A_R_LINEAR_____17_CM 0. 65535. FORMAT "%5.0"
 /begin AXIS_DESCR COM_AXIS ONLINE_DUMMY _CNV_S_6_RANGE_FMY__320_CM 6 0. 5. AXIS_PTS_REF ldp_fmy_dtc /end AXIS_DESCR
/end CHARACTERISTIC
/begin CHARACTERISTIC ID_ERR_ENVD_TCO_GRD "" CURVE 0x608d8 _REC_CUR_20_u1_u1 17. _CNV_S_6_RANGE_DIAG_321_CM 4. 21.
 /begin AXIS_DESCR COM_AXIS ONLINE_DUMMY _CNV_S_4_RANGE_FMY__322_CM 4 0. 3. AXIS_PTS_REF ldp_fmy_envd /end AXIS_DESCR
/end CHARACTERISTIC
/begin CHARACTERISTIC C_DIAG_CONF_TCO_GRD "" VALUE 0x608e8 _REC_VAL_20_u1 255. _CNV_A_R_LINEAR_____13_CM 0. 255. FORMAT "%3.0" /end CHARACTERISTIC
/begin CHARACTERISTIC C_DC_INC_TCO_GRD "" VALUE 0x608e9 _REC_VAL_20_u1 255. _CNV_A_R_LINEAR_____13_CM 0. 255. FORMAT "%3.0" /end CHARACTERISTIC
/begin CHARACTERISTIC C_DC_MAX_TCO_GRD "" VALUE 0x608eb _REC_VAL_20_u1 255. _CNV_A_R_LINEAR_____13_CM 0. 255. FORMAT "%3.0" /end CHARACTERISTIC
/begin CHARACTERISTIC C_DC_DEC_TCO_GRD "" VALUE 0x608ea _REC_VAL_20_u1 255. _CNV_A_R_LINEAR_____13_CM 0. 255. FORMAT "%3.0" /end CHARACTERISTIC
/begin CHARACTERISTIC ID_ERR_DTC_ECT_MEC "" CURVE 0x608f0 _REC_CUR_20_u2_u2 65535. _CNV_A_R_LINEAR_____17_CM 0. 65535. FORMAT "%5.0"
 /begin AXIS_DESCR COM_AXIS ONLINE_DUMMY _CNV_S_6_RANGE_FMY__320_CM 6 0. 5. AXIS_PTS_REF ldp_fmy_dtc /end AXIS_DESCR
/end CHARACTERISTIC
/begin CHARACTERISTIC ID_ERR_ENVD_ECT_MEC "" CURVE 0x608ec _REC_CUR_20_u1_u1 17. _CNV_S_6_RANGE_DIAG_321_CM 4. 21.
 /begin AXIS_DESCR COM_AXIS ONLINE_DUMMY _CNV_S_4_RANGE_FMY__322_CM 4 0. 3. AXIS_PTS_REF ldp_fmy_envd /end AXIS_DESCR
/end CHARACTERISTIC
/begin CHARACTERISTIC C_DIAG_CONF_ECT_MEC "" VALUE 0x608fc _REC_VAL_20_u1 255. _CNV_A_R_LINEAR_____13_CM 0. 255. FORMAT "%3.0" /end CHARACTERISTIC
/begin CHARACTERISTIC C_DC_INC_ECT_MEC "" VALUE 0x608fd _REC_VAL_20_u1 255. _CNV_A_R_LINEAR_____13_CM 0. 255. FORMAT "%3.0" /end CHARACTERISTIC
/begin CHARACTERISTIC C_DC_MAX_ECT_MEC "" VALUE 0x608ff _REC_VAL_20_u1 255. _CNV_A_R_LINEAR_____13_CM 0. 255. FORMAT "%3.0" /end CHARACTERISTIC
/begin CHARACTERISTIC C_DC_DEC_ECT_MEC "" VALUE 0x608fe _REC_VAL_20_u1 255. _CNV_A_R_LINEAR_____13_CM 0. 255. FORMAT "%3.0" /end CHARACTERISTIC
/begin CHARACTERISTIC ID_ERR_DTC_ECT_EL "" CURVE 0x60904 _REC_CUR_20_u2_u2 65535. _CNV_A_R_LINEAR_____17_CM 0. 65535. FORMAT "%5.0"
 /begin AXIS_DESCR COM_AXIS ONLINE_DUMMY _CNV_S_6_RANGE_FMY__320_CM 6 0. 5. AXIS_PTS_REF ldp_fmy_dtc /end AXIS_DESCR
/end CHARACTERISTIC
/begin CHARACTERISTIC ID_ERR_ENVD_ECT_EL "" CURVE 0x60900 _REC_CUR_20_u1_u1 17. _CNV_S_6_RANGE_DIAG_321_CM 4. 21.
 /begin AXIS_DESCR COM_AXIS ONLINE_DUMMY _CNV_S_4_RANGE_FMY__322_CM 4 0. 3. AXIS_PTS_REF ldp_fmy_envd /end AXIS_DESCR
/end CHARACTERISTIC
/begin CHARACTERISTIC C_DIAG_CONF_ECT_EL "" VALUE 0x60910 _REC_VAL_20_u1 255. _CNV_A_R_LINEAR_____13_CM 0. 255. FORMAT "%3.0" /end CHARACTERISTIC
/begin CHARACTERISTIC C_DC_INC_ECT_EL "" VALUE 0x60911 _REC_VAL_20_u1 255. _CNV_A_R_LINEAR_____13_CM 0. 255. FORMAT "%3.0" /end CHARACTERISTIC
/begin CHARACTERISTIC C_DC_MAX_ECT_EL "" VALUE 0x60913 _REC_VAL_20_u1 255. _CNV_A_R_LINEAR_____13_CM 0. 255. FORMAT "%3.0" /end CHARACTERISTIC
/begin CHARACTERISTIC C_DC_DEC_ECT_EL "" VALUE 0x60912 _REC_VAL_20_u1 255. _CNV_A_R_LINEAR_____13_CM 0. 255. FORMAT "%3.0" /end CHARACTERISTIC
/begin AXIS_PTS ldp_fmy_dtc "" 0x69b92 DTC _REC_AXS_20_u2 5. _CNV_S_6_RANGE_FMY__320_CM 6 0. 5. /end AXIS_PTS
/begin CHARACTERISTIC ID_ERR_DTC_TCO_PLAUS "" CURVE 0x60918 _REC_CUR_20_u2_u2 65535. _CNV_A_R_LINEAR_____17_CM 0. 65535. FORMAT "%5.0"
 /begin AXIS_DESCR COM_AXIS ONLINE_DUMMY _CNV_S_6_RANGE_FMY__320_CM 6 0. 5. AXIS_PTS_REF ldp_fmy_dtc /end AXIS_DESCR
/end CHARACTERISTIC
/begin CHARACTERISTIC ID_ERR_ENVD_TCO_PLAUS "" CURVE 0x60914 _REC_CUR_20_u1_u1 17. _CNV_S_6_RANGE_DIAG_321_CM 4. 21.
 /begin AXIS_DESCR COM_AXIS ONLINE_DUMMY _CNV_S_4_RANGE_FMY__322_CM 4 0. 3. AXIS_PTS_REF ldp_fmy_envd /end AXIS_DESCR
/end CHARACTERISTIC
/begin CHARACTERISTIC C_DIAG_CONF_TCO_PLAUS "" VALUE 0x60924 _REC_VAL_20_u1 255. _CNV_A_R_LINEAR_____13_CM 0. 255. FORMAT "%3.0" /end CHARACTERISTIC
/begin CHARACTERISTIC C_DC_INC_TCO_PLAUS "" VALUE 0x60925 _REC_VAL_20_u1 255. _CNV_A_R_LINEAR_____13_CM 0. 255. FORMAT "%3.0" /end CHARACTERISTIC
/begin CHARACTERISTIC C_DC_MAX_TCO_PLAUS "" VALUE 0x60927 _REC_VAL_20_u1 255. _CNV_A_R_LINEAR_____13_CM 0. 255. FORMAT "%3.0" /end CHARACTERISTIC
/begin CHARACTERISTIC C_DC_DEC_TCO_PLAUS "" VALUE 0x60926 _REC_VAL_20_u1 255. _CNV_A_R_LINEAR_____13_CM 0. 255. FORMAT "%3.0" /end CHARACTERISTIC
/begin CHARACTERISTIC ID_ERR_DTC_ISC_H "" CURVE 0x6092c _REC_CUR_20_u2_u2 65535. _CNV_A_R_LINEAR_____17_CM 0. 65535. FORMAT "%5.0"
 /begin AXIS_DESCR COM_AXIS ONLINE_DUMMY _CNV_S_6_RANGE_FMY__320_CM 6 0. 5. AXIS_PTS_REF ldp_fmy_dtc /end AXIS_DESCR
/end CHARACTERISTIC
/begin CHARACTERISTIC ID_ERR_ENVD_ISC_H "" CURVE 0x60928 _REC_CUR_20_u1_u1 17. _CNV_S_6_RANGE_DIAG_321_CM 4. 21.
 /begin AXIS_DESCR COM_AXIS ONLINE_DUMMY _CNV_S_4_RANGE_FMY__322_CM 4 0. 3. AXIS_PTS_REF ldp_fmy_envd /end AXIS_DESCR
/end CHARACTERISTIC
/begin CHARACTERISTIC C_DIAG_CONF_ISC_H "" VALUE 0x60938 _REC_VAL_20_u1 255. _CNV_A_R_LINEAR_____13_CM 0. 255. FORMAT "%3.0" /end CHARACTERISTIC
/begin CHARACTERISTIC C_DC_INC_ISC_H "" VALUE 0x60939 _REC_VAL_20_u1 255. _CNV_A_R_LINEAR_____13_CM 0. 255. FORMAT "%3.0" /end CHARACTERISTIC
/begin CHARACTERISTIC C_DC_MAX_ISC_H "" VALUE 0x6093b _REC_VAL_20_u1 255. _CNV_A_R_LINEAR_____13_CM 0. 255. FORMAT "%3.0" /end CHARACTERISTIC
/begin CHARACTERISTIC C_DC_DEC_ISC_H "" VALUE 0x6093a _REC_VAL_20_u1 255. _CNV_A_R_LINEAR_____13_CM 0. 255. FORMAT "%3.0" /end CHARACTERISTIC
/begin CHARACTERISTIC ID_ERR_DTC_ISC_L "" CURVE 0x60940 _REC_CUR_20_u2_u2 65535. _CNV_A_R_LINEAR_____17_CM 0. 65535. FORMAT "%5.0"
 /begin AXIS_DESCR COM_AXIS ONLINE_DUMMY _CNV_S_6_RANGE_FMY__320_CM 6 0. 5. AXIS_PTS_REF ldp_fmy_dtc /end AXIS_DESCR
/end CHARACTERISTIC
/begin CHARACTERISTIC ID_ERR_ENVD_ISC_L "" CURVE 0x6093c _REC_CUR_20_u1_u1 17. _CNV_S_6_RANGE_DIAG_321_CM 4. 21.
 /begin AXIS_DESCR COM_AXIS ONLINE_DUMMY _CNV_S_4_RANGE_FMY__322_CM 4 0. 3. AXIS_PTS_REF ldp_fmy_envd /end AXIS_DESCR
/end CHARACTERISTIC
/begin CHARACTERISTIC C_DIAG_CONF_ISC_L "" VALUE 0x6094c _REC_VAL_20_u1 255. _CNV_A_R_LINEAR_____13_CM 0. 255. FORMAT "%3.0" /end CHARACTERISTIC
/begin CHARACTERISTIC C_DC_INC_ISC_L "" VALUE 0x6094d _REC_VAL_20_u1 255. _CNV_A_R_LINEAR_____13_CM 0. 255. FORMAT "%3.0" /end CHARACTERISTIC
/begin CHARACTERISTIC C_DC_MAX_ISC_L "" VALUE 0x6094f _REC_VAL_20_u1 255. _CNV_A_R_LINEAR_____13_CM 0. 255. FORMAT "%3.0" /end CHARACTERISTIC
/begin CHARACTERISTIC C_DC_DEC_ISC_L "" VALUE 0x6094e _REC_VAL_20_u1 255. _CNV_A_R_LINEAR_____13_CM 0. 255. FORMAT "%3.0" /end CHARACTERISTIC
/begin AXIS_PTS ldp_fmy_envd "" 0x69b8d ENVD _REC_AXS_20_u1 3. _CNV_S_4_RANGE_FMY__322_CM 4 0. 3. /end AXIS_PTS
/begin CHARACTERISTIC ID_ERR_DTC_MIS_MPL "" CURVE 0x60af8 _REC_CUR_20_u2_u2 65535. _CNV_A_R_LINEAR_____17_CM 0. 65535. FORMAT "%5.0"
 /begin AXIS_DESCR COM_AXIS ONLINE_DUMMY _CNV_S_6_RANGE_FMY__320_CM 6 0. 5. AXIS_PTS_REF ldp_fmy_dtc /end AXIS_DESCR
/end CHARACTERISTIC
/begin CHARACTERISTIC ID_ERR_ENVD_MIS_MPL "" CURVE 0x60af4 _REC_CUR_20_u1_u1 17. _CNV_S_6_RANGE_DIAG_321_CM 4. 21.
 /begin AXIS_DESCR COM_AXIS ONLINE_DUMMY _CNV_S_4_RANGE_FMY__322_CM 4 0. 3. AXIS_PTS_REF ldp_fmy_envd /end AXIS_DESCR
/end CHARACTERISTIC
/begin CHARACTERISTIC C_DIAG_CONF_MIS_MPL "" VALUE 0x60b04 _REC_VAL_20_u1 255. _CNV_A_R_LINEAR_____13_CM 0. 255. FORMAT "%3.0" /end CHARACTERISTIC
/begin CHARACTERISTIC C_DC_INC_MIS_MPL "" VALUE 0x60b05 _REC_VAL_20_u1 255. _CNV_A_R_LINEAR_____13_CM 0. 255. FORMAT "%3.0" /end CHARACTERISTIC
/begin CHARACTERISTIC C_DC_MAX_MIS_MPL "" VALUE 0x60b07 _REC_VAL_20_u1 255. _CNV_A_R_LINEAR_____13_CM 0. 255. FORMAT "%3.0" /end CHARACTERISTIC
/begin CHARACTERISTIC C_DC_DEC_MIS_MPL "" VALUE 0x60b06 _REC_VAL_20_u1 255. _CNV_A_R_LINEAR_____13_CM 0. 255. FORMAT "%3.0" /end CHARACTERISTIC
/begin CHARACTERISTIC ID_ERR_DTC_MIS_A_0 "" CURVE 0x60a08 _REC_CUR_20_u2_u2 65535. _CNV_A_R_LINEAR_____17_CM 0. 65535. FORMAT "%5.0"
 /begin AXIS_DESCR COM_AXIS ONLINE_DUMMY _CNV_S_6_RANGE_FMY__320_CM 6 0. 5. AXIS_PTS_REF ldp_fmy_dtc /end AXIS_DESCR
/end CHARACTERISTIC
/begin CHARACTERISTIC ID_ERR_ENVD_MIS_A_0 "" CURVE 0x60a04 _REC_CUR_20_u1_u1 17. _CNV_S_6_RANGE_DIAG_321_CM 4. 21.
 /begin AXIS_DESCR COM_AXIS ONLINE_DUMMY _CNV_S_4_RANGE_FMY__322_CM 4 0. 3. AXIS_PTS_REF ldp_fmy_envd /end AXIS_DESCR
/end CHARACTERISTIC
/begin CHARACTERISTIC C_DIAG_CONF_MIS_A_0 "" VALUE 0x60a14 _REC_VAL_20_u1 255. _CNV_A_R_LINEAR_____13_CM 0. 255. FORMAT "%3.0" /end CHARACTERISTIC
/begin CHARACTERISTIC C_DC_INC_MIS_A_0 "" VALUE 0x60a15 _REC_VAL_20_u1 255. _CNV_A_R_LINEAR_____13_CM 0. 255. FORMAT "%3.0" /end CHARACTERISTIC
/begin CHARACTERISTIC C_DC_MAX_MIS_A_0 "" VALUE 0x60a17 _REC_VAL_20_u1 255. _CNV_A_R_LINEAR_____13_CM 0. 255. FORMAT "%3.0" /end CHARACTERISTIC
/begin CHARACTERISTIC C_DC_DEC_MIS_A_0 "" VALUE 0x60a16 _REC_VAL_20_u1 255. _CNV_A_R_LINEAR_____13_CM 0. 255. FORMAT "%3.0" /end CHARACTERISTIC
/begin CHARACTERISTIC ID_ERR_DTC_MIS_A_1 "" CURVE 0x60a1c _REC_CUR_20_u2_u2 65535. _CNV_A_R_LINEAR_____17_CM 0. 65535. FORMAT "%5.0"
 /begin AXIS_DESCR COM_AXIS ONLINE_DUMMY _CNV_S_6_RANGE_FMY__320_CM 6 0. 5. AXIS_PTS_REF ldp_fmy_dtc /end AXIS_DESCR
/end CHARACTERISTIC
/begin CHARACTERISTIC ID_ERR_ENVD_MIS_A_1 "" CURVE 0x60a18 _REC_CUR_20_u1_u1 17. _CNV_S_6_RANGE_DIAG_321_CM 4. 21.
 /begin AXIS_DESCR COM_AXIS ONLINE_DUMMY _CNV_S_4_RANGE_FMY__322_CM 4 0. 3. AXIS_PTS_REF ldp_fmy_envd /end AXIS_DESCR
/end CHARACTERISTIC
/begin CHARACTERISTIC C_DIAG_CONF_MIS_A_1 "" VALUE 0x60a28 _REC_VAL_20_u1 255. _CNV_A_R_LINEAR_____13_CM 0. 255. FORMAT "%3.0" /end CHARACTERISTIC
/begin CHARACTERISTIC C_DC_INC_MIS_A_1 "" VALUE 0x60a29 _REC_VAL_20_u1 255. _CNV_A_R_LINEAR_____13_CM 0. 255. FORMAT "%3.0" /end CHARACTERISTIC
/begin CHARACTERISTIC C_DC_MAX_MIS_A_1 "" VALUE 0x60a2b _REC_VAL_20_u1 255. _CNV_A_R_LINEAR_____13_CM 0. 255. FORMAT "%3.0" /end CHARACTERISTIC
/begin CHARACTERISTIC C_DC_DEC_MIS_A_1 "" VALUE 0x60a2a _REC_VAL_20_u1 255. _CNV_A_R_LINEAR_____13_CM 0. 255. FORMAT "%3.0" /end CHARACTERISTIC
/begin CHARACTERISTIC ID_ERR_DTC_MIS_A_2 "" CURVE 0x60a30 _REC_CUR_20_u2_u2 65535. _CNV_A_R_LINEAR_____17_CM 0. 65535. FORMAT "%5.0"
 /begin AXIS_DESCR COM_AXIS ONLINE_DUMMY _CNV_S_6_RANGE_FMY__320_CM 6 0. 5. AXIS_PTS_REF ldp_fmy_dtc /end AXIS_DESCR
/end CHARACTERISTIC
/begin CHARACTERISTIC ID_ERR_ENVD_MIS_A_2 "" CURVE 0x60a2c _REC_CUR_20_u1_u1 17. _CNV_S_6_RANGE_DIAG_321_CM 4. 21.
 /begin AXIS_DESCR COM_AXIS ONLINE_DUMMY _CNV_S_4_RANGE_FMY__322_CM 4 0. 3. AXIS_PTS_REF ldp_fmy_envd /end AXIS_DESCR
/end CHARACTERISTIC
/begin CHARACTERISTIC C_DIAG_CONF_MIS_A_2 "" VALUE 0x60a3c _REC_VAL_20_u1 255. _CNV_A_R_LINEAR_____13_CM 0. 255. FORMAT "%3.0" /end CHARACTERISTIC
/begin CHARACTERISTIC C_DC_INC_MIS_A_2 "" VALUE 0x60a3d _REC_VAL_20_u1 255. _CNV_A_R_LINEAR_____13_CM 0. 255. FORMAT "%3.0" /end CHARACTERISTIC
/begin CHARACTERISTIC C_DC_MAX_MIS_A_2 "" VALUE 0x60a3f _REC_VAL_20_u1 255. _CNV_A_R_LINEAR_____13_CM 0. 255. FORMAT "%3.0" /end CHARACTERISTIC
/begin CHARACTERISTIC C_DC_DEC_MIS_A_2 "" VALUE 0x60a3e _REC_VAL_20_u1 255. _CNV_A_R_LINEAR_____13_CM 0. 255. FORMAT "%3.0" /end CHARACTERISTIC
/begin CHARACTERISTIC ID_ERR_DTC_MIS_A_3 "" CURVE 0x60a44 _REC_CUR_20_u2_u2 65535. _CNV_A_R_LINEAR_____17_CM 0. 65535. FORMAT "%5.0"
 /begin AXIS_DESCR COM_AXIS ONLINE_DUMMY _CNV_S_6_RANGE_FMY__320_CM 6 0. 5. AXIS_PTS_REF ldp_fmy_dtc /end AXIS_DESCR
/end CHARACTERISTIC
/begin CHARACTERISTIC ID_ERR_ENVD_MIS_A_3 "" CURVE 0x60a40 _REC_CUR_20_u1_u1 17. _CNV_S_6_RANGE_DIAG_321_CM 4. 21.
 /begin AXIS_DESCR COM_AXIS ONLINE_DUMMY _CNV_S_4_RANGE_FMY__322_CM 4 0. 3. AXIS_PTS_REF ldp_fmy_envd /end AXIS_DESCR
/end CHARACTERISTIC
/begin CHARACTERISTIC C_DIAG_CONF_MIS_A_3 "" VALUE 0x60a50 _REC_VAL_20_u1 255. _CNV_A_R_LINEAR_____13_CM 0. 255. FORMAT "%3.0" /end CHARACTERISTIC
/begin CHARACTERISTIC C_DC_INC_MIS_A_3 "" VALUE 0x60a51 _REC_VAL_20_u1 255. _CNV_A_R_LINEAR_____13_CM 0. 255. FORMAT "%3.0" /end CHARACTERISTIC
/begin CHARACTERISTIC C_DC_MAX_MIS_A_3 "" VALUE 0x60a53 _REC_VAL_20_u1 255. _CNV_A_R_LINEAR_____13_CM 0. 255. FORMAT "%3.0" /end CHARACTERISTIC
/begin CHARACTERISTIC C_DC_DEC_MIS_A_3 "" VALUE 0x60a52 _REC_VAL_20_u1 255. _CNV_A_R_LINEAR_____13_CM 0. 255. FORMAT "%3.0" /end CHARACTERISTIC
/begin CHARACTERISTIC ID_ERR_DTC_MIS_A_4 "" CURVE 0x60a58 _REC_CUR_20_u2_u2 65535. _CNV_A_R_LINEAR_____17_CM 0. 65535. FORMAT "%5.0"
 /begin AXIS_DESCR COM_AXIS ONLINE_DUMMY _CNV_S_6_RANGE_FMY__320_CM 6 0. 5. AXIS_PTS_REF ldp_fmy_dtc /end AXIS_DESCR
/end CHARACTERISTIC
/begin CHARACTERISTIC ID_ERR_ENVD_MIS_A_4 "" CURVE 0x60a54 _REC_CUR_20_u1_u1 17. _CNV_S_6_RANGE_DIAG_321_CM 4. 21.
 /begin AXIS_DESCR COM_AXIS ONLINE_DUMMY _CNV_S_4_RANGE_FMY__322_CM 4 0. 3. AXIS_PTS_REF ldp_fmy_envd /end AXIS_DESCR
/end CHARACTERISTIC
/begin CHARACTERISTIC C_DIAG_CONF_MIS_A_4 "" VALUE 0x60a64 _REC_VAL_20_u1 255. _CNV_A_R_LINEAR_____13_CM 0. 255. FORMAT "%3.0" /end CHARACTERISTIC
/begin CHARACTERISTIC C_DC_INC_MIS_A_4 "" VALUE 0x60a65 _REC_VAL_20_u1 255. _CNV_A_R_LINEAR_____13_CM 0. 255. FORMAT "%3.0" /end CHARACTERISTIC
/begin CHARACTERISTIC C_DC_MAX_MIS_A_4 "" VALUE 0x60a67 _REC_VAL_20_u1 255. _CNV_A_R_LINEAR_____13_CM 0. 255. FORMAT "%3.0" /end CHARACTERISTIC
/begin CHARACTERISTIC C_DC_DEC_MIS_A_4 "" VALUE 0x60a66 _REC_VAL_20_u1 255. _CNV_A_R_LINEAR_____13_CM 0. 255. FORMAT "%3.0" /end CHARACTERISTIC
/begin CHARACTERISTIC ID_ERR_DTC_MIS_A_5 "" CURVE 0x60a6c _REC_CUR_20_u2_u2 65535. _CNV_A_R_LINEAR_____17_CM 0. 65535. FORMAT "%5.0"
 /begin AXIS_DESCR COM_AXIS ONLINE_DUMMY _CNV_S_6_RANGE_FMY__320_CM 6 0. 5. AXIS_PTS_REF ldp_fmy_dtc /end AXIS_DESCR
/end CHARACTERISTIC
/begin CHARACTERISTIC ID_ERR_ENVD_MIS_A_5 "" CURVE 0x60a68 _REC_CUR_20_u1_u1 17. _CNV_S_6_RANGE_DIAG_321_CM 4. 21.
 /begin AXIS_DESCR COM_AXIS ONLINE_DUMMY _CNV_S_4_RANGE_FMY__322_CM 4 0. 3. AXIS_PTS_REF ldp_fmy_envd /end AXIS_DESCR
/end CHARACTERISTIC
/begin CHARACTERISTIC C_DIAG_CONF_MIS_A_5 "" VALUE 0x60a78 _REC_VAL_20_u1 255. _CNV_A_R_LINEAR_____13_CM 0. 255. FORMAT "%3.0" /end CHARACTERISTIC
/begin CHARACTERISTIC C_DC_INC_MIS_A_5 "" VALUE 0x60a79 _REC_VAL_20_u1 255. _CNV_A_R_LINEAR_____13_CM 0. 255. FORMAT "%3.0" /end CHARACTERISTIC
/begin CHARACTERISTIC C_DC_MAX_MIS_A_5 "" VALUE 0x60a7b _REC_VAL_20_u1 255. _CNV_A_R_LINEAR_____13_CM 0. 255. FORMAT "%3.0" /end CHARACTERISTIC
/begin CHARACTERISTIC C_DC_DEC_MIS_A_5 "" VALUE 0x60a7a _REC_VAL_20_u1 255. _CNV_A_R_LINEAR_____13_CM 0. 255. FORMAT "%3.0" /end CHARACTERISTIC
/begin CHARACTERISTIC ID_ERR_DTC_MIS_B_0 "" CURVE 0x60a80 _REC_CUR_20_u2_u2 65535. _CNV_A_R_LINEAR_____17_CM 0. 65535. FORMAT "%5.0"
 /begin AXIS_DESCR COM_AXIS ONLINE_DUMMY _CNV_S_6_RANGE_FMY__320_CM 6 0. 5. AXIS_PTS_REF ldp_fmy_dtc /end AXIS_DESCR
/end CHARACTERISTIC
/begin CHARACTERISTIC ID_ERR_ENVD_MIS_B_0 "" CURVE 0x60a7c _REC_CUR_20_u1_u1 17. _CNV_S_6_RANGE_DIAG_321_CM 4. 21.
 /begin AXIS_DESCR COM_AXIS ONLINE_DUMMY _CNV_S_4_RANGE_FMY__322_CM 4 0. 3. AXIS_PTS_REF ldp_fmy_envd /end AXIS_DESCR
/end CHARACTERISTIC
/begin CHARACTERISTIC C_DIAG_CONF_MIS_B_0 "" VALUE 0x60a8c _REC_VAL_20_u1 255. _CNV_A_R_LINEAR_____13_CM 0. 255. FORMAT "%3.0" /end CHARACTERISTIC
/begin CHARACTERISTIC C_DC_INC_MIS_B_0 "" VALUE 0x60a8d _REC_VAL_20_u1 255. _CNV_A_R_LINEAR_____13_CM 0. 255. FORMAT "%3.0" /end CHARACTERISTIC
/begin CHARACTERISTIC C_DC_MAX_MIS_B_0 "" VALUE 0x60a8f _REC_VAL_20_u1 255. _CNV_A_R_LINEAR_____13_CM 0. 255. FORMAT "%3.0" /end CHARACTERISTIC
/begin CHARACTERISTIC C_DC_DEC_MIS_B_0 "" VALUE 0x60a8e _REC_VAL_20_u1 255. _CNV_A_R_LINEAR_____13_CM 0. 255. FORMAT "%3.0" /end CHARACTERISTIC
/begin CHARACTERISTIC ID_ERR_DTC_MIS_B_1 "" CURVE 0x60a94 _REC_CUR_20_u2_u2 65535. _CNV_A_R_LINEAR_____17_CM 0. 65535. FORMAT "%5.0"
 /begin AXIS_DESCR COM_AXIS ONLINE_DUMMY _CNV_S_6_RANGE_FMY__320_CM 6 0. 5. AXIS_PTS_REF ldp_fmy_dtc /end AXIS_DESCR
/end CHARACTERISTIC
/begin CHARACTERISTIC ID_ERR_ENVD_MIS_B_1 "" CURVE 0x60a90 _REC_CUR_20_u1_u1 17. _CNV_S_6_RANGE_DIAG_321_CM 4. 21.
 /begin AXIS_DESCR COM_AXIS ONLINE_DUMMY _CNV_S_4_RANGE_FMY__322_CM 4 0. 3. AXIS_PTS_REF ldp_fmy_envd /end AXIS_DESCR
/end CHARACTERISTIC
/begin CHARACTERISTIC C_DIAG_CONF_MIS_B_1 "" VALUE 0x60aa0 _REC_VAL_20_u1 255. _CNV_A_R_LINEAR_____13_CM 0. 255. FORMAT "%3.0" /end CHARACTERISTIC
/begin CHARACTERISTIC C_DC_INC_MIS_B_1 "" VALUE 0x60aa1 _REC_VAL_20_u1 255. _CNV_A_R_LINEAR_____13_CM 0. 255. FORMAT "%3.0" /end CHARACTERISTIC
/begin CHARACTERISTIC C_DC_MAX_MIS_B_1 "" VALUE 0x60aa3 _REC_VAL_20_u1 255. _CNV_A_R_LINEAR_____13_CM 0. 255. FORMAT "%3.0" /end CHARACTERISTIC
/begin CHARACTERISTIC C_DC_DEC_MIS_B_1 "" VALUE 0x60aa2 _REC_VAL_20_u1 255. _CNV_A_R_LINEAR_____13_CM 0. 255. FORMAT "%3.0" /end CHARACTERISTIC
/begin CHARACTERISTIC ID_ERR_DTC_MIS_B_2 "" CURVE 0x60aa8 _REC_CUR_20_u2_u2 65535. _CNV_A_R_LINEAR_____17_CM 0. 65535. FORMAT "%5.0"
 /begin AXIS_DESCR COM_AXIS ONLINE_DUMMY _CNV_S_6_RANGE_FMY__320_CM 6 0. 5. AXIS_PTS_REF ldp_fmy_dtc /end AXIS_DESCR
/end CHARACTERISTIC
/begin CHARACTERISTIC ID_ERR_ENVD_MIS_B_2 "" CURVE 0x60aa4 _REC_CUR_20_u1_u1 17. _CNV_S_6_RANGE_DIAG_321_CM 4. 21.
 /begin AXIS_DESCR COM_AXIS ONLINE_DUMMY _CNV_S_4_RANGE_FMY__322_CM 4 0. 3. AXIS_PTS_REF ldp_fmy_envd /end AXIS_DESCR
/end CHARACTERISTIC
/begin CHARACTERISTIC C_DIAG_CONF_MIS_B_2 "" VALUE 0x60ab4 _REC_VAL_20_u1 255. _CNV_A_R_LINEAR_____13_CM 0. 255. FORMAT "%3.0" /end CHARACTERISTIC
/begin CHARACTERISTIC C_DC_INC_MIS_B_2 "" VALUE 0x60ab5 _REC_VAL_20_u1 255. _CNV_A_R_LINEAR_____13_CM 0. 255. FORMAT "%3.0" /end CHARACTERISTIC
/begin CHARACTERISTIC C_DC_MAX_MIS_B_2 "" VALUE 0x60ab7 _REC_VAL_20_u1 255. _CNV_A_R_LINEAR_____13_CM 0. 255. FORMAT "%3.0" /end CHARACTERISTIC
/begin CHARACTERISTIC C_DC_DEC_MIS_B_2 "" VALUE 0x60ab6 _REC_VAL_20_u1 255. _CNV_A_R_LINEAR_____13_CM 0. 255. FORMAT "%3.0" /end CHARACTERISTIC
/begin CHARACTERISTIC ID_ERR_DTC_MIS_B_3 "" CURVE 0x60abc _REC_CUR_20_u2_u2 65535. _CNV_A_R_LINEAR_____17_CM 0. 65535. FORMAT "%5.0"
 /begin AXIS_DESCR COM_AXIS ONLINE_DUMMY _CNV_S_6_RANGE_FMY__320_CM 6 0. 5. AXIS_PTS_REF ldp_fmy_dtc /end AXIS_DESCR
/end CHARACTERISTIC
/begin CHARACTERISTIC ID_ERR_ENVD_MIS_B_3 "" CURVE 0x60ab8 _REC_CUR_20_u1_u1 17. _CNV_S_6_RANGE_DIAG_321_CM 4. 21.
 /begin AXIS_DESCR COM_AXIS ONLINE_DUMMY _CNV_S_4_RANGE_FMY__322_CM 4 0. 3. AXIS_PTS_REF ldp_fmy_envd /end AXIS_DESCR
/end CHARACTERISTIC
/begin CHARACTERISTIC C_DIAG_CONF_MIS_B_3 "" VALUE 0x60ac8 _REC_VAL_20_u1 255. _CNV_A_R_LINEAR_____13_CM 0. 255. FORMAT "%3.0" /end CHARACTERISTIC
/begin CHARACTERISTIC C_DC_INC_MIS_B_3 "" VALUE 0x60ac9 _REC_VAL_20_u1 255. _CNV_A_R_LINEAR_____13_CM 0. 255. FORMAT "%3.0" /end CHARACTERISTIC
/begin CHARACTERISTIC C_DC_MAX_MIS_B_3 "" VALUE 0x60acb _REC_VAL_20_u1 255. _CNV_A_R_LINEAR_____13_CM 0. 255. FORMAT "%3.0" /end CHARACTERISTIC
/begin CHARACTERISTIC C_DC_DEC_MIS_B_3 "" VALUE 0x60aca _REC_VAL_20_u1 255. _CNV_A_R_LINEAR_____13_CM 0. 255. FORMAT "%3.0" /end CHARACTERISTIC
/begin CHARACTERISTIC ID_ERR_DTC_MIS_B_4 "" CURVE 0x60ad0 _REC_CUR_20_u2_u2 65535. _CNV_A_R_LINEAR_____17_CM 0. 65535. FORMAT "%5.0"
 /begin AXIS_DESCR COM_AXIS ONLINE_DUMMY _CNV_S_6_RANGE_FMY__320_CM 6 0. 5. AXIS_PTS_REF ldp_fmy_dtc /end AXIS_DESCR
/end CHARACTERISTIC
/begin CHARACTERISTIC ID_ERR_ENVD_MIS_B_4 "" CURVE 0x60acc _REC_CUR_20_u1_u1 17. _CNV_S_6_RANGE_DIAG_321_CM 4. 21.
 /begin AXIS_DESCR COM_AXIS ONLINE_DUMMY _CNV_S_4_RANGE_FMY__322_CM 4 0. 3. AXIS_PTS_REF ldp_fmy_envd /end AXIS_DESCR
/end CHARACTERISTIC
/begin CHARACTERISTIC C_DIAG_CONF_MIS_B_4 "" VALUE 0x60adc _REC_VAL_20_u1 255. _CNV_A_R_LINEAR_____13_CM 0. 255. FORMAT "%3.0" /end CHARACTERISTIC
/begin CHARACTERISTIC C_DC_INC_MIS_B_4 "" VALUE 0x60add _REC_VAL_20_u1 255. _CNV_A_R_LINEAR_____13_CM 0. 255. FORMAT "%3.0" /end CHARACTERISTIC
/begin CHARACTERISTIC C_DC_MAX_MIS_B_4 "" VALUE 0x60adf _REC_VAL_20_u1 255. _CNV_A_R_LINEAR_____13_CM 0. 255. FORMAT "%3.0" /end CHARACTERISTIC
/begin CHARACTERISTIC C_DC_DEC_MIS_B_4 "" VALUE 0x60ade _REC_VAL_20_u1 255. _CNV_A_R_LINEAR_____13_CM 0. 255. FORMAT "%3.0" /end CHARACTERISTIC
/begin CHARACTERISTIC ID_ERR_DTC_MIS_B_5 "" CURVE 0x60ae4 _REC_CUR_20_u2_u2 65535. _CNV_A_R_LINEAR_____17_CM 0. 65535. FORMAT "%5.0"
 /begin AXIS_DESCR COM_AXIS ONLINE_DUMMY _CNV_S_6_RANGE_FMY__320_CM 6 0. 5. AXIS_PTS_REF ldp_fmy_dtc /end AXIS_DESCR
/end CHARACTERISTIC
/begin CHARACTERISTIC ID_ERR_ENVD_MIS_B_5 "" CURVE 0x60ae0 _REC_CUR_20_u1_u1 17. _CNV_S_6_RANGE_DIAG_321_CM 4. 21.
 /begin AXIS_DESCR COM_AXIS ONLINE_DUMMY _CNV_S_4_RANGE_FMY__322_CM 4 0. 3. AXIS_PTS_REF ldp_fmy_envd /end AXIS_DESCR
/end CHARACTERISTIC
/begin CHARACTERISTIC C_DIAG_CONF_MIS_B_5 "" VALUE 0x60af0 _REC_VAL_20_u1 255. _CNV_A_R_LINEAR_____13_CM 0. 255. FORMAT "%3.0" /end CHARACTERISTIC
/begin CHARACTERISTIC C_DC_INC_MIS_B_5 "" VALUE 0x60af1 _REC_VAL_20_u1 255. _CNV_A_R_LINEAR_____13_CM 0. 255. FORMAT "%3.0" /end CHARACTERISTIC
/begin CHARACTERISTIC C_DC_MAX_MIS_B_5 "" VALUE 0x60af3 _REC_VAL_20_u1 255. _CNV_A_R_LINEAR_____13_CM 0. 255. FORMAT "%3.0" /end CHARACTERISTIC
/begin CHARACTERISTIC C_DC_DEC_MIS_B_5 "" VALUE 0x60af2 _REC_VAL_20_u1 255. _CNV_A_R_LINEAR_____13_CM 0. 255. FORMAT "%3.0" /end CHARACTERISTIC
/begin CHARACTERISTIC ID_ERR_DTC_SEG_T_AD "" CURVE 0x609f4 _REC_CUR_20_u2_u2 65535. _CNV_A_R_LINEAR_____17_CM 0. 65535. FORMAT "%5.0"
 /begin AXIS_DESCR COM_AXIS ONLINE_DUMMY _CNV_S_6_RANGE_FMY__320_CM 6 0. 5. AXIS_PTS_REF ldp_fmy_dtc /end AXIS_DESCR
/end CHARACTERISTIC
/begin CHARACTERISTIC ID_ERR_ENVD_SEG_T_AD "" CURVE 0x609f0 _REC_CUR_20_u1_u1 17. _CNV_S_6_RANGE_DIAG_321_CM 4. 21.
 /begin AXIS_DESCR COM_AXIS ONLINE_DUMMY _CNV_S_4_RANGE_FMY__322_CM 4 0. 3. AXIS_PTS_REF ldp_fmy_envd /end AXIS_DESCR
/end CHARACTERISTIC
/begin CHARACTERISTIC C_DIAG_CONF_SEG_T_AD "" VALUE 0x60a00 _REC_VAL_20_u1 255. _CNV_A_R_LINEAR_____13_CM 0. 255. FORMAT "%3.0" /end CHARACTERISTIC
/begin CHARACTERISTIC C_DC_INC_SEG_T_AD "" VALUE 0x60a01 _REC_VAL_20_u1 255. _CNV_A_R_LINEAR_____13_CM 0. 255. FORMAT "%3.0" /end CHARACTERISTIC
/begin CHARACTERISTIC C_DC_MAX_SEG_T_AD "" VALUE 0x60a03 _REC_VAL_20_u1 255. _CNV_A_R_LINEAR_____13_CM 0. 255. FORMAT "%3.0" /end CHARACTERISTIC
/begin CHARACTERISTIC C_DC_DEC_SEG_T_AD "" VALUE 0x60a02 _REC_VAL_20_u1 255. _CNV_A_R_LINEAR_____13_CM 0. 255. FORMAT "%3.0" /end CHARACTERISTIC
/begin CHARACTERISTIC ID_ERR_DTC_ISA_1 "" CURVE 0x609cc _REC_CUR_20_u2_u2 65535. _CNV_A_R_LINEAR_____17_CM 0. 65535. FORMAT "%5.0"
 /begin AXIS_DESCR COM_AXIS ONLINE_DUMMY _CNV_S_6_RANGE_FMY__320_CM 6 0. 5. AXIS_PTS_REF ldp_fmy_dtc /end AXIS_DESCR
/end CHARACTERISTIC
/begin CHARACTERISTIC ID_ERR_ENVD_ISA_1 "" CURVE 0x609c8 _REC_CUR_20_u1_u1 17. _CNV_S_6_RANGE_DIAG_321_CM 4. 21.
 /begin AXIS_DESCR COM_AXIS ONLINE_DUMMY _CNV_S_4_RANGE_FMY__322_CM 4 0. 3. AXIS_PTS_REF ldp_fmy_envd /end AXIS_DESCR
/end CHARACTERISTIC
/begin CHARACTERISTIC C_DIAG_CONF_ISA_1 "" VALUE 0x609d8 _REC_VAL_20_u1 255. _CNV_A_R_LINEAR_____13_CM 0. 255. FORMAT "%3.0" /end CHARACTERISTIC
/begin CHARACTERISTIC C_DC_INC_ISA_1 "" VALUE 0x609d9 _REC_VAL_20_u1 255. _CNV_A_R_LINEAR_____13_CM 0. 255. FORMAT "%3.0" /end CHARACTERISTIC
/begin CHARACTERISTIC C_DC_MAX_ISA_1 "" VALUE 0x609db _REC_VAL_20_u1 255. _CNV_A_R_LINEAR_____13_CM 0. 255. FORMAT "%3.0" /end CHARACTERISTIC
/begin CHARACTERISTIC C_DC_DEC_ISA_1 "" VALUE 0x609da _REC_VAL_20_u1 255. _CNV_A_R_LINEAR_____13_CM 0. 255. FORMAT "%3.0" /end CHARACTERISTIC
/begin CHARACTERISTIC ID_ERR_DTC_ISA_2 "" CURVE 0x609e0 _REC_CUR_20_u2_u2 65535. _CNV_A_R_LINEAR_____17_CM 0. 65535. FORMAT "%5.0"
 /begin AXIS_DESCR COM_AXIS ONLINE_DUMMY _CNV_S_6_RANGE_FMY__320_CM 6 0. 5. AXIS_PTS_REF ldp_fmy_dtc /end AXIS_DESCR
/end CHARACTERISTIC
/begin CHARACTERISTIC ID_ERR_ENVD_ISA_2 "" CURVE 0x609dc _REC_CUR_20_u1_u1 17. _CNV_S_6_RANGE_DIAG_321_CM 4. 21.
 /begin AXIS_DESCR COM_AXIS ONLINE_DUMMY _CNV_S_4_RANGE_FMY__322_CM 4 0. 3. AXIS_PTS_REF ldp_fmy_envd /end AXIS_DESCR
/end CHARACTERISTIC
/begin CHARACTERISTIC C_DIAG_CONF_ISA_2 "" VALUE 0x609ec _REC_VAL_20_u1 255. _CNV_A_R_LINEAR_____13_CM 0. 255. FORMAT "%3.0" /end CHARACTERISTIC
/begin CHARACTERISTIC C_DC_INC_ISA_2 "" VALUE 0x609ed _REC_VAL_20_u1 255. _CNV_A_R_LINEAR_____13_CM 0. 255. FORMAT "%3.0" /end CHARACTERISTIC
/begin CHARACTERISTIC C_DC_MAX_ISA_2 "" VALUE 0x609ef _REC_VAL_20_u1 255. _CNV_A_R_LINEAR_____13_CM 0. 255. FORMAT "%3.0" /end CHARACTERISTIC
/begin CHARACTERISTIC C_DC_DEC_ISA_2 "" VALUE 0x609ee _REC_VAL_20_u1 255. _CNV_A_R_LINEAR_____13_CM 0. 255. FORMAT "%3.0" /end CHARACTERISTIC
/begin CHARACTERISTIC ID_ERR_DTC_MEC_ISA "" CURVE 0x609b8 _REC_CUR_20_u2_u2 65535. _CNV_A_R_LINEAR_____17_CM 0. 65535. FORMAT "%5.0"
 /begin AXIS_DESCR COM_AXIS ONLINE_DUMMY _CNV_S_6_RANGE_FMY__320_CM 6 0. 5. AXIS_PTS_REF ldp_fmy_dtc /end AXIS_DESCR
/end CHARACTERISTIC
/begin CHARACTERISTIC ID_ERR_ENVD_MEC_ISA "" CURVE 0x609b4 _REC_CUR_20_u1_u1 17. _CNV_S_6_RANGE_DIAG_321_CM 4. 21.
 /begin AXIS_DESCR COM_AXIS ONLINE_DUMMY _CNV_S_4_RANGE_FMY__322_CM 4 0. 3. AXIS_PTS_REF ldp_fmy_envd /end AXIS_DESCR
/end CHARACTERISTIC
/begin CHARACTERISTIC C_DIAG_CONF_MEC_ISA "" VALUE 0x609c4 _REC_VAL_20_u1 255. _CNV_A_R_LINEAR_____13_CM 0. 255. FORMAT "%3.0" /end CHARACTERISTIC
/begin CHARACTERISTIC C_DC_INC_MEC_ISA "" VALUE 0x609c5 _REC_VAL_20_u1 255. _CNV_A_R_LINEAR_____13_CM 0. 255. FORMAT "%3.0" /end CHARACTERISTIC
/begin CHARACTERISTIC C_DC_MAX_MEC_ISA "" VALUE 0x609c7 _REC_VAL_20_u1 255. _CNV_A_R_LINEAR_____13_CM 0. 255. FORMAT "%3.0" /end CHARACTERISTIC
/begin CHARACTERISTIC C_DC_DEC_MEC_ISA "" VALUE 0x609c6 _REC_VAL_20_u1 255. _CNV_A_R_LINEAR_____13_CM 0. 255. FORMAT "%3.0" /end CHARACTERISTIC
/begin CHARACTERISTIC ID_ERR_DTC_MSW_3 "" CURVE 0x609a4 _REC_CUR_20_u2_u2 65535. _CNV_A_R_LINEAR_____17_CM 0. 65535. FORMAT "%5.0"
 /begin AXIS_DESCR COM_AXIS ONLINE_DUMMY _CNV_S_6_RANGE_FMY__320_CM 6 0. 5. AXIS_PTS_REF ldp_fmy_dtc /end AXIS_DESCR
/end CHARACTERISTIC
/begin CHARACTERISTIC ID_ERR_ENVD_MSW_3 "" CURVE 0x609a0 _REC_CUR_20_u1_u1 17. _CNV_S_6_RANGE_DIAG_321_CM 4. 21.
 /begin AXIS_DESCR COM_AXIS ONLINE_DUMMY _CNV_S_4_RANGE_FMY__322_CM 4 0. 3. AXIS_PTS_REF ldp_fmy_envd /end AXIS_DESCR
/end CHARACTERISTIC
/begin CHARACTERISTIC C_DIAG_CONF_MSW_3 "" VALUE 0x609b0 _REC_VAL_20_u1 255. _CNV_A_R_LINEAR_____13_CM 0. 255. FORMAT "%3.0" /end CHARACTERISTIC
/begin CHARACTERISTIC C_DC_INC_MSW_3 "" VALUE 0x609b1 _REC_VAL_20_u1 255. _CNV_A_R_LINEAR_____13_CM 0. 255. FORMAT "%3.0" /end CHARACTERISTIC
/begin CHARACTERISTIC C_DC_MAX_MSW_3 "" VALUE 0x609b3 _REC_VAL_20_u1 255. _CNV_A_R_LINEAR_____13_CM 0. 255. FORMAT "%3.0" /end CHARACTERISTIC
/begin CHARACTERISTIC C_DC_DEC_MSW_3 "" VALUE 0x609b2 _REC_VAL_20_u1 255. _CNV_A_R_LINEAR_____13_CM 0. 255. FORMAT "%3.0" /end CHARACTERISTIC
/begin CHARACTERISTIC ID_ERR_DTC_MSW_2 "" CURVE 0x60990 _REC_CUR_20_u2_u2 65535. _CNV_A_R_LINEAR_____17_CM 0. 65535. FORMAT "%5.0"
 /begin AXIS_DESCR COM_AXIS ONLINE_DUMMY _CNV_S_6_RANGE_FMY__320_CM 6 0. 5. AXIS_PTS_REF ldp_fmy_dtc /end AXIS_DESCR
/end CHARACTERISTIC
/begin CHARACTERISTIC ID_ERR_ENVD_MSW_2 "" CURVE 0x6098c _REC_CUR_20_u1_u1 17. _CNV_S_6_RANGE_DIAG_321_CM 4. 21.
 /begin AXIS_DESCR COM_AXIS ONLINE_DUMMY _CNV_S_4_RANGE_FMY__322_CM 4 0. 3. AXIS_PTS_REF ldp_fmy_envd /end AXIS_DESCR
/end CHARACTERISTIC
/begin CHARACTERISTIC C_DIAG_CONF_MSW_2 "" VALUE 0x6099c _REC_VAL_20_u1 255. _CNV_A_R_LINEAR_____13_CM 0. 255. FORMAT "%3.0" /end CHARACTERISTIC
/begin CHARACTERISTIC C_DC_INC_MSW_2 "" VALUE 0x6099d _REC_VAL_20_u1 255. _CNV_A_R_LINEAR_____13_CM 0. 255. FORMAT "%3.0" /end CHARACTERISTIC
/begin CHARACTERISTIC C_DC_MAX_MSW_2 "" VALUE 0x6099f _REC_VAL_20_u1 255. _CNV_A_R_LINEAR_____13_CM 0. 255. FORMAT "%3.0" /end CHARACTERISTIC
/begin CHARACTERISTIC C_DC_DEC_MSW_2 "" VALUE 0x6099e _REC_VAL_20_u1 255. _CNV_A_R_LINEAR_____13_CM 0. 255. FORMAT "%3.0" /end CHARACTERISTIC
/begin CHARACTERISTIC ID_ERR_DTC_MSW_TOG "" CURVE 0x6097c _REC_CUR_20_u2_u2 65535. _CNV_A_R_LINEAR_____17_CM 0. 65535. FORMAT "%5.0"
 /begin AXIS_DESCR COM_AXIS ONLINE_DUMMY _CNV_S_6_RANGE_FMY__320_CM 6 0. 5. AXIS_PTS_REF ldp_fmy_dtc /end AXIS_DESCR
/end CHARACTERISTIC
/begin CHARACTERISTIC ID_ERR_ENVD_MSW_TOG "" CURVE 0x60978 _REC_CUR_20_u1_u1 17. _CNV_S_6_RANGE_DIAG_321_CM 4. 21.
 /begin AXIS_DESCR COM_AXIS ONLINE_DUMMY _CNV_S_4_RANGE_FMY__322_CM 4 0. 3. AXIS_PTS_REF ldp_fmy_envd /end AXIS_DESCR
/end CHARACTERISTIC
/begin CHARACTERISTIC C_DIAG_CONF_MSW_TOG "" VALUE 0x60988 _REC_VAL_20_u1 255. _CNV_A_R_LINEAR_____13_CM 0. 255. FORMAT "%3.0" /end CHARACTERISTIC
/begin CHARACTERISTIC C_DC_INC_MSW_TOG "" VALUE 0x60989 _REC_VAL_20_u1 255. _CNV_A_R_LINEAR_____13_CM 0. 255. FORMAT "%3.0" /end CHARACTERISTIC
/begin CHARACTERISTIC C_DC_MAX_MSW_TOG "" VALUE 0x6098b _REC_VAL_20_u1 255. _CNV_A_R_LINEAR_____13_CM 0. 255. FORMAT "%3.0" /end CHARACTERISTIC
/begin CHARACTERISTIC C_DC_DEC_MSW_TOG "" VALUE 0x6098a _REC_VAL_20_u1 255. _CNV_A_R_LINEAR_____13_CM 0. 255. FORMAT "%3.0" /end CHARACTERISTIC
/begin CHARACTERISTIC ID_ERR_DTC_IM_BTS_PLAUS "" CURVE 0x60968 _REC_CUR_20_u2_u2 65535. _CNV_A_R_LINEAR_____17_CM 0. 65535. FORMAT "%5.0"
 /begin AXIS_DESCR COM_AXIS ONLINE_DUMMY _CNV_S_6_RANGE_FMY__320_CM 6 0. 5. AXIS_PTS_REF ldp_fmy_dtc /end AXIS_DESCR
/end CHARACTERISTIC
/begin CHARACTERISTIC ID_ERR_ENVD_IM_BTS_PLAUS "" CURVE 0x60964 _REC_CUR_20_u1_u1 17. _CNV_S_6_RANGE_DIAG_321_CM 4. 21.
 /begin AXIS_DESCR COM_AXIS ONLINE_DUMMY _CNV_S_4_RANGE_FMY__322_CM 4 0. 3. AXIS_PTS_REF ldp_fmy_envd /end AXIS_DESCR
/end CHARACTERISTIC
/begin CHARACTERISTIC C_DIAG_CONF_IM_BTS_PLAUS "" VALUE 0x60974 _REC_VAL_20_u1 255. _CNV_A_R_LINEAR_____13_CM 0. 255. FORMAT "%3.0" /end CHARACTERISTIC
/begin CHARACTERISTIC C_DC_INC_IM_BTS_PLAUS "" VALUE 0x60975 _REC_VAL_20_u1 255. _CNV_A_R_LINEAR_____13_CM 0. 255. FORMAT "%3.0" /end CHARACTERISTIC
/begin CHARACTERISTIC C_DC_MAX_IM_BTS_PLAUS "" VALUE 0x60977 _REC_VAL_20_u1 255. _CNV_A_R_LINEAR_____13_CM 0. 255. FORMAT "%3.0" /end CHARACTERISTIC
/begin CHARACTERISTIC C_DC_DEC_IM_BTS_PLAUS "" VALUE 0x60976 _REC_VAL_20_u1 255. _CNV_A_R_LINEAR_____13_CM 0. 255. FORMAT "%3.0" /end CHARACTERISTIC
/begin CHARACTERISTIC ID_ERR_DTC_IM_BLS_PLAUS "" CURVE 0x60954 _REC_CUR_20_u2_u2 65535. _CNV_A_R_LINEAR_____17_CM 0. 65535. FORMAT "%5.0"
 /begin AXIS_DESCR COM_AXIS ONLINE_DUMMY _CNV_S_6_RANGE_FMY__320_CM 6 0. 5. AXIS_PTS_REF ldp_fmy_dtc /end AXIS_DESCR
/end CHARACTERISTIC
/begin CHARACTERISTIC ID_ERR_ENVD_IM_BLS_PLAUS "" CURVE 0x60950 _REC_CUR_20_u1_u1 17. _CNV_S_6_RANGE_DIAG_321_CM 4. 21.
 /begin AXIS_DESCR COM_AXIS ONLINE_DUMMY _CNV_S_4_RANGE_FMY__322_CM 4 0. 3. AXIS_PTS_REF ldp_fmy_envd /end AXIS_DESCR
/end CHARACTERISTIC
/begin CHARACTERISTIC C_DIAG_CONF_IM_BLS_PLAUS "" VALUE 0x60960 _REC_VAL_20_u1 255. _CNV_A_R_LINEAR_____13_CM 0. 255. FORMAT "%3.0" /end CHARACTERISTIC
/begin CHARACTERISTIC C_DC_INC_IM_BLS_PLAUS "" VALUE 0x60961 _REC_VAL_20_u1 255. _CNV_A_R_LINEAR_____13_CM 0. 255. FORMAT "%3.0" /end CHARACTERISTIC
/begin CHARACTERISTIC C_DC_MAX_IM_BLS_PLAUS "" VALUE 0x60963 _REC_VAL_20_u1 255. _CNV_A_R_LINEAR_____13_CM 0. 255. FORMAT "%3.0" /end CHARACTERISTIC
/begin CHARACTERISTIC C_DC_DEC_IM_BLS_PLAUS "" VALUE 0x60962 _REC_VAL_20_u1 255. _CNV_A_R_LINEAR_____13_CM 0. 255. FORMAT "%3.0" /end CHARACTERISTIC
/begin CHARACTERISTIC LC_ABC_BENCH_CAL "logical constant to manage the anti-bounce bench mode" VALUE 0x69245 _REC_VAL_20_u1 1. _CNV_A_R_LINEAR_____17_CM 0. 1. FORMAT "%2.0" /end CHARACTERISTIC
/begin CHARACTERISTIC C_VB_MIN_MSW_DIAG "Min. battery voltage for MSW diagnosis" VALUE 0x6472d _REC_VAL_20_u1 26. _CNV_A_R_LINEAR_____188_CM 0. 26. FORMAT "%3.1" /end CHARACTERISTIC
/begin CHARACTERISTIC C_ABC_MAX_MSW_2 "Debounce counter maximum value - MSW diagnosis" VALUE 0x6472f _REC_VAL_20_u1 254. _CNV_A_R_LINEAR_____17_CM 1. 255. FORMAT "%3.0" /end CHARACTERISTIC
/begin CHARACTERISTIC C_ABC_INC_MSW_2 "Debounce counter increment - MSW diagnosis" VALUE 0x6472e _REC_VAL_20_u1 255. _CNV_A_R_LINEAR_____13_CM 0. 255. FORMAT "%3.0" /end CHARACTERISTIC
/begin CHARACTERISTIC C_T_MIN_MSW_BIT_DIAG "Min. diagnostic threshold - Toggle bit monitoring" VALUE 0x64732 _REC_VAL_20_u1 2550. _CNV_A_R_LINEAR_____337_CM 10. 2560. FORMAT "%5.0" /end CHARACTERISTIC
/begin CHARACTERISTIC C_T_MAX_MSW_BIT_DIAG "Max. diagnostic threshold - Toggle bit monitoring" VALUE 0x64733 _REC_VAL_20_u1 2550. _CNV_A_R_LINEAR_____337_CM 10. 2560. FORMAT "%5.0" /end CHARACTERISTIC
/begin CHARACTERISTIC C_ABC_INC_MSW_TOG "Debounce counter increment - Toggle bit monitoring" VALUE 0x64734 _REC_VAL_20_u1 255. _CNV_A_R_LINEAR_____13_CM 0. 255. FORMAT "%3.0" /end CHARACTERISTIC
/begin CHARACTERISTIC C_ABC_MAX_MSW_TOG "Debounce counter maximum value - Toggle bit monitoring" VALUE 0x64735 _REC_VAL_20_u1 254. _CNV_A_R_LINEAR_____17_CM 1. 255. FORMAT "%3.0" /end CHARACTERISTIC
/begin MEASUREMENT LV_ERR_MSW_2 "???" UBYTE _CNV_S_2_RANGE______76_CM 1 100. 0. 1. ECU_ADDRESS 0x3fd3c0 /end MEASUREMENT
/begin MEASUREMENT LV_ERR_MSW_3 "???" UBYTE _CNV_S_2_RANGE______76_CM 1 100. 0. 1. ECU_ADDRESS 0x3fd3c1 /end MEASUREMENT
/begin MEASUREMENT LV_ERR_MSW_TOG "???" UBYTE _CNV_S_2_RANGE______76_CM 1 100. 0. 1. ECU_ADDRESS 0x3fd3bf /end MEASUREMENT
/begin CHARACTERISTIC C_ABC_INC_MSW_3 "Debounce counter increment - MSW diagnosis" VALUE 0x64731 _REC_VAL_20_u1 255. _CNV_A_R_LINEAR_____13_CM 0. 255. FORMAT "%3.0" /end CHARACTERISTIC
/begin CHARACTERISTIC C_ABC_MAX_MSW_3 "Debounce counter maximum value - MSW diagnosis" VALUE 0x64730 _REC_VAL_20_u1 254. _CNV_A_R_LINEAR_____17_CM 1. 255. FORMAT "%3.0" /end CHARACTERISTIC
/begin MEASUREMENT LV_ERR_ISA_1 "electrical error idle speed actuator (ISA) coil 1 (opening)" UBYTE _CNV_S_2_RANGE______77_R_CM 1 100. 0. 255. ECU_ADDRESS 0x3fd3c3 /end MEASUREMENT
/begin MEASUREMENT LV_ERR_ISA_2 "electrical error idle speed actuator (ISA) coil 2 (closing)" UBYTE _CNV_S_2_RANGE______77_R_CM 1 100. 0. 255. ECU_ADDRESS 0x3fd3c4 /end MEASUREMENT
/begin MEASUREMENT STATE_ISA_DIAG "state of idle speed actuator" UBYTE _CNV_S_6_RANGE_STAT_341_CM 1 100. 0. 5. ECU_ADDRESS 0x3fda0e /end MEASUREMENT
/begin CHARACTERISTIC C_ISAPWM_MIN_DIAG "???" VALUE 0x64738 _REC_VAL_20_u2 99.99847412 _CNV_A_R_LINEAR_____144_CM 0. 99.99847412 /end CHARACTERISTIC
/begin CHARACTERISTIC C_ISAPWM_MAX_DIAG "???" VALUE 0x6473a _REC_VAL_20_u2 99.99847412 _CNV_A_R_LINEAR_____144_CM 0. 99.99847412 /end CHARACTERISTIC
/begin CHARACTERISTIC C_ABC_INC_ISA_1 "Debounce counter increment - electrical error - ISA opening coil" VALUE 0x6473c _REC_VAL_20_u1 255. _CNV_A_R_LINEAR_____13_CM 0. 255. FORMAT "%3.0" /end CHARACTERISTIC
/begin CHARACTERISTIC C_ABC_INC_ISA_2 "Debounce counter increment - electrical error - ISA closing coil" VALUE 0x6473d _REC_VAL_20_u1 255. _CNV_A_R_LINEAR_____13_CM 0. 255. FORMAT "%3.0" /end CHARACTERISTIC
/begin CHARACTERISTIC C_ABC_MAX_ISA_1 "Debounce counter maximum value - electrical error - ISA opening coil" VALUE 0x6473e _REC_VAL_20_u1 254. _CNV_A_R_LINEAR_____17_CM 1. 255. FORMAT "%3.0" /end CHARACTERISTIC
/begin CHARACTERISTIC C_ABC_MAX_ISA_2 "Debounce counter maximum value - electrical error - ISA opening coil" VALUE 0x6473f _REC_VAL_20_u1 254. _CNV_A_R_LINEAR_____17_CM 1. 255. FORMAT "%3.0" /end CHARACTERISTIC
/begin CHARACTERISTIC C_AR_RED_DIF_MAX_DIAG "???" VALUE 0x64740 _REC_VAL_20_s2 99.99847412 _CNV_A_R_LINEAR_____149_CM -50. 49.99847412 FORMAT "%7.3" /end CHARACTERISTIC
/begin CHARACTERISTIC C_AR_RED_DIF_MIN_DIAG "???" VALUE 0x64742 _REC_VAL_20_s2 99.99847412 _CNV_A_R_LINEAR_____149_CM -50. 49.99847412 FORMAT "%7.3" /end CHARACTERISTIC
/begin CHARACTERISTIC C_N_ISA_DIAG "engine speed condition - diagnosis of mechanical fault ISA" VALUE 0x64744 _REC_VAL_20_u1 8160. _CNV_A_R_LINEAR_____15_CM 0. 8160. FORMAT "%4.0" /end CHARACTERISTIC
/begin CHARACTERISTIC C_MAF_TURB_RATIO_DIAG "MAF_TURB_RATIO condition - diagnosis of mechanical fault ISA" VALUE 0x64745 _REC_VAL_20_u1 0.9960940000000002 _CNV_A_R_LINEAR_____8_CM 0. 0.996094 FORMAT "%5.3" /end CHARACTERISTIC
/begin CHARACTERISTIC C_TPS_AV_TOL_ISA_AD "MTC condition - diagnosis of mechanical fault ISA" VALUE 0x64746 _REC_VAL_20_s2 119.5 _CNV_A_R_LINEAR_____199_CM -119.5 0. FORMAT "%8.3" /end CHARACTERISTIC
/begin CHARACTERISTIC C_ABC_INC_ISA_MEC "debounce counter increment - diagnosis of mechanical fault ISA" VALUE 0x64748 _REC_VAL_20_u1 255. _CNV_A_R_LINEAR_____13_CM 0. 255. FORMAT "%3.0" /end CHARACTERISTIC
/begin MEASUREMENT LV_ERR_MEC_ISA "error bit mechanical fault at ISA-valve" UBYTE _CNV_S_2_RANGE______77_R_CM 1 100. 0. 255. ECU_ADDRESS 0x3fd3c2 /end MEASUREMENT
/begin CHARACTERISTIC C_ABC_MAX_ISA_MEC "debounce counter maximum value - diagnosis of mechanical fault ISA" VALUE 0x64749 _REC_VAL_20_u1 254. _CNV_A_R_LINEAR_____17_CM 1. 255. FORMAT "%3.0" /end CHARACTERISTIC
/begin COMPU_METHOD _CNV_A_R_LINEAR_____0_CM "" RAT_FUNC "%6.3" "rpm" COEFFS 0 1. 0. 0 0 1 /end COMPU_METHOD
/begin COMPU_METHOD _CNV_A_R_LINEAR_____3_CM "" RAT_FUNC "%6.3" "ms" COEFFS 0 0.1 0. 0 0 1 /end COMPU_METHOD
/begin COMPU_METHOD _CNV_A_R_LINEAR_____6_CM "" RAT_FUNC "%6.3" "°CRK" COEFFS 0 2.666666666666667 0. 0 0 1 /end COMPU_METHOD
/begin COMPU_METHOD _CNV_A_R_LINEAR_____8_CM "" RAT_FUNC "%6.3" "[-]" COEFFS 0 255.9999357490357 0. 0 0 1 /end COMPU_METHOD
/begin COMPU_METHOD _CNV_A_R_LINEAR_____13_CM "" RAT_FUNC "%6.3" "[-]" COEFFS 0 1. 0. 0 0 1 /end COMPU_METHOD
/begin COMPU_METHOD _CNV_A_R_LINEAR_____15_CM "" RAT_FUNC "%6.3" "rpm" COEFFS 0 3.125e-002 0. 0 0 1 /end COMPU_METHOD
/begin COMPU_METHOD _CNV_A_R_LINEAR_____16_CM "" RAT_FUNC "%6.3" "%" COEFFS 0 2.56 0. 0 0 1 /end COMPU_METHOD
/begin COMPU_METHOD _CNV_A_R_LINEAR_____17_CM "" RAT_FUNC "%6.3" "-" COEFFS 0 1. 0. 0 0 1 /end COMPU_METHOD
/begin COMPU_METHOD _CNV_A_R_LINEAR_____18_CM "" RAT_FUNC "%6.3" "s" COEFFS 0 10. 0. 0 0 1 /end COMPU_METHOD
/begin COMPU_METHOD _CNV_A_R_LINEAR_____19_CM "" RAT_FUNC "%6.3" "s" COEFFS 0 200. 0. 0 0 1 /end COMPU_METHOD
/begin COMPU_METHOD _CNV_A_R_LINEAR_____20_CM "" RAT_FUNC "%6.3" "s" COEFFS 0 1. 0. 0 0 1 /end COMPU_METHOD
/begin COMPU_METHOD _CNV_A_R_LINEAR_____21_CM "" RAT_FUNC "%6.3" "s" COEFFS 0 100. 0. 0 0 1 /end COMPU_METHOD
/begin COMPU_METHOD _CNV_A_R_LINEAR_____22_CM "" RAT_FUNC "%6.3" "°C" COEFFS 0 1.333333333333333 64. 0 0 1 /end COMPU_METHOD
/begin COMPU_METHOD _CNV_A_R_LINEAR_____23_CM "" RAT_FUNC "%6.3" "°C" COEFFS 0 1.333333333333333 0. 0 0 1 /end COMPU_METHOD
/begin COMPU_METHOD _CNV_A_R_LINEAR_____34_CM "" RAT_FUNC "%6.3" "°TPS" COEFFS 0 137.0962343096234 0. 0 0 1 /end COMPU_METHOD
/begin COMPU_METHOD _CNV_A_R_LINEAR_____35_CM "" RAT_FUNC "%6.3" "°TPS/5ms" COEFFS 0 137.0962586026216 -6.746863121520619e-007 0 0 1 /end COMPU_METHOD
/begin COMPU_METHOD _CNV_A_R_LINEAR_____36_CM "" RAT_FUNC "%6.3" "°TPS" COEFFS 0 137.0962586026216 -6.746863121520619e-007 0 0 1 /end COMPU_METHOD
/begin COMPU_METHOD _CNV_A_R_LINEAR_____38_CM "" RAT_FUNC "%6.3" "V" COEFFS 0 204.7999998974999 0. 0 0 1 /end COMPU_METHOD
/begin COMPU_METHOD _CNV_A_R_LINEAR_____39_CM "" RAT_FUNC "%6.3" "V" COEFFS 0 204.7999995887937 0. 0 0 1 /end COMPU_METHOD
/begin COMPU_METHOD _CNV_A_R_LINEAR_____40_CM "" RAT_FUNC "%6.3" "V" COEFFS 0 51.2 0. 0 0 1 /end COMPU_METHOD
/begin COMPU_METHOD _CNV_A_R_LINEAR_____41_CM "" RAT_FUNC "%6.3" "V" COEFFS 0 102.3999997943969 0. 0 0 1 /end COMPU_METHOD
/begin COMPU_METHOD _CNV_A_R_LINEAR_____42_CM "" RAT_FUNC "%6.3" "V" COEFFS 0 9.846168103048838 0. 0 0 1 /end COMPU_METHOD
/begin COMPU_METHOD _CNV_A_R_LINEAR_____43_CM "" RAT_FUNC "%6.3" "km/h" COEFFS 0 1. 0. 0 0 1 /end COMPU_METHOD
/begin COMPU_METHOD _CNV_A_R_LINEAR_____51_CM "" RAT_FUNC "%6.3" "mg/stk" COEFFS 0 0.183585313174946 0. 0 0 1 /end COMPU_METHOD
/begin COMPU_METHOD _CNV_A_R_LINEAR_____64_CM "" RAT_FUNC "%6.3" "-" COEFFS 0 127.9991955827809 0. 0 0 1 /end COMPU_METHOD
/begin COMPU_METHOD _CNV_A_R_LINEAR_____68_CM "" RAT_FUNC "%6.3" "-" COEFFS 0 255.9983911655618 0. 0 0 1 /end COMPU_METHOD
/begin COMPU_METHOD _CNV_S_2_RANGE______74_CM "" TAB_VERB "%6.3" "[-]" COMPU_TAB_REF _CNV_S_2_RANGE______74 /end COMPU_METHOD
/begin COMPU_VTAB _CNV_S_2_RANGE______74 "" TAB_VERB 2 0 "0" 1 "1" /end COMPU_VTAB
/begin COMPU_METHOD _CNV_S_2_RANGE______75_R_CM "" TAB_VERB "%6.3" "-" COMPU_TAB_REF _CNV_S_2_RANGE______75_R /end COMPU_METHOD
/begin COMPU_VTAB_RANGE _CNV_S_2_RANGE______75_R "" 2 0 0 "0" 1 255 "1" /end COMPU_VTAB_RANGE
/begin COMPU_METHOD _CNV_S_2_RANGE______76_CM "" TAB_VERB "%6.3" "-" COMPU_TAB_REF _CNV_S_2_RANGE______76 /end COMPU_METHOD
/begin COMPU_VTAB _CNV_S_2_RANGE______76 "" TAB_VERB 2 0 "0" 1 "1" /end COMPU_VTAB
/begin COMPU_METHOD _CNV_S_2_RANGE______77_R_CM "" TAB_VERB "%6.3" "[-]" COMPU_TAB_REF _CNV_S_2_RANGE______77_R /end COMPU_METHOD
/begin COMPU_VTAB_RANGE _CNV_S_2_RANGE______77_R "" 2 0 0 "0" 1 255 "1" /end COMPU_VTAB_RANGE
/begin COMPU_METHOD _CNV_A_R_LINEAR_____81_CM "" RAT_FUNC "%6.3" "°TPS/s" COEFFS 0 8.535564853556485e-002 0. 0 0 1 /end COMPU_METHOD
/begin COMPU_METHOD _CNV_A_R_LINEAR_____89_CM "" RAT_FUNC "%6.3" "V" COEFFS 0 39.38462959968585 0. 0 0 1 /end COMPU_METHOD
/begin COMPU_METHOD _CNV_A_R_LINEAR_____90_CM "" RAT_FUNC "%6.3" "-" COEFFS 0 4095.999999839998 -1.280019205296412e-006 0 0 1 /end COMPU_METHOD
/begin COMPU_METHOD _CNV_A_R_LINEAR_____104_CM "" RAT_FUNC "%6.3" "-" COEFFS 0 8191.999999679995 0. 0 0 1 /end COMPU_METHOD
/begin COMPU_METHOD _CNV_A_R_LINEAR_____144_CM "" RAT_FUNC "%6.3" "%" COEFFS 0 655.3600000071681 0. 0 0 1 /end COMPU_METHOD
/begin COMPU_METHOD _CNV_A_R_LINEAR_____149_CM "" RAT_FUNC "%6.3" "%" COEFFS 0 655.3600000071681 3.584063961170614e-007 0 0 1 /end COMPU_METHOD
/begin COMPU_METHOD _CNV_A_R_LINEAR_____158_CM "" RAT_FUNC "%6.3" "V" COEFFS 0 204.8 0. 0 0 1 /end COMPU_METHOD
/begin COMPU_METHOD _CNV_A_R_LINEAR_____159_CM "" RAT_FUNC "%6.3" "%" COEFFS 0 327.6800000071683 0. 0 0 1 /end COMPU_METHOD
/begin COMPU_METHOD _CNV_S_11_RANGE_TPS__160_CM "" TAB_VERB "%6.3" "-" COMPU_TAB_REF _CNV_S_11_RANGE_TPS__160 /end COMPU_METHOD
/begin COMPU_VTAB _CNV_S_11_RANGE_TPS__160 "" TAB_VERB 11 0 "ST_CHK_CHK_LIH_1" 1 "ST_CHK_GO_UPPER_POS" 2 "ST_CHK_CHK_LIH_2" 3 "ST_CHK_END" 4 "AD_CHK_LIH_1" 5 "AD_GO_UPPER_POS" 6 "AD_CHK_LIH_2" 7 "AD_GO_LOWER_STOP" 8 "AD_GO_LIH" 9 "AD_CHK_LIH_3" 10 "AD_END" /end COMPU_VTAB
/begin COMPU_METHOD _CNV_A_R_LINEAR_____161_CM "" RAT_FUNC "%6.3" "°TPS/V" COEFFS 0 1365.3125 0. 0 0 1 /end COMPU_METHOD
/begin COMPU_METHOD _CNV_A_R_LINEAR_____188_CM "" RAT_FUNC "%6.3" "V" COEFFS 0 9.807692307692308 0. 0 0 1 /end COMPU_METHOD
/begin COMPU_METHOD _CNV_S_10_RANGE_CRK__189_CM "" TAB_VERB "%6.3" "[-]" COMPU_TAB_REF _CNV_S_10_RANGE_CRK__189 /end COMPU_METHOD
/begin COMPU_VTAB _CNV_S_10_RANGE_CRK__189 "" TAB_VERB 10 0 "BIOS_EPO_CRK_SYNC" 1 "BIOS_EPO_CRK_SYNC_CHK_MIS" 2 "BIOS_EPO_CRK_SYNC_GAP_SIM" 3 "BIOS_EPO_CRK_SYNC_CHK_GAP" 4 "BIOS_EPO_CRK_SYNC_GAP" 5 "BIOS_CRK_VLD_TEETH" 6 "BIOS_CRK_FIRST_TOOTH" 7 "BIOS_EPO_CRK_SENS_DLY" 8 "BIOS_EPO_CRK_FIRST_EDGE" 9 "BIOS_EPO_CRK_PAS" /end COMPU_VTAB
/begin COMPU_METHOD _CNV_S_4_RANGE_STAT_190_CM "" TAB_VERB "%6.3" "-" COMPU_TAB_REF _CNV_S_4_RANGE_STAT_190 /end COMPU_METHOD
/begin COMPU_VTAB _CNV_S_4_RANGE_STAT_190 "" TAB_VERB 4 0 "CAM_EDGE_NO_ERROR" 1 "CAM_EDGE_BELOW" 2 "CAM_EDGE_ABOVE" 4 "CAM_EDGE_WRONG" /end COMPU_VTAB
/begin COMPU_METHOD _CNV_S_5_RANGE_STAT_193_CM "" TAB_VERB "%6.3" "-" COMPU_TAB_REF _CNV_S_5_RANGE_STAT_193 /end COMPU_METHOD
/begin COMPU_VTAB _CNV_S_5_RANGE_STAT_193 "" TAB_VERB 5 0 "TPS_NO_ERROR" 1 "TPS_LIH_1" 2 "TPS_LIH_2" 4 "TPS_LIH_MAX" 8 "TPS_DBL_ERROR" /end COMPU_VTAB
/begin COMPU_METHOD _CNV_S_5_RANGE_STAT_194_CM "" TAB_VERB "%6.3" "-" COMPU_TAB_REF _CNV_S_5_RANGE_STAT_194 /end COMPU_METHOD
/begin COMPU_VTAB _CNV_S_5_RANGE_STAT_194 "" TAB_VERB 5 0 "ETC_NO_LIH" 1 "ETC_LIH_1" 2 "ETC_LIH_2_REV" 4 "ETC_LIH_2" 8 "ETC_LIH_3" /end COMPU_VTAB
/begin COMPU_METHOD _CNV_A_R_LINEAR_____199_CM "" RAT_FUNC "%6.3" "°TPS" COEFFS 0 137.0962343096234 1.818989403545857e-012 0 0 1 /end COMPU_METHOD
/begin COMPU_METHOD _CNV_A_R_LINEAR_____216_CM "" RAT_FUNC "%6.3" "µs" COEFFS 0 -1. 0. 0 0 1 /end COMPU_METHOD
/begin COMPU_METHOD _CNV_A_R_LINEAR_____217_CM "" RAT_FUNC "%6.3" "-" COEFFS 0 127.9983874218908 1.612578109245533e-003 0 0 1 /end COMPU_METHOD
/begin COMPU_METHOD _CNV_S_6_RANGE_FMY__320_CM "" TAB_VERB "%6.3" "[-]" COMPU_TAB_REF _CNV_S_6_RANGE_FMY__320 /end COMPU_METHOD
/begin COMPU_VTAB _CNV_S_6_RANGE_FMY__320 "" TAB_VERB 6 0 "0" 1 "1" 2 "2" 3 "3" 4 "global" 5 "cus" /end COMPU_VTAB
/begin COMPU_METHOD _CNV_S_6_RANGE_DIAG_321_CM "" TAB_VERB "%6.3" "[-]" COMPU_TAB_REF _CNV_S_6_RANGE_DIAG_321 /end COMPU_METHOD
/begin COMPU_VTAB _CNV_S_6_RANGE_DIAG_321 "" TAB_VERB 6 4 "tco" 10 "n" 11 "vs" 19 "tia" 20 "vb" 21 "tps_av" /end COMPU_VTAB
/begin COMPU_METHOD _CNV_S_4_RANGE_FMY__322_CM "" TAB_VERB "%6.3" "[-]" COMPU_TAB_REF _CNV_S_4_RANGE_FMY__322 /end COMPU_METHOD
/begin COMPU_VTAB _CNV_S_4_RANGE_FMY__322 "" TAB_VERB 4 0 "0" 1 "1" 2 "2" 3 "3" /end COMPU_VTAB
/begin COMPU_METHOD _CNV_A_R_LINEAR_____337_CM "" RAT_FUNC "%6.3" "ms" COEFFS 0 0.1 -1. 0 0 1 /end COMPU_METHOD
/begin COMPU_METHOD _CNV_S_6_RANGE_STAT_341_CM "" TAB_VERB "%6.3" "[-]" COMPU_TAB_REF _CNV_S_6_RANGE_STAT_341 /end COMPU_METHOD
/begin COMPU_VTAB _CNV_S_6_RANGE_STAT_341 "" TAB_VERB 6 0 "no error" 1 "error active / no substitutes" 2 "error active / closing 100%" 3 "error active / substitute opening" 4 "error active / closing 0%" 5 "error active / limp home" /end COMPU_VTAB
/begin RECORD_LAYOUT _REC_VAL_20_u2 FNC_VALUES 1 UWORD COLUMN_DIR DIRECT /end RECORD_LAYOUT
/begin RECORD_LAYOUT _REC_VAL_20_s2 FNC_VALUES 1 SWORD COLUMN_DIR DIRECT /end RECORD_LAYOUT
/begin RECORD_LAYOUT _REC_VAL_20_u1 FNC_VALUES 1 UBYTE COLUMN_DIR DIRECT /end RECORD_LAYOUT
/begin RECORD_LAYOUT _REC_AXS_20_u2 NO_AXIS_PTS_X 1 UWORD AXIS_PTS_X 2 UWORD INDEX_INCR DIRECT /end RECORD_LAYOUT
/begin RECORD_LAYOUT _REC_AXS_20_u1 NO_AXIS_PTS_X 1 UBYTE AXIS_PTS_X 2 UBYTE INDEX_INCR DIRECT /end RECORD_LAYOUT
/begin RECORD_LAYOUT _REC_CUR_20_u2_u2 FNC_VALUES 1 UWORD COLUMN_DIR DIRECT /end RECORD_LAYOUT
/begin RECORD_LAYOUT _REC_CUR_20_u2_u1 FNC_VALUES 1 UWORD COLUMN_DIR DIRECT /end RECORD_LAYOUT
/begin RECORD_LAYOUT _REC_CUR_20_u1_u1 FNC_VALUES 1 UBYTE COLUMN_DIR DIRECT /end RECORD_LAYOUT
/begin RECORD_LAYOUT _REC_MAP_20_u2_u2_u1 FNC_VALUES 1 UWORD COLUMN_DIR DIRECT /end RECORD_LAYOUT
/begin FUNCTION DIA_Error_memory_interface "_Error-memory interface"
 /begin DEF_CHARACTERISTIC C_DC_MAX_TD_IGC_CUT_0 C_DC_DEC_TD_IGC_CUT_0 ID_ERR_DTC_TD_IGC_CUT_1 ID_ERR_ENVD_TD_IGC_CUT_1 C_DIAG_CONF_TD_IGC_CUT_1 C_DC_INC_TD_IGC_CUT_1 C_DC_MAX_TD_IGC_CUT_1 C_DC_DEC_TD_IGC_CUT_1 ID_ERR_DTC_TD_IGC_CUT_2 ID_ERR_ENVD_TD_IGC_CUT_2 C_DIAG_CONF_TD_IGC_CUT_2 C_DC_INC_TD_IGC_CUT_2 C_DC_MAX_TD_IGC_CUT_2 C_DC_DEC_TD_IGC_CUT_2 ID_ERR_DTC_TD_IGC_CUT_3 ID_ERR_ENVD_TD_IGC_CUT_3 C_DIAG_CONF_TD_IGC_CUT_3 C_DC_INC_TD_IGC_CUT_3 C_DC_MAX_TD_IGC_CUT_3 C_DC_DEC_TD_IGC_CUT_3 ID_ERR_DTC_TD_IGC_CUT_4 ID_ERR_ENVD_TD_IGC_CUT_4 C_DIAG_CONF_TD_IGC_CUT_4 C_DC_INC_TD_IGC_CUT_4 C_DC_MAX_TD_IGC_CUT_4 C_DC_DEC_TD_IGC_CUT_4 ID_ERR_DTC_TD_IGC_CUT_5 ID_ERR_ENVD_TD_IGC_CUT_5 C_DIAG_CONF_TD_IGC_CUT_5 C_DC_INC_TD_IGC_CUT_5 C_DC_MAX_TD_IGC_CUT_5 C_DC_DEC_TD_IGC_CUT_5 ID_ERR_DTC_DUR_IGC_0 ID_ERR_ENVD_DUR_IGC_0 C_DIAG_CONF_DUR_IGC_0 C_DC_INC_DUR_IGC_0 C_DC_MAX_DUR_IGC_0 C_DC_DEC_DUR_IGC_0 ID_ERR_DTC_DUR_IGC_1 ID_ERR_ENVD_DUR_IGC_1 C_DIAG_CONF_DUR_IGC_1 C_DC_INC_DUR_IGC_1 C_DC_MAX_DUR_IGC_1 C_DC_DEC_DUR_IGC_1 ID_ERR_DTC_DUR_IGC_2 ID_ERR_ENVD_DUR_IGC_2 C_DIAG_CONF_DUR_IGC_2 C_DC_INC_DUR_IGC_2 C_DC_MAX_DUR_IGC_2 C_DC_DEC_DUR_IGC_2 ID_ERR_DTC_DUR_IGC_3 ID_ERR_ENVD_DUR_IGC_3 C_DIAG_CONF_DUR_IGC_3 C_DC_INC_DUR_IGC_3 C_DC_MAX_DUR_IGC_3 C_DC_DEC_DUR_IGC_3 ID_ERR_DTC_DUR_IGC_4 ID_ERR_ENVD_DUR_IGC_4 C_DIAG_CONF_DUR_IGC_4 C_DC_INC_DUR_IGC_4 C_DC_MAX_DUR_IGC_4 C_DC_DEC_DUR_IGC_4 ID_ERR_DTC_DUR_IGC_5 ID_ERR_ENVD_DUR_IGC_5 C_DIAG_CONF_DUR_IGC_5 C_DC_INC_DUR_IGC_5 C_DC_MAX_DUR_IGC_5 C_DC_DEC_DUR_IGC_5 ID_ERR_DTC_TPS_1 ID_ERR_ENVD_TPS_1 C_DIAG_CONF_TPS_1 C_DC_INC_TPS_1 C_DC_MAX_TPS_1 C_DC_DEC_TPS_1 ID_ERR_DTC_TPS_2 ID_ERR_ENVD_TPS_2 C_DIAG_CONF_TPS_2 C_DC_INC_TPS_2 C_DC_MAX_TPS_2 C_DC_DEC_TPS_2 ID_ERR_DTC_TPS_MAF_1 ID_ERR_ENVD_TPS_MAF_1 C_DIAG_CONF_TPS_MAF_1 C_DC_INC_TPS_MAF_1 C_DC_MAX_TPS_MAF_1 C_DC_DEC_TPS_MAF_1 ID_ERR_DTC_TPS_MAF_2 ID_ERR_ENVD_TPS_MAF_2 C_DIAG_CONF_TPS_MAF_2 C_DC_INC_TPS_MAF_2 C_DC_MAX_TPS_MAF_2 C_DC_DEC_TPS_MAF_2 ID_ERR_DTC_TD ID_ERR_ENVD_TD C_DIAG_CONF_TD C_DC_INC_TD C_DC_MAX_TD C_DC_DEC_TD ID_ERR_DTC_V_REF_1 ID_ERR_ENVD_V_REF_1 C_DIAG_CONF_V_REF_1 C_DC_INC_V_REF_1 C_DC_MAX_V_REF_1 C_DC_DEC_V_REF_1 ID_ERR_DTC_V_REF_2 ID_ERR_ENVD_V_REF_2 C_DIAG_CONF_V_REF_2 C_DC_INC_V_REF_2 C_DC_MAX_V_REF_2 C_DC_DEC_V_REF_2 ID_ERR_DTC_PVS_1 ID_ERR_ENVD_PVS_1 C_DIAG_CONF_PVS_1 C_DC_INC_PVS_1 C_DC_MAX_PVS_1 C_DC_DEC_PVS_1 ID_ERR_DTC_PVS_2 ID_ERR_ENVD_PVS_2 C_DIAG_CONF_PVS_2 C_DC_INC_PVS_2 C_DC_MAX_PVS_2 C_DC_DEC_PVS_2 ID_ERR_DTC_PVS_RATIO ID_ERR_ENVD_PVS_RATIO C_DIAG_CONF_PVS_RATIO C_DC_INC_PVS_RATIO C_DC_MAX_PVS_RATIO C_DC_DEC_PVS_RATIO ID_ERR_DTC_PVS_DOUBLE ID_ERR_ENVD_PVS_DOUBLE C_DIAG_CONF_PVS_DOUBLE C_DC_INC_PVS_DOUBLE C_DC_MAX_PVS_DOUBLE C_DC_DEC_PVS_DOUBLE ID_ERR_DTC_MTC_DR ID_ERR_ENVD_MTC_DR C_DIAG_CONF_MTC_DR C_DC_INC_MTC_DR C_DC_MAX_MTC_DR C_DC_DEC_MTC_DR ID_ERR_DTC_MTC_CTL_1 ID_ERR_ENVD_MTC_CTL_1 C_DIAG_CONF_MTC_CTL_1 C_DC_INC_MTC_CTL_1 C_DC_MAX_MTC_CTL_1 C_DC_DEC_MTC_CTL_1 ID_ERR_DTC_MTC_CTL_2 ID_ERR_ENVD_MTC_CTL_2 C_DIAG_CONF_MTC_CTL_2 C_DC_INC_MTC_CTL_2 C_DC_MAX_MTC_CTL_2 C_DC_DEC_MTC_CTL_2 ID_ERR_DTC_MTC_CTL_3 ID_ERR_ENVD_MTC_CTL_3 C_DIAG_CONF_MTC_CTL_3 C_DC_INC_MTC_CTL_3 C_DC_MAX_MTC_CTL_3 C_DC_DEC_MTC_CTL_3 ID_ERR_DTC_TPS_AD ID_ERR_ENVD_TPS_AD C_DIAG_CONF_TPS_AD C_DC_INC_TPS_AD C_DC_MAX_TPS_AD C_DC_DEC_TPS_AD ID_ERR_DTC_TPS_ST_CHK_1 ID_ERR_ENVD_TPS_ST_CHK_1 C_DIAG_CONF_TPS_ST_CHK_1 C_DC_INC_TPS_ST_CHK_1 C_DC_MAX_TPS_ST_CHK_1 C_DC_DEC_TPS_ST_CHK_1 ID_ERR_DTC_TPS_ST_CHK_2 ID_ERR_ENVD_TPS_ST_CHK_2 C_DIAG_CONF_TPS_ST_CHK_2 C_DC_INC_TPS_ST_CHK_2 C_DC_MAX_TPS_ST_CHK_2 C_DC_DEC_TPS_ST_CHK_2 ID_ERR_DTC_GEN ID_ERR_ENVD_GEN C_DIAG_CONF_GEN C_DC_INC_GEN C_DC_MAX_GEN C_DC_DEC_GEN ID_ERR_DTC_VIM ID_ERR_ENVD_VIM C_DIAG_CONF_VIM C_DC_INC_VIM C_DC_MAX_VIM C_DC_DEC_VIM ID_ERR_DTC_ENG_PSN ID_ERR_ENVD_ENG_PSN C_DIAG_CONF_ENG_PSN C_DC_INC_ENG_PSN C_DC_MAX_ENG_PSN C_DC_DEC_ENG_PSN ID_ERR_DTC_TOOTH_PER ID_ERR_ENVD_TOOTH_PER C_DIAG_CONF_TOOTH_PER C_DC_INC_TOOTH_PER C_DC_MAX_TOOTH_PER C_DC_DEC_TOOTH_PER ID_ERR_DTC_TPU_SYN ID_ERR_ENVD_TPU_SYN C_DIAG_CONF_TPU_SYN C_DC_INC_TPU_SYN C_DC_MAX_TPU_SYN C_DC_DEC_TPU_SYN ID_ERR_DTC_CAM_PER_0 ID_ERR_ENVD_CAM_PER_0 C_DIAG_CONF_CAM_PER_0 C_DC_INC_CAM_PER_0 C_DC_MAX_CAM_PER_0 C_DC_DEC_CAM_PER_0 ID_ERR_DTC_CAM_PER_1 ID_ERR_ENVD_CAM_PER_1 C_DIAG_CONF_CAM_PER_1 C_DC_INC_CAM_PER_1 C_DC_MAX_CAM_PER_1 C_DC_DEC_CAM_PER_1 ID_ERR_DTC_CAM_PSN_0 ID_ERR_ENVD_CAM_PSN_0 C_DIAG_CONF_CAM_PSN_0 C_DC_INC_CAM_PSN_0 C_DC_MAX_CAM_PSN_0 C_DC_DEC_CAM_PSN_0 ID_ERR_DTC_CAM_PSN_1 ID_ERR_ENVD_CAM_PSN_1 C_DIAG_CONF_CAM_PSN_1 C_DC_INC_CAM_PSN_1 C_DC_MAX_CAM_PSN_1 C_DC_DEC_CAM_PSN_1 ID_ERR_DTC_TOUT_TXU_1 ID_ERR_ENVD_TOUT_TXU_1 C_DIAG_CONF_TOUT_TXU_1 C_DC_INC_TOUT_TXU_1 C_DC_MAX_TOUT_TXU_1 C_DC_DEC_TOUT_TXU_1 ID_ERR_DTC_CAN_BOFF ID_ERR_ENVD_CAN_BOFF C_DIAG_CONF_CAN_BOFF C_DC_INC_CAN_BOFF C_DC_MAX_CAN_BOFF C_DC_DEC_CAN_BOFF ID_ERR_DTC_RLY_MAIN ID_ERR_ENVD_RLY_MAIN C_DIAG_CONF_RLY_MAIN C_DC_INC_RLY_MAIN C_DC_MAX_RLY_MAIN C_DC_DEC_RLY_MAIN ID_ERR_DTC_RLY_ACCOUT ID_ERR_ENVD_RLY_ACCOUT C_DIAG_CONF_RLY_ACCOUT C_DC_INC_RLY_ACCOUT C_DC_MAX_RLY_ACCOUT C_DC_DEC_RLY_ACCOUT ID_ERR_DTC_SAP ID_ERR_ENVD_SAP C_DIAG_CONF_SAP C_DC_INC_SAP C_DC_MAX_SAP C_DC_DEC_SAP ID_ERR_DTC_SAV ID_ERR_ENVD_SAV C_DIAG_CONF_SAV C_DC_INC_SAV C_DC_MAX_SAV C_DC_DEC_SAV ID_ERR_DTC_ECF ID_ERR_ENVD_ECF C_DIAG_CONF_ECF C_DC_INC_ECF C_DC_MAX_ECF C_DC_DEC_ECF ID_ERR_DTC_TCO_EL ID_ERR_ENVD_TCO_EL C_DIAG_CONF_TCO_EL C_DC_INC_TCO_EL C_DC_MAX_TCO_EL C_DC_DEC_TCO_EL ID_ERR_DTC_TCO_STUCK ID_ERR_ENVD_TCO_STUCK C_DIAG_CONF_TCO_STUCK C_DC_INC_TCO_STUCK C_DC_MAX_TCO_STUCK C_DC_DEC_TCO_STUCK ID_ERR_DTC_TCO_GRD ID_ERR_ENVD_TCO_GRD C_DIAG_CONF_TCO_GRD C_DC_INC_TCO_GRD C_DC_MAX_TCO_GRD C_DC_DEC_TCO_GRD ID_ERR_DTC_ECT_MEC ID_ERR_ENVD_ECT_MEC C_DIAG_CONF_ECT_MEC C_DC_INC_ECT_MEC C_DC_MAX_ECT_MEC C_DC_DEC_ECT_MEC ID_ERR_DTC_ECT_EL ID_ERR_ENVD_ECT_EL C_DIAG_CONF_ECT_EL C_DC_INC_ECT_EL C_DC_MAX_ECT_EL C_DC_DEC_ECT_EL ID_ERR_DTC_TCO_PLAUS ID_ERR_ENVD_TCO_PLAUS C_DIAG_CONF_TCO_PLAUS C_DC_INC_TCO_PLAUS C_DC_MAX_TCO_PLAUS C_DC_DEC_TCO_PLAUS ID_ERR_DTC_ISC_H ID_ERR_ENVD_ISC_H C_DIAG_CONF_ISC_H C_DC_INC_ISC_H C_DC_MAX_ISC_H C_DC_DEC_ISC_H ID_ERR_DTC_ISC_L ID_ERR_ENVD_ISC_L C_DIAG_CONF_ISC_L C_DC_INC_ISC_L C_DC_MAX_ISC_L C_DC_DEC_ISC_L ID_ERR_DTC_MIS_MPL ID_ERR_ENVD_MIS_MPL C_DIAG_CONF_MIS_MPL C_DC_INC_MIS_MPL C_DC_MAX_MIS_MPL C_DC_DEC_MIS_MPL ID_ERR_DTC_MIS_A_0 ID_ERR_ENVD_MIS_A_0 C_DIAG_CONF_MIS_A_0 C_DC_INC_MIS_A_0 C_DC_MAX_MIS_A_0 C_DC_DEC_MIS_A_0 ID_ERR_DTC_MIS_A_1 ID_ERR_ENVD_MIS_A_1 C_DIAG_CONF_MIS_A_1 C_DC_INC_MIS_A_1 C_DC_MAX_MIS_A_1 C_DC_DEC_MIS_A_1 ID_ERR_DTC_MIS_A_2 ID_ERR_ENVD_MIS_A_2 C_DIAG_CONF_MIS_A_2 C_DC_INC_MIS_A_2 C_DC_MAX_MIS_A_2 C_DC_DEC_MIS_A_2 ID_ERR_DTC_MIS_A_3 ID_ERR_ENVD_MIS_A_3 C_DIAG_CONF_MIS_A_3 C_DC_INC_MIS_A_3 C_DC_MAX_MIS_A_3 C_DC_DEC_MIS_A_3 ID_ERR_DTC_MIS_A_4 ID_ERR_ENVD_MIS_A_4 C_DIAG_CONF_MIS_A_4 C_DC_INC_MIS_A_4 C_DC_MAX_MIS_A_4 C_DC_DEC_MIS_A_4 ID_ERR_DTC_MIS_A_5 ID_ERR_ENVD_MIS_A_5 C_DIAG_CONF_MIS_A_5 C_DC_INC_MIS_A_5 C_DC_MAX_MIS_A_5 C_DC_DEC_MIS_A_5 ID_ERR_DTC_MIS_B_0 ID_ERR_ENVD_MIS_B_0 C_DIAG_CONF_MIS_B_0 C_DC_INC_MIS_B_0 C_DC_MAX_MIS_B_0 C_DC_DEC_MIS_B_0 ID_ERR_DTC_MIS_B_1 ID_ERR_ENVD_MIS_B_1 C_DIAG_CONF_MIS_B_1 C_DC_INC_MIS_B_1 C_DC_MAX_MIS_B_1 C_DC_DEC_MIS_B_1 ID_ERR_DTC_MIS_B_2 ID_ERR_ENVD_MIS_B_2 C_DIAG_CONF_MIS_B_2 C_DC_INC_MIS_B_2 C_DC_MAX_MIS_B_2 C_DC_DEC_MIS_B_2 ID_ERR_DTC_MIS_B_3 ID_ERR_ENVD_MIS_B_3 C_DIAG_CONF_MIS_B_3 C_DC_INC_MIS_B_3 C_DC_MAX_MIS_B_3 C_DC_DEC_MIS_B_3 ID_ERR_DTC_MIS_B_4 ID_ERR_ENVD_MIS_B_4 C_DIAG_CONF_MIS_B_4 C_DC_INC_MIS_B_4 C_DC_MAX_MIS_B_4 C_DC_DEC_MIS_B_4 ID_ERR_DTC_MIS_B_5 ID_ERR_ENVD_MIS_B_5 C_DIAG_CONF_MIS_B_5 C_DC_INC_MIS_B_5 C_DC_MAX_MIS_B_5 C_DC_DEC_MIS_B_5 ID_ERR_DTC_SEG_T_AD ID_ERR_ENVD_SEG_T_AD C_DIAG_CONF_SEG_T_AD C_DC_INC_SEG_T_AD C_DC_MAX_SEG_T_AD C_DC_DEC_SEG_T_AD ID_ERR_DTC_ISA_1 ID_ERR_ENVD_ISA_1 C_DIAG_CONF_ISA_1 C_DC_INC_ISA_1 C_DC_MAX_ISA_1 C_DC_DEC_ISA_1 ID_ERR_DTC_ISA_2 ID_ERR_ENVD_ISA_2 C_DIAG_CONF_ISA_2 C_DC_INC_ISA_2 C_DC_MAX_ISA_2 C_DC_DEC_ISA_2 ID_ERR_DTC_MEC_ISA ID_ERR_ENVD_MEC_ISA C_DIAG_CONF_MEC_ISA C_DC_INC_MEC_ISA C_DC_MAX_MEC_ISA C_DC_DEC_MEC_ISA ID_ERR_DTC_MSW_3 ID_ERR_ENVD_MSW_3 C_DIAG_CONF_MSW_3 C_DC_INC_MSW_3 C_DC_MAX_MSW_3 C_DC_DEC_MSW_3 ID_ERR_DTC_MSW_2 ID_ERR_ENVD_MSW_2 C_DIAG_CONF_MSW_2 C_DC_INC_MSW_2 C_DC_MAX_MSW_2 C_DC_DEC_MSW_2 ID_ERR_DTC_MSW_TOG ID_ERR_ENVD_MSW_TOG C_DIAG_CONF_MSW_TOG C_DC_INC_MSW_TOG C_DC_MAX_MSW_TOG C_DC_DEC_MSW_TOG ID_ERR_DTC_IM_BTS_PLAUS ID_ERR_ENVD_IM_BTS_PLAUS C_DIAG_CONF_IM_BTS_PLAUS C_DC_INC_IM_BTS_PLAUS C_DC_MAX_IM_BTS_PLAUS C_DC_DEC_IM_BTS_PLAUS ID_ERR_DTC_IM_BLS_PLAUS ID_ERR_ENVD_IM_BLS_PLAUS C_DIAG_CONF_IM_BLS_PLAUS C_DC_INC_IM_BLS_PLAUS C_DC_MAX_IM_BLS_PLAUS C_DC_DEC_IM_BLS_PLAUS LC_ABC_BENCH_CAL /end DEF_CHARACTERISTIC
/end FUNCTION
/begin FUNCTION DIA_Canister_purge_valve_diagnos "_Canister purge valve diagnosis (CPS)"
 /begin DEF_CHARACTERISTIC C_ABC_MAX_CPS C_ABC_INC_CPS C_CPPWM_SUB_DIAG_1 C_CPPWM_SUB_DIAG_2 C_CPPWM_MIN_DIAG C_CPPWM_MAX_DIAG /end DEF_CHARACTERISTIC
 /begin OUT_MEASUREMENT LV_ERR_CPS /end OUT_MEASUREMENT
/end FUNCTION
/begin FUNCTION DIA_Engine_throttle_diagnosis_wi "_Engine throttle diagnosis with activated adaptation"
 /begin OUT_MEASUREMENT LV_TPS_AD_CUR_OFF LV_TPS_AD_DIAG_CUR_OFF LV_TPS_AD_REQ LV_ERR_TPS_AD V_TPS_AD_BOL_GAIN_1 /end OUT_MEASUREMENT
/end FUNCTION
/begin FUNCTION DIA_ETC_driver_diagnosis "_ETC driver diagnosis" /begin DEF_CHARACTERISTIC C_ABC_INC_MTC_DR C_ABC_MAX_MTC_DR /end DEF_CHARACTERISTIC /begin OUT_MEASUREMENT LV_ERR_MTC_DR /end OUT_MEASUREMENT /end FUNCTION
/begin FUNCTION DIA_Lambda_sensor_upstream_heate "_Lambda sensor upstream heater diagnosis" /begin OUT_MEASUREMENT LV_ERR_LSH_UP_1 LV_ERR_LSH_UP_2 /end OUT_MEASUREMENT /end FUNCTION
/begin FUNCTION DIA_Lambda_sensor_downstream_hea "_Lambda sensor downstream heater diagnosis" /begin OUT_MEASUREMENT LV_ERR_LSH_DOWN_1 LV_ERR_LSH_DOWN_2 /end OUT_MEASUREMENT /end FUNCTION
/begin FUNCTION DIA_Generator_diagnosis "_Generator diagnosis" /begin DEF_CHARACTERISTIC C_ABC_INC_GEN C_ABC_MAX_GEN /end DEF_CHARACTERISTIC /begin OUT_MEASUREMENT LV_ERR_GEN /end OUT_MEASUREMENT /end FUNCTION
/begin FUNCTION DIA_Crankshaft_Signal_Diagnosis_ "_Crankshaft Signal Diagnosis and Plausibility Check"
 /begin DEF_CHARACTERISTIC C_ABC_INC_ENG_PSN_PREV_SYN C_ABC_INC_ENG_PSN_DUR_ST C_ABC_MAX_ENG_PSN C_ABC_INC_ENG_PSN_AST C_ABC_INC_TOOTH_PER_PREV_SYN C_ABC_INC_TOOTH_PER_AST C_ABC_MAX_TOOTH_PER C_ABC_INC_TOOTH_PER_DUR_ST C_ABC_INC_TPU_SYN_PREV_SYN C_ABC_INC_TPU_SYN_DUR_ST C_ABC_MAX_TPU_SYN C_ABC_INC_TPU_SYN_AST /end DEF_CHARACTERISTIC
 /begin OUT_MEASUREMENT LV_ERR_CRK LV_ERR_ENG_PSN ERR_ABC_ENG_PSN LV_ERR_TOOTH_PER ERR_ABC_TOOTH_PER LV_ERR_TPU_SYN ERR_ABC_TPU_SYN CRK_STATE_DIAG CRK_STATE_SYN /end OUT_MEASUREMENT
/end FUNCTION
/begin FUNCTION DIA_Camshaft_Sensor_Diagnosis_an "_Camshaft Sensor Diagnosis and Plausibility Check"
 /begin DEF_CHARACTERISTIC ID_WIN_BOL_CHK_CAM_0 ID_WIN_BOL_CHK_CAM_1 ID_WIN_TOL_CHK_CAM_1 ID_WIN_TOL_CHK_CAM_0 C_ABC_INC_CAM_PER_0 C_ABC_INC_CAM_PER_1 C_ABC_MAX_CAM_PER_1 C_ABC_MAX_CAM_PER_0 C_ABC_INC_CAM_PSN_0 C_ABC_INC_CAM_PSN_1 C_ABC_MAX_CAM_PSN_0 C_ABC_MAX_CAM_PSN_1 /end DEF_CHARACTERISTIC
 /begin OUT_MEASUREMENT LV_ERR_CAM_0 LV_ERR_CAM_1 LV_ERR_CAM_PER_0 ERR_ABC_CAM_PER_0 CAM_EDGE_NR_0 CAM_EDGE_NR_1 CAM_EDGE_CTR_1 LV_ERR_CAM_PER_1 LV_ERR_CAM_PSN_1 LV_ERR_CAM_PSN_0 ERR_ABC_CAM_PER_1 ERR_ABC_CAM_PSN_1 ERR_ABC_CAM_PSN_0 CAM_EDGE_CTR_0 CAM_EDGE_0 CAM_EDGE_1 STATE_CAM_EDGE_CTR_0 STATE_CAM_EDGE_CTR_1 LV_ERR_CAM /end OUT_MEASUREMENT
/end FUNCTION
/begin FUNCTION DIA_Secondary_Air_Valve_Diagnosi "_Secondary Air Valve Diagnosis (SAV)" /begin DEF_CHARACTERISTIC C_ABC_INC_SAV C_ABC_MAX_SAV /end DEF_CHARACTERISTIC /begin OUT_MEASUREMENT LV_ERR_SAV /end OUT_MEASUREMENT /end FUNCTION
/begin FUNCTION DIA_Electronical_Cooling_Fan_Dia "_Electronical Cooling Fan Diagnosis (ECF)"
 /begin DEF_CHARACTERISTIC C_ABC_INC_ECF C_ABC_MAX_ECF C_ECFPWM_MAX_DIAG C_ECFPWM_MIN_DIAG /end DEF_CHARACTERISTIC
 /begin OUT_MEASUREMENT LV_ERR_ECF /end OUT_MEASUREMENT
/end FUNCTION
/begin FUNCTION DIA_Secondary_Air_Pump_Diagnosis "_Secondary Air Pump Diagnosis (SAP)" /begin DEF_CHARACTERISTIC C_ABC_INC_SAP C_ABC_MAX_SAP /end DEF_CHARACTERISTIC /begin OUT_MEASUREMENT LV_ERR_SAP /end OUT_MEASUREMENT /end FUNCTION
/begin FUNCTION DIA_Air_Condition_Compressor_Con "_Air Condition Compressor Control Relay Diagnosis (RLY_ACCOUT)" /begin DEF_CHARACTERISTIC C_ABC_INC_RLY_ACCOUT C_ABC_MAX_RLY_ACCOUT /end DEF_CHARACTERISTIC /begin OUT_MEASUREMENT LV_ERR_RLY_ACCOUT /end OUT_MEASUREMENT /end FUNCTION
/begin FUNCTION DIA_Main_Relay_Diagnosis__RLY_MA "_Main Relay Diagnosis (RLY_MAIN)"
 /begin DEF_CHARACTERISTIC C_T_DLY_RLY_MAIN_DIAG C_T_RLY_MAIN_DIAG C_VB_RLY_MAIN_DIAG C_V_IGK_RLY_MAIN_DIAG C_ABC_INC_RLY_MAIN C_ABC_MAX_RLY_MAIN /end DEF_CHARACTERISTIC
 /begin OUT_MEASUREMENT LV_ERR_RLY_MAIN T_RLY_MAIN_DIAG /end OUT_MEASUREMENT
/end FUNCTION
/begin FUNCTION TPS_TPS___ETC_Limp_Home_Manager "_TPS / ETC Limp-Home Manager"
 /begin OUT_MEASUREMENT LV_TPS_MTC_N_LIM LV_MTC_LIH_CUR_OFF LV_ERR_TPS LV_N_LIM_ETC_LIH LV_N_LIM_ETC_LIH_REV STATE_TPS_DIAG STATE_ETC_LIH LV_MTC_CUR_OFF_REQ /end OUT_MEASUREMENT
/end FUNCTION
/begin FUNCTION DIA_Coolant_Temperature_Sensor_D "_Coolant Temperature Sensor Diagnosis (TCO)"
 /begin DEF_CHARACTERISTIC C_T_TIA_TCO_DIAG C_TCO_GRD_MAX_DIAG C_TCO_MAX_DIAG C_TCO_MIN_DIAG C_TIA_TCO_DIAG IP_TCO_SUB_DIF_MIN_DIAG__TCO_ST IP_TCO_MES_DIF_MIN_DIAG__TCO_ST C_ABC_INC_TCO C_ABC_INC_TCO_GRD_DIAG C_ABC_MAX_TCO C_ABC_MAX_TCO_GRD_DIAG /end DEF_CHARACTERISTIC
 /begin OUT_MEASUREMENT LV_ERR_TCO_EL LV_ERR_TCO_STUCK TCO_DIF_DIAG TCO_MIN_DIAG TCO_MAX_DIAG TCO_SUB_DIF_DIAG TCO_SUB_MIN_DIAG TCO_SUB_MAX_DIAG LV_ERR_TCO_GRD LV_ERR_TCO /end OUT_MEASUREMENT
/end FUNCTION
/begin FUNCTION DIA_TCO_Sensor_Plausibility_Diag "_TCO-Sensor Plausibility Diagnosis for Lambda Control Activation Monitoring" /begin DEF_CHARACTERISTIC ID_T_TCO_MIN__TIA /end DEF_CHARACTERISTIC /begin OUT_MEASUREMENT LV_ERR_TCO_PLAUS T_TCO_MIN /end OUT_MEASUREMENT /end FUNCTION
/begin FUNCTION DIA_Idle_Speed_Control_Diagnosis "_Idle Speed Control Diagnosis"
 /begin DEF_CHARACTERISTIC C_MAF_MAX_DIAG_ISC C_REL_FLOW_CPS_MAX_DIAG_ISC_ C_N_DIF_MAX_DIAG_ISC C_N_DIF_MIN_DIAG_ISC C_ABC_INC_ISC_L C_ABC_MAX_ISC_H C_ABC_MAX_ISC_L C_ABC_INC_ISC_H C_ABC_DEC_ISC_L C_CPPWM_MAX_DIAG_ISC C_ABC_DEC_ISC_H C_T_DLY_ISC_DIAG /end DEF_CHARACTERISTIC
 /begin OUT_MEASUREMENT LV_ERR_ISC_H LV_ERR_ISC_L ABC_N_SP_IS_DIAG_H ABC_N_SP_IS_DIAG_L T_ISC_DIAG /end OUT_MEASUREMENT
/end FUNCTION
/begin FUNCTION DIA_CAN_diagnosis "_CAN diagnosis"
 /begin DEF_CHARACTERISTIC C_T_MIN_CAN_DIAG C_VB_MIN_CAN_DIAG C_ASR_3_CYCNR_MAX C_ABC_INC_TOUT_ASR_3 C_ABC_MAX_TOUT_ASR_3 C_ASR_1_CYCNR_MAX C_ABC_INC_TOUT_ASR_1 C_ABC_MAX_TOUT_ASR_1 C_ETCU_1_CYCNR_MAX C_ABC_INC_TOUT_ETCU_1 C_ABC_MAX_TOUT_ETCU_1 C_ICL_2_CYCNR_MAX C_ABC_INC_TOUT_ICL_2_ C_ABC_MAX_TOUT_ICL_2 C_ICL_3_CYCNR_MAX C_TXU_1_CYCNR_MAX C_ABC_INC_TOUT_ICL_3_ C_ABC_MAX_TOUT_ICL_3 C_ABC_INC_TOUT_TXU_1 C_ABC_INC_CAN_BOFF C_ABC_MAX_TOUT_TXU_1 C_ABC_MAX_CAN_BOFF /end DEF_CHARACTERISTIC
 /begin OUT_MEASUREMENT LV_CAN_VB_VLD LV_ERR_TOUT_ASR_1 CYC_CTR_ASR_3_DIAG LV_ERR_TOUT_ASR_3 CYC_CTR_ASR_1_DIAG LV_ERR_TOUT_ETCU_1 CYC_CTR_ETCU_1_DIAG LV_ERR_TOUT_ICL_2 CYC_CTR_ICL_2_DIAG LV_ERR_TOUT_ICL_3 CYC_CTR_ICL_3_DIAG CYC_CTR_TXU_1_DIAG LV_ERR_TOUT_TXU_1 LV_ERR_CAN_BOFF /end OUT_MEASUREMENT
/end FUNCTION
/begin FUNCTION DIA_ETC_Actuator_diagnosis_and_a "_ETC Actuator diagnosis and adaption"
 /begin DEF_CHARACTERISTIC C_T_DYW_TPS_LIH_CHK C_T_MAX_TPS_AD C_T_MAX_TPS_LIH_CHK C_T_MAX_TPS_SP_RST_CHK C_T_TPS_AD_HYS C_TPS_SP_BOL_LGRD C_TPS_SP_RST_CHK C_TPS_SP_RST_CHK_BAS C_TPS_SP_RST_CHK_HYS C_TPS_SP_RST_CHK_LGRD C_V_TPS_AD_BOL_INI_1 C_V_TPS_AD_BOL_INI_2 C_V_TPS_AD_HYS C_V_TPS_AD_WIN_LIH C_V_TPS_LIH_CHK_HYS C_V_TPS_SP_LIH_1 C_V_TPS_SP_LIH_2 C_MTCPWM_PI_MAX_DIAG C_TPS_DIF_MAX_DIAG C_T_TPS_DIF_DIAG C_T_MTCPWM_PI_DIAG_CUR_OFF C_V_TPS_DIF_BOL C_V_TPS_GRD_MAX C_V_TPS_SWI_GAIN_1 C_V_TPS_HYS_GAIN_1 C_TPS_AD_SLOP_GAIN_INI_1 C_TPS_AD_OFS_GAIN_INI_1 C_TPS_SLOP C_V_TPS_AD_WIN_BOL C_T_MTCPWM_PI_DIAG /end DEF_CHARACTERISTIC
 /begin OUT_MEASUREMENT LV_N_LIM_TPS_AD TPS_AV_1 TPS_AV_2 TPS_GRD TPS_SP_AD V_TPS_AD_BOL_2 V_TPS_AD_EL_BOL_1 V_TPS_AD_EL_BOL_2 V_TPS_AD_LIH_1 V_TPS_AD_LIH_2 TPS_SEG TPS_SEG_1 TPS_SEG_2 LV_TPS_AD_ACT TPS_AD_SLOP_GAIN_1 TPS_AD_OFS_GAIN_1 TPS_SEG_GAIN_1 V_TPS_GAIN_1 TPS_AV_GAIN_1 TPS_LIH_1 TPS_LIH_2 LV_TPS_GAIN_ACT_1 V_TPS_GAIN_TOL_ENA_1 V_TPS_GAIN_BOL_ENA_1 LV_ERR_TPS_ST_CHK_1 LV_ERR_TPS_ST_CHK_2 LV_ERR_MTC_CTL_1 LV_ERR_MTC_CTL_2 LV_ERR_MTC_CTL_3 TPS_AD_STEP TPS_LIH TPS_LIH_INI V_TPS_AD_BOL_1 V_TPS_AD_TOL_1 V_TPS_AD_TOL_GAIN_1 INH_IV_TPS_AD TPS_AV TPS_AV_CTL TPS_AV_CTL_1 TPS_AV_CTL_2 TPS_AV_CTL_GAIN_1 /end OUT_MEASUREMENT
/end FUNCTION
/begin FUNCTION DIA_Multifunctional_steering_whe "_Multifunctional steering wheel (MSW)"
 /begin DEF_CHARACTERISTIC C_VB_MIN_MSW_DIAG C_ABC_MAX_MSW_2 C_ABC_INC_MSW_2 C_T_MIN_MSW_BIT_DIAG C_T_MAX_MSW_BIT_DIAG C_ABC_INC_MSW_TOG C_ABC_MAX_MSW_TOG C_ABC_INC_MSW_3 C_ABC_MAX_MSW_3 /end DEF_CHARACTERISTIC
 /begin OUT_MEASUREMENT LV_ERR_MSW_2 LV_ERR_MSW_3 LV_ERR_MSW_TOG /end OUT_MEASUREMENT
/end FUNCTION
/begin FUNCTION DIA_Pedal_value_sensor_diagnosis "_Pedal value sensor diagnosis"
 /begin DEF_CHARACTERISTIC C_N_PVS_BLS_BTS_PLAUS C_VS_PVS_BLS_BTS_PLAUS C_PV_AV_PVS_BLS_BTS_PLAUS LC_PVS_BLS_BTS_PLAUS_ENA C_CTR_MAX_PVS_BLS_BTS_PLAUS C_CTR_MAX_PV_AV_CON C_PV_AV_HYS_BLS_BTS_PLAUS C_PV_AV_BLS_NOT_PLAUS C_PV_AV_BLS_NOT_PLAUS_LGRD /end DEF_CHARACTERISTIC
 /begin OUT_MEASUREMENT CTR_PVS_BLS_BTS_PLAUS LV_PVS_BLS_BTS_NOT_PLAUS LV_PV_AV_STAT_ LV_DET_NOT_PLAUS_ACT /end OUT_MEASUREMENT
/end FUNCTION
/begin FUNCTION DIA_Brake_light_switch_diagnosis "_Brake light switch diagnosis (BLS/BTS)"
 /begin DEF_CHARACTERISTIC C_T_BTS_PLAUS_MAX C_ABC_INC_IM_BTS_PLAUS C_ABC_INC_IM_BLS_PLAUS C_ABC_MAX_IM_BTS_PLAUS C_ABC_MAX_IM_BLS_PLAUS /end DEF_CHARACTERISTIC
 /begin OUT_MEASUREMENT LV_BRAKE_DET LV_ERR_BLS_PLAUS LV_ERR_IM_BTS_PLAUS LV_ERR_IM_BLS_PLAUS /end OUT_MEASUREMENT
/end FUNCTION
/begin FUNCTION DIA_Idle_Speed_Actuator_Diagnosi "_Idle Speed Actuator Diagnosis"
 /begin DEF_CHARACTERISTIC C_ISAPWM_MIN_DIAG C_ISAPWM_MAX_DIAG C_ABC_INC_ISA_1 C_ABC_INC_ISA_2 C_ABC_MAX_ISA_1 C_ABC_MAX_ISA_2 C_AR_RED_DIF_MAX_DIAG C_AR_RED_DIF_MIN_DIAG C_N_ISA_DIAG C_MAF_TURB_RATIO_DIAG C_TPS_AV_TOL_ISA_AD C_ABC_INC_ISA_MEC C_ABC_MAX_ISA_MEC /end DEF_CHARACTERISTIC
 /begin OUT_MEASUREMENT LV_ERR_ISA_1 LV_ERR_ISA_2 STATE_ISA_DIAG LV_ERR_MEC_ISA /end OUT_MEASUREMENT
/end FUNCTION
/begin FUNCTION DIA_Engine_roughness_idle_diagno "_Engine roughness idle diagnosis"
 /begin DEF_CHARACTERISTIC IP_THD_IS_ER_DIAG__N__MAF IP_FAC_THD_IS_ER_DIAG__TCO C_CRLC_IS_ER_DIAG /end DEF_CHARACTERISTIC
 /begin OUT_MEASUREMENT ER_MMV_IS_DIAG_0 ER_MMV_IS_DIAG_1 ER_MMV_IS_DIAG_2 ER_MMV_IS_DIAG_3 ER_MMV_IS_DIAG_4 ER_MMV_IS_DIAG_5 /end OUT_MEASUREMENT
/end FUNCTION
/begin FUNCTION DIA_Variable_Intake_Manifold__VI "_Variable Intake Manifold (VIM) H-Bridge Diagnosis" /begin DEF_CHARACTERISTIC C_ABC_INC_VIM_DIAG C_ABC_MAX_VIM_DIAG /end DEF_CHARACTERISTIC /begin OUT_MEASUREMENT LV_ERR_VIM /end OUT_MEASUREMENT /end FUNCTION
/begin FUNCTION EOS_Engine_Operating_States "EOS"
 /begin SUB_FUNCTION EOS_General_engine_operating_sta EOS_Basic_operating_states__LV_S EOS_Basic_functions__FL__INF___R EOS_Auxiliary_start_functions EOS_Combustion_Management EOS_Catalyst_heating_functions EOS_Combustion_Mode_Switch /end SUB_FUNCTION
/end FUNCTION
/begin FUNCTION EOS_General_engine_operating_sta "_General engine operating states" /begin DEF_CHARACTERISTIC C_T_MAX_ECU ldpm_tco_9 IP_N_MAX_TOL_ST /end DEF_CHARACTERISTIC /begin OUT_MEASUREMENT LV_ES /end OUT_MEASUREMENT /end FUNCTION
/end MODULE
/end PROJECT
