ASAP2_VERSION 1 31
/begin PROJECT MS45 "Rover Motorsteuerung V6"
/begin HEADER "_default_HeaderComment" PROJECT_NO _50 /end HEADER
/begin MODULE _default_ModuleName "_default_ModuleLongIdentifier"
/begin MOD_COMMON "_default_ModCommonComment" DEPOSIT ABSOLUTE BYTE_ORDER MSB_FIRST ALIGNMENT_BYTE 1 ALIGNMENT_WORD 2 ALIGNMENT_LONG 4 ALIGNMENT_FLOAT32_IEEE 4 ALIGNMENT_FLOAT64_IEEE 8 /end MOD_COMMON
/begin CHARACTERISTIC C_AMP_REF "reference value of the ambient pressure" VALUE 0x67b5c _REC_VAL_20_u2 5434. _CNV_A_R_LINEAR_____1_CM 0. 5434. FORMAT "%7.2" /end CHARACTERISTIC
/begin CHARACTERISTIC C_N_MIN_MAF_DIAG "Engine speed condition" VALUE 0x67c22 _REC_VAL_20_u1 2448. _CNV_A_R_LINEAR_____15_CM 0. 8160. FORMAT "%4.0" /end CHARACTERISTIC
/begin CHARACTERISTIC C_TCO_DIAG "TCO threshold for calculation of substitutes" VALUE 0x67c9d _REC_VAL_20_u1 28.575 _CNV_A_R_LINEAR_____22_CM -48. 142.5 FORMAT "%5.1" /end CHARACTERISTIC
/begin CHARACTERISTIC C_TEG_MES_GRD_MAX "Maximum exhaust gas temperature gradient " VALUE 0x67cc2 _REC_VAL_20_u2 1023.984375 _CNV_A_R_LINEAR_____25_CM 0. 1023.984375 FORMAT "%6.1" /end CHARACTERISTIC
/begin CHARACTERISTIC C_TIA_MAX_DIAG "TIA threshold for short to ground - TIA diagnosis" VALUE 0x67cdd _REC_VAL_20_u1 28.575 _CNV_A_R_LINEAR_____22_CM -48. 142.5 FORMAT "%5.1" /end CHARACTERISTIC
/begin CHARACTERISTIC C_TIA_MIN_DIAG "TIA threshold for short to VB or line break - TIA diagnosis" VALUE 0x67cdf _REC_VAL_20_u1 28.575 _CNV_A_R_LINEAR_____22_CM -48. 142.5 FORMAT "%5.1" /end CHARACTERISTIC
/begin CHARACTERISTIC C_TIA_SUB_BOL "Intake air substitute temperature" VALUE 0x67ce1 _REC_VAL_20_u1 28.575 _CNV_A_R_LINEAR_____22_CM -48. 142.5 FORMAT "%5.1" /end CHARACTERISTIC
/begin CHARACTERISTIC C_TIA_SUB_TOL "Intake air substitute temperature" VALUE 0x67ce2 _REC_VAL_20_u1 28.575 _CNV_A_R_LINEAR_____22_CM -48. 142.5 FORMAT "%5.1" /end CHARACTERISTIC
/begin CHARACTERISTIC C_TPS_MIN_MAF_DIAG "TPS threshold" VALUE 0x67cf0 _REC_VAL_20_u2 119.5 _CNV_A_R_LINEAR_____34_CM 0. 119.5 FORMAT "%7.3" /end CHARACTERISTIC
/begin CHARACTERISTIC C_V_AMP_MAX_DIAG "maximum diagnostic value for the ambient pressure value" VALUE 0x67d48 _REC_VAL_20_u2 4.99511719 _CNV_A_R_LINEAR_____38_CM 0. 4.99511719 FORMAT "%5.3" /end CHARACTERISTIC
/begin CHARACTERISTIC C_V_AMP_MIN_DIAG "minimum diagnostic value for the ambient pressure value" VALUE 0x67d4a _REC_VAL_20_u2 4.99511719 _CNV_A_R_LINEAR_____38_CM 0. 4.99511719 FORMAT "%5.3" /end CHARACTERISTIC
/begin MEASUREMENT V_AMP "Ambient pressure sensor raw acquisition" UWORD _CNV_A_R_LINEAR_____38_CM 1 100. 0. 4.99511719 ECU_ADDRESS 0x3fa8ea FORMAT "%5.3" /end MEASUREMENT
/begin MEASUREMENT V_TIA "Intake air temperature sensor raw acquisition." UBYTE _CNV_A_R_LINEAR_____48_CM 1 100. 0. 4.98046875 ECU_ADDRESS 0x3fa900 FORMAT "%5.3" /end MEASUREMENT
/begin MEASUREMENT LV_IM_BLS "brake light switch" UBYTE _CNV_S_2_RANGE______74_CM 1 100. 0. 1. ECU_ADDRESS 0x3fa973 BIT_MASK 0x1 /end MEASUREMENT
/begin MEASUREMENT LV_KEY_OFF "Boolean for ignition key status (ON / OFF)" UBYTE _CNV_S_2_RANGE______74_CM 1 100. 0. 1. ECU_ADDRESS 0x3fa912 BIT_MASK 0x1 /end MEASUREMENT
/begin MEASUREMENT V_PVS_1 "Pedal value sensor 1 raw acquisition" UWORD _CNV_A_R_LINEAR_____38_CM 1 100. 0. 4.99511719 ECU_ADDRESS 0x3fa8f0 FORMAT "%5.3" /end MEASUREMENT
/begin MEASUREMENT V_PVS_2 "Pedal value sensor 2 raw acquisition" UWORD _CNV_A_R_LINEAR_____38_CM 1 100. 0. 4.99511719 ECU_ADDRESS 0x3fa8f2 FORMAT "%5.3" /end MEASUREMENT
/begin MEASUREMENT V_TCO "Coolant temperature sensor raw acquisition." UWORD _CNV_A_R_LINEAR_____38_CM 1 100. 0. 4.99511719 ECU_ADDRESS 0x3fa902 FORMAT "%5.3" /end MEASUREMENT
/begin MEASUREMENT V_TCO_EX "coolant temperature at cooler outlet" UWORD _CNV_A_R_LINEAR_____38_CM 1 100. 0. 4.99511719 ECU_ADDRESS 0x3fa8fe FORMAT "%5.3" /end MEASUREMENT
/begin MEASUREMENT V_TPS_1 "Throttle position sensor 1 raw acquisition." UWORD _CNV_A_R_LINEAR_____38_CM 1 100. 0. 4.99511719 ECU_ADDRESS 0x3fa8f8 FORMAT "%5.3" /end MEASUREMENT
/begin MEASUREMENT V_TPS_2 "Throttle position sensor 2 raw acquisition." UWORD _CNV_A_R_LINEAR_____38_CM 1 100. 0. 4.99511719 ECU_ADDRESS 0x3fa8fa FORMAT "%5.3" /end MEASUREMENT
/begin CHARACTERISTIC ID_CRK_TOOTH_PER_SP_FAC "" CURVE 0x64fc8 _REC_CUR_20_u1_u2 0.9375 _CNV_A_R_LINEAR_____87_CM 0. 0.9375 FORMAT "%6.4"
 /begin AXIS_DESCR COM_AXIS N _CNV_A_R_LINEAR_____0_CM 6 0. 8160. FORMAT "%4.0" AXIS_PTS_REF ldpm_n_id_crk_acq /end AXIS_DESCR
/end CHARACTERISTIC
/begin AXIS_PTS ldpm_n_id_crk_acq "" 0x61cae N _REC_AXS_20_u2 8160. _CNV_A_R_LINEAR_____0_CM 6 0. 8160. FORMAT "%4.0" /end AXIS_PTS
/begin CHARACTERISTIC C_N_MIN_CRK_TOOTH_VLD "" VALUE 0x67c1c _REC_VAL_20_u2 8160. _CNV_A_R_LINEAR_____0_CM 0. 8160. FORMAT "%4.0" /end CHARACTERISTIC
/begin CHARACTERISTIC ID_CRK_TOOTH_RATIO "" CURVE 0x64fce _REC_CUR_20_u1_u2 0.9375 _CNV_A_R_LINEAR_____87_CM 0. 0.9375 FORMAT "%6.4"
 /begin AXIS_DESCR COM_AXIS N _CNV_A_R_LINEAR_____0_CM 6 0. 8160. FORMAT "%4.0" AXIS_PTS_REF ldpm_n_id_crk_acq /end AXIS_DESCR
/end CHARACTERISTIC
/begin CHARACTERISTIC C_SWI_CPP_AS "control byte tank purge pump" VALUE 0x67c3d _REC_VAL_20_u1 1. _CNV_S_2_RANGE______88_CM 0. 1. /end CHARACTERISTIC
/begin CHARACTERISTIC C_SWI_EBOX_CFA_AS "control byte E-box cooling fan" VALUE 0x67c3e _REC_VAL_20_u1 1. _CNV_S_2_RANGE______88_CM 0. 1. /end CHARACTERISTIC
/begin CHARACTERISTIC C_SWI_RLY_ACC_AS "control byte air conditioning compressor relay" VALUE 0x67c41 _REC_VAL_20_u1 1. _CNV_S_2_RANGE______88_CM 0. 1. /end CHARACTERISTIC
/begin CHARACTERISTIC C_SWI_FTLDP_AS "control byte tank leakage detection motor" VALUE 0x67c40 _REC_VAL_20_u1 1. _CNV_S_2_RANGE______88_CM 0. 1. /end CHARACTERISTIC
/begin CHARACTERISTIC C_SWI_TLD_AS "control byte tank leakage detection" VALUE 0x67c43 _REC_VAL_20_u1 1. _CNV_S_2_RANGE______88_CM 0. 1. /end CHARACTERISTIC
/begin CHARACTERISTIC C_SWI_RLY_ST_AS "control byte starter relay" VALUE 0x67c42 _REC_VAL_20_u1 1. _CNV_S_2_RANGE______88_CM 0. 1. /end CHARACTERISTIC
/begin CHARACTERISTIC C_SWI_VEPU_AS "control byte venturi pump" VALUE 0x67c44 _REC_VAL_20_u1 1. _CNV_S_2_RANGE______88_CM 0. 1. /end CHARACTERISTIC
/begin CHARACTERISTIC C_SWI_EF_AS "control byte exhaust flap" VALUE 0x67c3f _REC_VAL_20_u1 1. _CNV_S_2_RANGE______88_CM 0. 1. /end CHARACTERISTIC
/begin MEASUREMENT VBR_MES "After relay battery voltage value after average" UWORD _CNV_A_R_LINEAR_____89_CM 1 100. 0. 25.9746 ECU_ADDRESS 0x3fa916 FORMAT "%5.2" /end MEASUREMENT
/begin MEASUREMENT VB_MES "Battery voltage value measured (10 bits)" UWORD _CNV_A_R_LINEAR_____89_CM 1 100. 0. 25.9746 ECU_ADDRESS 0x3fa914 FORMAT "%5.2" /end MEASUREMENT
/begin MEASUREMENT LV_IM_ST "starter" UBYTE _CNV_S_2_RANGE______74_CM 1 100. 0. 1. ECU_ADDRESS 0x3fa96c BIT_MASK 0x1 /end MEASUREMENT
/begin MEASUREMENT LV_IM_LOCK "????" UBYTE _CNV_S_2_RANGE______74_CM 1 100. 0. 1. ECU_ADDRESS 0x3fa96d BIT_MASK 0x1 /end MEASUREMENT
/begin MEASUREMENT LV_IM_CRU_SET_AC "cruise control set / accelerate" UBYTE _CNV_S_2_RANGE______74_CM 1 100. 0. 1. ECU_ADDRESS 0x3fa96e BIT_MASK 0x1 /end MEASUREMENT
/begin MEASUREMENT LV_IM_CRU_RESU_DECE "cruise control resume / decelerate" UBYTE _CNV_S_2_RANGE______74_CM 1 100. 0. 1. ECU_ADDRESS 0x3fa96f BIT_MASK 0x1 /end MEASUREMENT
/begin MEASUREMENT LV_IM_CRU_MAIN_OFF "cruise control main switch / off" UBYTE _CNV_S_2_RANGE______74_CM 1 100. 0. 1. ECU_ADDRESS 0x3fa970 BIT_MASK 0x1 /end MEASUREMENT
/begin MEASUREMENT LV_IM_BTS "brake test switch" UBYTE _CNV_S_2_RANGE______74_CM 1 100. 0. 1. ECU_ADDRESS 0x3fa972 BIT_MASK 0x1 /end MEASUREMENT
/begin MEASUREMENT V_TOIL "Oil temperature sensor raw acquisition" UBYTE _CNV_A_R_LINEAR_____40_CM 1 100. 0. 4.98046875 ECU_ADDRESS 0x3fa901 FORMAT "%5.3" /end MEASUREMENT
/begin MEASUREMENT V_MAF "Mass air flow sensor raw acquisition" UBYTE _CNV_A_R_LINEAR_____40_CM 1 100. 0. 4.98046875 ECU_ADDRESS 0x3fa8e0 FORMAT "%5.3" /end MEASUREMENT
/begin MEASUREMENT VBK "Battery voltage after key raw acquisition" UWORD _CNV_A_R_LINEAR_____38_CM 1 100. 0. 4.99511719 ECU_ADDRESS 0x3fa8e2 FORMAT "%5.3" /end MEASUREMENT
/begin MEASUREMENT VBR "Battery voltage after relay raw acquisition" UWORD _CNV_A_R_LINEAR_____38_CM 1 100. 0. 4.99511719 ECU_ADDRESS 0x3fa8e4 FORMAT "%5.3" /end MEASUREMENT
/begin MEASUREMENT V_LS_UP_1 "Upstream oxygen sensor voltage raw acquisition - Bank n° 1" UWORD _CNV_A_R_LINEAR_____38_CM 1 100. 0. 4.99511719 ECU_ADDRESS 0x3fa8e6 FORMAT "%5.3" /end MEASUREMENT
/begin MEASUREMENT V_LS_UP_2 "Upstream oxygen sensor voltage raw acquisition - Bank n° 2" UWORD _CNV_A_R_LINEAR_____38_CM 1 100. 0. 4.99511719 ECU_ADDRESS 0x3fa8e8 FORMAT "%5.3" /end MEASUREMENT
/begin MEASUREMENT V_LS_DOWN_2 "Downstream oxygen sensor voltage raw acquisition - Bank n° 2" UWORD _CNV_A_R_LINEAR_____38_CM 1 100. 0. 4.99511719 ECU_ADDRESS 0x3fa8ee FORMAT "%5.3" /end MEASUREMENT
/begin MEASUREMENT V_LS_DOWN_1 "Downstream oxygen sensor voltage raw acquisition - Bank n° 1" UWORD _CNV_A_R_LINEAR_____38_CM 1 100. 0. 4.99511719 ECU_ADDRESS 0x3fa8ec FORMAT "%5.3" /end MEASUREMENT
/begin MEASUREMENT VCC_PVS_1 "Voltage supply for pedal value sensor 1 (and TPS) raw acquisition" UWORD _CNV_A_R_LINEAR_____38_CM 1 100. 0. 4.99511719 ECU_ADDRESS 0x3fa8f4 FORMAT "%5.3" /end MEASUREMENT
/begin MEASUREMENT VCC_PVS_2 "Voltage supply for pedal value sensor 2 raw acquisition" UWORD _CNV_A_R_LINEAR_____38_CM 1 100. 0. 4.99511719 ECU_ADDRESS 0x3fa8f6 FORMAT "%5.3" /end MEASUREMENT
/begin MEASUREMENT V_VIM_FB "Variable intake manifold feedback sensor raw acquisition." UWORD _CNV_A_R_LINEAR_____38_CM 1 100. 0. 4.99511719 ECU_ADDRESS 0x3fa908 FORMAT "%5.3" /end MEASUREMENT
/begin MEASUREMENT V_FPS "Fuel pressure sensor raw acquisition" UWORD _CNV_A_R_LINEAR_____38_CM 1 100. 0. 4.99511719 ECU_ADDRESS 0x3fa90a FORMAT "%5.3" /end MEASUREMENT
/begin MEASUREMENT V_SAF "" UBYTE _CNV_A_R_LINEAR_____40_CM 1 100. 0. 4.98046875 ECU_ADDRESS 0x3fa8e1 FORMAT "%5.3" /end MEASUREMENT
/begin MEASUREMENT LV_ERR_MAF "MAF error detected" UBYTE _CNV_S_2_RANGE______77_R_CM 1 100. 0. 255. ECU_ADDRESS 0x3fd354 /end MEASUREMENT
/begin MEASUREMENT LV_ERR_TCO_EX "TCO_EX error detected" UBYTE _CNV_S_2_RANGE______77_R_CM 1 100. 0. 255. ECU_ADDRESS 0x3fd356 /end MEASUREMENT
/begin MEASUREMENT LV_ERR_TOIL "???" UBYTE _CNV_S_2_RANGE______77_R_CM 1 100. 0. 255. ECU_ADDRESS 0x3fd357 /end MEASUREMENT
/begin CHARACTERISTIC C_ABC_MAX_TIA "Debounce counter maximum value - TIA diagnosis" VALUE 0x67b49 _REC_VAL_20_u1 25.4 _CNV_A_R_LINEAR_____17_CM 1. 255. FORMAT "%3.0" /end CHARACTERISTIC
/begin CHARACTERISTIC C_ABC_INC_TIA "Debounce counter increment - TIA diagnosis" VALUE 0x67b3b _REC_VAL_20_u1 25.5 _CNV_A_R_LINEAR_____13_CM 0. 255. FORMAT "%3.0" /end CHARACTERISTIC
/begin CHARACTERISTIC C_TOIL_MIN_DIAG "TOIL threshold for short to VB or line break - TOIL diagnosis" VALUE 0x67ce9 _REC_VAL_20_u1 200. _CNV_A_R_LINEAR_____32_CM -40. 160. FORMAT "%3.0" /end CHARACTERISTIC
/begin CHARACTERISTIC C_TCO_MAX_TOIL_DIAG "TCO threshold - TOIL diagnosis" VALUE 0x67ca6 _REC_VAL_20_u1 190.5 _CNV_A_R_LINEAR_____22_CM -48. 142.5 FORMAT "%5.1" /end CHARACTERISTIC
/begin CHARACTERISTIC C_TOIL_SUB_DIAG "Substitude value for TOIL" VALUE 0x67ceb _REC_VAL_20_u1 200. _CNV_A_R_LINEAR_____32_CM -40. 160. FORMAT "%3.0" /end CHARACTERISTIC
/begin CHARACTERISTIC C_TOIL_MAX_DIAG "TOIL threshold for short to ground - TOIL diagnosis" VALUE 0x67ce7 _REC_VAL_20_u1 200. _CNV_A_R_LINEAR_____32_CM -40. 160. FORMAT "%3.0" /end CHARACTERISTIC
/begin CHARACTERISTIC C_ABC_INC_TCO_EX "Debounce counter increment - TCO_EX diagnosis" VALUE 0x67b3a _REC_VAL_20_u1 255. _CNV_A_R_LINEAR_____13_CM 0. 255. FORMAT "%3.0" /end CHARACTERISTIC
/begin CHARACTERISTIC C_ABC_MAX_TCO_EX "Debounce counter maximum value- TCO_EX diagnosis" VALUE 0x67b48 _REC_VAL_20_u1 254. _CNV_A_R_LINEAR_____17_CM 1. 255. FORMAT "%3.0" /end CHARACTERISTIC
/begin CHARACTERISTIC C_ABC_MAX_AMP "Maximum value of the anti - bounce counter" VALUE 0x67b3f _REC_VAL_20_u1 10.16 _CNV_A_R_LINEAR_____17_CM 1. 255. FORMAT "%3.0" /end CHARACTERISTIC
/begin CHARACTERISTIC C_ABC_MAX_RLY_EFP "Debounce counter maximum value" VALUE 0x67b46 _REC_VAL_20_u1 254. _CNV_A_R_LINEAR_____17_CM 1. 255. FORMAT "%3.0" /end CHARACTERISTIC
/begin CHARACTERISTIC C_ABC_INC_RLY_EFP "Debounce counter increment" VALUE 0x67b38 _REC_VAL_20_u1 255. _CNV_A_R_LINEAR_____13_CM 0. 255. FORMAT "%3.0" /end CHARACTERISTIC
/begin CHARACTERISTIC C_ABC_INC_LSH_UP "Anti-bounce counter increment for upstream O2-sensor heater signal diagnosis." VALUE 0x67b36 _REC_VAL_20_u1 255. _CNV_A_R_LINEAR_____13_CM 0. 255. FORMAT "%3.0" /end CHARACTERISTIC
/begin CHARACTERISTIC C_ABC_MAX_LSH_DOWN "Maximum value of the anti-bounce counter for upstream O2-sensor heater command signal diagnosis." VALUE 0x67b43 _REC_VAL_20_u1 254. _CNV_A_R_LINEAR_____17_CM 1. 255. FORMAT "%3.0" /end CHARACTERISTIC
/begin CHARACTERISTIC C_ABC_MAX_LSH_UP "Maximum value of the anti-bounce counter for upstream O2-sensor heater command signal diagnosis." VALUE 0x67b44 _REC_VAL_20_u1 254. _CNV_A_R_LINEAR_____17_CM 1. 255. FORMAT "%3.0" /end CHARACTERISTIC
/begin CHARACTERISTIC C_ABC_INC_LSH_DOWN "Anti-bounce counter increment for upstream O2-sensor heater signal diagnosis." VALUE 0x67b35 _REC_VAL_20_u1 255. _CNV_A_R_LINEAR_____13_CM 0. 255. FORMAT "%3.0" /end CHARACTERISTIC
/begin CHARACTERISTIC C_PWM_LSH_DOWN_MIN "Minimum O2-Sensor heater duty cycle to perform the electrical diagnosis" VALUE 0x67c31 _REC_VAL_20_u1 99.609375 _CNV_A_R_LINEAR_____16_CM 0. 99.609375 FORMAT "%5.1" /end CHARACTERISTIC
/begin CHARACTERISTIC C_TEG_DYN_MIN_LSH_DIAG "Minimum exhaust gas temperature threshold to permit SCB to set fault during LSH power rise state" VALUE 0x67cc0 _REC_VAL_20_u2 2047. _CNV_A_R_LINEAR_____94_CM 0. 2047. FORMAT "%7.2" /end CHARACTERISTIC
/begin CHARACTERISTIC C_TEMP_CAT_MIN_LSH_DIAG "Minimum catalyst temperature threshold to permit SCB to set fault during LSH preheating state" VALUE 0x67cc4 _REC_VAL_20_u2 1023.984375 _CNV_A_R_LINEAR_____95_CM -33. 990.984375 FORMAT "%6.2" /end CHARACTERISTIC
/begin CHARACTERISTIC C_PWM_LSH_DOWN_MAX "Maximum O2-Sensor heater duty cycle to perform the electrical diagnosis" VALUE 0x67c30 _REC_VAL_20_u1 99.609375 _CNV_A_R_LINEAR_____16_CM 0. 99.609375 FORMAT "%5.1" /end CHARACTERISTIC
/begin CHARACTERISTIC C_PWM_LSH_UP_MIN "Minimum O2-Sensor heater duty cycle to perform the electrical diagnosis" VALUE 0x67c33 _REC_VAL_20_u1 99.609375 _CNV_A_R_LINEAR_____16_CM 0. 99.609375 FORMAT "%5.1" /end CHARACTERISTIC
/begin CHARACTERISTIC C_PWM_LSH_UP_MAX "Maximum O2-Sensor heater duty cycle to perform the electrical diagnosis" VALUE 0x67c32 _REC_VAL_20_u1 99.609375 _CNV_A_R_LINEAR_____16_CM 0. 99.609375 FORMAT "%5.1" /end CHARACTERISTIC
/begin CHARACTERISTIC C_VB_MIN_LSH_DIAG "Minimum battery voltage threshold above which diagnosis is permitted" VALUE 0x67d5c _REC_VAL_20_u1 25.8984 _CNV_A_R_LINEAR_____42_CM 0. 25.8984 FORMAT "%3.1" /end CHARACTERISTIC
/begin CHARACTERISTIC C_VB_MAX_LSH_DIAG "Maximum battery voltage threshold under which diagnosis is permitted" VALUE 0x67d5a _REC_VAL_20_u1 25.8984 _CNV_A_R_LINEAR_____42_CM 0. 25.8984 FORMAT "%3.1" /end CHARACTERISTIC
/begin CHARACTERISTIC C_ABC_INC_TOIL "Debounce counter increment - TOIL diagnosis" VALUE 0x67b3c _REC_VAL_20_u1 255. _CNV_A_R_LINEAR_____13_CM 0. 255. FORMAT "%3.0" /end CHARACTERISTIC
/begin CHARACTERISTIC C_ABC_MAX_TOIL "Debounce counter maximum value - TOIL diagnosis" VALUE 0x67b4a _REC_VAL_20_u1 254. _CNV_A_R_LINEAR_____17_CM 1. 255. FORMAT "%3.0" /end CHARACTERISTIC
/begin MEASUREMENT LV_ERR_VLS_UP_SCB_2 "electrical error, UP 2" UBYTE _CNV_S_2_RANGE______75_R_CM 1 100. 0. 255. ECU_ADDRESS 0x3fd36f /end MEASUREMENT
/begin MEASUREMENT LV_ERR_VLS_UP_SCG_1 "" UBYTE _CNV_S_2_RANGE______75_R_CM 1 100. 0. 255. ECU_ADDRESS 0x3fd370 /end MEASUREMENT
/begin MEASUREMENT LV_ERR_VLS_UP_SCG_2 "" UBYTE _CNV_S_2_RANGE______75_R_CM 1 100. 0. 255. ECU_ADDRESS 0x3fd371 /end MEASUREMENT
/begin MEASUREMENT LV_ERR_VLS_UP_SCB_1 "electrical error, UP 1" UBYTE _CNV_S_2_RANGE______75_R_CM 1 100. 0. 255. ECU_ADDRESS 0x3fd36e /end MEASUREMENT
/begin MEASUREMENT LV_ERR_VLS_DOWN_SCB_1 "electrical error, DOWN 1" UBYTE _CNV_S_2_RANGE______75_R_CM 1 100. 0. 255. ECU_ADDRESS 0x3fd374 /end MEASUREMENT
/begin MEASUREMENT LV_ERR_VLS_DOWN_SCB_2 "electrical error, DOWN 2" UBYTE _CNV_S_2_RANGE______75_R_CM 1 100. 0. 255. ECU_ADDRESS 0x3fd375 /end MEASUREMENT
/begin MEASUREMENT LV_ERR_VLS_DOWN_SCG_2 "electrical error, UP 2" UBYTE _CNV_S_2_RANGE______75_R_CM 1 100. 0. 255. ECU_ADDRESS 0x3fd377 /end MEASUREMENT
/begin MEASUREMENT LV_ERR_VLS_DOWN_SCG_1 "electrical error, UP 1" UBYTE _CNV_S_2_RANGE______75_R_CM 1 100. 0. 255. ECU_ADDRESS 0x3fd376 /end MEASUREMENT
/begin MEASUREMENT LV_ERR_VLS_UP_OL_2 "electrical error, UP 2" UBYTE _CNV_S_2_RANGE______75_R_CM 1 100. 0. 255. ECU_ADDRESS 0x3fd373 /end MEASUREMENT
/begin MEASUREMENT LV_ERR_VLS_DOWN_OL_2 "electrical error, DOWN 2" UBYTE _CNV_S_2_RANGE______75_R_CM 1 100. 0. 255. ECU_ADDRESS 0x3fd379 /end MEASUREMENT
/begin MEASUREMENT LV_ERR_VLS_DOWN_OL_1 "electrical error, DOWN 1" UBYTE _CNV_S_2_RANGE______75_R_CM 1 100. 0. 255. ECU_ADDRESS 0x3fd378 /end MEASUREMENT
/begin MEASUREMENT LV_ERR_VLS_STK_2 "voltage excursion error, UP 2" UBYTE _CNV_S_2_RANGE______75_R_CM 1 100. 0. 255. ECU_ADDRESS 0x3fd37b /end MEASUREMENT
/begin MEASUREMENT LV_ERR_LAM_LIM_2 "lambda control limit, bank 2" UBYTE _CNV_S_2_RANGE______75_R_CM 1 100. 0. 255. ECU_ADDRESS 0x3fd37d /end MEASUREMENT
/begin MEASUREMENT LV_ERR_LAM_LIM_1 "lambda control limit, bank 1" UBYTE _CNV_S_2_RANGE______75_R_CM 1 100. 0. 255. ECU_ADDRESS 0x3fd37c /end MEASUREMENT
/begin CHARACTERISTIC C_ABC_MAX_VLS_UP "Debounce counter maximum value" VALUE 0x67b4c _REC_VAL_20_u1 254. _CNV_A_R_LINEAR_____17_CM 1. 255. FORMAT "%3.0" /end CHARACTERISTIC
/begin CHARACTERISTIC C_MAF_MIN_VLS_DIAG "MAF condition for diagnosis" VALUE 0x67be4 _REC_VAL_20_u2 1389. _CNV_A_R_LINEAR_____56_CM 0. 1389. FORMAT "%7.2" /end CHARACTERISTIC
/begin CHARACTERISTIC C_VLS_BOL_OPEN_DIAG "lower VLS threshold for the detection of line break" VALUE 0x67d5e _REC_VAL_20_u2 4.99511719 _CNV_A_R_LINEAR_____38_CM 0. 4.99511719 FORMAT "%5.3" /end CHARACTERISTIC
/begin CHARACTERISTIC C_T_VLS_OPEN_UP_DIAG "Time conditions for error detection" VALUE 0x67c96 _REC_VAL_20_u2 327.675 _CNV_A_R_LINEAR_____96_CM 0. 327.675 FORMAT "%6.2" /end CHARACTERISTIC
/begin CHARACTERISTIC C_T_DLY_LS_DIAG "Time condition for diagnosis line break at PUC" VALUE 0x67c4a _REC_VAL_20_u2 65533. _CNV_A_R_LINEAR_____20_CM 1. 65534. FORMAT "%5.0" /end CHARACTERISTIC
/begin CHARACTERISTIC C_VLS_MAX_UP_DIAG "Diagnosis threshold,  pre-cat sensor" VALUE 0x67d66 _REC_VAL_20_u2 4.99511719 _CNV_A_R_LINEAR_____38_CM 0. 4.99511719 FORMAT "%5.3" /end CHARACTERISTIC
/begin CHARACTERISTIC C_ABC_INC_VLS_UP "Debounce counter increment" VALUE 0x67b3e _REC_VAL_20_u1 255. _CNV_A_R_LINEAR_____13_CM 0. 255. FORMAT "%3.0" /end CHARACTERISTIC
/begin CHARACTERISTIC C_ABC_INC_VLS_DOWN "Debounce counter increment" VALUE 0x67b3d _REC_VAL_20_u1 255. _CNV_A_R_LINEAR_____13_CM 0. 255. FORMAT "%3.0" /end CHARACTERISTIC
/begin CHARACTERISTIC C_VLS_MAX_DOWN_DIAG "Diagnosis threshold, post-cat sensor" VALUE 0x67d64 _REC_VAL_20_u2 4.99511719 _CNV_A_R_LINEAR_____38_CM 0. 4.99511719 FORMAT "%5.3" /end CHARACTERISTIC
/begin CHARACTERISTIC C_VLS_MIN_DOWN_DIAG "VLS diagnosis threshold" VALUE 0x67d68 _REC_VAL_20_u2 4.99511719 _CNV_A_R_LINEAR_____38_CM 0. 4.99511719 FORMAT "%5.3" /end CHARACTERISTIC
/begin CHARACTERISTIC C_T_VLS_GND_UP_DIAG "Time conditions for error entry in case of warm sensor" VALUE 0x67c94 _REC_VAL_20_u2 327.675 _CNV_A_R_LINEAR_____96_CM 0. 327.675 FORMAT "%6.2" /end CHARACTERISTIC
/begin CHARACTERISTIC C_T_VLS_GND_DOWN_DIAG "Time condition for error entry" VALUE 0x67c92 _REC_VAL_20_u2 327.675 _CNV_A_R_LINEAR_____97_CM 0. 327.675 FORMAT "%6.2" /end CHARACTERISTIC
/begin CHARACTERISTIC C_VLS_TOL_OPEN_DIAG "upper VLS threshold for the detection of line break" VALUE 0x67d6c _REC_VAL_20_u2 4.99511719 _CNV_A_R_LINEAR_____38_CM 0. 4.99511719 FORMAT "%5.3" /end CHARACTERISTIC
/begin CHARACTERISTIC C_VLS_TOL_OPEN_DOWN_DIAG "upper ULS threshold for detection of line break at PUC" VALUE 0x67d6e _REC_VAL_20_u2 4.99511719 _CNV_A_R_LINEAR_____38_CM 0. 4.99511719 FORMAT "%5.3" /end CHARACTERISTIC
/begin CHARACTERISTIC C_VLS_BOL_OPEN_DOWN_DIAG "lower ULS threshold for detection of line break at PUC" VALUE 0x67d60 _REC_VAL_20_u2 4.99511719 _CNV_A_R_LINEAR_____38_CM 0. 4.99511719 FORMAT "%5.3" /end CHARACTERISTIC
/begin CHARACTERISTIC C_MAF_INT_VLS_CAT_PUC "Mass air flow integral in PUC for start of diagnosis" VALUE 0x67bdc _REC_VAL_20_u2 1820.398 _CNV_A_R_LINEAR_____98_CM 0. 1820.398 FORMAT "%7.2" /end CHARACTERISTIC
/begin CHARACTERISTIC C_ABC_MAX_VLS_DOWN "Debounce counter maximum value" VALUE 0x67b4b _REC_VAL_20_u1 254. _CNV_A_R_LINEAR_____17_CM 1. 255. FORMAT "%3.0" /end CHARACTERISTIC
/begin CHARACTERISTIC C_LAM_P_SUM_DIAG "Number of P jumps for activation of diagnosis" VALUE 0x67bc8 _REC_VAL_20_u1 254. _CNV_A_R_LINEAR_____17_CM 1. 255. FORMAT "%3.0" /end CHARACTERISTIC
/begin CHARACTERISTIC C_VLS_DIF_MAX_MIN_DIAG "min. admissible voltage excursion" VALUE 0x67d62 _REC_VAL_20_u2 4.99992371 _CNV_A_R_LINEAR_____99_CM 0. 4.99992371 FORMAT "%7.5" /end CHARACTERISTIC
/begin CHARACTERISTIC C_VLS_MIN_UP_DIAG "VLS threshold" VALUE 0x67d6a _REC_VAL_20_u2 4.99511719 _CNV_A_R_LINEAR_____38_CM 0. 4.99511719 FORMAT "%5.3" /end CHARACTERISTIC
/begin MEASUREMENT LV_ERR_IV_0 "???" UBYTE _CNV_S_2_RANGE______77_R_CM 1 100. 0. 255. ECU_ADDRESS 0x3fd35e /end MEASUREMENT
/begin MEASUREMENT LV_ERR_IV_1 "???" UBYTE _CNV_S_2_RANGE______77_R_CM 1 100. 0. 255. ECU_ADDRESS 0x3fd35f /end MEASUREMENT
/begin MEASUREMENT LV_ERR_IV_2 "???" UBYTE _CNV_S_2_RANGE______77_R_CM 1 100. 0. 255. ECU_ADDRESS 0x3fd360 /end MEASUREMENT
/begin MEASUREMENT LV_ERR_IV_3 "???" UBYTE _CNV_S_2_RANGE______77_R_CM 1 100. 0. 255. ECU_ADDRESS 0x3fd361 /end MEASUREMENT
/begin MEASUREMENT LV_ERR_IV_4 "???" UBYTE _CNV_S_2_RANGE______77_R_CM 1 100. 0. 255. ECU_ADDRESS 0x3fd362 /end MEASUREMENT
/begin MEASUREMENT LV_ERR_IV_5 "???" UBYTE _CNV_S_2_RANGE______77_R_CM 1 100. 0. 255. ECU_ADDRESS 0x3fd363 /end MEASUREMENT
/begin MEASUREMENT LV_ERR_VLS_STK_1 "voltage excursion error, UP 1" UBYTE _CNV_S_2_RANGE______75_R_CM 1 100. 0. 255. ECU_ADDRESS 0x3fd37a /end MEASUREMENT
/begin MEASUREMENT LV_ERR_RLY_EFP "???" UBYTE _CNV_S_2_RANGE______75_R_CM 1 100. 0. 255. ECU_ADDRESS 0x3fd365 /end MEASUREMENT
/begin MEASUREMENT LV_ERR_VLS_UP_OL_1 "electrical error, UP 1" UBYTE _CNV_S_2_RANGE______75_R_CM 1 100. 0. 255. ECU_ADDRESS 0x3fd372 /end MEASUREMENT
/begin MEASUREMENT LV_ERR_TD "" UBYTE _CNV_S_2_RANGE______75_R_CM 1 100. 0. 255. ECU_ADDRESS 0x3fd35b /end MEASUREMENT
/begin CHARACTERISTIC C_CAM_SYNC_DLY "" VALUE 0x67b5e _REC_VAL_20_u1 2. _CNV_A_R_LINEAR_____17_CM 0. 2. FORMAT "%2.0" /end CHARACTERISTIC
/begin CHARACTERISTIC C_T_TIA_TCO_EX_DIAG "Time condition - TCO_EX diagnosis" VALUE 0x67c8a _REC_VAL_20_u2 65534. _CNV_A_R_LINEAR_____20_CM 1. 65535. FORMAT "%5.0" /end CHARACTERISTIC
/begin MEASUREMENT LV_IM_CS_PN "clutch switch" UBYTE _CNV_S_2_RANGE______74_CM 1 100. 0. 1. ECU_ADDRESS 0x3fa971 BIT_MASK 0x1 /end MEASUREMENT
/begin CHARACTERISTIC C_MAF_MIN_DIAG "max. mass air flow diagnostic threshold" VALUE 0x67be0 _REC_VAL_20_u2 614.390625 _CNV_A_R_LINEAR_____52_CM 0. 2047.96875 FORMAT "%6.2" /end CHARACTERISTIC
/begin CHARACTERISTIC C_LAM_CYCNR_DIAG "Time condition for error debounce" VALUE 0x67bc6 _REC_VAL_20_u2 1310.7 _CNV_A_R_LINEAR_____150_CM 0. 1310.7 FORMAT "%7.2" /end CHARACTERISTIC
/begin MEASUREMENT LV_ERR_TIA "TIA error detected" UBYTE _CNV_S_2_RANGE______77_R_CM 1 100. 0. 255. ECU_ADDRESS 0x3fd355 /end MEASUREMENT
/begin MEASUREMENT LV_MAF_SEG "indicates if segment number is even or odd in order to choose MAF_SUM / MAF_CTR or MAF_SUM_1 / MAF_CTR_1" UBYTE _CNV_S_2_RANGE______74_CM 1 100. 0. 1. ECU_ADDRESS 0x3fa918 BIT_MASK 0x1 /end MEASUREMENT
/begin MEASUREMENT MAF_SUM "accumulated mass air flow measurements for segment number (2n), n = 1,2,3,..." ULONG _CNV_A_R_LINEAR_____155_CM 1 100. 0. 67108863.98 ECU_ADDRESS 0x3fa920 FORMAT "%11.2" /end MEASUREMENT
/begin MEASUREMENT MAF_SUM_1 "accumulated mass air flow measurements for segment number (2n-1), n = 1,2,3,..." ULONG _CNV_A_R_LINEAR_____155_CM 1 100. 0. 67108863.98 ECU_ADDRESS 0x3fa924 FORMAT "%11.2" /end MEASUREMENT
/begin MEASUREMENT MAF_CTR "accumulated mass air flow measurements for segment number (2n), n = 1,2,3,..." UWORD _CNV_A_R_LINEAR_____17_CM 1 100. 0. 65535. ECU_ADDRESS 0x3fa91a FORMAT "%5.0" /end MEASUREMENT
/begin MEASUREMENT MAF_CTR_1 "accumulated mass air flow measurements for segment number (2n-1), n = 1,2,3,..." UWORD _CNV_A_R_LINEAR_____17_CM 1 100. 0. 65535. ECU_ADDRESS 0x3fa91c FORMAT "%5.0" /end MEASUREMENT
/begin CHARACTERISTIC C_ABC_MAX_MAF "Debounce counter maximum value, mass air flow meter diagnosis" VALUE 0x67b45 _REC_VAL_20_u1 10.16 _CNV_A_R_LINEAR_____17_CM 1. 255. FORMAT "%3.0" /end CHARACTERISTIC
/begin MEASUREMENT T_VS_DIAG_CTR "Time counter for fulfiled engine speed. mass air flow and LV_IGK conditions" UWORD _CNV_A_R_LINEAR_____20_CM 1 100. 0. 65535. ECU_ADDRESS 0x3fd15c FORMAT "%5.0" /end MEASUREMENT
/begin CHARACTERISTIC C_MAF_VS_MIN_DIAG "MAF condition - vehicle speed diagnosis" VALUE 0x67f1e _REC_VAL_20_u1 1389. _CNV_A_R_LINEAR_____51_CM 0. 1389. FORMAT "%4.0" /end CHARACTERISTIC
/begin CHARACTERISTIC C_N_VS_MIN_DIAG "Engine speed condition - vehicle speed diagnosis" VALUE 0x67f1c _REC_VAL_20_u2 8160. _CNV_A_R_LINEAR_____0_CM 0. 8160. FORMAT "%4.0" /end CHARACTERISTIC
/begin CHARACTERISTIC C_T_VS_MIN_DIAG "Time condition - vehicle speed diagnosis" VALUE 0x67f20 _REC_VAL_20_u2 65535. _CNV_A_R_LINEAR_____20_CM 0. 65535. FORMAT "%5.0" /end CHARACTERISTIC
/begin CHARACTERISTIC C_N_MIN_KNKS_DIAG "Lower engine speed treshold for knock sensor diagnosis" VALUE 0x67f30 _REC_VAL_20_u1 8160. _CNV_A_R_LINEAR_____15_CM 0. 8160. FORMAT "%4.0" /end CHARACTERISTIC
/begin CHARACTERISTIC C_MAF_MIN_KNKS_DIAG "Lower engine load treshold for knock sensor diagnosis" VALUE 0x67f32 _REC_VAL_20_u2 1389. _CNV_A_R_LINEAR_____56_CM 0. 1389. FORMAT "%7.2" /end CHARACTERISTIC
/begin CHARACTERISTIC C_NL_MIN_DIAG "Minimum noise level treshold" VALUE 0x67f34 _REC_VAL_20_u1 4.98046875 _CNV_A_R_LINEAR_____40_CM 0. 4.98046875 FORMAT "%5.3" /end CHARACTERISTIC
/begin CHARACTERISTIC C_NL_MAX_DIAG "Maximum noise level treshold" VALUE 0x67f35 _REC_VAL_20_u1 4.98046875 _CNV_A_R_LINEAR_____40_CM 0. 4.98046875 FORMAT "%5.3" /end CHARACTERISTIC
/begin CHARACTERISTIC C_ABC_INC_KNKS_DIAG "Debounce counter increment - knock sensor diagnosis" VALUE 0x67f36 _REC_VAL_20_u1 255. _CNV_A_R_LINEAR_____13_CM 0. 255. FORMAT "%3.0" /end CHARACTERISTIC
/begin CHARACTERISTIC C_ABC_MAX_KNKS_DIAG "Debounce counter maximum value - knock sensor diagnosis" VALUE 0x67f37 _REC_VAL_20_u1 254. _CNV_A_R_LINEAR_____17_CM 1. 255. FORMAT "%3.0" /end CHARACTERISTIC
/begin MEASUREMENT LV_INH_IGC_0 "Inhibition Bit for ignition system of cylinder x" UBYTE _CNV_S_2_RANGE______76_CM 1 100. 0. 1. ECU_ADDRESS 0x3fd4b1 /end MEASUREMENT
/begin MEASUREMENT LV_INH_IGC_1 "Inhibition Bit for ignition system of cylinder x" UBYTE _CNV_S_2_RANGE______76_CM 1 100. 0. 1. ECU_ADDRESS 0x3fd4b2 /end MEASUREMENT
/begin MEASUREMENT LV_INH_IGC_2 "Inhibition Bit for ignition system of cylinder x" UBYTE _CNV_S_2_RANGE______76_CM 1 100. 0. 1. ECU_ADDRESS 0x3fd4b3 /end MEASUREMENT
/begin MEASUREMENT LV_INH_IGC_3 "Inhibition Bit for ignition system of cylinder x" UBYTE _CNV_S_2_RANGE______76_CM 1 100. 0. 1. ECU_ADDRESS 0x3fd4b4 /end MEASUREMENT
/begin MEASUREMENT LV_INH_IGC_4 "Inhibition Bit for ignition system of cylinder x" UBYTE _CNV_S_2_RANGE______76_CM 1 100. 0. 1. ECU_ADDRESS 0x3fd4b5 /end MEASUREMENT
/begin MEASUREMENT LV_INH_IGC_5 "Inhibition Bit for ignition system of cylinder x" UBYTE _CNV_S_2_RANGE______76_CM 1 100. 0. 1. ECU_ADDRESS 0x3fd4b6 /end MEASUREMENT
/begin MEASUREMENT LV_ERR_TD_IGC_CUT_0 "Error bit for short cut to battery" UBYTE _CNV_S_2_RANGE______77_R_CM 1 100. 0. 255. ECU_ADDRESS 0x3fd38a /end MEASUREMENT
/begin MEASUREMENT LV_ERR_TD_IGC_CUT_1 "Error bit for short cut to battery" UBYTE _CNV_S_2_RANGE______77_R_CM 1 100. 0. 255. ECU_ADDRESS 0x3fd38b /end MEASUREMENT
/begin MEASUREMENT LV_ERR_TD_IGC_CUT_2 "Error bit for short cut to battery" UBYTE _CNV_S_2_RANGE______77_R_CM 1 100. 0. 255. ECU_ADDRESS 0x3fd38c /end MEASUREMENT
/begin MEASUREMENT LV_ERR_TD_IGC_CUT_3 "Error bit for short cut to battery" UBYTE _CNV_S_2_RANGE______77_R_CM 1 100. 0. 255. ECU_ADDRESS 0x3fd38d /end MEASUREMENT
/begin MEASUREMENT LV_ERR_TD_IGC_CUT_4 "Error bit for short cut to battery" UBYTE _CNV_S_2_RANGE______77_R_CM 1 100. 0. 255. ECU_ADDRESS 0x3fd38e /end MEASUREMENT
/begin MEASUREMENT LV_ERR_TD_IGC_CUT_5 "Error bit for short cut to battery" UBYTE _CNV_S_2_RANGE______77_R_CM 1 100. 0. 255. ECU_ADDRESS 0x3fd38f /end MEASUREMENT
/begin MEASUREMENT LV_ERR_DUR_IGC_1 "Error bit for short Burntime" UBYTE _CNV_S_2_RANGE______77_R_CM 1 100. 0. 255. ECU_ADDRESS 0x3fd391 /end MEASUREMENT
/begin MEASUREMENT LV_ERR_DUR_IGC_2 "Error bit for short Burntime" UBYTE _CNV_S_2_RANGE______77_R_CM 1 100. 0. 255. ECU_ADDRESS 0x3fd392 /end MEASUREMENT
/begin MEASUREMENT LV_ERR_DUR_IGC_3 "Error bit for short Burntime" UBYTE _CNV_S_2_RANGE______77_R_CM 1 100. 0. 255. ECU_ADDRESS 0x3fd393 /end MEASUREMENT
/begin MEASUREMENT LV_ERR_DUR_IGC_4 "Error bit for short Burntime" UBYTE _CNV_S_2_RANGE______77_R_CM 1 100. 0. 255. ECU_ADDRESS 0x3fd394 /end MEASUREMENT
/begin MEASUREMENT LV_ERR_DUR_IGC_5 "Error bit for short Burntime" UBYTE _CNV_S_2_RANGE______77_R_CM 1 100. 0. 255. ECU_ADDRESS 0x3fd395 /end MEASUREMENT
/begin AXIS_PTS ldp_n__v_dur_igc_min "" 0x61d90 N_32 _REC_AXS_20_u1 816. _CNV_A_R_LINEAR_____15_CM 6 0. 8160. FORMAT "%4.0" /end AXIS_PTS
/begin AXIS_PTS ldp_maf__v_dur_igc_min "" 0x61d97 MAF _REC_AXS_20_u1 138.9 _CNV_A_R_LINEAR_____51_CM 4 0. 1389. FORMAT "%4.0" /end AXIS_PTS
/begin CHARACTERISTIC C_IGA_OFF_CYCNR_HLD "Duration for regeneration cycle (2 engine evolutions); coil has been switched off" VALUE 0x67f4f _REC_VAL_20_u1 255. _CNV_A_R_LINEAR_____13_CM 0. 255. FORMAT "%3.0" /end CHARACTERISTIC
/begin CHARACTERISTIC C_ABC_TD_IGC_CUT "Value of anti-bounce counter after regeneration cycle" VALUE 0x67f4e _REC_VAL_20_u1 255. _CNV_A_R_LINEAR_____13_CM 0. 255. FORMAT "%3.0" /end CHARACTERISTIC
/begin CHARACTERISTIC C_ABC_MAX_TD_IGC_CUT "Maximum value of anti-bounce counter for the ignition system diagnosis to switch off the coil" VALUE 0x67f51 _REC_VAL_20_u1 254. _CNV_A_R_LINEAR_____17_CM 1. 255. FORMAT "%3.0" /end CHARACTERISTIC
/begin CHARACTERISTIC C_SUM_TD_IGC_CUT "Number of allowed trials to check the ignition system in one engine run" VALUE 0x67f52 _REC_VAL_20_u1 255. _CNV_A_R_LINEAR_____13_CM 0. 255. FORMAT "%3.0" /end CHARACTERISTIC
/begin CHARACTERISTIC C_TCO_MIN_DUR_IGC_DIAG "Minimum coolant temperature to enable the diagnosis" VALUE 0x67f53 _REC_VAL_20_u1 190.5 _CNV_A_R_LINEAR_____22_CM -48. 142.5 FORMAT "%5.1" /end CHARACTERISTIC
/begin CHARACTERISTIC C_ABC_INC_V_DUR_IGC "Debounce counter increment" VALUE 0x67f54 _REC_VAL_20_u1 255. _CNV_A_R_LINEAR_____13_CM 0. 255. FORMAT "%3.0" /end CHARACTERISTIC
/begin MEASUREMENT V_DUR_IGC_0 "Burntime for  respective cylinder" UWORD _CNV_A_R_LINEAR_____24_CM 1 100. 0. 20. ECU_ADDRESS 0x3fd324 FORMAT "%8.3" /end MEASUREMENT
/begin MEASUREMENT V_DUR_IGC_1 "Burntime for  respective cylinder" UWORD _CNV_A_R_LINEAR_____24_CM 1 100. 0. 20. ECU_ADDRESS 0x3fd326 FORMAT "%8.3" /end MEASUREMENT
/begin MEASUREMENT V_DUR_IGC_2 "Burntime for  respective cylinder" UWORD _CNV_A_R_LINEAR_____24_CM 1 100. 0. 20. ECU_ADDRESS 0x3fd328 FORMAT "%8.3" /end MEASUREMENT
/begin MEASUREMENT V_DUR_IGC_3 "Burntime for  respective cylinder" UWORD _CNV_A_R_LINEAR_____24_CM 1 100. 0. 20. ECU_ADDRESS 0x3fd32a FORMAT "%8.3" /end MEASUREMENT
/begin MEASUREMENT V_DUR_IGC_4 "Burntime for  respective cylinder" UWORD _CNV_A_R_LINEAR_____24_CM 1 100. 0. 20. ECU_ADDRESS 0x3fd32c FORMAT "%8.3" /end MEASUREMENT
/begin MEASUREMENT V_DUR_IGC_5 "Burntime for  respective cylinder" UWORD _CNV_A_R_LINEAR_____24_CM 1 100. 0. 20. ECU_ADDRESS 0x3fd32e FORMAT "%8.3" /end MEASUREMENT
/begin CHARACTERISTIC C_ABC_MAX_V_DUR_IGC "Debounce counter maximum" VALUE 0x67f55 _REC_VAL_20_u1 254. _CNV_A_R_LINEAR_____17_CM 1. 255. FORMAT "%3.0" /end CHARACTERISTIC
/begin CHARACTERISTIC C_ABC_INC_VCC_POTI "Increment debounce counter- Poti-supply voltage" VALUE 0x67f57 _REC_VAL_20_u1 255. _CNV_A_R_LINEAR_____13_CM 0. 255. FORMAT "%3.0" /end CHARACTERISTIC
/begin CHARACTERISTIC C_ABC_MAX_VCC_POTI "Maximum value debounce counter- Poti-supply voltage" VALUE 0x67f58 _REC_VAL_20_u1 254. _CNV_A_R_LINEAR_____17_CM 1. 255. FORMAT "%3.0" /end CHARACTERISTIC
/begin CHARACTERISTIC C_ABC_MAX_PVS_SP_1 "Debounce counter maximum value channel 1" VALUE 0x67f5a _REC_VAL_20_u1 254. _CNV_A_R_LINEAR_____17_CM 1. 255. FORMAT "%3.0" /end CHARACTERISTIC
/begin CHARACTERISTIC C_ABC_MAX_PVS_SP_2 "Debounce counter maximum value channel 2" VALUE 0x67f5b _REC_VAL_20_u1 254. _CNV_A_R_LINEAR_____17_CM 1. 255. FORMAT "%3.0" /end CHARACTERISTIC
/begin CHARACTERISTIC C_ABC_INC_PVS_SP_2 "Debounce counter Increment Channel 2" VALUE 0x67f5c _REC_VAL_20_u1 255. _CNV_A_R_LINEAR_____13_CM 0. 255. FORMAT "%3.0" /end CHARACTERISTIC
/begin CHARACTERISTIC C_ABC_INC_PVS_RATIO "Increment debounce counter" VALUE 0x67f5d _REC_VAL_20_u1 255. _CNV_A_R_LINEAR_____13_CM 0. 255. FORMAT "%3.0" /end CHARACTERISTIC
/begin MEASUREMENT LV_ERR_PVS_2 "Logical value (set, if PVS - Channel 2 has debounced a range error)" UBYTE _CNV_S_2_RANGE______77_R_CM 1 100. 0. 255. ECU_ADDRESS 0x3fd39b /end MEASUREMENT
/begin MEASUREMENT LV_PVS_H_R_1 "Logical value (set, if PVS - Channel 1 debounced a high resistance)" UBYTE _CNV_S_2_RANGE______74_CM 1 100. 0. 1. ECU_ADDRESS 0x3fd517 BIT_MASK 0x1 /end MEASUREMENT
/begin MEASUREMENT LV_PVS_H_R_2 "Logical value (set, if PVS - Channel 2 debounced a high resistance)" UBYTE _CNV_S_2_RANGE______74_CM 1 100. 0. 1. ECU_ADDRESS 0x3fd518 BIT_MASK 0x1 /end MEASUREMENT
/begin MEASUREMENT LV_ERR_PVS_PRED "Logical value (set, if a PVS-error is present)" UBYTE _CNV_S_2_RANGE______77_R_CM 1 100. 0. 255. ECU_ADDRESS 0x3fd515 /end MEASUREMENT
/begin MEASUREMENT LV_ERR_V_REF_2 "Logical value (set, if supply voltage PVS- Channel 2 debounced)" UBYTE _CNV_S_2_RANGE______77_R_CM 1 100. 0. 255. ECU_ADDRESS 0x3fd39d /end MEASUREMENT
/begin MEASUREMENT LV_ERR_PVS_RATIO "Logical value (set, if a synchronous error between PVS_1 and PVS_2 is debounced)" UBYTE _CNV_S_2_RANGE______77_R_CM 1 100. 0. 255. ECU_ADDRESS 0x3fd39e /end MEASUREMENT
/begin MEASUREMENT LV_ERR_PVS_DOUBLE "Logical value (set, if a PVS double error is present)" UBYTE _CNV_S_2_RANGE______77_R_CM 1 100. 0. 255. ECU_ADDRESS 0x3fd39f /end MEASUREMENT
/begin CHARACTERISTIC C_ABC_MAX_PVS_RATIO "Maximum value debounce counter " VALUE 0x67f5e _REC_VAL_20_u1 254. _CNV_A_R_LINEAR_____17_CM 1. 255. FORMAT "%3.0" /end CHARACTERISTIC
/begin CHARACTERISTIC C_VCC_DIF_POTI "max. permissible variance of the supply voltage of 5V" VALUE 0x67f60 _REC_VAL_20_u2 4.99511719 _CNV_A_R_LINEAR_____38_CM 0. 4.99511719 FORMAT "%5.3" /end CHARACTERISTIC
/begin CHARACTERISTIC C_V_PVS_MAX_DIAG_1 "Upper diagnosis threshold channel 1" VALUE 0x67f62 _REC_VAL_20_u2 4.99511719 _CNV_A_R_LINEAR_____38_CM 0. 4.99511719 FORMAT "%5.3" /end CHARACTERISTIC
/begin AXIS_PTS ldp_v_pvs_min "" 0x61dcc V_PVS_MIN _REC_AXS_20_u2 4.99511719 _CNV_A_R_LINEAR_____38_CM 2 0. 4.99511719 FORMAT "%5.3" /end AXIS_PTS
/begin CHARACTERISTIC ID_V_DUR_IGC_MIN__N__MAF "Minimum duration of the primary over voltage to detect ignition errors" MAP 0x61d9c _REC_MAP_20_u2_u1_u1 20. _CNV_A_R_LINEAR_____24_CM 0. 20. FORMAT "%8.3"
 /begin AXIS_DESCR COM_AXIS N_32 _CNV_A_R_LINEAR_____15_CM 6 0. 8160. FORMAT "%4.0" AXIS_PTS_REF ldp_n__v_dur_igc_min /end AXIS_DESCR
 /begin AXIS_DESCR COM_AXIS MAF _CNV_A_R_LINEAR_____51_CM 4 0. 1389. FORMAT "%4.0" AXIS_PTS_REF ldp_maf__v_dur_igc_min /end AXIS_DESCR
/end CHARACTERISTIC
/begin CHARACTERISTIC C_V_PVS_MAX_DIAG_2 "Upper diagnosis threshold channel 2" VALUE 0x67f64 _REC_VAL_20_u2 4.99511719 _CNV_A_R_LINEAR_____38_CM 0. 4.99511719 FORMAT "%5.3" /end CHARACTERISTIC
/begin CHARACTERISTIC C_V_PVS_MIN_DIAG_2 "lower diagnosis-threshold channel 2" VALUE 0x67f66 _REC_VAL_20_u2 4.99511719 _CNV_A_R_LINEAR_____38_CM 0. 4.99511719 FORMAT "%5.3" /end CHARACTERISTIC
/begin MEASUREMENT LV_ERR_V_REF_1 "Logical value (set, if supply voltage PVS- Channel 1  debounced)" UBYTE _CNV_S_2_RANGE______77_R_CM 1 100. 0. 255. ECU_ADDRESS 0x3fd39c /end MEASUREMENT
/begin CHARACTERISTIC C_T_IS_PVS_ERR "Minimum idle dwell time in error cases" VALUE 0x67f6a _REC_VAL_20_u1 2.55 _CNV_A_R_LINEAR_____21_CM 0. 2.55 FORMAT "%4.2" /end CHARACTERISTIC
/begin CHARACTERISTIC IP_PVS_RATIO_HYS "permissible variance of the PVS-values" CURVE 0x61dd2 _REC_CUR_20_u2_u2 4.99511719 _CNV_A_R_LINEAR_____38_CM 0. 4.99511719 FORMAT "%5.3"
 /begin AXIS_DESCR COM_AXIS ONLINE_DUMMY _CNV_A_R_LINEAR_____38_CM 2 0. 4.99511719 FORMAT "%5.3" AXIS_PTS_REF ldp_v_pvs_min /end AXIS_DESCR
/end CHARACTERISTIC
/begin MEASUREMENT LV_DYN_LIM_1_ACT "Limited dynamic 1 is  active / passive" UBYTE _CNV_S_2_RANGE______74_CM 1 100. 0. 1. ECU_ADDRESS 0x3fd519 BIT_MASK 0x1 /end MEASUREMENT
/begin MEASUREMENT LV_DYN_LIM_2_ACT "Limited dynamic 2 is  active / passive" UBYTE _CNV_S_2_RANGE______74_CM 1 100. 0. 1. ECU_ADDRESS 0x3fd51a BIT_MASK 0x1 /end MEASUREMENT
/begin CHARACTERISTIC C_ABC_INC_PVS_SP_1 "Debounce counter Increment Channel 1" VALUE 0x67f59 _REC_VAL_20_u1 255. _CNV_A_R_LINEAR_____13_CM 0. 255. FORMAT "%3.0" /end CHARACTERISTIC
/begin CHARACTERISTIC C_ABC_INC_TPS_1 "Debounce counter Increment, TPS diagnosis, Channel 1" VALUE 0x67f8a _REC_VAL_20_u1 255. _CNV_A_R_LINEAR_____13_CM 0. 255. FORMAT "%3.0" /end CHARACTERISTIC
/begin CHARACTERISTIC C_ABC_INC_TPS_2 "Debounce counter Increment, TPS diagnosis, Channel 2" VALUE 0x67f8b _REC_VAL_20_u1 255. _CNV_A_R_LINEAR_____13_CM 0. 255. FORMAT "%3.0" /end CHARACTERISTIC
/begin CHARACTERISTIC C_ABC_MAX_TPS_2 "Debounce counter maximum value, TPS diagnosis, Channel 2" VALUE 0x67f8c _REC_VAL_20_u1 254. _CNV_A_R_LINEAR_____17_CM 1. 255. FORMAT "%3.0" /end CHARACTERISTIC
/begin MEASUREMENT LV_ERR_PVS_1 "Logical value (set, if PVS - Channel 1 has debounced a range error)" UBYTE _CNV_S_2_RANGE______77_R_CM 1 100. 0. 255. ECU_ADDRESS 0x3fd39a /end MEASUREMENT
/begin CHARACTERISTIC C_ABC_MAX_TPS_1 "Debounce counter maximum value, TPS diagnosis, Channel 1" VALUE 0x67f8d _REC_VAL_20_u1 254. _CNV_A_R_LINEAR_____17_CM 1. 255. FORMAT "%3.0" /end CHARACTERISTIC
/begin CHARACTERISTIC C_V_TPS_MIN_DIAG_1 "lower diagnostic voltage, pot  1" VALUE 0x67f8e _REC_VAL_20_u2 4.99511719 _CNV_A_R_LINEAR_____38_CM 0. 4.99511719 FORMAT "%5.3" /end CHARACTERISTIC
/begin CHARACTERISTIC C_V_TPS_MIN_DIAG_2 "lower diagnostic voltage, pot  2" VALUE 0x67f90 _REC_VAL_20_u2 4.99511719 _CNV_A_R_LINEAR_____38_CM 0. 4.99511719 FORMAT "%5.3" /end CHARACTERISTIC
/begin CHARACTERISTIC C_V_TPS_MAX_DIAG_2 "upper diagnostic voltage, pot  2" VALUE 0x67f92 _REC_VAL_20_u2 4.99511719 _CNV_A_R_LINEAR_____38_CM 0. 4.99511719 FORMAT "%5.3" /end CHARACTERISTIC
/begin MEASUREMENT LV_ERR_TPS_2 "Logic variable  (set if  TPS_2 is being identified as errored)" UBYTE _CNV_S_2_RANGE______77_R_CM 1 100. 0. 255. ECU_ADDRESS 0x3fd397 /end MEASUREMENT
/begin MEASUREMENT TPS_MAF_DIF_2 "Deviation of the substitute DK angle from TPS_2" UWORD _CNV_A_R_LINEAR_____162_CM 1 100. 0. 128. ECU_ADDRESS 0x3fd01e FORMAT "%7.3" /end MEASUREMENT
/begin MEASUREMENT TPS_MAF_DIF_INT_2 "Sum of deviation between DK substitute value and TPS_2" UWORD _CNV_A_R_LINEAR_____162_CM 1 100. 0. 128. ECU_ADDRESS 0x3fd022 FORMAT "%7.3" /end MEASUREMENT
/begin MEASUREMENT TPS_MAF_DIF_INT_1 "Sum of deviation between DK substitute value and TPS_1" UWORD _CNV_A_R_LINEAR_____162_CM 1 100. 0. 128. ECU_ADDRESS 0x3fd020 FORMAT "%7.3" /end MEASUREMENT
/begin MEASUREMENT MAF_SUB_1 "Substitute mass air flow calculated with TPS_AV_1" UWORD _CNV_A_R_LINEAR_____56_CM 1 100. 0. 1389. ECU_ADDRESS 0x3fd024 FORMAT "%7.2" /end MEASUREMENT
/begin MEASUREMENT MAF_SUB_2 "Substitute mass air flow calculated with TPS_AV_2" UWORD _CNV_A_R_LINEAR_____56_CM 1 100. 0. 1389. ECU_ADDRESS 0x3fd026 FORMAT "%7.2" /end MEASUREMENT
/begin MEASUREMENT LV_ERR_TPS_RATIO "Logic variable (set if TPS ratio has been identified as faulty)" UBYTE _CNV_S_2_RANGE______77_R_CM 1 100. 0. 255. ECU_ADDRESS 0x3fd555 /end MEASUREMENT
/begin MEASUREMENT LV_ERR_TPS_MAF_1 "Logic variable (set if TPS_1 has been identified as faulty by the ratio check)" UBYTE _CNV_S_2_RANGE______77_R_CM 1 100. 0. 255. ECU_ADDRESS 0x3fd398 /end MEASUREMENT
/begin MEASUREMENT LV_ERR_TPS_MAF_2 "Logic variable(set if TPS_2 has been identified as faulty by the ratio check)" UBYTE _CNV_S_2_RANGE______77_R_CM 1 100. 0. 255. ECU_ADDRESS 0x3fd399 /end MEASUREMENT
/begin CHARACTERISTIC C_V_TPS_MAX_DIAG_1 "upper diagnostic voltage, pot  1" VALUE 0x67f94 _REC_VAL_20_u2 4.99511719 _CNV_A_R_LINEAR_____38_CM 0. 4.99511719 FORMAT "%5.3" /end CHARACTERISTIC
/begin CHARACTERISTIC C_V_TPS_RATIO_HYS "Admissible deviation of DK angle" VALUE 0x67f96 _REC_VAL_20_u2 4.99511719 _CNV_A_R_LINEAR_____38_CM 0. 4.99511719 FORMAT "%5.3" /end CHARACTERISTIC
/begin CHARACTERISTIC C_R_LS_GND_DOWN_MAX_DIAG "Lambda-downstreaam-sensor resistance threshold" VALUE 0x67f9a _REC_VAL_20_u2 65535. _CNV_A_R_LINEAR_____163_CM 0. 65535. FORMAT "%5.0" /end CHARACTERISTIC
/begin CHARACTERISTIC C_R_LS_GND_UP_MAX_DIAG "Lambda-sensor resistance threshold" VALUE 0x67c34 _REC_VAL_20_u2 65535. _CNV_A_R_LINEAR_____163_CM 0. 65535. FORMAT "%5.0" /end CHARACTERISTIC
/begin CHARACTERISTIC C_R_LS_OPEN_DOWN_MAX_DIAG "Lambda-downstream-sensor OL-resistance threshold" VALUE 0x67f9c _REC_VAL_20_u2 65535. _CNV_A_R_LINEAR_____163_CM 0. 65535. FORMAT "%5.0" /end CHARACTERISTIC
/begin CHARACTERISTIC C_R_LS_OPEN_UP_MIN_DIAG "Lambda-sensor open load resistance threshold" VALUE 0x67f98 _REC_VAL_20_u2 65535. _CNV_A_R_LINEAR_____163_CM 0. 65535. FORMAT "%5.0" /end CHARACTERISTIC
/begin CHARACTERISTIC C_R_LS_OPEN_DOWN_MIN_DIAG "Lambda-downstream sensor open load resistance threshold" VALUE 0x67f9e _REC_VAL_20_u2 65535. _CNV_A_R_LINEAR_____163_CM 0. 65535. FORMAT "%5.0" /end CHARACTERISTIC
/begin CHARACTERISTIC C_MAF_MES_MAX_TPS_DIAG "Maximum threshold for usable air mass flow signal" VALUE 0x67fa4 _REC_VAL_20_u2 1389. _CNV_A_R_LINEAR_____56_CM 0. 1389. FORMAT "%7.2" /end CHARACTERISTIC
/begin AXIS_PTS ldp_maf_mes__maf_dif_tps_diag "" 0x61dfa MAF_MES _REC_AXS_20_u2 1389. _CNV_A_R_LINEAR_____56_CM 4 0. 1389. FORMAT "%7.2" /end AXIS_PTS
/begin MEASUREMENT LV_TD_IGC_CUT_0 "Diagnostic-bit of primary short circuit to battery" UBYTE _CNV_S_2_RANGE______74_CM 1 100. 0. 1. ECU_ADDRESS 0x3fa99c BIT_MASK 0x1 /end MEASUREMENT
/begin MEASUREMENT LV_TD_IGC_CUT_1 "Diagnostic-bit of primary short circuit to battery" UBYTE _CNV_S_2_RANGE______74_CM 1 100. 0. 1. ECU_ADDRESS 0x3fa99d BIT_MASK 0x1 /end MEASUREMENT
/begin MEASUREMENT LV_TD_IGC_CUT_2 "Diagnostic-bit of primary short circuit to battery" UBYTE _CNV_S_2_RANGE______74_CM 1 100. 0. 1. ECU_ADDRESS 0x3fa99e BIT_MASK 0x1 /end MEASUREMENT
/begin MEASUREMENT LV_TD_IGC_CUT_3 "Diagnostic-bit of primary short circuit to battery" UBYTE _CNV_S_2_RANGE______74_CM 1 100. 0. 1. ECU_ADDRESS 0x3fa99f BIT_MASK 0x1 /end MEASUREMENT
/begin MEASUREMENT LV_TD_IGC_CUT_4 "Diagnostic-bit of primary short circuit to battery" UBYTE _CNV_S_2_RANGE______74_CM 1 100. 0. 1. ECU_ADDRESS 0x3fa9a0 BIT_MASK 0x1 /end MEASUREMENT
/begin MEASUREMENT LV_TD_IGC_CUT_5 "Diagnostic-bit of primary short circuit to battery" UBYTE _CNV_S_2_RANGE______74_CM 1 100. 0. 1. ECU_ADDRESS 0x3fa9a1 BIT_MASK 0x1 /end MEASUREMENT
/begin AXIS_PTS ldp_tps_av__maf_1_diag "" 0x61e16 TPS_AV _REC_AXS_20_u2 119.5 _CNV_A_R_LINEAR_____164_CM 16 0. 119.5 FORMAT "%7.3" /end AXIS_PTS
/begin AXIS_PTS ldpm_tia_1 "" 0x61e38 TIA _REC_AXS_20_u1 190.5 _CNV_A_R_LINEAR_____22_CM 6 -48. 142.5 FORMAT "%5.1" /end AXIS_PTS
/begin AXIS_PTS ldpm_tco__fac_tco_tqi "" 0x61e3f TCO _REC_AXS_20_u1 190.5 _CNV_A_R_LINEAR_____22_CM 6 -48. 142.5 FORMAT "%5.1" /end AXIS_PTS
/begin CHARACTERISTIC IP_MAF_1_DIAG__N__TPS_AV "Substitute mass air flow through MTC" MAP 0x67fae _REC_MAP_20_u2_u1_u2 1389. _CNV_A_R_LINEAR_____56_CM 0. 1389. FORMAT "%7.2"
 /begin AXIS_DESCR COM_AXIS N_32 _CNV_A_R_LINEAR_____15_CM 16 0. 8160. FORMAT "%4.0" AXIS_PTS_REF ldpm_n_32_6 /end AXIS_DESCR
 /begin AXIS_DESCR COM_AXIS TPS_AV _CNV_A_R_LINEAR_____164_CM 16 0. 119.5 FORMAT "%7.3" AXIS_PTS_REF ldp_tps_av__maf_1_diag /end AXIS_DESCR
/end CHARACTERISTIC
/begin CHARACTERISTIC IP_MAF_ADD_TIA_FAC__TIA "Correction of air density" CURVE 0x681ae _REC_CUR_20_u1_u1 1.9921875 _CNV_A_R_LINEAR_____67_CM 0. 1.9921875 FORMAT "%5.3"
 /begin AXIS_DESCR COM_AXIS TIA _CNV_A_R_LINEAR_____22_CM 6 -48. 142.5 FORMAT "%5.1" AXIS_PTS_REF ldpm_tia_1 /end AXIS_DESCR
/end CHARACTERISTIC
/begin CHARACTERISTIC IP_FAC_TCO_TQI__TCO "Coolant temperature correction" CURVE 0x681b4 _REC_CUR_20_u1_u1 1.9921875 _CNV_A_R_LINEAR_____67_CM 0. 1.9921875 FORMAT "%5.3"
 /begin AXIS_DESCR COM_AXIS TCO _CNV_A_R_LINEAR_____22_CM 6 -48. 142.5 FORMAT "%5.1" AXIS_PTS_REF ldpm_tco__fac_tco_tqi /end AXIS_DESCR
/end CHARACTERISTIC
/begin MEASUREMENT TPS_MAF_DIF_1 "Deviation of the substitute DK angle from TPS_1" UWORD _CNV_A_R_LINEAR_____162_CM 1 100. 0. 128. ECU_ADDRESS 0x3fd01c FORMAT "%7.3" /end MEASUREMENT
/begin MEASUREMENT TPS_MAF_DIF_MMV_1 "moving mean value of the difference between the DK position 1 and the map value" UWORD _CNV_A_R_LINEAR_____162_CM 1 100. 0. 128. ECU_ADDRESS 0x3fd028 FORMAT "%7.3" /end MEASUREMENT
/begin MEASUREMENT TPS_MAF_DIF_MMV_2 "moving mean value of the difference between the DK position 2 and the map value" UWORD _CNV_A_R_LINEAR_____162_CM 1 100. 0. 128. ECU_ADDRESS 0x3fd02a FORMAT "%7.3" /end MEASUREMENT
/begin CHARACTERISTIC C_TPS_MAF_DIF_INT_THD "Limit for integrated deviation between DK angle channel X and map value" VALUE 0x67fa0 _REC_VAL_20_u2 128. _CNV_A_R_LINEAR_____162_CM 0. 128. FORMAT "%7.3" /end CHARACTERISTIC
/begin CHARACTERISTIC C_TPS_MAF_DIF_MMV_THD "Limit  for calculation of the floating mean value of the deviation between channel X and map value" VALUE 0x681ba _REC_VAL_20_u2 128. _CNV_A_R_LINEAR_____162_CM 0. 128. FORMAT "%7.3" /end CHARACTERISTIC
/begin CHARACTERISTIC C_TPS_MAF_CRLC_DIF "Correlation constant for filtering of error (second error)" VALUE 0x681bc _REC_VAL_20_u2 0.99998474 _CNV_A_R_LINEAR_____2_CM 0. 0.99998474 FORMAT "%7.5" /end CHARACTERISTIC
/begin MEASUREMENT LV_ERR_TPS_1 "Logic variable  (set if  TPS_1 is being identified as errored)" UBYTE _CNV_S_2_RANGE______77_R_CM 1 100. 0. 255. ECU_ADDRESS 0x3fd396 /end MEASUREMENT
/begin CHARACTERISTIC C_TPS_MAX "Maximum mechanical opening angle of the throttle valve in degree" VALUE 0x67cee _REC_VAL_20_u2 119.5 _CNV_A_R_LINEAR_____34_CM 0. 119.5 /end CHARACTERISTIC
/begin AXIS_PTS ldpm_n_32_6 "" 0x61e04 N_32 _REC_AXS_20_u1 8160. _CNV_A_R_LINEAR_____15_CM 16 0. 8160. FORMAT "%4.0" /end AXIS_PTS
/begin CHARACTERISTIC C_V_PVS_MIN_DIAG_1 "lower diagnosis-threshold channel 1" VALUE 0x67f68 _REC_VAL_20_u2 4.99511719 _CNV_A_R_LINEAR_____38_CM 0. 4.99511719 FORMAT "%5.3" /end CHARACTERISTIC
/begin CHARACTERISTIC C_ABC_MAX_PVS_H_R_1 "debounce counter maximum channel 1" VALUE 0x681d9 _REC_VAL_20_u1 254. _CNV_A_R_LINEAR_____17_CM 1. 255. FORMAT "%3.0" /end CHARACTERISTIC
/begin CHARACTERISTIC C_ABC_MAX_PVS_H_R_2 "debounce counter maximum channel 2" VALUE 0x681da _REC_VAL_20_u1 254. _CNV_A_R_LINEAR_____17_CM 1. 255. FORMAT "%3.0" /end CHARACTERISTIC
/begin CHARACTERISTIC IP_MAF_DIF_TPS_DIAG__MAF_MES "Normalization factor for deviation between measured and calculated DK value" CURVE 0x67fa6 _REC_CUR_20_u2_u2 1389. _CNV_A_R_LINEAR_____56_CM 0. 1389. FORMAT "%7.2"
 /begin AXIS_DESCR COM_AXIS MAF_MES _CNV_A_R_LINEAR_____56_CM 4 0. 1389. FORMAT "%7.2" AXIS_PTS_REF ldp_maf_mes__maf_dif_tps_diag /end AXIS_DESCR
/end CHARACTERISTIC
/begin CHARACTERISTIC C_T_TPS_DIF_INT "Integration time for deviation between measured and calculated DK value" VALUE 0x67fa2 _REC_VAL_20_u1 1.275 _CNV_A_R_LINEAR_____19_CM 0. 1.275 FORMAT "%5.3" /end CHARACTERISTIC
/begin CHARACTERISTIC C_ABC_INC_TD_IGC_CUT "Anti-bounce counter increment for the ignition system diagnosis 1/720°CRK" VALUE 0x67f50 _REC_VAL_20_u1 255. _CNV_A_R_LINEAR_____13_CM 0. 255. FORMAT "%3.0" /end CHARACTERISTIC
/begin CHARACTERISTIC C_ESB_IGN_CUT_DIAG "Enable byte for the diagnosis configuration" VALUE 0x68208 _REC_VAL_20_u2 65535. _CNV_A_R_LINEAR_____17_CM 0. 65535. FORMAT "%5.0" /end CHARACTERISTIC
/begin MEASUREMENT BIOS_T_SEG_MIS "" UWORD _CNV_A_R_LINEAR_____165_CM 1 100. 0. 65535. ECU_ADDRESS 0x3fa9ac FORMAT "%5.0" /end MEASUREMENT
/begin MEASUREMENT LV_ERR_DUR_IGC_0 "Error bit for short Burntime" UBYTE _CNV_S_2_RANGE______77_R_CM 1 100. 0. 255. ECU_ADDRESS 0x3fd390 /end MEASUREMENT
/begin MEASUREMENT STATE_PVS_DIAG "Status of PVS-diagnosis" UBYTE _CNV_S_9_RANGE_STAT_170_CM 1 100. 0. 128. ECU_ADDRESS 0x3fd963 /end MEASUREMENT
/begin MEASUREMENT LV_N_SP_IS_LIH_ACT "LIH idle speed setpoint" UBYTE _CNV_S_2_RANGE______76_CM 1 100. 0. 1. ECU_ADDRESS 0x3fd51c BIT_MASK 0x1 /end MEASUREMENT
/begin AXIS_PTS ldp_vb__ivvtpwm "" 0x61ec2 VB _REC_AXS_20_u1 25.8984 _CNV_A_R_LINEAR_____42_CM 4 0. 25.8984 FORMAT "%3.1" /end AXIS_PTS
/begin CHARACTERISTIC C_ABC_INC_MAF "Debounce counter increment, mass air flow meter diagnosis" VALUE 0x67b37 _REC_VAL_20_u1 10.2 _CNV_A_R_LINEAR_____13_CM 0. 255. FORMAT "%3.0" /end CHARACTERISTIC
/begin MEASUREMENT PORTPWM "PWM setpoint for port flap" UWORD _CNV_A_R_LINEAR_____144_CM 1 100. 0. 99.99847412 ECU_ADDRESS 0x3fc5c8 /end MEASUREMENT
/begin MEASUREMENT PORT_SP "relative port deactivation setpoint" UWORD _CNV_A_R_LINEAR_____144_CM 1 100. 0. 99.99847412 ECU_ADDRESS 0x3fc5cc /end MEASUREMENT
/begin MEASUREMENT VLFT_SP "valve lift setpoint (raw value)" UWORD _CNV_A_R_LINEAR_____182_CM 1 100. 0. 65.535 ECU_ADDRESS 0x3fc5ce /end MEASUREMENT
/begin MEASUREMENT PORT_SP_PHY "physical port flap angle setpoint (raw value)" UWORD _CNV_A_R_LINEAR_____183_CM 1 100. 0. 99.99847412 ECU_ADDRESS 0x3fc5d0 /end MEASUREMENT
/begin MEASUREMENT PORT_AV "actual value port flap" UWORD _CNV_A_R_LINEAR_____183_CM 1 100. 0. 99.99847412 ECU_ADDRESS 0x3fc5d4 /end MEASUREMENT
/begin MEASUREMENT FAC_PORT_DEAC "Relative dynamic position of the port flap" UWORD _CNV_A_R_LINEAR_____2_CM 1 100. 0. 0.99998474 ECU_ADDRESS 0x3fc5ca FORMAT "%7.5" /end MEASUREMENT
/begin AXIS_PTS ldp_n_32__port_sp_afs "" 0x61eda N_32 _REC_AXS_20_u1 816. _CNV_A_R_LINEAR_____15_CM 6 0. 8160. FORMAT "%4.0" /end AXIS_PTS
/begin AXIS_PTS ldp_n_32__port_sp_afl "" 0x61ee1 N_32 _REC_AXS_20_u1 816. _CNV_A_R_LINEAR_____15_CM 6 0. 8160. FORMAT "%4.0" /end AXIS_PTS
/begin AXIS_PTS ldp_n_32__port_sp_s "" 0x61ee8 N_32 _REC_AXS_20_u1 816. _CNV_A_R_LINEAR_____15_CM 6 0. 8160. FORMAT "%4.0" /end AXIS_PTS
/begin AXIS_PTS ldp_fac_tq_req__port_sp_afs "" 0x61ef0 FAC_TQ_REQ _REC_AXS_20_u2 1.99996948 _CNV_A_R_LINEAR_____5_CM 6 0. 1.99996948 FORMAT "%7.5" /end AXIS_PTS
/begin AXIS_PTS ldp_tco__tcoport_sp "" 0x61f0c TCO _REC_AXS_20_u1 190.5 _CNV_A_R_LINEAR_____22_CM 8 -48. 142.5 FORMAT "%5.1" /end AXIS_PTS
/begin MEASUREMENT PORT_SP_RAW "relative port deactivation setpoint (raw value)" UWORD _CNV_A_R_LINEAR_____144_CM 1 100. 0. 99.99847412 ECU_ADDRESS 0x3fc5d2 /end MEASUREMENT
/begin MEASUREMENT EXC_SP_REL "relative eccenter setpoint for variable valve lift" UWORD _CNV_A_R_LINEAR_____144_CM 1 100. 0. 99.99847412 ECU_ADDRESS 0x3fc5c6 /end MEASUREMENT
/begin AXIS_PTS ldp_exc_sp_rel__vlft_sp "" 0x61f16 EXC_SP_REL _REC_AXS_20_u2 99.99847412 _CNV_A_R_LINEAR_____144_CM 12 0. 99.99847412 /end AXIS_PTS
/begin AXIS_PTS ldp_portpwm__port_sp_phy "" 0x61f30 PORTPWM _REC_AXS_20_u2 99.99847412 _CNV_A_R_LINEAR_____144_CM 12 0. 99.99847412 /end AXIS_PTS
/begin AXIS_PTS ldp_fac_tq_req__port_sp_afl "" 0x61efe FAC_TQ_REQ _REC_AXS_20_u2 1.99996948 _CNV_A_R_LINEAR_____5_CM 6 0. 1.99996948 FORMAT "%7.5" /end AXIS_PTS
/begin AXIS_PTS ldp_fac_tq_req__port_sp_s "" 0x61f4a FAC_TQ_REQ _REC_AXS_20_u2 1.99996948 _CNV_A_R_LINEAR_____5_CM 6 0. 1.99996948 FORMAT "%7.5" /end AXIS_PTS
/begin AXIS_PTS ldp_v_port__port_av "" 0x61f58 V_PORT _REC_AXS_20_u2 4.99511719 _CNV_A_R_LINEAR_____38_CM 12 0. 4.99511719 FORMAT "%5.3" /end AXIS_PTS
/begin CHARACTERISTIC IP_PORT_SP_AFS "relative port deactivation setpoint for air/fuel stoichiometric combustion mode" MAP 0x68ab2 _REC_MAP_20_u2_u1_u2 99.99847412 _CNV_A_R_LINEAR_____144_CM 0. 99.99847412
 /begin AXIS_DESCR COM_AXIS N_32 _CNV_A_R_LINEAR_____15_CM 6 0. 8160. FORMAT "%4.0" AXIS_PTS_REF ldp_n_32__port_sp_afs /end AXIS_DESCR
 /begin AXIS_DESCR COM_AXIS FAC_TQ_REQ _CNV_A_R_LINEAR_____5_CM 6 0. 1.99996948 FORMAT "%7.5" AXIS_PTS_REF ldp_fac_tq_req__port_sp_afs /end AXIS_DESCR
/end CHARACTERISTIC
/begin CHARACTERISTIC IP_PORT_SP_AFL "relative port deactivation setpoint for air/fuel lean combustion mode" MAP 0x68afa _REC_MAP_20_u2_u1_u2 99.99847412 _CNV_A_R_LINEAR_____144_CM 0. 99.99847412
 /begin AXIS_DESCR COM_AXIS N_32 _CNV_A_R_LINEAR_____15_CM 6 0. 8160. FORMAT "%4.0" AXIS_PTS_REF ldp_n_32__port_sp_afl /end AXIS_DESCR
 /begin AXIS_DESCR COM_AXIS FAC_TQ_REQ _CNV_A_R_LINEAR_____5_CM 6 0. 1.99996948 FORMAT "%7.5" AXIS_PTS_REF ldp_fac_tq_req__port_sp_afl /end AXIS_DESCR
/end CHARACTERISTIC
/begin CHARACTERISTIC IP_FAC_TCO_PORT_SP "temperature correction of PORT_SP" CURVE 0x68b42 _REC_CUR_20_u1_u1 0.99610001 _CNV_A_R_LINEAR_____68_CM 0. 0.99610001 FORMAT "%5.3"
 /begin AXIS_DESCR COM_AXIS TCO _CNV_A_R_LINEAR_____22_CM 8 -48. 142.5 FORMAT "%5.1" AXIS_PTS_REF ldp_tco__tcoport_sp /end AXIS_DESCR
/end CHARACTERISTIC
/begin CHARACTERISTIC IP_VLFT_SP__EXC_SP_REL "valve lift vs. excenter setpoint" CURVE 0x68b4a _REC_CUR_20_u2_u2 65.535 _CNV_A_R_LINEAR_____182_CM 0. 65.535
 /begin AXIS_DESCR COM_AXIS EXC_SP_REL _CNV_A_R_LINEAR_____144_CM 12 0. 99.99847412 AXIS_PTS_REF ldp_exc_sp_rel__vlft_sp /end AXIS_DESCR
/end CHARACTERISTIC
/begin CHARACTERISTIC IP_PORT_SP_PHY__PORTPWM "port flap angle vs. port setpoint PWM" CURVE 0x68b62 _REC_CUR_20_u2_u2 99.99847412 _CNV_A_R_LINEAR_____183_CM 0. 99.99847412
 /begin AXIS_DESCR COM_AXIS PORTPWM _CNV_A_R_LINEAR_____144_CM 12 0. 99.99847412 AXIS_PTS_REF ldp_portpwm__port_sp_phy /end AXIS_DESCR
/end CHARACTERISTIC
/begin CHARACTERISTIC IP_PORT_SP_S "relative port deactivation setpoint map for stratified combustion mode" MAP 0x68b7a _REC_MAP_20_u2_u1_u2 99.99847412 _CNV_A_R_LINEAR_____144_CM 0. 99.99847412
 /begin AXIS_DESCR COM_AXIS N_32 _CNV_A_R_LINEAR_____15_CM 6 0. 8160. FORMAT "%4.0" AXIS_PTS_REF ldp_n_32__port_sp_s /end AXIS_DESCR
 /begin AXIS_DESCR COM_AXIS FAC_TQ_REQ _CNV_A_R_LINEAR_____5_CM 6 0. 1.99996948 FORMAT "%7.5" AXIS_PTS_REF ldp_fac_tq_req__port_sp_s /end AXIS_DESCR
/end CHARACTERISTIC
/begin CHARACTERISTIC IP_PORT_SP_RGN_NT "relative port deactivation setpoint map for regeneration NOX trap " MAP 0x68bc2 _REC_MAP_20_u2_u1_u2 99.99847412 _CNV_A_R_LINEAR_____144_CM 0. 99.99847412
 /begin AXIS_DESCR COM_AXIS N_32 _CNV_A_R_LINEAR_____15_CM 6 0. 8160. FORMAT "%4.0" AXIS_PTS_REF ldp_n_32__port_sp_s /end AXIS_DESCR
 /begin AXIS_DESCR COM_AXIS FAC_TQ_REQ _CNV_A_R_LINEAR_____5_CM 6 0. 1.99996948 FORMAT "%7.5" AXIS_PTS_REF ldp_fac_tq_req__port_sp_s /end AXIS_DESCR
/end CHARACTERISTIC
/begin CHARACTERISTIC IP_PORT_AV__V_PORT "conversion table for linearization of PORT_AV value acquisition" CURVE 0x68c0a _REC_CUR_20_u2_u2 99.99847412 _CNV_A_R_LINEAR_____183_CM 0. 99.99847412
 /begin AXIS_DESCR COM_AXIS V_PORT _CNV_A_R_LINEAR_____38_CM 12 0. 4.99511719 FORMAT "%5.3" AXIS_PTS_REF ldp_v_port__port_av /end AXIS_DESCR
/end CHARACTERISTIC
/begin CHARACTERISTIC C_TCO_MIN_PORT "coolant temperature minimum value for port deactivation (activation condtion)" VALUE 0x68c26 _REC_VAL_20_u1 190.5 _CNV_A_R_LINEAR_____22_CM -48. 142.5 FORMAT "%5.1" /end CHARACTERISTIC
/begin CHARACTERISTIC C_CRLC_PORT_SP "Correlation constant for PORT_SP filtering" VALUE 0x68c27 _REC_VAL_20_u1 0.99610001 _CNV_A_R_LINEAR_____68_CM 0. 0.99610001 FORMAT "%5.3" /end CHARACTERISTIC
/begin CHARACTERISTIC LC_VVL_INH_AS "logical constant for to deactivate EXC_SP_REL by application system (LC_VVL_INH_AS = 0  -> active)" VALUE 0x68c29 _REC_VAL_20_u1 1. _CNV_A_R_LINEAR_____17_CM 0. 1. FORMAT "%2.0" /end CHARACTERISTIC
/begin MEASUREMENT V_EGR "Position feedback EGR valve" UWORD _CNV_A_R_LINEAR_____38_CM 1 100. 0. 4.99511719 ECU_ADDRESS 0x3fa90e FORMAT "%5.3" /end MEASUREMENT
/begin MEASUREMENT V_DMTL "Diagnosis module tank leakage currency raw acquisition" UWORD _CNV_A_R_LINEAR_____38_CM 1 100. 0. 4.99511719 ECU_ADDRESS 0x3fa90c FORMAT "%5.3" /end MEASUREMENT
/begin MEASUREMENT V_PORT "Position feedback port flaps" UWORD _CNV_A_R_LINEAR_____38_CM 1 100. 0. 4.99511719 ECU_ADDRESS 0x3fa910 FORMAT "%5.3" /end MEASUREMENT
/begin MEASUREMENT LV_ERR_IVVT_0 "IVVT 0 Error" UBYTE _CNV_S_2_RANGE______77_R_CM 1 100. 0. 255. ECU_ADDRESS 0x3fd35c /end MEASUREMENT
/begin MEASUREMENT LV_ERR_IVVT_1 "IVVT 1 Error" UBYTE _CNV_S_2_RANGE______77_R_CM 1 100. 0. 255. ECU_ADDRESS 0x3fd35d /end MEASUREMENT
/begin CHARACTERISTIC LC_PORT_INH_AS "logical constant for to deactivate PORTPWM by application system (LC_PORT_INH_AS = 0  -> active)" VALUE 0x68c28 _REC_VAL_20_u1 1. _CNV_A_R_LINEAR_____17_CM 0. 1. FORMAT "%2.0" /end CHARACTERISTIC
/begin CHARACTERISTIC C_EXC_SP_INI "initialization value for eccenter setpoint (variable valve lift)" VALUE 0x68c24 _REC_VAL_20_u2 99.99847412 _CNV_A_R_LINEAR_____144_CM 0. 99.99847412 /end CHARACTERISTIC
/begin CHARACTERISTIC C_ABC_INC_IV "Debounce counter increment" VALUE 0x67b34 _REC_VAL_20_u1 255. _CNV_A_R_LINEAR_____13_CM 0. 255. FORMAT "%3.0" /end CHARACTERISTIC
/begin CHARACTERISTIC C_PORTPWM_INI "initialization value for port flap PWM setpoint " VALUE 0x68c22 _REC_VAL_20_u2 99.99847412 _CNV_A_R_LINEAR_____144_CM 0. 99.99847412 /end CHARACTERISTIC
/begin MEASUREMENT LV_ERR_VLS_UP_1 "General error flag for Lambda upstream sensors" UBYTE _CNV_S_2_RANGE______76_CM 1 100. 0. 1. ECU_ADDRESS 0x3fd492 BIT_MASK 0x1 /end MEASUREMENT
/begin MEASUREMENT LV_ERR_VLS_UP_2 "General error flag for Lambda upstream sensors" UBYTE _CNV_S_2_RANGE______76_CM 1 100. 0. 1. ECU_ADDRESS 0x3fd49a BIT_MASK 0x1 /end MEASUREMENT
/begin MEASUREMENT LV_ERR_VLS_DOWN_2 "General error flag for Lambda downstream sensors" UBYTE _CNV_S_2_RANGE______76_CM 1 100. 0. 1. ECU_ADDRESS 0x3fd49b BIT_MASK 0x1 /end MEASUREMENT
/begin MEASUREMENT LV_ERR_VLS_DOWN_1 "General error flag for Lambda downstream sensors" UBYTE _CNV_S_2_RANGE______76_CM 1 100. 0. 1. ECU_ADDRESS 0x3fd493 BIT_MASK 0x1 /end MEASUREMENT
/begin MEASUREMENT LV_ERR_TEG_PCAT_DOWN_1 "Temp. after precatalyst error flag" UBYTE _CNV_S_2_RANGE______77_R_CM 1 100. 0. 255. ECU_ADDRESS 0x3fd359 /end MEASUREMENT
/begin MEASUREMENT LV_ERR_TEG_PCAT_DOWN_2 "Temp. after precatalyst error flag" UBYTE _CNV_S_2_RANGE______77_R_CM 1 100. 0. 255. ECU_ADDRESS 0x3fd35a /end MEASUREMENT
/begin MEASUREMENT LV_ERR_PREL_TEG_PCAT_DOWN_2 "Temp. after precatalyst antibounce flag" UBYTE _CNV_S_2_RANGE______77_R_CM 1 100. 0. 255. ECU_ADDRESS 0x3fd53f /end MEASUREMENT
/begin MEASUREMENT LV_ERR_PREL_TEG_PCAT_DOWN_1 "Temp. after precatalyst antibounce flag" UBYTE _CNV_S_2_RANGE______77_R_CM 1 100. 0. 255. ECU_ADDRESS 0x3fd53e /end MEASUREMENT
/begin CHARACTERISTIC C_V_TEG_PCAT_DOWN_DIAG_MIN "minimum voltage threshold for erroe detection" VALUE 0x6913c _REC_VAL_20_u2 4.99511719 _CNV_A_R_LINEAR_____38_CM 0. 4.99511719 FORMAT "%5.3" /end CHARACTERISTIC
/begin CHARACTERISTIC C_V_TEG_PCAT_DOWN_DIAG_MAX "maximum voltage threshold for erroe detection" VALUE 0x6913e _REC_VAL_20_u2 4.99511719 _CNV_A_R_LINEAR_____38_CM 0. 4.99511719 FORMAT "%5.3" /end CHARACTERISTIC
/begin CHARACTERISTIC C_V_TEG_MES_GRD_MAX "maximum voltage gradient threshold for error detection" VALUE 0x69140 _REC_VAL_20_u2 4.99511719 _CNV_A_R_LINEAR_____38_CM 0. 4.99511719 FORMAT "%5.3" /end CHARACTERISTIC
/begin CHARACTERISTIC C_ABC_INC_TEG_PCAT_DOWN "debounce counter increment-TEG diagnosis" VALUE 0x69142 _REC_VAL_20_u1 255. _CNV_A_R_LINEAR_____13_CM 0. 255. FORMAT "%3.0" /end CHARACTERISTIC
/begin CHARACTERISTIC C_ABC_MAX_TEG_PCAT_DOWN "debounce counter maximumt-TEG diagnosis" VALUE 0x69143 _REC_VAL_20_u1 254. _CNV_A_R_LINEAR_____17_CM 1. 255. FORMAT "%3.0" /end CHARACTERISTIC
/begin MEASUREMENT V_TEG_PCAT_DOWN_1 "Catalyst temperature sensor raw acquisition - cylinder bank 1" UWORD _CNV_A_R_LINEAR_____38_CM 1 100. 0. 4.99511719 ECU_ADDRESS 0x3fa904 FORMAT "%5.3" /end MEASUREMENT
/begin MEASUREMENT V_TEG_PCAT_DOWN_2 "Catalyst temperature sensor raw acquisition - cylinder bank 2" UWORD _CNV_A_R_LINEAR_____38_CM 1 100. 0. 4.99511719 ECU_ADDRESS 0x3fa906 FORMAT "%5.3" /end MEASUREMENT
/begin CHARACTERISTIC ID_CRK_GAP_RATIO "" CURVE 0x69136 _REC_CUR_20_u1_u2 0.9375 _CNV_A_R_LINEAR_____87_CM 0. 0.9375 FORMAT "%6.4"
 /begin AXIS_DESCR COM_AXIS N _CNV_A_R_LINEAR_____0_CM 6 0. 8160. FORMAT "%4.0" AXIS_PTS_REF ldpm_n_id_crk_acq /end AXIS_DESCR
/end CHARACTERISTIC
/begin MEASUREMENT LV_ERR_PVS "Logical value (set, if a PVS -error is debounced)" UBYTE _CNV_S_2_RANGE______77_R_CM 1 100. 0. 255. ECU_ADDRESS 0x3fd516 /end MEASUREMENT
/begin CHARACTERISTIC C_ABC_MAX_IV "Debounce counter maximum value" VALUE 0x67b41 _REC_VAL_20_u1 254. _CNV_A_R_LINEAR_____17_CM 1. 255. FORMAT "%3.0" /end CHARACTERISTIC
/begin MEASUREMENT LV_ERR_ECT_MEC "ECT Mechanical error detected" UBYTE _CNV_S_2_RANGE______77_R_CM 1 100. 0. 255. ECU_ADDRESS 0x3fd3b8 /end MEASUREMENT
/begin CHARACTERISTIC C_TCO_ST_ECT_PLAUS_DIAG "Constant to detect a cold engine" VALUE 0x6918f _REC_VAL_20_u1 190.5 _CNV_A_R_LINEAR_____22_CM -48. 142.5 FORMAT "%5.1" /end CHARACTERISTIC
/begin CHARACTERISTIC C_TCO_TCO_EX_PLAUS_DIAG "TCO/TCO_EX Plausiblization difference" VALUE 0x69190 _REC_VAL_20_u1 190.5 _CNV_A_R_LINEAR_____23_CM 0. 190.5 FORMAT "%5.1" /end CHARACTERISTIC
/begin CHARACTERISTIC C_ABC_INC_ECT_EL "Debounce counter increment - Thermostat heating diagnosis" VALUE 0x69191 _REC_VAL_20_u1 255. _CNV_A_R_LINEAR_____13_CM 0. 255. FORMAT "%3.0" /end CHARACTERISTIC
/begin CHARACTERISTIC C_ABC_INC_ECT_MEC "Debounce counter increment - Thermostat heating diagnosis" VALUE 0x69193 _REC_VAL_20_u1 255. _CNV_A_R_LINEAR_____13_CM 0. 255. FORMAT "%3.0" /end CHARACTERISTIC
/begin CHARACTERISTIC C_ABC_MAX_ECT_EL "Debounce counter maximum value - Thermostat heating diagnosis" VALUE 0x69192 _REC_VAL_20_u1 254. _CNV_A_R_LINEAR_____17_CM 1. 255. FORMAT "%3.0" /end CHARACTERISTIC
/begin CHARACTERISTIC C_ABC_MAX_ECT_MEC "Debounce counter maximum value - Thermostat heating diagnosis" VALUE 0x69194 _REC_VAL_20_u1 254. _CNV_A_R_LINEAR_____17_CM 1. 255. FORMAT "%3.0" /end CHARACTERISTIC
/begin CHARACTERISTIC C_ECTPWM_MAX_DIAG "Maximum PWM for ECT diagnosis" VALUE 0x69195 _REC_VAL_20_u1 99.609375 _CNV_A_R_LINEAR_____16_CM 0. 99.609375 FORMAT "%4.1" /end CHARACTERISTIC
/begin CHARACTERISTIC C_ECTPWM_MIN_DIAG "Minimum PWM for ECT diagnosis" VALUE 0x69196 _REC_VAL_20_u1 99.609375 _CNV_A_R_LINEAR_____16_CM 0. 99.609375 FORMAT "%4.1" /end CHARACTERISTIC
/begin CHARACTERISTIC C_MAF_MAX_DIAG "min. mass air flow diagnostic threshold" VALUE 0x67bde _REC_VAL_20_u2 614.390625 _CNV_A_R_LINEAR_____52_CM 0. 2047.96875 FORMAT "%6.2" /end CHARACTERISTIC
/begin CHARACTERISTIC C_VVTPWM_AS "VVT enable PWM from application system" VALUE 0x67d7c _REC_VAL_20_u2 99.99847412 _CNV_A_R_LINEAR_____144_CM 0. 99.99847412 /end CHARACTERISTIC
/begin MEASUREMENT LV_ERR_ECT_EL "ECT Electrical error detected" UBYTE _CNV_S_2_RANGE______77_R_CM 1 100. 0. 255. ECU_ADDRESS 0x3fd3b9 /end MEASUREMENT
/begin MEASUREMENT LV_ERR_ECT "ECT error detected" UBYTE _CNV_S_2_RANGE______77_R_CM 1 100. 0. 255. ECU_ADDRESS 0x3fd476 /end MEASUREMENT
/begin MEASUREMENT BIOS_CRU_DATA "status off MSW module" UBYTE _CNV_S_5_RANGE_BIOS_204_R_CM 1 100. 110. 255. ECU_ADDRESS 0x3fa97a /end MEASUREMENT
/begin MEASUREMENT LV_ERR_AMP "Error of the ambient pressure sensor" UBYTE _CNV_S_2_RANGE______77_R_CM 1 100. 0. 255. ECU_ADDRESS 0x3fd358 /end MEASUREMENT
/begin CHARACTERISTIC C_ABC_INC_AMP "Anti - bounce counter increment" VALUE 0x67b32 _REC_VAL_20_u1 10.2 _CNV_A_R_LINEAR_____13_CM 0. 255. FORMAT "%3.0" /end CHARACTERISTIC
/begin CHARACTERISTIC C_ABC_MAX_LAM_LIM "Debounce counter maximum value" VALUE 0x67b42 _REC_VAL_20_u1 254. _CNV_A_R_LINEAR_____17_CM 1. 255. FORMAT "%3.0" /end CHARACTERISTIC
/begin MEASUREMENT LV_ERR_IGC "General error flag for ignition" UBYTE _CNV_S_2_RANGE______77_R_CM 1 100. 0. 255. ECU_ADDRESS 0x3fd4b7 /end MEASUREMENT
/begin CHARACTERISTIC C_ISAPWM_AS "ISA control PWM from application system" VALUE 0x691b2 _REC_VAL_20_u2 99.99847412 _CNV_A_R_LINEAR_____144_CM 0. 99.99847412 /end CHARACTERISTIC
/begin CHARACTERISTIC LC_POW_CORD_INH "Configuration of alternator powermanagement" VALUE 0x69bf0 _REC_VAL_20_u1 1. _CNV_A_R_LINEAR_____13_CM 0. 1. FORMAT "%1.0" /end CHARACTERISTIC
/begin AXIS_PTS ldp_id_maf_tab_1 "" 0x6153a INDEX_1 _REC_AXS_20_u1 255. _CNV_A_R_LINEAR_____13_CM 16 0. 255. FORMAT "%3.0" /end AXIS_PTS
/begin AXIS_PTS ldp_id_saf_tab_1 "" 0x6218d INDEX_1 _REC_AXS_20_u1 255. _CNV_A_R_LINEAR_____13_CM 16 0. 255. FORMAT "%3.0" /end AXIS_PTS
/begin AXIS_PTS ldp_id_maf_tab_2 "" 0x6154b INDEX_2 _REC_AXS_20_u1 255. _CNV_A_R_LINEAR_____13_CM 16 0. 255. FORMAT "%3.0" /end AXIS_PTS
/begin AXIS_PTS ldp_id_saf_tab_2 "" 0x6219e INDEX_2 _REC_AXS_20_u1 255. _CNV_A_R_LINEAR_____13_CM 16 0. 255. FORMAT "%3.0" /end AXIS_PTS
/begin CHARACTERISTIC ID_MAF_TAB "conversion table for MAF value" MAP 0x65538 _REC_MAP_20_u2_u1_u1 1023.984375 _CNV_A_R_LINEAR_____219_CM 0. 1023.984375 FORMAT "%7.2"
 /begin AXIS_DESCR COM_AXIS ONLINE_DUMMY _CNV_A_R_LINEAR_____13_CM 16 0. 255. FORMAT "%3.0" AXIS_PTS_REF ldp_id_maf_tab_1 /end AXIS_DESCR
 /begin AXIS_DESCR COM_AXIS ONLINE_DUMMY _CNV_A_R_LINEAR_____13_CM 16 0. 255. FORMAT "%3.0" AXIS_PTS_REF ldp_id_maf_tab_2 /end AXIS_DESCR
/end CHARACTERISTIC
/begin CHARACTERISTIC ID_SAF_TAB "conversion table for SAF value" MAP 0x69bf2 _REC_MAP_20_u2_u1_u1 1023.984375 _CNV_A_R_LINEAR_____219_CM 0. 1023.984375 FORMAT "%7.2"
 /begin AXIS_DESCR COM_AXIS ONLINE_DUMMY _CNV_A_R_LINEAR_____13_CM 16 0. 255. FORMAT "%3.0" AXIS_PTS_REF ldp_id_saf_tab_1 /end AXIS_DESCR
 /begin AXIS_DESCR COM_AXIS ONLINE_DUMMY _CNV_A_R_LINEAR_____13_CM 16 0. 255. FORMAT "%3.0" AXIS_PTS_REF ldp_id_saf_tab_2 /end AXIS_DESCR
/end CHARACTERISTIC
/begin MEASUREMENT SAF_KGH_CLC "SA mass flow" UWORD _CNV_A_R_LINEAR_____219_CM 1 100. 0. 1023.984375 ECU_ADDRESS 0x3fce96 FORMAT "%7.2" /end MEASUREMENT
/begin MEASUREMENT T_DLY_SA_ACT "Time after Start of secondary air function for very slow SAF-calculation" UWORD _CNV_A_R_LINEAR_____21_CM 1 100. 0. 655.35 ECU_ADDRESS 0x3fce94 FORMAT "%6.2" /end MEASUREMENT
/begin AXIS_PTS ldp_maf_cyl__saf_mdl "secondary air mass flow depending of MAF_CYL" 0x612bc MAF_CYL _REC_AXS_20_u2 2047.96875 _CNV_A_R_LINEAR_____52_CM 8 0. 2047.96875 FORMAT "%7.2" /end AXIS_PTS
/begin AXIS_PTS ldp_amp__saf_cor_amp "correction of secondary air mass flow depending of ambient pressure" 0x612d8 AMP _REC_AXS_20_u2 5434. _CNV_A_R_LINEAR_____1_CM 8 0. 5434. FORMAT "%7.2" /end AXIS_PTS
/begin AXIS_PTS ldp_vb__saf_cor_vb "correction of secondary air mass flow depending of battery voltage" 0x612ce VB _REC_AXS_20_u1 26. _CNV_A_R_LINEAR_____188_CM 8 0. 26. FORMAT "%4.1" /end AXIS_PTS
/begin AXIS_PTS ldp_tia__saf_cor_tia "correction of secondary air mass flow depending of ambient temperature" 0x612ea TIA _REC_AXS_20_u1 190.5 _CNV_A_R_LINEAR_____22_CM 8 -48. 142.5 FORMAT "%5.1" /end AXIS_PTS
/begin CHARACTERISTIC C_T_DLY_SA_ACT "Delaytime after start of secondary air function for very slow SAF-calculation  " VALUE 0x64616 _REC_VAL_20_u2 655.35 _CNV_A_R_LINEAR_____21_CM 0. 655.35 FORMAT "%6.2" /end CHARACTERISTIC
/begin CHARACTERISTIC C_CRLC_SAF_ST "Correlation constant of secondary air mass flow after the start of SA" VALUE 0x64618 _REC_VAL_20_u1 0.9960940000000002 _CNV_A_R_LINEAR_____8_CM 0. 0.996094 FORMAT "%5.3" /end CHARACTERISTIC
/begin CHARACTERISTIC C_CRLC_SAF "Correlation constant of secondary air mass flow" VALUE 0x64619 _REC_VAL_20_u1 0.9960940000000002 _CNV_A_R_LINEAR_____8_CM 0. 0.996094 FORMAT "%5.3" /end CHARACTERISTIC
/begin MEASUREMENT SAF_KGH "corrected value of SA mass flow" UWORD _CNV_A_R_LINEAR_____219_CM 1 100. 0. 1023.984375 ECU_ADDRESS 0x3fce90 FORMAT "%7.2" /end MEASUREMENT
/begin CHARACTERISTIC IP_SAF_MDL "secondary air mass flow depending of MAF_CYL" CURVE 0x6461a _REC_CUR_20_u2_u2 1023.984375 _CNV_A_R_LINEAR_____219_CM 0. 1023.984375 FORMAT "%7.2"
 /begin AXIS_DESCR COM_AXIS MAF_CYL _CNV_A_R_LINEAR_____52_CM 8 0. 2047.96875 FORMAT "%7.2" AXIS_PTS_REF ldp_maf_cyl__saf_mdl /end AXIS_DESCR
/end CHARACTERISTIC
/begin CHARACTERISTIC IP_SAF_COR_VB "correction of secondary air mass flow depending of VB" CURVE 0x6462a _REC_CUR_20_u2_u1 1023.984375 _CNV_A_R_LINEAR_____219_CM 0. 1023.984375 FORMAT "%7.2"
 /begin AXIS_DESCR COM_AXIS VB _CNV_A_R_LINEAR_____188_CM 8 0. 26. FORMAT "%4.1" AXIS_PTS_REF ldp_vb__saf_cor_vb /end AXIS_DESCR
/end CHARACTERISTIC
/begin CHARACTERISTIC IP_SAF_COR_AMP "correction of secondary air mass flow depending of AMP" CURVE 0x6463a _REC_CUR_20_u1_u2 0.99610001 _CNV_A_R_LINEAR_____68_CM 0. 0.99610001 FORMAT "%5.3"
 /begin AXIS_DESCR COM_AXIS AMP _CNV_A_R_LINEAR_____1_CM 8 0. 5434. FORMAT "%7.2" AXIS_PTS_REF ldp_amp__saf_cor_amp /end AXIS_DESCR
/end CHARACTERISTIC
/begin CHARACTERISTIC IP_SAF_COR_TIA "correction of secondary air mass flow depending of TIA" CURVE 0x64642 _REC_CUR_20_u1_u1 0.99610001 _CNV_A_R_LINEAR_____68_CM 0. 0.99610001 FORMAT "%5.3"
 /begin AXIS_DESCR COM_AXIS TIA _CNV_A_R_LINEAR_____22_CM 8 -48. 142.5 FORMAT "%5.1" AXIS_PTS_REF ldp_tia__saf_cor_tia /end AXIS_DESCR
/end CHARACTERISTIC
/begin MEASUREMENT CTR_ABC_TEG_PCAT_DOWN_1 "" UBYTE _CNV_A_R_LINEAR_____13_CM 1 100. 0. 255. ECU_ADDRESS 0x3fc2da FORMAT "%3.0" /end MEASUREMENT
/begin MEASUREMENT ERR_INFO_STAT "" UWORD _CNV_S_2_RANGE______77_R_CM 1 100. 0. 255. ECU_ADDRESS 0x3fc2dc /end MEASUREMENT
/begin MEASUREMENT LV_ERR_DET_TEG_PCAT_DOWN_1 "" UWORD _CNV_S_2_RANGE______77_R_CM 1 100. 0. 255. ECU_ADDRESS 0x3fc2dc BIT_MASK 0x100 /end MEASUREMENT
/begin MEASUREMENT LV_ERR_SYM_CHG_TEG_PCAT_DOWN_1 "" UWORD _CNV_S_2_RANGE______77_R_CM 1 100. 0. 255. ECU_ADDRESS 0x3fc2dc BIT_MASK 0x400 /end MEASUREMENT
/begin MEASUREMENT LV_CDN_DIAG_TEG_PCAT_DOWN_1 "" UWORD _CNV_S_2_RANGE______77_R_CM 1 100. 0. 255. ECU_ADDRESS 0x3fc2dc BIT_MASK 0x800 /end MEASUREMENT
/begin MEASUREMENT ERR_SYM_TEG_PCAT_DOWN_1 "" UWORD _CNV_S_5_RANGE_ERR__323_CM 1 100. 0. 8. ECU_ADDRESS 0x3fc2dc BIT_MASK 0xF /end MEASUREMENT
/begin MEASUREMENT LV_END_DIAG_TEG_PCAT_DOWN_1 "" UWORD _CNV_S_2_RANGE______77_R_CM 1 100. 0. 255. ECU_ADDRESS 0x3fc2dc BIT_MASK 0x1000 /end MEASUREMENT
/begin MEASUREMENT CTR_ABC_END_TEG_PCAT_DOWN_1 "" UBYTE _CNV_A_R_LINEAR_____13_CM 1 100. 0. 255. ECU_ADDRESS 0x3fc2de FORMAT "%3.0" /end MEASUREMENT
/begin MEASUREMENT CTR_ABC_TEG_PCAT_DOWN_2 "" UBYTE _CNV_A_R_LINEAR_____13_CM 1 100. 0. 255. ECU_ADDRESS 0x3fc2e0 FORMAT "%3.0" /end MEASUREMENT
/begin MEASUREMENT LV_ERR_DET_TEG_PCAT_DOWN_2 "" UWORD _CNV_S_2_RANGE______77_R_CM 1 100. 0. 255. ECU_ADDRESS 0x3fc2e2 BIT_MASK 0x100 /end MEASUREMENT
/begin MEASUREMENT LV_ERR_SYM_CHG_TEG_PCAT_DOWN_2 "" UWORD _CNV_S_2_RANGE______77_R_CM 1 100. 0. 255. ECU_ADDRESS 0x3fc2e2 BIT_MASK 0x400 /end MEASUREMENT
/begin MEASUREMENT LV_CDN_DIAG_TEG_PCAT_DOWN_2 "" UWORD _CNV_S_2_RANGE______77_R_CM 1 100. 0. 255. ECU_ADDRESS 0x3fc2e2 BIT_MASK 0x800 /end MEASUREMENT
/begin MEASUREMENT ERR_SYM_TEG_PCAT_DOWN_2 "" UWORD _CNV_S_5_RANGE_ERR__323_CM 1 100. 0. 8. ECU_ADDRESS 0x3fc2e2 BIT_MASK 0xF /end MEASUREMENT
/begin MEASUREMENT LV_END_DIAG_TEG_PCAT_DOWN_2 "" UWORD _CNV_S_2_RANGE______77_R_CM 1 100. 0. 255. ECU_ADDRESS 0x3fc2e2 BIT_MASK 0x1000 /end MEASUREMENT
/begin MEASUREMENT CTR_ABC_END_DIAG_TEG_PCAT_DOWN_2 "" UBYTE _CNV_A_R_LINEAR_____13_CM 1 100. 0. 255. ECU_ADDRESS 0x3fc2e4 FORMAT "%3.0" /end MEASUREMENT
/begin MEASUREMENT CTR_ABC_TCO_EX "" UBYTE _CNV_A_R_LINEAR_____13_CM 1 100. 0. 255. ECU_ADDRESS 0x3fc2ec FORMAT "%3.0" /end MEASUREMENT
/begin MEASUREMENT LV_ERR_DET_TCO_EX "" UWORD _CNV_S_2_RANGE______77_R_CM 1 100. 0. 255. ECU_ADDRESS 0x3fc2ee BIT_MASK 0x100 /end MEASUREMENT
/begin MEASUREMENT LV_ERR_SYM_CHG_TCO_EX "" UWORD _CNV_S_2_RANGE______77_R_CM 1 100. 0. 255. ECU_ADDRESS 0x3fc2ee BIT_MASK 0x400 /end MEASUREMENT
/begin MEASUREMENT LV_CDN_DIAG_TCO_EX "" UWORD _CNV_S_2_RANGE______77_R_CM 1 100. 0. 255. ECU_ADDRESS 0x3fc2ee BIT_MASK 0x800 /end MEASUREMENT
/begin MEASUREMENT ERR_SYM_TCO_EX "" UWORD _CNV_S_5_RANGE_ERR__323_CM 1 100. 0. 8. ECU_ADDRESS 0x3fc2ee BIT_MASK 0xF /end MEASUREMENT
/begin MEASUREMENT LV_END_DIAG_TCO_EX "" UWORD _CNV_S_2_RANGE______77_R_CM 1 100. 0. 255. ECU_ADDRESS 0x3fc2ee BIT_MASK 0x1000 /end MEASUREMENT
/begin MEASUREMENT CTR_ABC_END_DIAG_TCO_EX "" UBYTE _CNV_A_R_LINEAR_____13_CM 1 100. 0. 255. ECU_ADDRESS 0x3fc2f0 FORMAT "%3.0" /end MEASUREMENT
/begin MEASUREMENT CTR_ABC_TIA "" UBYTE _CNV_A_R_LINEAR_____13_CM 1 100. 0. 255. ECU_ADDRESS 0x3fc2f2 FORMAT "%3.0" /end MEASUREMENT
/begin MEASUREMENT LV_ERR_DET_TIA "" UWORD _CNV_S_2_RANGE______77_R_CM 1 100. 0. 255. ECU_ADDRESS 0x3fc2f4 BIT_MASK 0x100 /end MEASUREMENT
/begin MEASUREMENT LV_ERR_SYM_CHG_TIA "" UWORD _CNV_S_2_RANGE______77_R_CM 1 100. 0. 255. ECU_ADDRESS 0x3fc2f4 BIT_MASK 0x400 /end MEASUREMENT
/begin MEASUREMENT LV_CDN_DIAG_TIA "" UWORD _CNV_S_2_RANGE______77_R_CM 1 100. 0. 255. ECU_ADDRESS 0x3fc2f4 BIT_MASK 0x800 /end MEASUREMENT
/begin MEASUREMENT ERR_SYM_TIA "" UWORD _CNV_S_5_RANGE_ERR__323_CM 1 100. 0. 8. ECU_ADDRESS 0x3fc2f4 BIT_MASK 0xF /end MEASUREMENT
/begin MEASUREMENT LV_END_DIAG_TIA "" UWORD _CNV_S_2_RANGE______77_R_CM 1 100. 0. 255. ECU_ADDRESS 0x3fc2f4 BIT_MASK 0x1000 /end MEASUREMENT
/begin MEASUREMENT CTR_ABC_END_DIAG_TIA "" UBYTE _CNV_A_R_LINEAR_____13_CM 1 100. 0. 255. ECU_ADDRESS 0x3fc2f6 FORMAT "%3.0" /end MEASUREMENT
/begin MEASUREMENT CTR_ABC_AMP "" UBYTE _CNV_A_R_LINEAR_____13_CM 1 100. 0. 255. ECU_ADDRESS 0x3fc2f8 FORMAT "%3.0" /end MEASUREMENT
/begin MEASUREMENT LV_ERR_DET_AMP "" UWORD _CNV_S_2_RANGE______77_R_CM 1 100. 0. 255. ECU_ADDRESS 0x3fc2fa BIT_MASK 0x100 /end MEASUREMENT
/begin MEASUREMENT LV_ERR_SYM_CHG_AMP "" UWORD _CNV_S_2_RANGE______77_R_CM 1 100. 0. 255. ECU_ADDRESS 0x3fc2fa BIT_MASK 0x400 /end MEASUREMENT
/begin MEASUREMENT LV_CDN_DIAG_AMP "" UWORD _CNV_S_2_RANGE______77_R_CM 1 100. 0. 255. ECU_ADDRESS 0x3fc2fa BIT_MASK 0x800 /end MEASUREMENT
/begin MEASUREMENT ERR_SYM_AMP "" UWORD _CNV_S_5_RANGE_ERR__323_CM 1 100. 0. 8. ECU_ADDRESS 0x3fc2fa BIT_MASK 0xF /end MEASUREMENT
/begin MEASUREMENT LV_END_DIAG_AMP "" UWORD _CNV_S_2_RANGE______77_R_CM 1 100. 0. 255. ECU_ADDRESS 0x3fc2fa BIT_MASK 0x1000 /end MEASUREMENT
/begin MEASUREMENT CTR_ABC_END_DIAG_AMP "" UBYTE _CNV_A_R_LINEAR_____13_CM 1 100. 0. 255. ECU_ADDRESS 0x3fc2fc FORMAT "%3.0" /end MEASUREMENT
/begin MEASUREMENT CTR_ABC_MAF "" UBYTE _CNV_A_R_LINEAR_____13_CM 1 100. 0. 255. ECU_ADDRESS 0x3fc2fe FORMAT "%3.0" /end MEASUREMENT
/begin MEASUREMENT LV_ERR_DET_MAF "" UWORD _CNV_S_2_RANGE______77_R_CM 1 100. 0. 255. ECU_ADDRESS 0x3fc300 BIT_MASK 0x100 /end MEASUREMENT
/begin MEASUREMENT LV_ERR_SYM_CHG_MAF "" UWORD _CNV_S_2_RANGE______77_R_CM 1 100. 0. 255. ECU_ADDRESS 0x3fc300 BIT_MASK 0x400 /end MEASUREMENT
/begin MEASUREMENT LV_CDN_DIAG_MAF "" UWORD _CNV_S_2_RANGE______77_R_CM 1 100. 0. 255. ECU_ADDRESS 0x3fc300 BIT_MASK 0x800 /end MEASUREMENT
/begin MEASUREMENT ERR_SYM_MAF "" UWORD _CNV_S_5_RANGE_ERR__323_CM 1 100. 0. 8. ECU_ADDRESS 0x3fc300 BIT_MASK 0xF /end MEASUREMENT
/begin MEASUREMENT LV_END_DIAG_MAF "" UWORD _CNV_S_2_RANGE______77_R_CM 1 100. 0. 255. ECU_ADDRESS 0x3fc300 BIT_MASK 0x1000 /end MEASUREMENT
/begin MEASUREMENT CTR_ABC_END_DIAG_MAF "" UBYTE _CNV_A_R_LINEAR_____13_CM 1 100. 0. 255. ECU_ADDRESS 0x3fc302 FORMAT "%3.0" /end MEASUREMENT
/begin MEASUREMENT CTR_ABC_VLS_UP_SCB_1 "" UBYTE _CNV_A_R_LINEAR_____13_CM 1 100. 0. 255. ECU_ADDRESS 0x3fc304 FORMAT "%3.0" /end MEASUREMENT
/begin MEASUREMENT LV_ERR_DET_VLS_UP_SCB_1 "" UWORD _CNV_S_2_RANGE______77_R_CM 1 100. 0. 255. ECU_ADDRESS 0x3fc306 BIT_MASK 0x100 /end MEASUREMENT
/begin MEASUREMENT LV_ERR_SYM_CHG_VLS_UP_SCB_1 "" UWORD _CNV_S_2_RANGE______77_R_CM 1 100. 0. 255. ECU_ADDRESS 0x3fc306 BIT_MASK 0x400 /end MEASUREMENT
/begin MEASUREMENT LV_CDN_DIAG_VLS_UP_SCB_1 "" UWORD _CNV_S_2_RANGE______77_R_CM 1 100. 0. 255. ECU_ADDRESS 0x3fc306 BIT_MASK 0x800 /end MEASUREMENT
/begin MEASUREMENT ERR_SYM_VLS_UP_SCB_1 "" UWORD _CNV_S_5_RANGE_ERR__323_CM 1 100. 0. 8. ECU_ADDRESS 0x3fc306 BIT_MASK 0xF /end MEASUREMENT
/begin MEASUREMENT LV_END_DIAG_VLS_UP_SCB_1 "" UWORD _CNV_S_2_RANGE______77_R_CM 1 100. 0. 255. ECU_ADDRESS 0x3fc306 BIT_MASK 0x1000 /end MEASUREMENT
/begin MEASUREMENT CTR_ABC_END_DIAG_VLS_UP_SCB_1 "" UBYTE _CNV_A_R_LINEAR_____13_CM 1 100. 0. 255. ECU_ADDRESS 0x3fc308 FORMAT "%3.0" /end MEASUREMENT
/begin MEASUREMENT CTR_ABC_VLS_UP_SCB_2 "" UBYTE _CNV_A_R_LINEAR_____13_CM 1 100. 0. 255. ECU_ADDRESS 0x3fc30a FORMAT "%3.0" /end MEASUREMENT
/begin MEASUREMENT LV_ERR_DET_VLS_UP_SCB_2 "" UWORD _CNV_S_2_RANGE______77_R_CM 1 100. 0. 255. ECU_ADDRESS 0x3fc30c BIT_MASK 0x100 /end MEASUREMENT
/begin MEASUREMENT LV_ERR_SYM_CHG_VLS_UP_SCB_2 "" UWORD _CNV_S_2_RANGE______77_R_CM 1 100. 0. 255. ECU_ADDRESS 0x3fc30c BIT_MASK 0x400 /end MEASUREMENT
/begin MEASUREMENT LV_CDN_DIAG_VLS_UP_SCB_2 "" UWORD _CNV_S_2_RANGE______77_R_CM 1 100. 0. 255. ECU_ADDRESS 0x3fc30c BIT_MASK 0x800 /end MEASUREMENT
/begin MEASUREMENT ERR_SYM_VLS_UP_SCB_2 "" UWORD _CNV_S_5_RANGE_ERR__323_CM 1 100. 0. 8. ECU_ADDRESS 0x3fc30c BIT_MASK 0xF /end MEASUREMENT
/begin MEASUREMENT LV_END_DIAG_VLS_UP_SCB_2 "" UWORD _CNV_S_2_RANGE______77_R_CM 1 100. 0. 255. ECU_ADDRESS 0x3fc30c BIT_MASK 0x1000 /end MEASUREMENT
/begin MEASUREMENT CTR_ABC_END_DIAG_VLS_UP_SCB_2 "" UBYTE _CNV_A_R_LINEAR_____13_CM 1 100. 0. 255. ECU_ADDRESS 0x3fc30e FORMAT "%3.0" /end MEASUREMENT
/begin MEASUREMENT CTR_ABC_VLS_UP_SCG_1 "" UBYTE _CNV_A_R_LINEAR_____13_CM 1 100. 0. 255. ECU_ADDRESS 0x3fc310 FORMAT "%3.0" /end MEASUREMENT
/begin MEASUREMENT LV_ERR_DET_VLS_UP_SCG_1 "" UWORD _CNV_S_2_RANGE______77_R_CM 1 100. 0. 255. ECU_ADDRESS 0x3fc312 BIT_MASK 0x100 /end MEASUREMENT
/begin MEASUREMENT LV_ERR_SYM_CHG_VLS_UP_SCG_1 "" UWORD _CNV_S_2_RANGE______77_R_CM 1 100. 0. 255. ECU_ADDRESS 0x3fc312 BIT_MASK 0x400 /end MEASUREMENT
/begin MEASUREMENT LV_CDN_DIAG_VLS_UP_SCG_1 "" UWORD _CNV_S_2_RANGE______77_R_CM 1 100. 0. 255. ECU_ADDRESS 0x3fc312 BIT_MASK 0x800 /end MEASUREMENT
/begin MEASUREMENT ERR_SYM_VLS_UP_SCG_1 "" UWORD _CNV_S_5_RANGE_ERR__323_CM 1 100. 0. 8. ECU_ADDRESS 0x3fc312 BIT_MASK 0xF /end MEASUREMENT
/begin MEASUREMENT LV_END_DIAG_VLS_UP_SCG_1 "" UWORD _CNV_S_2_RANGE______77_R_CM 1 100. 0. 255. ECU_ADDRESS 0x3fc312 BIT_MASK 0x1000 /end MEASUREMENT
/begin MEASUREMENT CTR_ABC_END_DIAG_VLS_UP_SCG_1 "" UBYTE _CNV_A_R_LINEAR_____13_CM 1 100. 0. 255. ECU_ADDRESS 0x3fc314 FORMAT "%3.0" /end MEASUREMENT
/begin MEASUREMENT CTR_ABC_VLS_UP_SCG_2 "" UBYTE _CNV_A_R_LINEAR_____13_CM 1 100. 0. 255. ECU_ADDRESS 0x3fc316 FORMAT "%3.0" /end MEASUREMENT
/begin MEASUREMENT LV_ERR_DET_VLS_UP_SCG_2 "" UWORD _CNV_S_2_RANGE______77_R_CM 1 100. 0. 255. ECU_ADDRESS 0x3fc318 BIT_MASK 0x100 /end MEASUREMENT
/begin MEASUREMENT LV_ERR_SYM_CHG_VLS_UP_SCG_2 "" UWORD _CNV_S_2_RANGE______77_R_CM 1 100. 0. 255. ECU_ADDRESS 0x3fc318 BIT_MASK 0x400 /end MEASUREMENT
/begin MEASUREMENT LV_CDN_DIAG_VLS_UP_SCG_2 "" UWORD _CNV_S_2_RANGE______77_R_CM 1 100. 0. 255. ECU_ADDRESS 0x3fc318 BIT_MASK 0x800 /end MEASUREMENT
/begin MEASUREMENT ERR_SYM_VLS_UP_SCG_2 "" UWORD _CNV_S_5_RANGE_ERR__323_CM 1 100. 0. 8. ECU_ADDRESS 0x3fc318 BIT_MASK 0xF /end MEASUREMENT
/begin MEASUREMENT LV_END_DIAG_VLS_UP_SCG_2 "" UWORD _CNV_S_2_RANGE______77_R_CM 1 100. 0. 255. ECU_ADDRESS 0x3fc318 BIT_MASK 0x1000 /end MEASUREMENT
/begin MEASUREMENT CTR_ABC_END_DIAG_VLS_UP_SCG_2 "" UBYTE _CNV_A_R_LINEAR_____13_CM 1 100. 0. 255. ECU_ADDRESS 0x3fc31a FORMAT "%3.0" /end MEASUREMENT
/begin MEASUREMENT CTR_ABC_VLS_UP_OL_1 "" UBYTE _CNV_A_R_LINEAR_____13_CM 1 100. 0. 255. ECU_ADDRESS 0x3fc31c FORMAT "%3.0" /end MEASUREMENT
/begin MEASUREMENT LV_ERR_DET_VLS_UP_OL_1 "" UWORD _CNV_S_2_RANGE______77_R_CM 1 100. 0. 255. ECU_ADDRESS 0x3fc31e BIT_MASK 0x100 /end MEASUREMENT
/begin MEASUREMENT LV_ERR_SYM_CHG_VLS_UP_OL_1 "" UWORD _CNV_S_2_RANGE______77_R_CM 1 100. 0. 255. ECU_ADDRESS 0x3fc31e BIT_MASK 0x400 /end MEASUREMENT
/begin MEASUREMENT LV_CDN_DIAG_VLS_UP_OL_1 "" UWORD _CNV_S_2_RANGE______77_R_CM 1 100. 0. 255. ECU_ADDRESS 0x3fc31e BIT_MASK 0x800 /end MEASUREMENT
/begin MEASUREMENT ERR_SYM_VLS_UP_OL_1 "" UWORD _CNV_S_5_RANGE_ERR__323_CM 1 100. 0. 8. ECU_ADDRESS 0x3fc31e BIT_MASK 0xF /end MEASUREMENT
/begin MEASUREMENT LV_END_DIAG_VLS_UP_OL_1 "" UWORD _CNV_S_2_RANGE______77_R_CM 1 100. 0. 255. ECU_ADDRESS 0x3fc31e BIT_MASK 0x1000 /end MEASUREMENT
/begin MEASUREMENT CTR_ABC_END_DIAG_OL_1 "" UBYTE _CNV_A_R_LINEAR_____13_CM 1 100. 0. 255. ECU_ADDRESS 0x3fc320 FORMAT "%3.0" /end MEASUREMENT
/begin MEASUREMENT CTR_ABC_VLS_UP_OL_2 "" UBYTE _CNV_A_R_LINEAR_____13_CM 1 100. 0. 255. ECU_ADDRESS 0x3fc322 FORMAT "%3.0" /end MEASUREMENT
/begin MEASUREMENT LV_ERR_DET_VLS_UP_OL_2 "" UWORD _CNV_S_2_RANGE______77_R_CM 1 100. 0. 255. ECU_ADDRESS 0x3fc324 BIT_MASK 0x100 /end MEASUREMENT
/begin MEASUREMENT LV_ERR_SYM_CHG_VLS_UP_OL_2 "" UWORD _CNV_S_2_RANGE______77_R_CM 1 100. 0. 255. ECU_ADDRESS 0x3fc324 BIT_MASK 0x400 /end MEASUREMENT
/begin MEASUREMENT LV_CDN_DIAG_VLS_UP_OL_2 "" UWORD _CNV_S_2_RANGE______77_R_CM 1 100. 0. 255. ECU_ADDRESS 0x3fc324 BIT_MASK 0x800 /end MEASUREMENT
/begin MEASUREMENT ERR_SYM_VLS_UP_OL_2 "" UWORD _CNV_S_5_RANGE_ERR__323_CM 1 100. 0. 8. ECU_ADDRESS 0x3fc324 BIT_MASK 0xF /end MEASUREMENT
/begin MEASUREMENT LV_END_DIAG_VLS_UP_OL_2 "" UWORD _CNV_S_2_RANGE______77_R_CM 1 100. 0. 255. ECU_ADDRESS 0x3fc324 BIT_MASK 0x1000 /end MEASUREMENT
/begin MEASUREMENT CTR_ABC_END_DIAG_OL_2 "" UBYTE _CNV_A_R_LINEAR_____13_CM 1 100. 0. 255. ECU_ADDRESS 0x3fc326 FORMAT "%3.0" /end MEASUREMENT
/begin MEASUREMENT CTR_ABC_VLS_DOWN_SCB_1 "" UBYTE _CNV_A_R_LINEAR_____13_CM 1 100. 0. 255. ECU_ADDRESS 0x3fc328 FORMAT "%3.0" /end MEASUREMENT
/begin MEASUREMENT LV_ERR_DET_VLS_DOWN_SCB_1 "" UWORD _CNV_S_2_RANGE______77_R_CM 1 100. 0. 255. ECU_ADDRESS 0x3fc32a BIT_MASK 0x100 /end MEASUREMENT
/begin MEASUREMENT LV_ERR_SYM_CHG_VLS_DOWN_SCB_1 "" UWORD _CNV_S_2_RANGE______77_R_CM 1 100. 0. 255. ECU_ADDRESS 0x3fc32a BIT_MASK 0x400 /end MEASUREMENT
/begin MEASUREMENT LV_CDN_DIAG_VLS_DOWN_SCB_1 "" UWORD _CNV_S_2_RANGE______77_R_CM 1 100. 0. 255. ECU_ADDRESS 0x3fc32a BIT_MASK 0x800 /end MEASUREMENT
/begin MEASUREMENT ERR_SYM_VLS_DOWN_SCB_1 "" UWORD _CNV_S_5_RANGE_ERR__323_CM 1 100. 0. 8. ECU_ADDRESS 0x3fc32a BIT_MASK 0xF /end MEASUREMENT
/begin MEASUREMENT LV_END_DIAG_VLS_DOWN_SCB_1 "" UWORD _CNV_S_2_RANGE______77_R_CM 1 100. 0. 255. ECU_ADDRESS 0x3fc32a BIT_MASK 0x1000 /end MEASUREMENT
/begin MEASUREMENT CTR_ABC_END_DIAG_DOWN_SCB_1 "" UBYTE _CNV_A_R_LINEAR_____13_CM 1 100. 0. 255. ECU_ADDRESS 0x3fc32c FORMAT "%3.0" /end MEASUREMENT
/begin MEASUREMENT CTR_ABC_VLS_DOWN_SCB_2 "" UBYTE _CNV_A_R_LINEAR_____13_CM 1 100. 0. 255. ECU_ADDRESS 0x3fc32e FORMAT "%3.0" /end MEASUREMENT
/begin MEASUREMENT LV_ERR_DET_VLS_DOWN_SCB_2 "" UWORD _CNV_S_2_RANGE______77_R_CM 1 100. 0. 255. ECU_ADDRESS 0x3fc330 BIT_MASK 0x100 /end MEASUREMENT
/begin MEASUREMENT LV_ERR_SYM_CHG_VLS_DOWN_SCB_2 "" UWORD _CNV_S_2_RANGE______77_R_CM 1 100. 0. 255. ECU_ADDRESS 0x3fc330 BIT_MASK 0x400 /end MEASUREMENT
/begin MEASUREMENT LV_CDN_DIAG_VLS_DOWN_SCB_2 "" UWORD _CNV_S_2_RANGE______77_R_CM 1 100. 0. 255. ECU_ADDRESS 0x3fc330 BIT_MASK 0x800 /end MEASUREMENT
/begin MEASUREMENT ERR_SYM_VLS_DOWN_SCB_2 "" UWORD _CNV_S_5_RANGE_ERR__323_CM 1 100. 0. 8. ECU_ADDRESS 0x3fc330 BIT_MASK 0xF /end MEASUREMENT
/begin MEASUREMENT LV_END_DIAG_VLS_DOWN_SCB_2 "" UWORD _CNV_S_2_RANGE______77_R_CM 1 100. 0. 255. ECU_ADDRESS 0x3fc330 BIT_MASK 0x1000 /end MEASUREMENT
/begin MEASUREMENT CTR_ABC_END_DIAG_VLS_DOWN_SCB_2 "" UBYTE _CNV_A_R_LINEAR_____13_CM 1 100. 0. 255. ECU_ADDRESS 0x3fc332 FORMAT "%3.0" /end MEASUREMENT
/begin MEASUREMENT CTR_ABC_VLS_DOWN_SCG_1 "" UBYTE _CNV_A_R_LINEAR_____13_CM 1 100. 0. 255. ECU_ADDRESS 0x3fc334 FORMAT "%3.0" /end MEASUREMENT
/begin MEASUREMENT LV_ERR_DET_VLS_DOWN_SCG_1 "" UWORD _CNV_S_2_RANGE______77_R_CM 1 100. 0. 255. ECU_ADDRESS 0x3fc336 BIT_MASK 0x100 /end MEASUREMENT
/begin MEASUREMENT LV_ERR_SYM_CHG_VLS_DOWN_SCG_1 "" UWORD _CNV_S_2_RANGE______77_R_CM 1 100. 0. 255. ECU_ADDRESS 0x3fc336 BIT_MASK 0x400 /end MEASUREMENT
/begin MEASUREMENT LV_CDN_DIAG_VLS_DOWN_SCG_1 "" UWORD _CNV_S_2_RANGE______77_R_CM 1 100. 0. 255. ECU_ADDRESS 0x3fc336 BIT_MASK 0x800 /end MEASUREMENT
/begin MEASUREMENT ERR_SYM_VLS_DOWN_SCG_1 "" UWORD _CNV_S_5_RANGE_ERR__323_CM 1 100. 0. 8. ECU_ADDRESS 0x3fc336 BIT_MASK 0xF /end MEASUREMENT
/begin MEASUREMENT LV_END_DIAG_VLS_DOWN_SCG_1 "" UWORD _CNV_S_2_RANGE______77_R_CM 1 100. 0. 255. ECU_ADDRESS 0x3fc336 BIT_MASK 0x1000 /end MEASUREMENT
/begin MEASUREMENT CTR_ABC_END_DIAG_VLS_DOWN_SCG_1 "" UBYTE _CNV_A_R_LINEAR_____13_CM 1 100. 0. 255. ECU_ADDRESS 0x3fc338 FORMAT "%3.0" /end MEASUREMENT
/begin MEASUREMENT CTR_ABC_VLS_DOWN_SCG_2 "" UBYTE _CNV_A_R_LINEAR_____13_CM 1 100. 0. 255. ECU_ADDRESS 0x3fc33a FORMAT "%3.0" /end MEASUREMENT
/begin MEASUREMENT LV_ERR_DET_VLS_DOWN_SCG_2 "" UWORD _CNV_S_2_RANGE______77_R_CM 1 100. 0. 255. ECU_ADDRESS 0x3fc33c BIT_MASK 0x100 /end MEASUREMENT
/begin MEASUREMENT LV_ERR_SYM_CHG_VLS_DOWN_SCG_2 "" UWORD _CNV_S_2_RANGE______77_R_CM 1 100. 0. 255. ECU_ADDRESS 0x3fc33c BIT_MASK 0x400 /end MEASUREMENT
/begin MEASUREMENT LV_CDN_DIAG_VLS_DOWN_SCG_2 "" UWORD _CNV_S_2_RANGE______77_R_CM 1 100. 0. 255. ECU_ADDRESS 0x3fc33c BIT_MASK 0x800 /end MEASUREMENT
/begin MEASUREMENT ERR_SYM_VLS_DOWN_SCG_2 "" UWORD _CNV_S_5_RANGE_ERR__323_CM 1 100. 0. 8. ECU_ADDRESS 0x3fc33c BIT_MASK 0xF /end MEASUREMENT
/begin MEASUREMENT LV_END_DIAG_VLS_DOWN_SCG_2 "" UWORD _CNV_S_2_RANGE______77_R_CM 1 100. 0. 255. ECU_ADDRESS 0x3fc33c BIT_MASK 0x1000 /end MEASUREMENT
/begin MEASUREMENT CTR_ABC_END_DIAG_VLS_DOWN_SCG_2 "" UBYTE _CNV_A_R_LINEAR_____13_CM 1 100. 0. 255. ECU_ADDRESS 0x3fc33e FORMAT "%3.0" /end MEASUREMENT
/begin MEASUREMENT CTR_ABC_VLS_DOWN_OL_1 "" UBYTE _CNV_A_R_LINEAR_____13_CM 1 100. 0. 255. ECU_ADDRESS 0x3fc340 FORMAT "%3.0" /end MEASUREMENT
/begin MEASUREMENT LV_ERR_DET_VLS_DOWN_OL_1 "" UWORD _CNV_S_2_RANGE______77_R_CM 1 100. 0. 255. ECU_ADDRESS 0x3fc342 BIT_MASK 0x100 /end MEASUREMENT
/begin MEASUREMENT LV_ERR_SYM_CHG_VLS_DOWN_OL_1 "" UWORD _CNV_S_2_RANGE______77_R_CM 1 100. 0. 255. ECU_ADDRESS 0x3fc342 BIT_MASK 0x400 /end MEASUREMENT
/begin MEASUREMENT LV_CDN_DIAG_VLS_DOWN_OL_1 "" UWORD _CNV_S_2_RANGE______77_R_CM 1 100. 0. 255. ECU_ADDRESS 0x3fc342 BIT_MASK 0x800 /end MEASUREMENT
/begin MEASUREMENT ERR_SYM_VLS_DOWN_OL_1 "" UWORD _CNV_S_5_RANGE_ERR__323_CM 1 100. 0. 8. ECU_ADDRESS 0x3fc342 BIT_MASK 0xF /end MEASUREMENT
/begin MEASUREMENT LV_END_DIAG_VLS_DOWN_OL_1 "" UWORD _CNV_S_2_RANGE______77_R_CM 1 100. 0. 255. ECU_ADDRESS 0x3fc342 BIT_MASK 0x1000 /end MEASUREMENT
/begin MEASUREMENT CTR_ABC_END_DIAG_VLS_DOWN_OL_1 "" UBYTE _CNV_A_R_LINEAR_____13_CM 1 100. 0. 255. ECU_ADDRESS 0x3fc344 FORMAT "%3.0" /end MEASUREMENT
/begin MEASUREMENT CTR_ABC_VLS_DOWN_OL_2 "" UBYTE _CNV_A_R_LINEAR_____13_CM 1 100. 0. 255. ECU_ADDRESS 0x3fc346 FORMAT "%3.0" /end MEASUREMENT
/begin MEASUREMENT LV_ERR_DET_VLS_DOWN_OL_2 "" UWORD _CNV_S_2_RANGE______77_R_CM 1 100. 0. 255. ECU_ADDRESS 0x3fc348 BIT_MASK 0x100 /end MEASUREMENT
/begin MEASUREMENT LV_ERR_SYM_CHG_VLS_DOWN_OL_2 "" UWORD _CNV_S_2_RANGE______77_R_CM 1 100. 0. 255. ECU_ADDRESS 0x3fc348 BIT_MASK 0x400 /end MEASUREMENT
/begin MEASUREMENT LV_CDN_DIAG_VLS_DOWN_OL_2 "" UWORD _CNV_S_2_RANGE______77_R_CM 1 100. 0. 255. ECU_ADDRESS 0x3fc348 BIT_MASK 0x800 /end MEASUREMENT
/begin MEASUREMENT ERR_SYM_VLS_DOWN_OL_2 "" UWORD _CNV_S_5_RANGE_ERR__323_CM 1 100. 0. 8. ECU_ADDRESS 0x3fc348 BIT_MASK 0xF /end MEASUREMENT
/begin MEASUREMENT LV_END_DIAG_VLS_DOWN_OL_2 "" UWORD _CNV_S_2_RANGE______77_R_CM 1 100. 0. 255. ECU_ADDRESS 0x3fc348 BIT_MASK 0x1000 /end MEASUREMENT
/begin MEASUREMENT CTR_ABC_END_DIAG_VLS_DOWN_OL_2 "" UBYTE _CNV_A_R_LINEAR_____13_CM 1 100. 0. 255. ECU_ADDRESS 0x3fc34a FORMAT "%3.0" /end MEASUREMENT
/begin MEASUREMENT CTR_ABC_VLS_STK_1 "" UBYTE _CNV_A_R_LINEAR_____13_CM 1 100. 0. 255. ECU_ADDRESS 0x3fc34c FORMAT "%3.0" /end MEASUREMENT
/begin MEASUREMENT LV_ERR_DET_VLS_STK_1 "" UWORD _CNV_S_2_RANGE______77_R_CM 1 100. 0. 255. ECU_ADDRESS 0x3fc34e BIT_MASK 0x100 /end MEASUREMENT
/begin MEASUREMENT LV_ERR_SYM_CHG_VLS_STK_1 "" UWORD _CNV_S_2_RANGE______77_R_CM 1 100. 0. 255. ECU_ADDRESS 0x3fc34e BIT_MASK 0x400 /end MEASUREMENT
/begin MEASUREMENT LV_CDN_DIAG_VLS_STK_1 "" UWORD _CNV_S_2_RANGE______77_R_CM 1 100. 0. 255. ECU_ADDRESS 0x3fc34e BIT_MASK 0x800 /end MEASUREMENT
/begin MEASUREMENT ERR_SYM_VLS_STK_1 "" UWORD _CNV_S_5_RANGE_ERR__323_CM 1 100. 0. 8. ECU_ADDRESS 0x3fc34e BIT_MASK 0xF /end MEASUREMENT
/begin MEASUREMENT LV_END_DIAG_VLS_STK_1 "" UWORD _CNV_S_2_RANGE______77_R_CM 1 100. 0. 255. ECU_ADDRESS 0x3fc34e BIT_MASK 0x1000 /end MEASUREMENT
/begin MEASUREMENT CTR_ABC_END_DIAG_VLS_STK_1 "" UBYTE _CNV_A_R_LINEAR_____13_CM 1 100. 0. 255. ECU_ADDRESS 0x3fc350 FORMAT "%3.0" /end MEASUREMENT
/begin MEASUREMENT CTR_ABC_VLS_STK_2 "" UBYTE _CNV_A_R_LINEAR_____13_CM 1 100. 0. 255. ECU_ADDRESS 0x3fc352 FORMAT "%3.0" /end MEASUREMENT
/begin MEASUREMENT LV_ERR_DET_VLS_STK_2 "" UWORD _CNV_S_2_RANGE______77_R_CM 1 100. 0. 255. ECU_ADDRESS 0x3fc354 BIT_MASK 0x100 /end MEASUREMENT
/begin MEASUREMENT LV_ERR_SYM_CHG_VLS_STK_2 "" UWORD _CNV_S_2_RANGE______77_R_CM 1 100. 0. 255. ECU_ADDRESS 0x3fc354 BIT_MASK 0x400 /end MEASUREMENT
/begin MEASUREMENT LV_CDN_DIAG_VLS_STK_2 "" UWORD _CNV_S_2_RANGE______77_R_CM 1 100. 0. 255. ECU_ADDRESS 0x3fc354 BIT_MASK 0x800 /end MEASUREMENT
/begin MEASUREMENT ERR_SYM_VLS_STK_2 "" UWORD _CNV_S_5_RANGE_ERR__323_CM 1 100. 0. 8. ECU_ADDRESS 0x3fc354 BIT_MASK 0xF /end MEASUREMENT
/begin MEASUREMENT LV_END_DIAG_VLS_STK_2 "" UWORD _CNV_S_2_RANGE______77_R_CM 1 100. 0. 255. ECU_ADDRESS 0x3fc354 BIT_MASK 0x1000 /end MEASUREMENT
/begin MEASUREMENT CTR_ABC_END_DIAG_VLS_STK_2 "" UBYTE _CNV_A_R_LINEAR_____13_CM 1 100. 0. 255. ECU_ADDRESS 0x3fc356 FORMAT "%3.0" /end MEASUREMENT
/begin MEASUREMENT CTR_ABC_LAM_LIM_1 "" UBYTE _CNV_A_R_LINEAR_____13_CM 1 100. 0. 255. ECU_ADDRESS 0x3fc358 FORMAT "%3.0" /end MEASUREMENT
/begin MEASUREMENT LV_ERR_DET_LAM_LIM_1 "" UWORD _CNV_S_2_RANGE______77_R_CM 1 100. 0. 255. ECU_ADDRESS 0x3fc35a BIT_MASK 0x100 /end MEASUREMENT
/begin MEASUREMENT LV_ERR_SYM_CHG_LAM_LIM_1 "" UWORD _CNV_S_2_RANGE______77_R_CM 1 100. 0. 255. ECU_ADDRESS 0x3fc35a BIT_MASK 0x400 /end MEASUREMENT
/begin MEASUREMENT LV_CDN_DIAG_LAM_LIM_1 "" UWORD _CNV_S_2_RANGE______77_R_CM 1 100. 0. 255. ECU_ADDRESS 0x3fc35a BIT_MASK 0x800 /end MEASUREMENT
/begin MEASUREMENT ERR_SYM_LAM_LIM_1 "" UWORD _CNV_S_5_RANGE_ERR__323_CM 1 100. 0. 8. ECU_ADDRESS 0x3fc35a BIT_MASK 0xF /end MEASUREMENT
/begin MEASUREMENT LV_END_DIAG_LAM_LIM_1 "" UWORD _CNV_S_2_RANGE______77_R_CM 1 100. 0. 255. ECU_ADDRESS 0x3fc35a BIT_MASK 0x1000 /end MEASUREMENT
/begin MEASUREMENT CTR_ABC_END_DIAG_LAM_LIM_1 "" UBYTE _CNV_A_R_LINEAR_____13_CM 1 100. 0. 255. ECU_ADDRESS 0x3fc35c FORMAT "%3.0" /end MEASUREMENT
/begin MEASUREMENT CTR_ABC_LAM_LIM_2 "" UBYTE _CNV_A_R_LINEAR_____13_CM 1 100. 0. 255. ECU_ADDRESS 0x3fc35e FORMAT "%3.0" /end MEASUREMENT
/begin MEASUREMENT LV_ERR_DET_LAM_LIM_2 "" UWORD _CNV_S_2_RANGE______77_R_CM 1 100. 0. 255. ECU_ADDRESS 0x3fc360 BIT_MASK 0x100 /end MEASUREMENT
/begin MEASUREMENT LV_ERR_SYM_CHG_LAM_LIM_2 "" UWORD _CNV_S_2_RANGE______77_R_CM 1 100. 0. 255. ECU_ADDRESS 0x3fc360 BIT_MASK 0x400 /end MEASUREMENT
/begin MEASUREMENT LV_CDN_DIAG_LAM_LIM_2 "" UWORD _CNV_S_2_RANGE______77_R_CM 1 100. 0. 255. ECU_ADDRESS 0x3fc360 BIT_MASK 0x800 /end MEASUREMENT
/begin MEASUREMENT ERR_SYM_LAM_LIM_2 "" UWORD _CNV_S_5_RANGE_ERR__323_CM 1 100. 0. 8. ECU_ADDRESS 0x3fc360 BIT_MASK 0xF /end MEASUREMENT
/begin MEASUREMENT LV_END_DIAG_LAM_LIM_2 "" UWORD _CNV_S_2_RANGE______77_R_CM 1 100. 0. 255. ECU_ADDRESS 0x3fc360 BIT_MASK 0x1000 /end MEASUREMENT
/begin MEASUREMENT CTR_ABC_END_DIAG_LAM_LIM_2 "" UBYTE _CNV_A_R_LINEAR_____13_CM 1 100. 0. 255. ECU_ADDRESS 0x3fc362 FORMAT "%3.0" /end MEASUREMENT
/begin MEASUREMENT CTR_ABC_IV_0 "" UBYTE _CNV_A_R_LINEAR_____13_CM 1 100. 0. 255. ECU_ADDRESS 0x3fc364 FORMAT "%3.0" /end MEASUREMENT
/begin MEASUREMENT LV_ERR_DET_IV_0 "" UWORD _CNV_S_2_RANGE______77_R_CM 1 100. 0. 255. ECU_ADDRESS 0x3fc366 BIT_MASK 0x100 /end MEASUREMENT
/begin MEASUREMENT LV_ERR_SYM_CHG_IV_0 "" UWORD _CNV_S_2_RANGE______77_R_CM 1 100. 0. 255. ECU_ADDRESS 0x3fc366 BIT_MASK 0x400 /end MEASUREMENT
/begin MEASUREMENT LV_CDN_DIAG_IV_0 "" UWORD _CNV_S_2_RANGE______77_R_CM 1 100. 0. 255. ECU_ADDRESS 0x3fc366 BIT_MASK 0x800 /end MEASUREMENT
/begin MEASUREMENT ERR_SYM_IV_0 "" UWORD _CNV_S_5_RANGE_ERR__323_CM 1 100. 0. 8. ECU_ADDRESS 0x3fc366 BIT_MASK 0xF /end MEASUREMENT
/begin MEASUREMENT LV_END_DIAG_IV_0 "" UWORD _CNV_S_2_RANGE______77_R_CM 1 100. 0. 255. ECU_ADDRESS 0x3fc366 BIT_MASK 0x1000 /end MEASUREMENT
/begin MEASUREMENT CTR_ABC_END_DIAG_IV_0 "" UBYTE _CNV_A_R_LINEAR_____13_CM 1 100. 0. 255. ECU_ADDRESS 0x3fc368 FORMAT "%3.0" /end MEASUREMENT
/begin MEASUREMENT CTR_ABC_IV_1 "" UBYTE _CNV_A_R_LINEAR_____13_CM 1 100. 0. 255. ECU_ADDRESS 0x3fc36a FORMAT "%3.0" /end MEASUREMENT
/begin MEASUREMENT LV_ERR_DET_IV_1 "" UWORD _CNV_S_2_RANGE______77_R_CM 1 100. 0. 255. ECU_ADDRESS 0x3fc36c BIT_MASK 0x100 /end MEASUREMENT
/begin MEASUREMENT LV_ERR_SYM_CHG_IV_1 "" UWORD _CNV_S_2_RANGE______77_R_CM 1 100. 0. 255. ECU_ADDRESS 0x3fc36c BIT_MASK 0x400 /end MEASUREMENT
/begin MEASUREMENT LV_CDN_DIAG_IV_1 "" UWORD _CNV_S_2_RANGE______77_R_CM 1 100. 0. 255. ECU_ADDRESS 0x3fc36c BIT_MASK 0x800 /end MEASUREMENT
/begin MEASUREMENT ERR_SYM_IV_1 "" UWORD _CNV_S_5_RANGE_ERR__323_CM 1 100. 0. 8. ECU_ADDRESS 0x3fc36c BIT_MASK 0xF /end MEASUREMENT
/begin MEASUREMENT LV_END_DIAG_IV_1 "" UWORD _CNV_S_2_RANGE______77_R_CM 1 100. 0. 255. ECU_ADDRESS 0x3fc36c BIT_MASK 0x1000 /end MEASUREMENT
/begin MEASUREMENT CTR_ABC_END_DIAG_IV_1 "" UBYTE _CNV_A_R_LINEAR_____13_CM 1 100. 0. 255. ECU_ADDRESS 0x3fc36e FORMAT "%3.0" /end MEASUREMENT
/begin MEASUREMENT CTR_ABC_IV_2 "" UBYTE _CNV_A_R_LINEAR_____13_CM 1 100. 0. 255. ECU_ADDRESS 0x3fc370 FORMAT "%3.0" /end MEASUREMENT
/begin MEASUREMENT LV_ERR_DET_IV_2 "" UWORD _CNV_S_2_RANGE______77_R_CM 1 100. 0. 255. ECU_ADDRESS 0x3fc372 BIT_MASK 0x100 /end MEASUREMENT
/begin MEASUREMENT LV_ERR_SYM_CHG_IV_2 "" UWORD _CNV_S_2_RANGE______77_R_CM 1 100. 0. 255. ECU_ADDRESS 0x3fc372 BIT_MASK 0x400 /end MEASUREMENT
/begin MEASUREMENT LV_CDN_DIAG_IV_2 "" UWORD _CNV_S_2_RANGE______77_R_CM 1 100. 0. 255. ECU_ADDRESS 0x3fc372 BIT_MASK 0x800 /end MEASUREMENT
/begin MEASUREMENT ERR_SYM_IV_2 "" UWORD _CNV_S_5_RANGE_ERR__323_CM 1 100. 0. 8. ECU_ADDRESS 0x3fc372 BIT_MASK 0xF /end MEASUREMENT
/begin MEASUREMENT LV_END_DIAG_IV_2 "" UWORD _CNV_S_2_RANGE______77_R_CM 1 100. 0. 255. ECU_ADDRESS 0x3fc372 BIT_MASK 0x1000 /end MEASUREMENT
/begin MEASUREMENT CTR_ABC_END_DIAG_IV_2 "" UBYTE _CNV_A_R_LINEAR_____13_CM 1 100. 0. 255. ECU_ADDRESS 0x3fc374 FORMAT "%3.0" /end MEASUREMENT
/begin MEASUREMENT CTR_ABC_IV_3 "" UBYTE _CNV_A_R_LINEAR_____13_CM 1 100. 0. 255. ECU_ADDRESS 0x3fc376 FORMAT "%3.0" /end MEASUREMENT
/begin MEASUREMENT LV_ERR_DET_IV_3 "" UWORD _CNV_S_2_RANGE______77_R_CM 1 100. 0. 255. ECU_ADDRESS 0x3fc378 BIT_MASK 0x100 /end MEASUREMENT
/begin MEASUREMENT LV_ERR_SYM_CHG_IV_3 "" UWORD _CNV_S_2_RANGE______77_R_CM 1 100. 0. 255. ECU_ADDRESS 0x3fc378 BIT_MASK 0x400 /end MEASUREMENT
/begin MEASUREMENT LV_CDN_DIAG_IV_3 "" UWORD _CNV_S_2_RANGE______77_R_CM 1 100. 0. 255. ECU_ADDRESS 0x3fc378 BIT_MASK 0x800 /end MEASUREMENT
/begin MEASUREMENT ERR_SYM_IV_3 "" UWORD _CNV_S_5_RANGE_ERR__323_CM 1 100. 0. 8. ECU_ADDRESS 0x3fc378 BIT_MASK 0xF /end MEASUREMENT
/begin MEASUREMENT LV_END_DIAG_IV_3 "" UWORD _CNV_S_2_RANGE______77_R_CM 1 100. 0. 255. ECU_ADDRESS 0x3fc378 BIT_MASK 0x1000 /end MEASUREMENT
/begin MEASUREMENT CTR_ABC_END_DIAG_IV_3 "" UBYTE _CNV_A_R_LINEAR_____13_CM 1 100. 0. 255. ECU_ADDRESS 0x3fc37a FORMAT "%3.0" /end MEASUREMENT
/begin MEASUREMENT CTR_ABC_IV_4 "" UBYTE _CNV_A_R_LINEAR_____13_CM 1 100. 0. 255. ECU_ADDRESS 0x3fc37c FORMAT "%3.0" /end MEASUREMENT
/begin MEASUREMENT LV_ERR_DET_IV_4 "" UWORD _CNV_S_2_RANGE______77_R_CM 1 100. 0. 255. ECU_ADDRESS 0x3fc37e BIT_MASK 0x100 /end MEASUREMENT
/begin MEASUREMENT LV_ERR_SYM_CHG_IV_4 "" UWORD _CNV_S_2_RANGE______77_R_CM 1 100. 0. 255. ECU_ADDRESS 0x3fc37e BIT_MASK 0x400 /end MEASUREMENT
/begin MEASUREMENT LV_CDN_DIAG_IV_4 "" UWORD _CNV_S_2_RANGE______77_R_CM 1 100. 0. 255. ECU_ADDRESS 0x3fc37e BIT_MASK 0x800 /end MEASUREMENT
/begin MEASUREMENT ERR_SYM_IV_4 "" UWORD _CNV_S_5_RANGE_ERR__323_CM 1 100. 0. 8. ECU_ADDRESS 0x3fc37e BIT_MASK 0xF /end MEASUREMENT
/begin MEASUREMENT LV_END_DIAG_IV_4 "" UWORD _CNV_S_2_RANGE______77_R_CM 1 100. 0. 255. ECU_ADDRESS 0x3fc37e BIT_MASK 0x1000 /end MEASUREMENT
/begin MEASUREMENT CTR_ABC_END_DIAG_IV_4 "" UBYTE _CNV_A_R_LINEAR_____13_CM 1 100. 0. 255. ECU_ADDRESS 0x3fc380 FORMAT "%3.0" /end MEASUREMENT
/begin MEASUREMENT CTR_ABC_IV_5 "" UBYTE _CNV_A_R_LINEAR_____13_CM 1 100. 0. 255. ECU_ADDRESS 0x3fc382 FORMAT "%3.0" /end MEASUREMENT
/begin MEASUREMENT LV_ERR_DET_IV_5 "" UWORD _CNV_S_2_RANGE______77_R_CM 1 100. 0. 255. ECU_ADDRESS 0x3fc384 BIT_MASK 0x100 /end MEASUREMENT
/begin MEASUREMENT LV_ERR_SYM_CHG_IV_5 "" UWORD _CNV_S_2_RANGE______77_R_CM 1 100. 0. 255. ECU_ADDRESS 0x3fc384 BIT_MASK 0x400 /end MEASUREMENT
/begin MEASUREMENT LV_CDN_DIAG_IV_5 "" UWORD _CNV_S_2_RANGE______77_R_CM 1 100. 0. 255. ECU_ADDRESS 0x3fc384 BIT_MASK 0x800 /end MEASUREMENT
/begin MEASUREMENT ERR_SYM_IV_5 "" UWORD _CNV_S_5_RANGE_ERR__323_CM 1 100. 0. 8. ECU_ADDRESS 0x3fc384 BIT_MASK 0xF /end MEASUREMENT
/begin MEASUREMENT LV_END_DIAG_IV_5 "" UWORD _CNV_S_2_RANGE______77_R_CM 1 100. 0. 255. ECU_ADDRESS 0x3fc384 BIT_MASK 0x1000 /end MEASUREMENT
/begin MEASUREMENT CTR_ABC_END_DIAG_IV_5 "" UBYTE _CNV_A_R_LINEAR_____13_CM 1 100. 0. 255. ECU_ADDRESS 0x3fc386 FORMAT "%3.0" /end MEASUREMENT
/begin MEASUREMENT CTR_ABC_LSH_UP_1 "" UBYTE _CNV_A_R_LINEAR_____13_CM 1 100. 0. 255. ECU_ADDRESS 0x3fc388 FORMAT "%3.0" /end MEASUREMENT
/begin MEASUREMENT LV_ERR_DET_LSH_UP_1 "" UWORD _CNV_S_2_RANGE______77_R_CM 1 100. 0. 255. ECU_ADDRESS 0x3fc38a BIT_MASK 0x100 /end MEASUREMENT
/begin MEASUREMENT LV_ERR_SYM_CHG_LSH_UP_1 "" UWORD _CNV_S_2_RANGE______77_R_CM 1 100. 0. 255. ECU_ADDRESS 0x3fc38a BIT_MASK 0x400 /end MEASUREMENT
/begin MEASUREMENT LV_CDN_DIAG_LSH_UP_1 "" UWORD _CNV_S_2_RANGE______77_R_CM 1 100. 0. 255. ECU_ADDRESS 0x3fc38a BIT_MASK 0x800 /end MEASUREMENT
/begin MEASUREMENT ERR_SYM_LSH_UP_1 "" UWORD _CNV_S_5_RANGE_ERR__323_CM 1 100. 0. 8. ECU_ADDRESS 0x3fc38a BIT_MASK 0xF /end MEASUREMENT
/begin MEASUREMENT LV_END_DIAG_LSH_UP_1 "" UWORD _CNV_S_2_RANGE______77_R_CM 1 100. 0. 255. ECU_ADDRESS 0x3fc38a BIT_MASK 0x1000 /end MEASUREMENT
/begin MEASUREMENT CTR_ABC_END_DIAG_LSH_UP_1 "" UBYTE _CNV_A_R_LINEAR_____13_CM 1 100. 0. 255. ECU_ADDRESS 0x3fc38c FORMAT "%3.0" /end MEASUREMENT
/begin MEASUREMENT CTR_ABC_LSH_UP_2 "" UBYTE _CNV_A_R_LINEAR_____13_CM 1 100. 0. 255. ECU_ADDRESS 0x3fc38e FORMAT "%3.0" /end MEASUREMENT
/begin MEASUREMENT LV_ERR_DET_LSH_UP_2 "" UWORD _CNV_S_2_RANGE______77_R_CM 1 100. 0. 255. ECU_ADDRESS 0x3fc390 BIT_MASK 0x100 /end MEASUREMENT
/begin MEASUREMENT LV_ERR_SYM_CHG_LSH_UP_2 "" UWORD _CNV_S_2_RANGE______77_R_CM 1 100. 0. 255. ECU_ADDRESS 0x3fc390 BIT_MASK 0x400 /end MEASUREMENT
/begin MEASUREMENT LV_CDN_DIAG_LSH_UP_2 "" UWORD _CNV_S_2_RANGE______77_R_CM 1 100. 0. 255. ECU_ADDRESS 0x3fc390 BIT_MASK 0x800 /end MEASUREMENT
/begin MEASUREMENT ERR_SYM_LSH_UP_2 "" UWORD _CNV_S_5_RANGE_ERR__323_CM 1 100. 0. 8. ECU_ADDRESS 0x3fc390 BIT_MASK 0xF /end MEASUREMENT
/begin MEASUREMENT LV_END_DIAG_LSH_UP_2 "" UWORD _CNV_S_2_RANGE______77_R_CM 1 100. 0. 255. ECU_ADDRESS 0x3fc390 BIT_MASK 0x1000 /end MEASUREMENT
/begin MEASUREMENT CTR_ABC_END_DIAG_LSH_UP_2 "" UBYTE _CNV_A_R_LINEAR_____13_CM 1 100. 0. 255. ECU_ADDRESS 0x3fc392 FORMAT "%3.0" /end MEASUREMENT
/begin MEASUREMENT CTR_ABC_LSH_DOWN_1 "" UBYTE _CNV_A_R_LINEAR_____13_CM 1 100. 0. 255. ECU_ADDRESS 0x3fc394 FORMAT "%3.0" /end MEASUREMENT
/begin MEASUREMENT LV_ERR_DET_LSH_DOWN_1 "" UWORD _CNV_S_2_RANGE______77_R_CM 1 100. 0. 255. ECU_ADDRESS 0x3fc396 BIT_MASK 0x100 /end MEASUREMENT
/begin MEASUREMENT LV_ERR_SYM_CHG_LSH_DOWN_1 "" UWORD _CNV_S_2_RANGE______77_R_CM 1 100. 0. 255. ECU_ADDRESS 0x3fc396 BIT_MASK 0x400 /end MEASUREMENT
/begin MEASUREMENT LV_CDN_DIAG_LSH_DOWN_1 "" UWORD _CNV_S_2_RANGE______77_R_CM 1 100. 0. 255. ECU_ADDRESS 0x3fc396 BIT_MASK 0x800 /end MEASUREMENT
/begin MEASUREMENT ERR_SYM_LSH_DOWN_1 "" UWORD _CNV_S_5_RANGE_ERR__323_CM 1 100. 0. 8. ECU_ADDRESS 0x3fc396 BIT_MASK 0xF /end MEASUREMENT
/begin MEASUREMENT LV_END_DIAG_LSH_DOWN_1 "" UWORD _CNV_S_2_RANGE______77_R_CM 1 100. 0. 255. ECU_ADDRESS 0x3fc396 BIT_MASK 0x1000 /end MEASUREMENT
/begin MEASUREMENT CTR_ABC_END_DIAG_LSH_DOWN_1 "" UBYTE _CNV_A_R_LINEAR_____13_CM 1 100. 0. 255. ECU_ADDRESS 0x3fc398 FORMAT "%3.0" /end MEASUREMENT
/begin MEASUREMENT CTR_ABC_LSH_DOWN_2 "" UBYTE _CNV_A_R_LINEAR_____13_CM 1 100. 0. 255. ECU_ADDRESS 0x3fc39a FORMAT "%3.0" /end MEASUREMENT
/begin MEASUREMENT LV_ERR_DET_LSH_DOWN_2 "" UWORD _CNV_S_2_RANGE______77_R_CM 1 100. 0. 255. ECU_ADDRESS 0x3fc39c BIT_MASK 0x100 /end MEASUREMENT
/begin MEASUREMENT LV_ERR_SYM_CHG_LSH_DOWN_2 "" UWORD _CNV_S_2_RANGE______77_R_CM 1 100. 0. 255. ECU_ADDRESS 0x3fc39c BIT_MASK 0x400 /end MEASUREMENT
/begin MEASUREMENT LV_CDN_DIAG_LSH_DOWN_2 "" UWORD _CNV_S_2_RANGE______77_R_CM 1 100. 0. 255. ECU_ADDRESS 0x3fc39c BIT_MASK 0x800 /end MEASUREMENT
/begin MEASUREMENT ERR_SYM_LSH_DOWN_2 "" UWORD _CNV_S_5_RANGE_ERR__323_CM 1 100. 0. 8. ECU_ADDRESS 0x3fc39c BIT_MASK 0xF /end MEASUREMENT
/begin MEASUREMENT LV_END_DIAG_LSH_DOWN_2 "" UWORD _CNV_S_2_RANGE______77_R_CM 1 100. 0. 255. ECU_ADDRESS 0x3fc39c BIT_MASK 0x1000 /end MEASUREMENT
/begin MEASUREMENT CTR_ABC_END_DIAG_LSH_DOWN_2 "" UBYTE _CNV_A_R_LINEAR_____13_CM 1 100. 0. 255. ECU_ADDRESS 0x3fc39e FORMAT "%3.0" /end MEASUREMENT
/begin MEASUREMENT CTR_ABC_RLY_EFP "" UBYTE _CNV_A_R_LINEAR_____13_CM 1 100. 0. 255. ECU_ADDRESS 0x3fc3a0 FORMAT "%3.0" /end MEASUREMENT
/begin MEASUREMENT LV_ERR_DET_RLY_EFP "" UWORD _CNV_S_2_RANGE______77_R_CM 1 100. 0. 255. ECU_ADDRESS 0x3fc3a2 BIT_MASK 0x100 /end MEASUREMENT
/begin MEASUREMENT LV_ERR_SYM_CHG_RLY_EFP "" UWORD _CNV_S_2_RANGE______77_R_CM 1 100. 0. 255. ECU_ADDRESS 0x3fc3a2 BIT_MASK 0x400 /end MEASUREMENT
/begin MEASUREMENT LV_CDN_DIAG_RLY_EFP "" UWORD _CNV_S_2_RANGE______77_R_CM 1 100. 0. 255. ECU_ADDRESS 0x3fc3a2 BIT_MASK 0x800 /end MEASUREMENT
/begin MEASUREMENT ERR_SYM_RLY_EFP "" UWORD _CNV_S_5_RANGE_ERR__323_CM 1 100. 0. 8. ECU_ADDRESS 0x3fc3a2 BIT_MASK 0xF /end MEASUREMENT
/begin MEASUREMENT LV_END_DIAG_RLY_EFP "" UWORD _CNV_S_2_RANGE______77_R_CM 1 100. 0. 255. ECU_ADDRESS 0x3fc3a2 BIT_MASK 0x1000 /end MEASUREMENT
/begin MEASUREMENT CTR_ABC_END_DIAG_RLY_EFP "" UBYTE _CNV_A_R_LINEAR_____13_CM 1 100. 0. 255. ECU_ADDRESS 0x3fc3a4 FORMAT "%3.0" /end MEASUREMENT
/begin MEASUREMENT CTR_ABC_CPS "" UBYTE _CNV_A_R_LINEAR_____13_CM 1 100. 0. 255. ECU_ADDRESS 0x3fc3a6 FORMAT "%3.0" /end MEASUREMENT
/begin MEASUREMENT LV_ERR_DET_CPS "" UWORD _CNV_S_2_RANGE______77_R_CM 1 100. 0. 255. ECU_ADDRESS 0x3fc3a8 BIT_MASK 0x100 /end MEASUREMENT
/begin MEASUREMENT B_KL15 "" UBYTE _CNV_A_R_LINEAR_____13_CM 1 100. 0. 255. ECU_ADDRESS 0x3fda01 BIT_MASK 0x1 /end MEASUREMENT
/begin MEASUREMENT B_MASTER "" UBYTE _CNV_A_R_LINEAR_____13_CM 1 100. 0. 255. ECU_ADDRESS 0x3fda0c BIT_MASK 0x1 /end MEASUREMENT
/begin MEASUREMENT BGCRLOC_1 "" UBYTE _CNV_A_R_LINEAR_____13_CM 1 100. 0. 255. ECU_ADDRESS 0x3faa64 BIT_MASK 0x1 /end MEASUREMENT
/begin MEASUREMENT FAKTTANSEL "Ansaugluftfaktor E-Lüfterstrom" UBYTE _CNV_A_R_LINEAR_____67_CM 1 100. 0. 1.9921875 ECU_ADDRESS 0x3faa65 FORMAT "%8.4" /end MEASUREMENT
/begin MEASUREMENT FAKTVFZGEL "Geschwindigkeitsfaktor E-Lüfterstrom" UBYTE _CNV_A_R_LINEAR_____67_CM 1 100. 0. 1. ECU_ADDRESS 0x3faa66 FORMAT "%8.4" /end MEASUREMENT
/begin MEASUREMENT I_ELU_VVT "Strom E-Lüfter und VVT-System" UWORD _CNV_R_R_i_vvt_q0p0_342_CM 1 100. 0. 4095.9375 ECU_ADDRESS 0x3faa56 FORMAT "%8.4" /end MEASUREMENT
/begin MEASUREMENT I_ELUEFTER "" UWORD _CNV_R_R_i_vvt_q0p0_342_CM 1 100. 0. 128. ECU_ADDRESS 0x3faa50 FORMAT "%8.4" /end MEASUREMENT
/begin MEASUREMENT I_ELUPWM "" UWORD _CNV_R_R_i_vvt_q0p0_342_CM 1 100. 0. 64. ECU_ADDRESS 0x3faa52 FORMAT "%8.4" /end MEASUREMENT
/begin MEASUREMENT I_ELUVFZG "" UWORD _CNV_R_R_i_vvt_q0p0_342_CM 1 100. 0. 64. ECU_ADDRESS 0x3faa54 FORMAT "%8.4" /end MEASUREMENT
/begin MEASUREMENT ST_CRAWENG "" UBYTE _CNV_R_R_igen_ub_q1_343_CM 1 100. 0. 254. ECU_ADDRESS 0x3faa67 FORMAT "%8.4" /end MEASUREMENT
/begin MEASUREMENT TAML "Tastverhältnis E-Lüfter" UBYTE _CNV_R_R_rel_ub_b10_344_CM 1 100. 0. 100. ECU_ADDRESS 0x3fd9ff FORMAT "%8.4" /end MEASUREMENT
/begin MEASUREMENT TAML_TMP "temporäres Tastverhältnis E-Lüfter" UWORD _CNV_R_R_rel_ub_b10_344_CM 1 100. 0. 100. ECU_ADDRESS 0x3faa58 FORMAT "%8.4" /end MEASUREMENT
/begin MEASUREMENT TANS "Ansaugluft" UBYTE _CNV_A_R_LINEAR_____345_CM 1 100. -48. 143.25 ECU_ADDRESS 0x3fda00 FORMAT "%8.4" /end MEASUREMENT
/begin MEASUREMENT TANS_TMP "temporäre Ansaugluft" UWORD _CNV_A_R_LINEAR_____345_CM 1 100. -48. 143.25 ECU_ADDRESS 0x3faa5a FORMAT "%8.4" /end MEASUREMENT
/begin MEASUREMENT UB_TMP "temporäre Batteriespannung" UWORD _CNV_A_R_spg_ubatt_346_CM 1 100. 0. 24.021 ECU_ADDRESS 0x3faa5c FORMAT "%8.4" /end MEASUREMENT
/begin MEASUREMENT VFZG "Fahrzeuggeschwindigkeit" UBYTE _CNV_R_R_vfzg_ub_q1_347_CM 1 100. 0. 318.75 ECU_ADDRESS 0x3fda02 FORMAT "%8.4" /end MEASUREMENT
/begin MEASUREMENT VFZG_TMP "temporäre Fahrzeuggeschwindigkeit" UWORD _CNV_R_R_vfzg_ub_q1_347_CM 1 100. 0. 318.75 ECU_ADDRESS 0x3faa5e FORMAT "%8.4" /end MEASUREMENT
/begin MEASUREMENT VVT_ES "VVT-Strom Bank 1 bzw. 4 Zylinder" UBYTE _CNV_R_R_i_vvt_ub_q_348_CM 1 100. -63.5 64. ECU_ADDRESS 0x3fda04 FORMAT "%8.4" /end MEASUREMENT
/begin MEASUREMENT VVT_ES2 "VVT-Strom Bank2" UBYTE _CNV_R_R_i_vvt_ub_q_348_CM 1 100. -63.5 64. ECU_ADDRESS 0x3fda05 FORMAT "%8.4" /end MEASUREMENT
/begin MEASUREMENT VVT_IB1_2 "Gesamtstrom VVT Bank1 bzw 4Zyl. und Bank2" UWORD _CNV_R_R_i_vvt_ub_q_348_CM 1 100. 0. 128. ECU_ADDRESS 0x3faa60 FORMAT "%8.4" /end MEASUREMENT
/begin MEASUREMENT VVT_IGES "Strombedarf des gesamten VVT-Systems" UWORD _CNV_R_R_i_vvt_q0p0_342_CM 1 100. 0. 192. ECU_ADDRESS 0x3faa62 FORMAT "%8.4" /end MEASUREMENT
/begin CHARACTERISTIC CRENGOF "Offset für Strombedarf Motor" VALUE 0x6d93a _REC_VAL_20_u1 127. _CNV_R_R_i_vvt_ub_q_348_CM -63.5 63.5 FORMAT "%8.4" /end CHARACTERISTIC
/begin CHARACTERISTIC CRVVTOF "Stromoffset VVT" VALUE 0x6d93b _REC_VAL_20_u1 127.5 _CNV_R_R_i_vvt_ub_q_348_CM -63.5 64. FORMAT "%8.4" /end CHARACTERISTIC
/begin CHARACTERISTIC KFELUPWM "Strom E-Lüfter über pwm und ub" MAP 0x6d842 _REC_MAP_32_u2_u2_u2 64. _CNV_R_R_i_vvt_q0p0_342_CM 0. 64. FORMAT "%8.4"
 /begin AXIS_DESCR STD_AXIS NO_INPUT_QUANTITY _CNV_R_R_rel_ub_b10_344_CM 8 0. 100. FORMAT "%8.4" /end AXIS_DESCR
 /begin AXIS_DESCR STD_AXIS NO_INPUT_QUANTITY _CNV_A_R_spg_ubatt_346_CM 8 0. 24.021 FORMAT "%8.4" /end AXIS_DESCR
/end CHARACTERISTIC
/begin CHARACTERISTIC KLELTEMP "Temperaturfaktor Elüfter" CURVE 0x6d8e6 _REC_CUR_32_u2_u2 1.9921875 _CNV_A_R_LINEAR_____67_CM 0. 1.9921875 FORMAT "%8.4"
 /begin AXIS_DESCR STD_AXIS NO_INPUT_QUANTITY _CNV_R_R_temp_uw_q0_349_CM 8 -48. 143.25 FORMAT "%8.4" /end AXIS_DESCR
/end CHARACTERISTIC
/begin CHARACTERISTIC KLELVFZG "Geschwindigkeitsfaktor E-Lüfter" CURVE 0x6d908 _REC_CUR_32_u2_u2 1. _CNV_A_R_LINEAR_____67_CM 0. 1. FORMAT "%8.4"
 /begin AXIS_DESCR STD_AXIS NO_INPUT_QUANTITY _CNV_R_R_vfzg_ub_q1_347_CM 12 0. 318.75 FORMAT "%8.4" /end AXIS_DESCR
/end CHARACTERISTIC
/begin MEASUREMENT B_FIRSTEMP "Bedingung Generatorstarttemperatur-Berechnung" UBYTE _CNV_A_R_LINEAR_____13_CM 1 100. 0. 255. ECU_ADDRESS 0x3fab2c BIT_MASK 0x1 /end MEASUREMENT
/begin MEASUREMENT B_GENE "Generatormoment enable/disable" UBYTE _CNV_A_R_LINEAR_____13_CM 1 100. 0. 255. ECU_ADDRESS 0x3fab2d BIT_MASK 0x1 /end MEASUREMENT
/begin MEASUREMENT B_GENOFF "" UBYTE _CNV_A_R_LINEAR_____13_CM 1 100. 0. 255. ECU_ADDRESS 0x3fac1f BIT_MASK 0x1 /end MEASUREMENT
/begin MEASUREMENT B_HEIZEN "Bedingung Generator in Heizphase" UBYTE _CNV_A_R_LINEAR_____13_CM 1 100. 0. 255. ECU_ADDRESS 0x3fab2e BIT_MASK 0x1 /end MEASUREMENT
/begin MEASUREMENT B_STEND "" UBYTE _CNV_A_R_LINEAR_____13_CM 1 100. 0. 255. ECU_ADDRESS 0x3fd9fb BIT_MASK 0x1 /end MEASUREMENT
/begin MEASUREMENT DFFGENTMP "Temp-Variable" UWORD _CNV_A_R_PCENT_350_CM 1 100. 0. 100. ECU_ADDRESS 0x3faad0 FORMAT "%8.4" /end MEASUREMENT
/begin MEASUREMENT GEN_TETA "Wirkungsgrad Generator W*PI temperaturkompensiert" UBYTE _CNV_R_R_geneta_q0p_351_CM 1 100. 0. 7.96875 ECU_ADDRESS 0x3fab33 FORMAT "%8.4" /end MEASUREMENT
/begin MEASUREMENT GEN_WETA "Wirkungsgrad Generator mit Omega*PI" UBYTE _CNV_R_R_geneta_q0p_351_CM 1 100. 0. 7.96875 ECU_ADDRESS 0x3fab34 FORMAT "%8.4" /end MEASUREMENT
/begin MEASUREMENT GENALFAK2 "Winderstands-Alpha-Faktor" UWORD _CNV_R_R_genalfak_u_352_CM 1 100. 0. 2.999939 ECU_ADDRESS 0x3faad2 FORMAT "%8.4" /end MEASUREMENT
/begin MEASUREMENT GENDELTAOF "Temperaturdifferenz Generator" SWORD _CNV_R_R_temp_sw_q0_353_CM 1 100. -48. 384. ECU_ADDRESS 0x3faad4 FORMAT "%8.4" /end MEASUREMENT
/begin MEASUREMENT GENDI_SPV "mittlerer quadratischer Diodenstrom" ULONG _CNV_R_R_genpv_ul_354_CM 1 100. 0. 510. ECU_ADDRESS 0x3fab14 FORMAT "%8.4" /end MEASUREMENT
/begin MEASUREMENT GENDTS "Temperaturerhoehung im Generatorstator" UWORD _CNV_R_R_gendt_q0p0_355_CM 1 100. 0. 768. ECU_ADDRESS 0x3faad6 FORMAT "%8.4" /end MEASUREMENT
/begin MEASUREMENT GENDTS_S1 "Temperaturerhöhung einer Statorspule und Diodenpaar" UWORD _CNV_R_R_gendt_q0p0_355_CM 1 100. 0. 192. ECU_ADDRESS 0x3faada FORMAT "%8.4" /end MEASUREMENT
/begin MEASUREMENT GENDTSVOR "Temp-Variable" UWORD _CNV_R_R_gendt_q0p0_355_CM 1 100. 0. 768. ECU_ADDRESS 0x3faad8 FORMAT "%8.4" /end MEASUREMENT
/begin MEASUREMENT GENFETA "Generatorwirkungsgrad Berechnnugsterm" UWORD _CNV_R_R_geneta_q0p_351_CM 1 100. 3.125e-002 2047.9688 ECU_ADDRESS 0x3faadc FORMAT "%8.4" /end MEASUREMENT
/begin MEASUREMENT GENI_DIFK "mittlerer Diodenstrom" UWORD _CNV_R_R_igen_uw_q0_356_CM 1 100. 0. 255. ECU_ADDRESS 0x3faae8 FORMAT "%8.4" /end MEASUREMENT
/begin MEASUREMENT GENI_END "Generatorstrom gemessen / gerechnet" UBYTE _CNV_R_R_igen_ub_q1_343_CM 1 100. 0. 254. ECU_ADDRESS 0x3fab31 FORMAT "%8.4" /end MEASUREMENT
/begin MEASUREMENT GENI_STFK "mittlerer Statorstrom" UWORD _CNV_R_R_igen_uw_q0_356_CM 1 100. 0. 255. ECU_ADDRESS 0x3faaea FORMAT "%8.4" /end MEASUREMENT
/begin MEASUREMENT GENI2_ST "mittlerer quadratischer Statorstrom" UWORD _CNV_A_R_LINEAR_____13_CM 1 100. 0. 65535. ECU_ADDRESS 0x3faade FORMAT "%8.4" /end MEASUREMENT
/begin MEASUREMENT GENIG "Generatorstrom gesamt" UBYTE _CNV_R_R_igen_ub_q1_343_CM 1 100. 0. 255. ECU_ADDRESS 0x3fab2f FORMAT "%8.4" /end MEASUREMENT
/begin MEASUREMENT GENIKALTUN "DF korrektiert ueber Generatordrehzahl" UWORD _CNV_R_R_igen_uw_q0_356_CM 1 100. 0. 2047.9688 ECU_ADDRESS 0x3faae0 FORMAT "%8.4" /end MEASUREMENT
/begin MEASUREMENT GENIMESS "gemessener Generatorstrom mit Messbereich" UBYTE _CNV_R_R_igen_ub_q1_343_CM 1 100. 0. 254. ECU_ADDRESS 0x3fab30 FORMAT "%8.4" /end MEASUREMENT
/begin MEASUREMENT GENINAFIL "Generatorstrom nach Filter" UWORD _CNV_R_R_igen_uw_q0_356_CM 1 100. 0. 256. ECU_ADDRESS 0x3faae2 FORMAT "%8.4" /end MEASUREMENT
/begin MEASUREMENT GENITEMP "korrigiertes DF Signal ueber Temperatur, Generatordrehzahl, Generatorspannung" UWORD _CNV_R_R_igen_uw_q0_356_CM 1 100. 0. 2047.9688 ECU_ADDRESS 0x3faae4 FORMAT "%8.4" /end MEASUREMENT
/begin MEASUREMENT GENIVORFIL "Generatorstrom vor Filter" UWORD _CNV_R_R_igen_uw_q0_356_CM 1 100. 0. 256. ECU_ADDRESS 0x3faae6 FORMAT "%8.4" /end MEASUREMENT
/begin MEASUREMENT GENRESTEMP "Resttemperatur Generator" SWORD _CNV_R_R_temp_sw_q0_353_CM 1 100. -48. 384. ECU_ADDRESS 0x3faaec FORMAT "%8.4" /end MEASUREMENT
/begin MEASUREMENT GENRS "Statorwiderstand" UWORD _CNV_R_R_genrstator_357_CM 1 100. 0. 0.99998474 ECU_ADDRESS 0x3faaee FORMAT "%8.4" /end MEASUREMENT
/begin MEASUREMENT GENSPV "Generatorstatorverlustleistung" UWORD _CNV_R_R_genpv_uw_q_358_CM 1 100. 0. 2047.9688 ECU_ADDRESS 0x3faaf0 FORMAT "%8.4" /end MEASUREMENT
/begin MEASUREMENT GENSPV_1 "Verlustleistung einer Statorspule" ULONG _CNV_R_R_genpv_ul_354_CM 1 100. 0. 262144. ECU_ADDRESS 0x3fab18 FORMAT "%8.4" /end MEASUREMENT
/begin MEASUREMENT GENSPV_2 "Verlustleistung eines Diodenpaars" ULONG _CNV_R_R_genpv_ul_354_CM 1 100. 0. 262144. ECU_ADDRESS 0x3fab1c FORMAT "%8.4" /end MEASUREMENT
/begin MEASUREMENT GENSTTEMP "Generatorstarttemperatur" UWORD _CNV_R_R_temp_uw_q0_349_CM 1 100. -48. 336. ECU_ADDRESS 0x3faaf2 FORMAT "%8.4" /end MEASUREMENT
/begin MEASUREMENT GENTEMP "Generatortemperatur" UWORD _CNV_R_R_temp_uw_q0_349_CM 1 100. -48. 336. ECU_ADDRESS 0x3faaf4 FORMAT "%8.4" /end MEASUREMENT
/begin MEASUREMENT GENTEMPAB "Abstelltemperatur Generator" UWORD _CNV_R_R_temp_uw_q0_349_CM 1 100. -48. 336. ECU_ADDRESS 0x3fac94 FORMAT "%8.4" /end MEASUREMENT
/begin MEASUREMENT GENTEMPDT "Temperaturdifferenz zwischen Abstelltemperatur und Umgebungstemperatur" SWORD _CNV_R_R_temp_sw_q0_353_CM 1 100. -48. 384. ECU_ADDRESS 0x3faaf6 FORMAT "%8.4" /end MEASUREMENT
/begin MEASUREMENT GENTEMPEND "Generatortemperatur endgültig" UWORD _CNV_R_R_temp_uw_q0_349_CM 1 100. -48. 336. ECU_ADDRESS 0x3faaf8 FORMAT "%8.4" /end MEASUREMENT
/begin MEASUREMENT GENTEMPEXP "Delta Abkühltemperatur" SWORD _CNV_R_R_temp_sw_q0_353_CM 1 100. -48. 384. ECU_ADDRESS 0x3faafa FORMAT "%8.4" /end MEASUREMENT
/begin MEASUREMENT GENTEMPFIL "gefilterte Generatortemperatur" UWORD _CNV_R_R_gendt_q0p0_355_CM 1 100. 0. 768. ECU_ADDRESS 0x3faafc FORMAT "%8.4" /end MEASUREMENT
/begin MEASUREMENT GENTEMPUMG "Generaturtemperatur Umgebung" UBYTE _CNV_A_R_LINEAR_____345_CM 1 100. -48. 143.25 ECU_ADDRESS 0x3fab32 FORMAT "%8.4" /end MEASUREMENT
/begin MEASUREMENT GENTREST "Generatorresttemperaturzeit" UWORD _CNV_R_R_igen_ub_q1_343_CM 1 100. 0. 65535. ECU_ADDRESS 0x3faafe FORMAT "%8.4" /end MEASUREMENT
/begin MEASUREMENT IGEN400A "gemmessener Generatorstrom 400A-Bereich" UWORD _CNV_R_R_igenmess10_359_CM 1 100. 0. 417.42038 ECU_ADDRESS 0x3fab00 FORMAT "%8.4" /end MEASUREMENT
/begin MEASUREMENT IGEN400FH "AD-Wert gemessener Generatorstrom 400A-Bereich" ULONG _CNV_R_R_igenmess10_359_CM 1 100. 0. 27356480. ECU_ADDRESS 0x3fab20 FORMAT "%8.4" /end MEASUREMENT
/begin MEASUREMENT IGEN40A "gemessener Generatorstrom 100A -Messbereich" UWORD _CNV_R_R_igenmess10_359_CM 1 100. 0. 417.42038 ECU_ADDRESS 0x3fab02 FORMAT "%8.4" /end MEASUREMENT
/begin MEASUREMENT IGEN40FH "AD-Wert gemessener Generatorstrom 100A-Bereich" ULONG _CNV_R_R_igenmess10_359_CM 1 100. 0. 27356480. ECU_ADDRESS 0x3fab24 FORMAT "%8.4" /end MEASUREMENT
/begin MEASUREMENT IGENMESS "gemessener Generatorstrom" UWORD _CNV_A_R_LINEAR_____13_CM 1 100. 0. 1024. ECU_ADDRESS 0x3fd2ba FORMAT "%8.4" /end MEASUREMENT
/begin MEASUREMENT MD_GENLOC "relatives Generatormoment" UBYTE _CNV_A_R_PCENT_350_CM 1 100. 0. 99.609375 ECU_ADDRESS 0x3fab37 FORMAT "%8.4" /end MEASUREMENT
/begin MEASUREMENT MD_GENNM "Generatormoment absolut" UWORD _CNV_R_R_md_ub_q0p0_360_CM 1 100. 0. 128. ECU_ADDRESS 0x3fab04 FORMAT "%8.4" /end MEASUREMENT
/begin MEASUREMENT MD_GENREL "relatives Generatormoment Ausgang" UBYTE _CNV_A_R_PCENT_350_CM 1 100. 0. 99.609375 ECU_ADDRESS 0x3fab38 FORMAT "%8.4" /end MEASUREMENT
/begin MEASUREMENT MDGENVF "relatives Generatordrehmoment" UBYTE _CNV_A_R_PCENT_350_CM 1 100. 0. 99.609375 ECU_ADDRESS 0x3fab35 FORMAT "%8.4" /end MEASUREMENT
/begin MEASUREMENT MDNORMTMP "temporäre MDNORM" UBYTE _CNV_R_R_md_ub_q16_361_CM 1 100. 16. 1008. ECU_ADDRESS 0x3fab36 FORMAT "%8.4" /end MEASUREMENT
/begin MEASUREMENT NGEN_W "Generatordrehzahl" UWORD _CNV_R_R_ngen_uw_q0_362_CM 1 100. 0. 32767.5 ECU_ADDRESS 0x3fab06 FORMAT "%8.4" /end MEASUREMENT
/begin MEASUREMENT NMOTS "Motordrehzahl U/s" UBYTE _CNV_R_R_igen_ub_q1_343_CM 1 100. 0. 255. ECU_ADDRESS 0x3fab39 FORMAT "%8.4" /end MEASUREMENT
/begin MEASUREMENT PGENAB "elektrische Generatorleistung" ULONG _CNV_R_R_genpv_uw_q_358_CM 1 100. 0. 4096. ECU_ADDRESS 0x3fab28 FORMAT "%8.4" /end MEASUREMENT
/begin MEASUREMENT ST_I_GEN "Generatorstrom" UBYTE _CNV_R_R_igen_ub_q1_343_CM 1 100. 0. 254. ECU_ADDRESS 0x3fab3a FORMAT "%8.4" /end MEASUREMENT
/begin MEASUREMENT STIGEN_TMP "Generatorstrom word" UWORD _CNV_R_R_igen_ub_q1_343_CM 1 100. 0. 255. ECU_ADDRESS 0x3fab08 FORMAT "%8.4" /end MEASUREMENT
/begin MEASUREMENT TABST_W "" UWORD _CNV_R_R_igen_ub_q1_343_CM 1 100. 0. 65535. ECU_ADDRESS 0x3fd2b8 FORMAT "%8.4" /end MEASUREMENT
/begin MEASUREMENT TSTCOUNTV "Testcounter-Wert" UWORD _CNV_R_R_igen_ub_q1_343_CM 1 100. 0. 65535. ECU_ADDRESS 0x3fab0a FORMAT "%8.4" /end MEASUREMENT
/begin MEASUREMENT TSTFIL_OUT "Testfilter Ausgang" UWORD _CNV_R_R_gendt_q0p0_355_CM 1 100. 0. 768. ECU_ADDRESS 0x3fab0c FORMAT "%8.4" /end MEASUREMENT
/begin MEASUREMENT TSTLOCINI "Temp-Variable" UBYTE _CNV_A_R_LINEAR_____13_CM 1 100. 0. 255. ECU_ADDRESS 0x3fab3b BIT_MASK 0x1 /end MEASUREMENT
/begin MEASUREMENT UFGEN_TMP "Sollspannung vom Generator" UWORD _CNV_R_R_spg_ugen_363_CM 1 100. 10.6 16. ECU_ADDRESS 0x3fab10 FORMAT "%8.4" /end MEASUREMENT
/begin MEASUREMENT UFGENTMP "Temp-Variable" UWORD _CNV_R_R_spg_ugen_363_CM 1 100. 10.6 36.1 ECU_ADDRESS 0x3fab0e FORMAT "%8.4" /end MEASUREMENT
/begin CHARACTERISTIC B_APIGDFN "Kennlinienumschalter für IG-Berechnung aus nmot und DF" VALUE 0x6e104 _REC_VAL_20_u1 255. _CNV_A_R_LINEAR_____13_CM 0. 255. FORMAT "%8.4" /end CHARACTERISTIC
/begin CHARACTERISTIC EN_MDGEN "Enable Generatormomenteinrechung" VALUE 0x6e105 _REC_VAL_20_u1 255. _CNV_R_R_igen_ub_q1_343_CM 0. 255. FORMAT "%8.4" /end CHARACTERISTIC
/begin CHARACTERISTIC GEN_IG_OF "Offsetwert Generatorstrom" VALUE 0x6e0f8 _REC_VAL_20_u2 2047.9688 _CNV_R_R_igen_uw_q0_356_CM 0. 2047.9688 FORMAT "%8.4" /end CHARACTERISTIC
/begin CHARACTERISTIC GENDIFAK "Stromfaktor Diode" VALUE 0x6e106 _REC_VAL_20_u1 0.99609375 _CNV_R_R_fak_q0p003_364_CM 0. 0.99609375 FORMAT "%8.4" /end CHARACTERISTIC
/begin CHARACTERISTIC GENITYP "Generatorstrotyp 0=gerechnet / 1=gemessen" VALUE 0x6e107 _REC_VAL_20_u1 1. _CNV_A_R_LINEAR_____13_CM 0. 1. FORMAT "%8.4" /end CHARACTERISTIC
/begin CHARACTERISTIC GENMDOF "Offset des Generatormoments" VALUE 0x6e108 _REC_VAL_20_u1 99.609375 _CNV_A_R_PCENT_350_CM 0. 99.609375 FORMAT "%8.4" /end CHARACTERISTIC
/begin CHARACTERISTIC GENRESTTYP "Typ der Generatorresttemperaturberechnung" VALUE 0x6e109 _REC_VAL_20_u1 255. _CNV_A_R_LINEAR_____13_CM 0. 255. FORMAT "%8.4" /end CHARACTERISTIC
/begin CHARACTERISTIC GENRS0 "Generatorstatorwiderstand bei 25°" VALUE 0x6e0f4 _REC_VAL_20_u2 0.99998474 _CNV_R_R_genrstator_357_CM 0. 0.99998474 FORMAT "%8.4" /end CHARACTERISTIC
/begin CHARACTERISTIC GENSTFAK "Stromfaktor Statorspule" VALUE 0x6e10a _REC_VAL_20_u1 0.99609375 _CNV_R_R_fak_q0p003_364_CM 0. 0.99609375 FORMAT "%8.4" /end CHARACTERISTIC
/begin CHARACTERISTIC GENTEMPAPP "Geneeratortemperatur mauelle Vorgabe" VALUE 0x6e0f6 _REC_VAL_20_u2 384. _CNV_R_R_temp_uw_q0_349_CM -48. 336. FORMAT "%8.4" /end CHARACTERISTIC
/begin CHARACTERISTIC GENTEMPMAN "Manuelle Generatorvorgabe" VALUE 0x6e10b _REC_VAL_20_u1 255. _CNV_A_R_LINEAR_____13_CM 0. 255. FORMAT "%8.4" /end CHARACTERISTIC
/begin CHARACTERISTIC GENTYP "Generatortyp" VALUE 0x6e10c _REC_VAL_20_u1 255. _CNV_A_R_LINEAR_____13_CM 0. 255. FORMAT "%8.4" /end CHARACTERISTIC
/begin CHARACTERISTIC GENUEBSETZ "Generatoruebersetzung" VALUE 0x6e10d _REC_VAL_20_u1 3.984375 _CNV_R_R_genuebsetz_365_CM 0. 3.984375 FORMAT "%8.4" /end CHARACTERISTIC
/begin CHARACTERISTIC GENUMGTYP "Generatorluftumgebung" VALUE 0x6e10e _REC_VAL_20_u1 255. _CNV_A_R_LINEAR_____13_CM 0. 255. FORMAT "%8.4" /end CHARACTERISTIC
/begin CHARACTERISTIC KFGENWETA "Wirkungsgrad Generator mit 2*PI" MAP 0x6dc62 _REC_MAP_32_u2_u2_u2 7.96875 _CNV_R_R_geneta_q0p_351_CM 0. 7.96875 FORMAT "%8.4"
 /begin AXIS_DESCR STD_AXIS NO_INPUT_QUANTITY _CNV_R_R_igen_ub_q1_343_CM 8 0. 255. FORMAT "%8.4" /end AXIS_DESCR
 /begin AXIS_DESCR STD_AXIS NO_INPUT_QUANTITY _CNV_R_R_ngen_uw_q0_362_CM 8 0. 32767.5 FORMAT "%8.4" /end AXIS_DESCR
/end CHARACTERISTIC
/begin CHARACTERISTIC KFIGDFNMOT "Generatorstrom Einfachkennfeld" MAP 0x6dd06 _REC_MAP_32_u2_u2_u2 2047.9688 _CNV_R_R_igen_uw_q0_356_CM 0. 2047.9688 FORMAT "%8.4"
 /begin AXIS_DESCR STD_AXIS NO_INPUT_QUANTITY _CNV_R_R_ngen_uw_q0_362_CM 8 0. 32767.5 FORMAT "%8.4" /end AXIS_DESCR
 /begin AXIS_DESCR STD_AXIS NO_INPUT_QUANTITY _CNV_A_R_PCENT_350_CM 8 0. 100. FORMAT "%8.4" /end AXIS_DESCR
/end CHARACTERISTIC
/begin CHARACTERISTIC KFIGENDF "Generatorstrom DF-Kennfeld" MAP 0x6ddaa _REC_MAP_32_u2_u2_u2 2047.9688 _CNV_R_R_igen_uw_q0_356_CM 0. 2047.9688 FORMAT "%8.4"
 /begin AXIS_DESCR STD_AXIS NO_INPUT_QUANTITY _CNV_A_R_PCENT_350_CM 7 0. 100. FORMAT "%8.4" /end AXIS_DESCR
 /begin AXIS_DESCR STD_AXIS NO_INPUT_QUANTITY _CNV_R_R_igen_uw_q0_356_CM 12 0. 2047.9688 FORMAT "%8.4" /end AXIS_DESCR
/end CHARACTERISTIC
/begin CHARACTERISTIC KFIGENKALT "Kaltkennfeld Generator" MAP 0x6de7c _REC_MAP_32_u2_u2_u2 2047.9688 _CNV_R_R_igen_uw_q0_356_CM 0. 2047.9688 FORMAT "%8.4"
 /begin AXIS_DESCR STD_AXIS NO_INPUT_QUANTITY _CNV_R_R_spg_ugen_363_CM 10 10.6 36.2 FORMAT "%8.4" /end AXIS_DESCR
 /begin AXIS_DESCR STD_AXIS NO_INPUT_QUANTITY _CNV_R_R_ngen_uw_q0_362_CM 11 0. 32767.5 FORMAT "%8.4" /end AXIS_DESCR
/end CHARACTERISTIC
/begin CHARACTERISTIC KFIGENT "Warmkennfeld Generator" MAP 0x6df86 _REC_MAP_32_u2_u2_u2 2047.9688 _CNV_R_R_igen_uw_q0_356_CM 0. 2047.9688 FORMAT "%8.4"
 /begin AXIS_DESCR STD_AXIS NO_INPUT_QUANTITY _CNV_R_R_igen_uw_q0_356_CM 10 0. 2047.9688 FORMAT "%8.4" /end AXIS_DESCR
 /begin AXIS_DESCR STD_AXIS NO_INPUT_QUANTITY _CNV_R_R_temp_uw_q0_349_CM 8 -48. 336. FORMAT "%8.4" /end AXIS_DESCR
/end CHARACTERISTIC
/begin CHARACTERISTIC KLFPVDIODE "Verlustleistungsfaktor eines Diodenpaars" CURVE 0x6e04e _REC_CUR_32_u2_u2 1.9921875 _CNV_A_R_LINEAR_____67_CM 0. 1.9921875 FORMAT "%8.4"
 /begin AXIS_DESCR STD_AXIS NO_INPUT_QUANTITY _CNV_R_R_temp_uw_q0_349_CM 5 -48. 336. FORMAT "%8.4" /end AXIS_DESCR
/end CHARACTERISTIC
/begin CHARACTERISTIC KLGENEXP "Abkühlkurve Generator" CURVE 0x6e064 _REC_CUR_32_u2_u2 1. _CNV_R_R_fak_q0p003_364_CM 0. 1. FORMAT "%8.4"
 /begin AXIS_DESCR STD_AXIS NO_INPUT_QUANTITY _CNV_R_R_igen_ub_q1_343_CM 13 0. 65535. FORMAT "%8.4" /end AXIS_DESCR
/end CHARACTERISTIC
/begin CHARACTERISTIC KLGENTEMPF "Korrekturfaktor I-Gen über Temperatur" CURVE 0x6e09a _REC_CUR_32_u2_u2 2.999939 _CNV_R_R_genalfak_u_352_CM 0. 2.999939 FORMAT "%8.4"
 /begin AXIS_DESCR STD_AXIS NO_INPUT_QUANTITY _CNV_R_R_spg_ugen_363_CM 6 10.6 36.2 FORMAT "%8.4" /end AXIS_DESCR
/end CHARACTERISTIC
/begin CHARACTERISTIC KLGENTETA "Temperatur_eta_faktor Generator" CURVE 0x6e0b4 _REC_CUR_32_u2_u2 0.99609375 _CNV_R_R_fak_q0p003_364_CM 0. 0.99609375 FORMAT "%8.4"
 /begin AXIS_DESCR STD_AXIS NO_INPUT_QUANTITY _CNV_R_R_temp_uw_q0_349_CM 6 -48. 336. FORMAT "%8.4" /end AXIS_DESCR
/end CHARACTERISTIC
/begin CHARACTERISTIC KLRTHGEN "RTH-Kennfeld Generator" CURVE 0x6e0ce _REC_CUR_32_u2_u2 4. _CNV_R_R_genuebsetz_365_CM 0. 4. FORMAT "%8.4"
 /begin AXIS_DESCR STD_AXIS NO_INPUT_QUANTITY _CNV_R_R_ngen_uw_q0_362_CM 9 0. 32767.5 FORMAT "%8.4" /end AXIS_DESCR
/end CHARACTERISTIC
/begin CHARACTERISTIC MESSBG400A "Generatormessbereich Umschaltung 100A/400A" VALUE 0x6e10f _REC_VAL_20_u1 1. _CNV_A_R_LINEAR_____13_CM 0. 1. FORMAT "%8.4" /end CHARACTERISTIC
/begin CHARACTERISTIC TSTCNTEN "Enable TestCounter" VALUE 0x6e110 _REC_VAL_20_u1 1. _CNV_R_R_igen_ub_q1_343_CM 0. 1. FORMAT "%8.4" /end CHARACTERISTIC
/begin CHARACTERISTIC TSTFIL_IN "Testfilter Eingang" VALUE 0x6e0fa _REC_VAL_20_u2 768. _CNV_R_R_gendt_q0p0_355_CM 0. 768. FORMAT "%8.4" /end CHARACTERISTIC
/begin CHARACTERISTIC TSTFIL_INI "Initialisierung Testfilter" VALUE 0x6e111 _REC_VAL_20_u1 255. _CNV_A_R_LINEAR_____13_CM 0. 255. FORMAT "%8.4" /end CHARACTERISTIC
/begin CHARACTERISTIC UGDIODERMS "RMS-Schwellspannung Generatordiode" VALUE 0x6e112 _REC_VAL_20_u1 1.9921875 _CNV_A_R_LINEAR_____67_CM 0. 1.9921875 FORMAT "%8.4" /end CHARACTERISTIC
/begin CHARACTERISTIC ZMGENIG "Zeitkonstante Generatorstrom" VALUE 0x6e0fc _REC_VAL_20_u2 1.9999695 _CNV_R_R_genzmig_uw_366_CM 0. 1.9999695 FORMAT "%8.4" /end CHARACTERISTIC
/begin CHARACTERISTIC ZMGENSTHZ "Zeitkonstante Generatorstator Aufheizung" VALUE 0x6e0fe _REC_VAL_20_u2 0.99998474 _CNV_R_R_genzmst_uw_367_CM 0. 0.99998474 FORMAT "%8.4" /end CHARACTERISTIC
/begin CHARACTERISTIC ZMGENSTKHL "Zeitkonstante Abkühlung Generator" VALUE 0x6e100 _REC_VAL_20_u2 0.99998474 _CNV_R_R_genzmst_uw_367_CM 0. 0.99998474 FORMAT "%8.4" /end CHARACTERISTIC
/begin CHARACTERISTIC ZMTESTFIL "Zeitkonstante Testfilter" VALUE 0x6e102 _REC_VAL_20_u2 0.99998474 _CNV_R_R_genzmst_uw_367_CM 0. 0.99998474 FORMAT "%8.4" /end CHARACTERISTIC
/begin MEASUREMENT B_INIBUMG "Hilfsbedingung Batterietemperaturumgebungsberechung" UBYTE _CNV_A_R_LINEAR_____13_CM 1 100. 0. 255. ECU_ADDRESS 0x3fab54 BIT_MASK 0x1 /end MEASUREMENT
/begin MEASUREMENT B_TNS "" UBYTE _CNV_A_R_LINEAR_____13_CM 1 100. 0. 255. ECU_ADDRESS 0x3fda0b BIT_MASK 0x1 /end MEASUREMENT
/begin MEASUREMENT BATT_A1 "Temp-Variable" FLOAT32_IEEE _CNV_A_R_LINEAR_____13_CM 1 100. -2147483648. 4294967295. ECU_ADDRESS 0x3fab80 FORMAT "%8.4" /end MEASUREMENT
/begin MEASUREMENT BATT_A2 "Temp-Variable" FLOAT32_IEEE _CNV_A_R_LINEAR_____13_CM 1 100. -2147483648. 4294967295. ECU_ADDRESS 0x3fab84 FORMAT "%8.4" /end MEASUREMENT
/begin MEASUREMENT BATT_C10 "Temp-Variable" FLOAT32_IEEE _CNV_A_R_LINEAR_____13_CM 1 100. -2147483648. 4294967295. ECU_ADDRESS 0x3fab88 FORMAT "%8.4" /end MEASUREMENT
/begin MEASUREMENT BATT_C11 "Temp-Variable" FLOAT32_IEEE _CNV_A_R_LINEAR_____13_CM 1 100. -2147483648. 4294967295. ECU_ADDRESS 0x3fab8c FORMAT "%8.4" /end MEASUREMENT
/begin MEASUREMENT BATT_C12 "Temp-Variable" FLOAT32_IEEE _CNV_A_R_LINEAR_____13_CM 1 100. -2147483648. 4294967295. ECU_ADDRESS 0x3fab90 FORMAT "%8.4" /end MEASUREMENT
/begin MEASUREMENT BATT_C13 "Temp-Variable" FLOAT32_IEEE _CNV_A_R_LINEAR_____13_CM 1 100. -2147483648. 4294967295. ECU_ADDRESS 0x3fab94 FORMAT "%8.4" /end MEASUREMENT
/begin MEASUREMENT BATT_C14 "Temp-Variable" FLOAT32_IEEE _CNV_A_R_LINEAR_____13_CM 1 100. -2147483648. 4294967295. ECU_ADDRESS 0x3fab98 FORMAT "%8.4" /end MEASUREMENT
/begin MEASUREMENT BATT_C8 "Temp-Variable" FLOAT32_IEEE _CNV_A_R_LINEAR_____13_CM 1 100. -2147483648. 4294967295. ECU_ADDRESS 0x3fab9c FORMAT "%8.4" /end MEASUREMENT
/begin MEASUREMENT BATT_C9 "Temp-Variable" FLOAT32_IEEE _CNV_A_R_LINEAR_____13_CM 1 100. -2147483648. 4294967295. ECU_ADDRESS 0x3faba0 FORMAT "%8.4" /end MEASUREMENT
/begin MEASUREMENT BATT_D1 "Temp-Variable" FLOAT32_IEEE _CNV_A_R_LINEAR_____13_CM 1 100. -2147483648. 4294967295. ECU_ADDRESS 0x3faba4 FORMAT "%8.4" /end MEASUREMENT
/begin MEASUREMENT BATT_E1 "Temp-Variable" FLOAT32_IEEE _CNV_A_R_LINEAR_____13_CM 1 100. -2147483648. 4294967295. ECU_ADDRESS 0x3faba8 FORMAT "%8.4" /end MEASUREMENT
/begin MEASUREMENT BATT_E2 "Temp-Variable" FLOAT32_IEEE _CNV_A_R_LINEAR_____13_CM 1 100. -2147483648. 4294967295. ECU_ADDRESS 0x3fabac FORMAT "%8.4" /end MEASUREMENT
/begin MEASUREMENT BATT_E3 "Temp-Variable" FLOAT32_IEEE _CNV_A_R_LINEAR_____13_CM 1 100. -2147483648. 4294967295. ECU_ADDRESS 0x3fabb0 FORMAT "%8.4" /end MEASUREMENT
/begin MEASUREMENT BATT_E4 "Temp-Variable" FLOAT32_IEEE _CNV_A_R_LINEAR_____13_CM 1 100. -2147483648. 4294967295. ECU_ADDRESS 0x3fabb4 FORMAT "%8.4" /end MEASUREMENT
/begin MEASUREMENT BATT_E5 "Temp-Variable" FLOAT32_IEEE _CNV_A_R_LINEAR_____13_CM 1 100. -2147483648. 4294967295. ECU_ADDRESS 0x3fabb8 FORMAT "%8.4" /end MEASUREMENT
/begin MEASUREMENT BATT_E6 "Temp-Variable" FLOAT32_IEEE _CNV_A_R_LINEAR_____13_CM 1 100. -2147483648. 4294967295. ECU_ADDRESS 0x3fabbc FORMAT "%8.4" /end MEASUREMENT
/begin MEASUREMENT BATT_TFIL "Zeitkonstante Batterie" FLOAT32_IEEE _CNV_A_R_LINEAR_____13_CM 1 100. -2147483648. 4294967295. ECU_ADDRESS 0x3fabc0 FORMAT "%8.4" /end MEASUREMENT
/begin MEASUREMENT BATT_W0 "Temp-Variable" FLOAT32_IEEE _CNV_A_R_LINEAR_____13_CM 1 100. -2147483648. 4294967295. ECU_ADDRESS 0x3fabc4 FORMAT "%8.4" /end MEASUREMENT
/begin MEASUREMENT BATTO_A "Temp-Variable" FLOAT32_IEEE _CNV_A_R_LINEAR_____13_CM 1 100. -2147483648. 4294967295. ECU_ADDRESS 0x3fab58 FORMAT "%8.4" /end MEASUREMENT
/begin MEASUREMENT BATTO_A1 "Temp-Variable" FLOAT32_IEEE _CNV_A_R_LINEAR_____13_CM 1 100. -2147483648. 4294967295. ECU_ADDRESS 0x3fab5c FORMAT "%8.4" /end MEASUREMENT
/begin MEASUREMENT BATTO_B "Temp-Variable" FLOAT32_IEEE _CNV_A_R_LINEAR_____13_CM 1 100. -2147483648. 4294967295. ECU_ADDRESS 0x3fab60 FORMAT "%8.4" /end MEASUREMENT
/begin MEASUREMENT BATTO_C "Temp-Variable" FLOAT32_IEEE _CNV_A_R_LINEAR_____13_CM 1 100. -2147483648. 4294967295. ECU_ADDRESS 0x3fab64 FORMAT "%8.4" /end MEASUREMENT
/begin MEASUREMENT BATTO_C1 "Temp-Variable" FLOAT32_IEEE _CNV_A_R_LINEAR_____13_CM 1 100. -2147483648. 4294967295. ECU_ADDRESS 0x3fab68 FORMAT "%8.4" /end MEASUREMENT
/begin MEASUREMENT BATTO_C2 "Temp-Variable" FLOAT32_IEEE _CNV_A_R_LINEAR_____13_CM 1 100. -2147483648. 4294967295. ECU_ADDRESS 0x3fab6c FORMAT "%8.4" /end MEASUREMENT
/begin MEASUREMENT BATTO_C3 "Temp-Variable" FLOAT32_IEEE _CNV_A_R_LINEAR_____13_CM 1 100. -2147483648. 4294967295. ECU_ADDRESS 0x3fab70 FORMAT "%8.4" /end MEASUREMENT
/begin MEASUREMENT BATTO_C4 "Temp-Variable" FLOAT32_IEEE _CNV_A_R_LINEAR_____13_CM 1 100. -2147483648. 4294967295. ECU_ADDRESS 0x3fab74 FORMAT "%8.4" /end MEASUREMENT
/begin MEASUREMENT BATTO_C6 "Temp-Variable" FLOAT32_IEEE _CNV_A_R_LINEAR_____13_CM 1 100. -2147483648. 4294967295. ECU_ADDRESS 0x3fab78 FORMAT "%8.4" /end MEASUREMENT
/begin MEASUREMENT BATTO_C7 "Temp-Variable" FLOAT32_IEEE _CNV_A_R_LINEAR_____13_CM 1 100. -2147483648. 4294967295. ECU_ADDRESS 0x3fab7c FORMAT "%8.4" /end MEASUREMENT
/begin MEASUREMENT CTRGENUTAR "Generatorsollspannung" UBYTE _CNV_A_R_LINEAR_____368_CM 1 100. 10.6 16.975 ECU_ADDRESS 0x3fab55 FORMAT "%5.2" /end MEASUREMENT
/begin MEASUREMENT DBET_ALF "Batterieaplphawert" FLOAT32_IEEE _CNV_A_R_LINEAR_____13_CM 1 100. -2147483648. 4294967295. ECU_ADDRESS 0x3fabcc FORMAT "%8.4" /end MEASUREMENT
/begin MEASUREMENT DBETALF_T "Temp-Variable" FLOAT32_IEEE _CNV_A_R_LINEAR_____13_CM 1 100. -2147483648. 4294967295. ECU_ADDRESS 0x3fabc8 FORMAT "%8.4" /end MEASUREMENT
/begin MEASUREMENT DT_TUMG "delta T-Umgebung" FLOAT32_IEEE _CNV_A_R_LINEAR_____13_CM 1 100. -2147483648. 4294967295. ECU_ADDRESS 0x3fabd0 FORMAT "%8.4" /end MEASUREMENT
/begin MEASUREMENT END_INIT "Temp-Variable Initialisierungsende" UBYTE _CNV_A_R_LINEAR_____13_CM 1 100. 0. 255. ECU_ADDRESS 0x3fab56 BIT_MASK 0x1 /end MEASUREMENT
/begin MEASUREMENT T_BATT_INI "Startwert Batterietemperatur" FLOAT32_IEEE _CNV_A_R_LINEAR_____13_CM 1 100. -2147483648. 4294967295. ECU_ADDRESS 0x3fabec FORMAT "%8.4" /end MEASUREMENT
/begin MEASUREMENT T_BATTABST "Batterieabstelltemperatur" FLOAT32_IEEE _CNV_A_R_LINEAR_____13_CM 1 100. -2147483648. 4294967295. ECU_ADDRESS 0x3faca0 FORMAT "%8.4" /end MEASUREMENT
/begin MEASUREMENT T_UMGABST "Abstell-Aussentemperatur" SBYTE _CNV_R_R_temp_q1_369_CM 1 100. -128. 127. ECU_ADDRESS 0x3fac98 FORMAT "%8.4" /end MEASUREMENT
/begin MEASUREMENT T_UMGABSTF "letzte Aussentemperatur" FLOAT32_IEEE _CNV_A_R_LINEAR_____13_CM 1 100. -2147483648. 4294967295. ECU_ADDRESS 0x3fabf0 FORMAT "%8.4" /end MEASUREMENT
/begin MEASUREMENT TABST_FL "Abstellzeit in float" FLOAT32_IEEE _CNV_A_R_LINEAR_____13_CM 1 100. -2147483648. 4294967295. ECU_ADDRESS 0x3fabd4 FORMAT "%8.4" /end MEASUREMENT
/begin MEASUREMENT TANSF "Ansaugluft in float" FLOAT32_IEEE _CNV_A_R_LINEAR_____13_CM 1 100. -2147483648. 4294967295. ECU_ADDRESS 0x3fabd8 FORMAT "%8.4" /end MEASUREMENT
/begin MEASUREMENT TBATINMANF "Initwert Batterietmperatur Hand temp." FLOAT32_IEEE _CNV_A_R_LINEAR_____13_CM 1 100. -2147483648. 4294967295. ECU_ADDRESS 0x3fabdc FORMAT "%8.4" /end MEASUREMENT
/begin MEASUREMENT TBATSTINIV "Starttemperatur Batterie vorne" FLOAT32_IEEE _CNV_A_R_LINEAR_____13_CM 1 100. -2147483648. 4294967295. ECU_ADDRESS 0x3fabe0 FORMAT "%8.4" /end MEASUREMENT
/begin MEASUREMENT TUMGBATOLD "vorherige Batterieumgebungstemperatur" FLOAT32_IEEE _CNV_A_R_LINEAR_____13_CM 1 100. -2147483648. 4294967295. ECU_ADDRESS 0x3fabe4 FORMAT "%8.4" /end MEASUREMENT
/begin MEASUREMENT TUMGBATTAB "Abstell-Umgebungstemperatur Batterie" FLOAT32_IEEE _CNV_A_R_LINEAR_____13_CM 1 100. -2147483648. 4294967295. ECU_ADDRESS 0x3fac9c FORMAT "%8.4" /end MEASUREMENT
/begin MEASUREMENT TUMGCAN "" SBYTE _CNV_R_R_temp_q1_369_CM 1 100. -128. 127. ECU_ADDRESS 0x3fda0a FORMAT "%8.4" /end MEASUREMENT
/begin MEASUREMENT TUMGCANF "aktuelle Aussentemperatur float" FLOAT32_IEEE _CNV_A_R_LINEAR_____13_CM 1 100. -2147483648. 4294967295. ECU_ADDRESS 0x3fabe8 FORMAT "%8.4" /end MEASUREMENT
/begin MEASUREMENT U_CHARGE "Sollwert Ladespannung" FLOAT32_IEEE _CNV_A_R_LINEAR_____13_CM 1 100. -2147483648. 4294967295. ECU_ADDRESS 0x3fabf4 FORMAT "%8.4" /end MEASUREMENT
/begin MEASUREMENT U_CHARGE2 "Sollwert Ladespannung" FLOAT32_IEEE _CNV_A_R_LINEAR_____13_CM 1 100. -2147483648. 4294967295. ECU_ADDRESS 0x3fabf8 FORMAT "%8.4" /end MEASUREMENT
/begin CHARACTERISTIC APPTBATINI "Enable Applikation Initwert Batterietemperatur" VALUE 0x6e292 _REC_VAL_20_u1 255. _CNV_A_R_LINEAR_____13_CM 0. 255. FORMAT "%8.4" /end CHARACTERISTIC
/begin CHARACTERISTIC BATT_ALFAH "Alphatau-Wert Batterie hinten" VALUE 0x6e2a8 _REC_VAL_20_S4 0.9999900000000002 _CNV_A_R_LINEAR_____13_CM 1.e-005 1. FORMAT "%8.4" /end CHARACTERISTIC
/begin CHARACTERISTIC BATT_ALFAV "Alphatau-Wert Batterie vorne" VALUE 0x6e2ac _REC_VAL_20_S4 0.9999900000000002 _CNV_A_R_LINEAR_____13_CM 1.e-005 1. FORMAT "%8.4" /end CHARACTERISTIC
/begin CHARACTERISTIC BATT_BETAV "Beta-Wert Batterie vorne" VALUE 0x6e2b0 _REC_VAL_20_S4 0.9999900000000002 _CNV_A_R_LINEAR_____13_CM 1.e-005 1. FORMAT "%8.4" /end CHARACTERISTIC
/begin CHARACTERISTIC BATT_MR "Temp-Variable" VALUE 0x6e293 _REC_VAL_20_u1 255. _CNV_A_R_LINEAR_____13_CM 0. 255. /end CHARACTERISTIC
/begin CHARACTERISTIC BATTHTAUVG "Zeitkonstante Batterie hinten bei VFZG>" VALUE 0x6e298 _REC_VAL_20_S4 1. _CNV_A_R_LINEAR_____13_CM 0. 1. FORMAT "%8.4" /end CHARACTERISTIC
/begin CHARACTERISTIC BATTHTAUVK "Zeitkonstante Batterie hinten bei VFZG<" VALUE 0x6e29c _REC_VAL_20_S4 1. _CNV_A_R_LINEAR_____13_CM 0. 1. FORMAT "%8.4" /end CHARACTERISTIC
/begin CHARACTERISTIC BATTVTAUVG "Zeitkonstante Batterie vorne bei VFZG>" VALUE 0x6e2a0 _REC_VAL_20_S4 1. _CNV_A_R_LINEAR_____13_CM 0. 1. FORMAT "%8.4" /end CHARACTERISTIC
/begin CHARACTERISTIC BATTVTAUVK "Zeitkonstante Batterie bei VFZG<Zeitkonstante Batterie bei VFZG>" VALUE 0x6e2a4 _REC_VAL_20_S4 1. _CNV_A_R_LINEAR_____13_CM 0. 1. FORMAT "%8.4" /end CHARACTERISTIC
/begin CHARACTERISTIC BATVFZGTAU "VFZG-Umschaltschwelle TAU Batterie" VALUE 0x6e294 _REC_VAL_20_u1 318.75 _CNV_R_R_vfzg_ub_q1_347_CM 0. 318.75 FORMAT "%8.4" /end CHARACTERISTIC
/begin CHARACTERISTIC KLBATTLSTR "Geschwindigkeitsfaktor Batterieumgebungstemperatur" CURVE 0x6e114 _REC_CUR_33_S4_S4 65534.9 _CNV_A_R_LINEAR_____13_CM 0.1 65535. FORMAT "%8.4"
 /begin AXIS_DESCR STD_AXIS NO_INPUT_QUANTITY _CNV_A_R_LINEAR_____13_CM 6 0. 65535. FORMAT "%8.4" /end AXIS_DESCR
/end CHARACTERISTIC
/begin CHARACTERISTIC KLEXPALH "Funktion EXP(-ALPHA*tabst_w) hinten" CURVE 0x6e148 _REC_CUR_33_S4_S4 1. _CNV_A_R_LINEAR_____13_CM 0. 1. FORMAT "%8.4"
 /begin AXIS_DESCR STD_AXIS NO_INPUT_QUANTITY _CNV_A_R_LINEAR_____13_CM 11 0. 65535. FORMAT "%8.4" /end AXIS_DESCR
/end CHARACTERISTIC
/begin CHARACTERISTIC KLEXPALV "Funktion EXP(-ALPHA*tabst_w) hinten" CURVE 0x6e1a4 _REC_CUR_33_S4_S4 1. _CNV_A_R_LINEAR_____13_CM 0. 1. FORMAT "%8.4"
 /begin AXIS_DESCR STD_AXIS NO_INPUT_QUANTITY _CNV_A_R_LINEAR_____13_CM 11 0. 65535. FORMAT "%8.4" /end AXIS_DESCR
/end CHARACTERISTIC
/begin CHARACTERISTIC KLEXPBETAV "Funktion EXP (-BETA*tabst_w)" CURVE 0x6e200 _REC_CUR_33_S4_S4 1. _CNV_A_R_LINEAR_____13_CM 0. 1. FORMAT "%8.4"
 /begin AXIS_DESCR STD_AXIS NO_INPUT_QUANTITY _CNV_A_R_LINEAR_____13_CM 11 0. 65535. FORMAT "%8.4" /end AXIS_DESCR
/end CHARACTERISTIC
/begin CHARACTERISTIC LADEKENNL "Batterieladespannungskennlinie" CURVE 0x6e25c _REC_CUR_33_S4_S4 16. _CNV_A_R_LINEAR_____13_CM 0. 16. FORMAT "%8.4"
 /begin AXIS_DESCR STD_AXIS NO_INPUT_QUANTITY _CNV_A_R_LINEAR_____13_CM 6 -2147483648. 4294967295. FORMAT "%8.4" /end AXIS_DESCR
/end CHARACTERISTIC
/begin CHARACTERISTIC PLBATTUMG "Plausibilisierung-Schwelle Batterieumgebungstemperatur" VALUE 0x6e2b4 _REC_VAL_20_S4 6442450943. _CNV_A_R_LINEAR_____13_CM -2147483648. 4294967295. FORMAT "%8.4" /end CHARACTERISTIC
/begin CHARACTERISTIC TBATINIMAN "Applikation INITWERT Batterietemperatur" VALUE 0x6e295 _REC_VAL_20_u1 191.25 _CNV_A_R_LINEAR_____345_CM -48. 143.25 FORMAT "%8.4" /end CHARACTERISTIC
/begin CHARACTERISTIC TBATTFTAUV "Zeitkonstante 5*Tau Batterievorne" VALUE 0x6e290 _REC_VAL_20_u2 65535. _CNV_R_R_igen_ub_q1_343_CM 0. 65535. FORMAT "%8.4" /end CHARACTERISTIC
/begin CHARACTERISTIC TBATTTAUFH "Zeitkonstante Batterie 5*Tau hinten" VALUE 0x6e2b8 _REC_VAL_20_S4 65535. _CNV_A_R_LINEAR_____13_CM 0. 65535. FORMAT "%8.4" /end CHARACTERISTIC
/begin CHARACTERISTIC ULADE_TAU "Batterieladespannungs Zeitkonstante" VALUE 0x6e2bc _REC_VAL_20_S4 1. _CNV_A_R_LINEAR_____13_CM 0. 1. FORMAT "%8.4" /end CHARACTERISTIC
/begin MEASUREMENT ST_LDSTGEN "Lastzustand Generator elektrisch/thermisch" UBYTE _CNV_A_R_LINEAR_____13_CM 1 100. 0. 255. ECU_ADDRESS 0x3fac0c FORMAT "%8.4" /end MEASUREMENT
/begin CHARACTERISTIC GENLDDFMAX "Schwell Anzeige maximaler Auslastungsgrad Generator" VALUE 0x6e2da _REC_VAL_20_u1 99.609375 _CNV_A_R_PCENT_350_CM 0. 99.609375 FORMAT "%8.4" /end CHARACTERISTIC
/begin CHARACTERISTIC KLGENLDST "Auslastungsgrad Generator" CURVE 0x6e2c0 _REC_CUR_32_u2_u2 100. _CNV_A_R_PCENT_350_CM 0. 100. FORMAT "%8.4"
 /begin AXIS_DESCR STD_AXIS NO_INPUT_QUANTITY _CNV_R_R_temp_uw_q0_349_CM 6 -48. 336. FORMAT "%8.4" /end AXIS_DESCR
/end CHARACTERISTIC
/begin MEASUREMENT B_FS "Bedingung Fahrstufe" UBYTE _CNV_A_R_LINEAR_____13_CM 1 100. 0. 255. ECU_ADDRESS 0x3fd9fc BIT_MASK 0x1 /end MEASUREMENT
/begin MEASUREMENT B_LL "Bedingung Leerlauf" UBYTE _CNV_A_R_LINEAR_____13_CM 1 100. 0. 255. ECU_ADDRESS 0x3fd9fd BIT_MASK 0x1 /end MEASUREMENT
/begin MEASUREMENT B_NSUB "Bedingung für Solldrehzahlanhebung bei niedriger Batterieladebilanz" UBYTE _CNV_A_R_LINEAR_____13_CM 1 100. 0. 255. ECU_ADDRESS 0x3fac0d BIT_MASK 0x1 /end MEASUREMENT
/begin MEASUREMENT N_IDLGSPEC "" UBYTE _CNV_A_R_LINEAR_____13_CM 1 100. 0. 255. ECU_ADDRESS 0x3fd9fe FORMAT "%8.4" /end MEASUREMENT
/begin MEASUREMENT NSLB "Lerrlaufdrehzahl von Ladebilanz Batterie" UBYTE _CNV_R_R_nmot_ub_q1_370_CM 1 100. 0. 2550. ECU_ADDRESS 0x3fac0e FORMAT "%8.4" /end MEASUREMENT
/begin MEASUREMENT NSLLM "Normdrehzahl" UBYTE _CNV_R_R_nmot_ub_q1_370_CM 1 100. 0. 2550. ECU_ADDRESS 0x3fda03 FORMAT "%8.4" /end MEASUREMENT
/begin CHARACTERISTIC B_APP_LLAH "Manuelle Umschaltung auf LL-Anhebung HAND" VALUE 0x6e2db _REC_VAL_20_u1 255. _CNV_A_R_LINEAR_____13_CM 0. 255. FORMAT "%8.4" /end CHARACTERISTIC
/begin CHARACTERISTIC GENLLAHAPP "Manuelle Leerlaufdrehzahlanhebung" VALUE 0x6e2dc _REC_VAL_20_u1 255. _CNV_A_R_LINEAR_____13_CM 0. 255. FORMAT "%8.4" /end CHARACTERISTIC
/begin CHARACTERISTIC NSUBO "nsoll bei Batterieladebilanz zu niedrig" VALUE 0x6e2dd _REC_VAL_20_u1 2550. _CNV_R_R_nmot_ub_q1_370_CM 0. 2550. FORMAT "%8.4" /end CHARACTERISTIC
/begin CHARACTERISTIC NSUBU "nsoll bei Batterieladebilanz io" VALUE 0x6e2de _REC_VAL_20_u1 2550. _CNV_R_R_nmot_ub_q1_370_CM 0. 2550. FORMAT "%8.4" /end CHARACTERISTIC
/begin MEASUREMENT B_GENOFFMD "Bedingung Generator-off-Anforderung" UBYTE _CNV_A_R_LINEAR_____13_CM 1 100. 0. 255. ECU_ADDRESS 0x3fac20 BIT_MASK 0x1 /end MEASUREMENT
/begin MEASUREMENT B_LLREIN "Bedingung LLR ist aktiv" UBYTE _CNV_A_R_LINEAR_____13_CM 1 100. 0. 255. ECU_ADDRESS 0x3fda08 BIT_MASK 0x1 /end MEASUREMENT
/begin MEASUREMENT B_VL "Bedingung Vollast" UBYTE _CNV_A_R_LINEAR_____13_CM 1 100. 0. 255. ECU_ADDRESS 0x3fda07 BIT_MASK 0x1 /end MEASUREMENT
/begin MEASUREMENT LOADRESP "gerechnete Loadresponse" UBYTE _CNV_R_R_t100msxs_u_371_CM 1 100. 0. 25.5 ECU_ADDRESS 0x3fac10 FORMAT "%8.4" /end MEASUREMENT
/begin MEASUREMENT TMST "Motorstarttemperatur" UBYTE _CNV_R_R_temp_uw_q0_349_CM 1 100. -48. 143.25 ECU_ADDRESS 0x3fda09 FORMAT "%8.4" /end MEASUREMENT
/begin CHARACTERISTIC ENAPPLGOFF "Enable Generatorauschaltsteuerung" VALUE 0x6e341 _REC_VAL_20_u1 255. _CNV_A_R_LINEAR_____13_CM 0. 255. FORMAT "%8.4" /end CHARACTERISTIC
/begin CHARACTERISTIC ENAPPLRESP "Enable Handsteuerung Loadresponse" VALUE 0x6e342 _REC_VAL_20_u1 255. _CNV_A_R_LINEAR_____13_CM 0. 255. FORMAT "%8.4" /end CHARACTERISTIC
/begin CHARACTERISTIC KFLORESP "Kennfeld Loadresponse ueber Motordrehzahl und rel. Luftmasse" MAP 0x6e2e0 _REC_MAP_32_u1_u1_u1 25.5 _CNV_R_R_t100msxs_u_371_CM 0. 25.5 FORMAT "%8.4"
 /begin AXIS_DESCR STD_AXIS NO_INPUT_QUANTITY _CNV_A_R_nmot_ub_q4_372_CM 6 0. 10200. FORMAT "%8.4" /end AXIS_DESCR
 /begin AXIS_DESCR STD_AXIS NO_INPUT_QUANTITY _CNV_A_R_rel_ub_q0p_373_CM 6 0. 191.25 FORMAT "%8.4" /end AXIS_DESCR
/end CHARACTERISTIC
/begin CHARACTERISTIC KLLORESPM "Motorabhängiger Loadresponse-Faktor" CURVE 0x6e314 _REC_CUR_32_u1_u1 3.984375 _CNV_R_R_genuebsetz_365_CM 0. 3.984375 FORMAT "%8.4"
 /begin AXIS_DESCR STD_AXIS NO_INPUT_QUANTITY _CNV_A_R_LINEAR_____345_CM 6 -48. 143.25 FORMAT "%8.4" /end AXIS_DESCR
/end CHARACTERISTIC
/begin CHARACTERISTIC KLZLRESOF "Kennlinie Generatorausschaltzeit bei Stillstand" CURVE 0x6e324 _REC_CUR_32_u1_u1 255. _CNV_R_R_igen_ub_q1_343_CM 0. 255. FORMAT "%8.4"
 /begin AXIS_DESCR STD_AXIS NO_INPUT_QUANTITY _CNV_A_R_LINEAR_____345_CM 6 -48. 143.25 FORMAT "%8.4" /end AXIS_DESCR
/end CHARACTERISTIC
/begin CHARACTERISTIC KLZLRESOFV "Kennlinie Generatorausschaltzeit bei Fahrt" CURVE 0x6e334 _REC_CUR_32_u1_u1 255. _CNV_R_R_igen_ub_q1_343_CM 0. 255. FORMAT "%8.4"
 /begin AXIS_DESCR STD_AXIS NO_INPUT_QUANTITY _CNV_A_R_LINEAR_____345_CM 6 -48. 143.25 FORMAT "%8.4" /end AXIS_DESCR
/end CHARACTERISTIC
/begin CHARACTERISTIC LRESPAPP "Load-Response Applikation" VALUE 0x6e343 _REC_VAL_20_u1 25.5 _CNV_R_R_t100msxs_u_371_CM 0. 25.5 FORMAT "%8.4" /end CHARACTERISTIC
/begin CHARACTERISTIC RLMXGENOF "relative Luftfüllungschwelle für Generatorzuschaltung" VALUE 0x6e344 _REC_VAL_20_u1 191.25 _CNV_A_R_rel_ub_q0p_373_CM 0. 191.25 FORMAT "%8.4" /end CHARACTERISTIC
/begin CHARACTERISTIC TGENOFVL "Generatorsabschaltzeit bei Vollastbeschleunigung" VALUE 0x6e345 _REC_VAL_20_u1 255. _CNV_R_R_igen_ub_q1_343_CM 0. 255. FORMAT "%8.4" /end CHARACTERISTIC
/begin CHARACTERISTIC TLORESPST "Startloadresponse" VALUE 0x6e346 _REC_VAL_20_u1 25.5 _CNV_R_R_t100msxs_u_371_CM 0. 25.5 FORMAT "%8.4" /end CHARACTERISTIC
/begin CHARACTERISTIC TVLOFHYST "Hysterese Generatorvollastabschaltung" VALUE 0x6e347 _REC_VAL_20_u1 255. _CNV_R_R_igen_ub_q1_343_CM 0. 255. FORMAT "%8.4" /end CHARACTERISTIC
/begin CHARACTERISTIC VGENOFMN "Geschwindigkeitgeneratorabschaltschwelle bei Vollastbeschleunigung" VALUE 0x6e348 _REC_VAL_20_u1 318.75 _CNV_R_R_vfzg_ub_q1_347_CM 0. 318.75 FORMAT "%8.4" /end CHARACTERISTIC
/begin CHARACTERISTIC VGENOGMX "Geschwindigkeitgeneratorzuschaltschwelle bei Vollastbeschleunigung" VALUE 0x6e349 _REC_VAL_20_u1 318.75 _CNV_R_R_vfzg_ub_q1_347_CM 0. 318.75 FORMAT "%8.4" /end CHARACTERISTIC
/begin MEASUREMENT B_GENOFFOK "Bedingung Generator OFF freigegeben" UBYTE _CNV_A_R_LINEAR_____13_CM 1 100. 0. 255. ECU_ADDRESS 0x3fac21 BIT_MASK 0x1 /end MEASUREMENT
/begin MEASUREMENT GENTIMEROF "Generator-Off-Timer" UBYTE _CNV_R_R_igen_ub_q1_343_CM 1 100. 0. 255. ECU_ADDRESS 0x3fac22 FORMAT "%8.4" /end MEASUREMENT
/begin CHARACTERISTIC B_APP_UGEN "Umschaltung auf manuelle Generatorspannungsvorgabe" VALUE 0x6e34a _REC_VAL_20_u1 255. _CNV_A_R_LINEAR_____13_CM 0. 255. FORMAT "%8.4" /end CHARACTERISTIC
/begin CHARACTERISTIC GENOFFTIME "maximale Generatorauszeit" VALUE 0x6e34b _REC_VAL_20_u1 255. _CNV_A_R_LINEAR_____13_CM 0. 255. FORMAT "%8.4" /end CHARACTERISTIC
/begin CHARACTERISTIC GENUMAX "maximale Generatorspannung" VALUE 0x6e34c _REC_VAL_20_u1 25.5 _CNV_R_R_spg_ugen_363_CM 10.6 36.1 FORMAT "%8.4" /end CHARACTERISTIC
/begin MEASUREMENT TQ_LOSS_ALTER "Torque losses due to the alternator" SWORD _CNV_A_R_LINEAR_____37_CM 1 100. -1024. 1023.96875 ECU_ADDRESS 0x3fd2be FORMAT "%6.2" /end MEASUREMENT
/begin MEASUREMENT TQ_LOSS_ALTER_1 "Torque losses by alternator" SWORD _CNV_A_R_LINEAR_____37_CM 1 100. -1024. 1023.96875 ECU_ADDRESS 0x3fd2c0 FORMAT "%6.2" /end MEASUREMENT
/begin MEASUREMENT STATE_ALTER "Status of alternator diagnosis" UBYTE _CNV_A_R_LINEAR_____17_CM 1 100. 0. 3. ECU_ADDRESS 0x3fda0d FORMAT "%2.0" /end MEASUREMENT
/begin MEASUREMENT LV_N_SP_IS_POW_ACT "nominal idle speed setpoint by powermanagement" UBYTE _CNV_S_2_RANGE______74_CM 1 100. 0. 1. ECU_ADDRESS 0x3fd5f2 /end MEASUREMENT
/begin MEASUREMENT N_SP_IS_POW_1 "nominal idle speed setpoint by powermanagement" UWORD _CNV_A_R_LINEAR_____0_CM 1 100. 0. 8160. ECU_ADDRESS 0x3fd2bc FORMAT "%4.0" /end MEASUREMENT
/begin MEASUREMENT MDNORM "Maximales indiziertes Motormoment für Moment-Normierung" UBYTE _CNV_R_R_md_ub_q16_361_CM 1 100. 0. 1008. ECU_ADDRESS 0x3fda06 FORMAT "%8.4" /end MEASUREMENT
/begin CHARACTERISTIC C_ABC_INC_IVVT "Debounce counter increment - VANOS diagnosis magnetic valve CAM_IN" VALUE 0x64fba _REC_VAL_20_u1 255. _CNV_A_R_LINEAR_____13_CM 0. 255. FORMAT "%3.0" /end CHARACTERISTIC
/begin CHARACTERISTIC C_IVVTPWM_MAX_DIAG "IVVT diagnosis max range" VALUE 0x64fbc _REC_VAL_20_u2 99.99847412 _CNV_A_R_LINEAR_____144_CM 0. 99.99847412 /end CHARACTERISTIC
/begin CHARACTERISTIC C_ABC_MAX_IVVT "Debounce counter maximum value - VANOS diagnosis magnetic valves" VALUE 0x64fbe _REC_VAL_20_u1 254. _CNV_A_R_LINEAR_____17_CM 1. 255. FORMAT "%3.0" /end CHARACTERISTIC
/begin CHARACTERISTIC IP_IVVTPWM_MIN_DIAG__VB "Torque conversion factor for anti-jerk funktion" CURVE 0x64fc0 _REC_CUR_20_u2_u1 99.99847412 _CNV_A_R_LINEAR_____144_CM 0. 99.99847412
 /begin AXIS_DESCR COM_AXIS VB _CNV_A_R_LINEAR_____42_CM 4 0. 25.8984 FORMAT "%3.1" AXIS_PTS_REF ldp_vb__ivvtpwm /end AXIS_DESCR
/end CHARACTERISTIC
/begin COMPU_METHOD _CNV_A_R_LINEAR_____0_CM "" RAT_FUNC "%6.3" "rpm" COEFFS 0 1. 0. 0 0 1 /end COMPU_METHOD
/begin COMPU_METHOD _CNV_A_R_LINEAR_____1_CM "" RAT_FUNC "%6.3" "hPa" COEFFS 0 12.06017666543982 0. 0 0 1 /end COMPU_METHOD
/begin COMPU_METHOD _CNV_A_R_LINEAR_____2_CM "" RAT_FUNC "%6.3" "-" COEFFS 0 65536.00007936121 0. 0 0 1 /end COMPU_METHOD
/begin COMPU_METHOD _CNV_A_R_LINEAR_____5_CM "" RAT_FUNC "%6.3" "-" COEFFS 0 32768.00003968061 0. 0 0 1 /end COMPU_METHOD
/begin COMPU_METHOD _CNV_A_R_LINEAR_____8_CM "" RAT_FUNC "%6.3" "[-]" COEFFS 0 255.9999357490357 0. 0 0 1 /end COMPU_METHOD
/begin COMPU_METHOD _CNV_A_R_LINEAR_____13_CM "" RAT_FUNC "%6.3" "[-]" COEFFS 0 1. 0. 0 0 1 /end COMPU_METHOD
/begin COMPU_METHOD _CNV_A_R_LINEAR_____15_CM "" RAT_FUNC "%6.3" "rpm" COEFFS 0 3.125e-002 0. 0 0 1 /end COMPU_METHOD
/begin COMPU_METHOD _CNV_A_R_LINEAR_____16_CM "" RAT_FUNC "%6.3" "%" COEFFS 0 2.56 0. 0 0 1 /end COMPU_METHOD
/begin COMPU_METHOD _CNV_A_R_LINEAR_____17_CM "" RAT_FUNC "%6.3" "-" COEFFS 0 1. 0. 0 0 1 /end COMPU_METHOD
/begin COMPU_METHOD _CNV_A_R_LINEAR_____19_CM "" RAT_FUNC "%6.3" "s" COEFFS 0 200. 0. 0 0 1 /end COMPU_METHOD
/begin COMPU_METHOD _CNV_A_R_LINEAR_____20_CM "" RAT_FUNC "%6.3" "s" COEFFS 0 1. 0. 0 0 1 /end COMPU_METHOD
/begin COMPU_METHOD _CNV_A_R_LINEAR_____21_CM "" RAT_FUNC "%6.3" "s" COEFFS 0 100. 0. 0 0 1 /end COMPU_METHOD
/begin COMPU_METHOD _CNV_A_R_LINEAR_____22_CM "" RAT_FUNC "%6.3" "°C" COEFFS 0 1.333333333333333 64. 0 0 1 /end COMPU_METHOD
/begin COMPU_METHOD _CNV_A_R_LINEAR_____23_CM "" RAT_FUNC "%6.3" "°C" COEFFS 0 1.333333333333333 0. 0 0 1 /end COMPU_METHOD
/begin COMPU_METHOD _CNV_A_R_LINEAR_____24_CM "" RAT_FUNC "%6.3" "ms" COEFFS 0 250. 0. 0 0 1 /end COMPU_METHOD
/begin COMPU_METHOD _CNV_A_R_LINEAR_____25_CM "" RAT_FUNC "%6.3" "°C" COEFFS 0 64. 0. 0 0 1 /end COMPU_METHOD
/begin COMPU_METHOD _CNV_A_R_LINEAR_____32_CM "" RAT_FUNC "%6.3" "°C" COEFFS 0 1. 40. 0 0 1 /end COMPU_METHOD
/begin COMPU_METHOD _CNV_A_R_LINEAR_____34_CM "" RAT_FUNC "%6.3" "°TPS" COEFFS 0 137.0962343096234 0. 0 0 1 /end COMPU_METHOD
/begin COMPU_METHOD _CNV_A_R_LINEAR_____37_CM "" RAT_FUNC "%6.3" "Nm" COEFFS 0 32. 0. 0 0 1 /end COMPU_METHOD
/begin COMPU_METHOD _CNV_A_R_LINEAR_____38_CM "" RAT_FUNC "%6.3" "V" COEFFS 0 204.7999998974999 0. 0 0 1 /end COMPU_METHOD
/begin COMPU_METHOD _CNV_A_R_LINEAR_____40_CM "" RAT_FUNC "%6.3" "V" COEFFS 0 51.2 0. 0 0 1 /end COMPU_METHOD
/begin COMPU_METHOD _CNV_A_R_LINEAR_____42_CM "" RAT_FUNC "%6.3" "V" COEFFS 0 9.846168103048838 0. 0 0 1 /end COMPU_METHOD
/begin COMPU_METHOD _CNV_A_R_LINEAR_____48_CM "" RAT_FUNC "%6.3" "-" COEFFS 0 51.2 0. 0 0 1 /end COMPU_METHOD
/begin COMPU_METHOD _CNV_A_R_LINEAR_____51_CM "" RAT_FUNC "%6.3" "mg/stk" COEFFS 0 0.183585313174946 0. 0 0 1 /end COMPU_METHOD
/begin COMPU_METHOD _CNV_A_R_LINEAR_____52_CM "" RAT_FUNC "%6.3" "kg/h" COEFFS 0 32. 0. 0 0 1 /end COMPU_METHOD
/begin COMPU_METHOD _CNV_A_R_LINEAR_____56_CM "" RAT_FUNC "%6.3" "mg/stk" COEFFS 0 47.18142548596112 0. 0 0 1 /end COMPU_METHOD
/begin COMPU_METHOD _CNV_A_R_LINEAR_____67_CM "" RAT_FUNC "%6.3" "[-]" COEFFS 0 128. 0. 0 0 1 /end COMPU_METHOD
/begin COMPU_METHOD _CNV_A_R_LINEAR_____68_CM "" RAT_FUNC "%6.3" "-" COEFFS 0 255.9983911655618 0. 0 0 1 /end COMPU_METHOD
/begin COMPU_METHOD _CNV_S_2_RANGE______74_CM "" TAB_VERB "%6.3" "[-]" COMPU_TAB_REF _CNV_S_2_RANGE______74 /end COMPU_METHOD
/begin COMPU_VTAB _CNV_S_2_RANGE______74 "" TAB_VERB 2 0 "0" 1 "1" /end COMPU_VTAB
/begin COMPU_METHOD _CNV_S_2_RANGE______75_R_CM "" TAB_VERB "%6.3" "-" COMPU_TAB_REF _CNV_S_2_RANGE______75_R /end COMPU_METHOD
/begin COMPU_VTAB_RANGE _CNV_S_2_RANGE______75_R "" 2 0 0 "0" 1 255 "1" /end COMPU_VTAB_RANGE
/begin COMPU_METHOD _CNV_S_2_RANGE______76_CM "" TAB_VERB "%6.3" "-" COMPU_TAB_REF _CNV_S_2_RANGE______76 /end COMPU_METHOD
/begin COMPU_VTAB _CNV_S_2_RANGE______76 "" TAB_VERB 2 0 "0" 1 "1" /end COMPU_VTAB
/begin COMPU_METHOD _CNV_S_2_RANGE______77_R_CM "" TAB_VERB "%6.3" "[-]" COMPU_TAB_REF _CNV_S_2_RANGE______77_R /end COMPU_METHOD
/begin COMPU_VTAB_RANGE _CNV_S_2_RANGE______77_R "" 2 0 0 "0" 1 255 "1" /end COMPU_VTAB_RANGE
/begin COMPU_METHOD _CNV_A_R_LINEAR_____87_CM "" RAT_FUNC "%6.3" "-" COEFFS 0 16. 0. 0 0 1 /end COMPU_METHOD
/begin COMPU_METHOD _CNV_S_2_RANGE______88_CM "" TAB_VERB "%6.3" "[-]" COMPU_TAB_REF _CNV_S_2_RANGE______88 /end COMPU_METHOD
/begin COMPU_VTAB _CNV_S_2_RANGE______88 "" TAB_VERB 2 0 "OFF" 1 "ON" /end COMPU_VTAB
/begin COMPU_METHOD _CNV_A_R_LINEAR_____89_CM "" RAT_FUNC "%6.3" "V" COEFFS 0 39.38462959968585 0. 0 0 1 /end COMPU_METHOD
/begin COMPU_METHOD _CNV_A_R_LINEAR_____94_CM "" RAT_FUNC "%6.3" "°C" COEFFS 0 16. 0. 0 0 1 /end COMPU_METHOD
/begin COMPU_METHOD _CNV_A_R_LINEAR_____95_CM "" RAT_FUNC "%6.3" "°C" COEFFS 0 64. 2112. 0 0 1 /end COMPU_METHOD
/begin COMPU_METHOD _CNV_A_R_LINEAR_____96_CM "" RAT_FUNC "%6.3" "s" COEFFS 0 100.0015259021897 0. 0 0 1 /end COMPU_METHOD
/begin COMPU_METHOD _CNV_A_R_LINEAR_____97_CM "" RAT_FUNC "%6.3" "s" COEFFS 0 50.00076295109484 0. 0 0 1 /end COMPU_METHOD
/begin COMPU_METHOD _CNV_A_R_LINEAR_____98_CM "" RAT_FUNC "%6.3" "g" COEFFS 0 36.00036915004301 0. 0 0 1 /end COMPU_METHOD
/begin COMPU_METHOD _CNV_A_R_LINEAR_____99_CM "" RAT_FUNC "%6.3" "V" COEFFS 0 13107.19998965744 0. 0 0 1 /end COMPU_METHOD
/begin COMPU_METHOD _CNV_A_R_LINEAR_____144_CM "" RAT_FUNC "%6.3" "%" COEFFS 0 655.3600000071681 0. 0 0 1 /end COMPU_METHOD
/begin COMPU_METHOD _CNV_A_R_LINEAR_____150_CM "" RAT_FUNC "%6.3" "s" COEFFS 0 50. 0. 0 0 1 /end COMPU_METHOD
/begin COMPU_METHOD _CNV_A_R_LINEAR_____155_CM "" RAT_FUNC "%6.3" "kg/h" COEFFS 0 64.00000000417234 0. 0 0 1 /end COMPU_METHOD
/begin COMPU_METHOD _CNV_A_R_LINEAR_____162_CM "" RAT_FUNC "%6.3" "-" COEFFS 0 511.9921875 0. 0 0 1 /end COMPU_METHOD
/begin COMPU_METHOD _CNV_A_R_LINEAR_____163_CM "" RAT_FUNC "%6.3" "ohm" COEFFS 0 1. 0. 0 0 1 /end COMPU_METHOD
/begin COMPU_METHOD _CNV_A_R_LINEAR_____164_CM "" RAT_FUNC "%6.3" "°TPS" COEFFS 0 548.4100418410042 0. 0 0 1 /end COMPU_METHOD
/begin COMPU_METHOD _CNV_A_R_LINEAR_____165_CM "" RAT_FUNC "%6.3" "µs" COEFFS 0 1. 0. 0 0 1 /end COMPU_METHOD
/begin COMPU_METHOD _CNV_S_9_RANGE_STAT_170_CM "" TAB_VERB "%6.3" "-" COMPU_TAB_REF _CNV_S_9_RANGE_STAT_170 /end COMPU_METHOD
/begin COMPU_VTAB _CNV_S_9_RANGE_STAT_170 "" TAB_VERB 9 0 "PVS_NO_ERROR" 1 "PVS_LIH_PRED" 2 "PVS_LIH_1" 4 "PVS_LIH_2" 8 "PVS_LIH_MIN" 16 "PVS_DBL_ERROR" 32 "PVS_LIH_BLS" 64 "PVS_LIH_1_PRED" 128 "PVS_LIH_2_PRED" /end COMPU_VTAB
/begin COMPU_METHOD _CNV_A_R_LINEAR_____182_CM "" RAT_FUNC "%6.3" "mm" COEFFS 0 1000. 0. 0 0 1 /end COMPU_METHOD
/begin COMPU_METHOD _CNV_A_R_LINEAR_____183_CM "" RAT_FUNC "%6.3" "°PORT" COEFFS 0 655.3600000071681 0. 0 0 1 /end COMPU_METHOD
/begin COMPU_METHOD _CNV_A_R_LINEAR_____188_CM "" RAT_FUNC "%6.3" "V" COEFFS 0 9.807692307692308 0. 0 0 1 /end COMPU_METHOD
/begin COMPU_METHOD _CNV_S_5_RANGE_BIOS_204_R_CM "" TAB_VERB "%6.3" "[-]" COMPU_TAB_REF _CNV_S_5_RANGE_BIOS_204_R /end COMPU_METHOD
/begin COMPU_VTAB_RANGE _CNV_S_5_RANGE_BIOS_204_R "" 5 110 111 "Resume" 182 183 "Set / Accelerate" 218 219 "OFF" 252 253 "Decelerate" 254 255 "None" /end COMPU_VTAB_RANGE
/begin COMPU_METHOD _CNV_A_R_LINEAR_____219_CM "" RAT_FUNC "%6.3" "kg/h" COEFFS 0 64. 0. 0 0 1 /end COMPU_METHOD
/begin COMPU_METHOD _CNV_S_5_RANGE_ERR__323_CM "" TAB_VERB "%6.3" "[-]" COMPU_TAB_REF _CNV_S_5_RANGE_ERR__323 /end COMPU_METHOD
/begin COMPU_VTAB _CNV_S_5_RANGE_ERR__323 "" TAB_VERB 5 0 "NO_SYM" 1 "SYM_0" 2 "SYM_1" 4 "SYM_2" 8 "SYM_3" /end COMPU_VTAB
/begin COMPU_METHOD _CNV_R_R_i_vvt_q0p0_342_CM "" RAT_FUNC "%6.3" "A" COEFFS 0. 65536. 0. 0. 0. 4096. /end COMPU_METHOD
/begin COMPU_METHOD _CNV_R_R_igen_ub_q1_343_CM "" RAT_FUNC "%6.3" "[-]" COEFFS 0. 1. 0. 0. 0. 1. /end COMPU_METHOD
/begin COMPU_METHOD _CNV_R_R_rel_ub_b10_344_CM "" RAT_FUNC "%6.3" "[-]" COEFFS 0. 255. 0. 0. 0. 100. /end COMPU_METHOD
/begin COMPU_METHOD _CNV_A_R_LINEAR_____345_CM "" RAT_FUNC "%6.3" "[-]" COEFFS 0 1.333333333333333 64. 0 0 1 /end COMPU_METHOD
/begin COMPU_METHOD _CNV_A_R_spg_ubatt_346_CM "" RAT_FUNC "%6.3" "[-]" COEFFS 0 10.61571125265393 0. 0 0 1 /end COMPU_METHOD
/begin COMPU_METHOD _CNV_R_R_vfzg_ub_q1_347_CM "" RAT_FUNC "%6.3" "[-]" COEFFS 0. 1. 0. 0. 0. 1.25 /end COMPU_METHOD
/begin COMPU_METHOD _CNV_R_R_i_vvt_ub_q_348_CM "" RAT_FUNC "%6.3" "A" COEFFS 0. 1. 63.5 0. 0. 0.5 /end COMPU_METHOD
/begin COMPU_METHOD _CNV_R_R_temp_uw_q0_349_CM "" RAT_FUNC "%6.3" "[-]" COEFFS 0. 1. 48. 0. 0. 0.75 /end COMPU_METHOD
/begin COMPU_METHOD _CNV_A_R_PCENT_350_CM "" RAT_FUNC "%6.3" "[-]" COEFFS 0 2.56 0. 0 0 1 /end COMPU_METHOD
/begin COMPU_METHOD _CNV_R_R_geneta_q0p_351_CM "" RAT_FUNC "%6.3" "-" COEFFS 0. 256. 0. 0. 0. 8. /end COMPU_METHOD
/begin COMPU_METHOD _CNV_R_R_genalfak_u_352_CM "" RAT_FUNC "%6.3" "[-]" COEFFS 0. 65536. 0. 0. 0. 4. /end COMPU_METHOD
/begin COMPU_METHOD _CNV_R_R_temp_sw_q0_353_CM "" RAT_FUNC "%6.3" "[-]" COEFFS 0. 4. 0. 0. 0. 3. /end COMPU_METHOD
/begin COMPU_METHOD _CNV_R_R_genpv_ul_354_CM "" RAT_FUNC "%6.3" "W" COEFFS 0. -1. 0. 0. 0. 262144. /end COMPU_METHOD
/begin COMPU_METHOD _CNV_R_R_gendt_q0p0_355_CM "" RAT_FUNC "%6.3" "°K" COEFFS 0. 1. 0. 0. 0. 0.75 /end COMPU_METHOD
/begin COMPU_METHOD _CNV_R_R_igen_uw_q0_356_CM "" RAT_FUNC "%6.3" "A" COEFFS 0. 65536. 0. 0. 0. 2048. /end COMPU_METHOD
/begin COMPU_METHOD _CNV_R_R_genrstator_357_CM "" RAT_FUNC "%6.3" "Ohm" COEFFS 0. 65536. 0. 0. 0. 1. /end COMPU_METHOD
/begin COMPU_METHOD _CNV_R_R_genpv_uw_q_358_CM "" RAT_FUNC "%6.3" "W" COEFFS 0. 65536. 0. 0. 0. 2048. /end COMPU_METHOD
/begin COMPU_METHOD _CNV_R_R_igenmess10_359_CM "" RAT_FUNC "%6.3" "A" COEFFS 0. 157. 0. 0. 0. 1. /end COMPU_METHOD
/begin COMPU_METHOD _CNV_R_R_md_ub_q0p0_360_CM "" RAT_FUNC "%6.3" "Nm" COEFFS 0. 1024. 0. 0. 0. 256. /end COMPU_METHOD
/begin COMPU_METHOD _CNV_R_R_md_ub_q16_361_CM "" RAT_FUNC "%6.3" "[-]" COEFFS 0. 1. 0. 0. 0. 16. /end COMPU_METHOD
/begin COMPU_METHOD _CNV_R_R_ngen_uw_q0_362_CM "" RAT_FUNC "%6.3" "U/min" COEFFS 0. 1. 0. 0. 0. 0.5 /end COMPU_METHOD
/begin COMPU_METHOD _CNV_R_R_spg_ugen_363_CM "" RAT_FUNC "%6.3" "[-]" COEFFS 0. 10. -106. 0. 0. 1. /end COMPU_METHOD
/begin COMPU_METHOD _CNV_R_R_fak_q0p003_364_CM "" RAT_FUNC "%6.3" "[-]" COEFFS 0. 256. 0. 0. 0. 1. /end COMPU_METHOD
/begin COMPU_METHOD _CNV_R_R_genuebsetz_365_CM "" RAT_FUNC "%6.3" "[-]" COEFFS 0. 256. 0. 0. 0. 4. /end COMPU_METHOD
/begin COMPU_METHOD _CNV_R_R_genzmig_uw_366_CM "" RAT_FUNC "%6.3" "[-]" COEFFS 0. 65536. 0. 0. 0. 2. /end COMPU_METHOD
/begin COMPU_METHOD _CNV_R_R_genzmst_uw_367_CM "" RAT_FUNC "%6.3" "[-]" COEFFS 0. 65536. 0. 0. 0. 1. /end COMPU_METHOD
/begin COMPU_METHOD _CNV_A_R_LINEAR_____368_CM "" RAT_FUNC "%6.3" "V" COEFFS 0 39.99999999999999 -423.9999999999998 0 0 1 /end COMPU_METHOD
/begin COMPU_METHOD _CNV_R_R_temp_q1_369_CM "" RAT_FUNC "%6.3" "°C" COEFFS 0. 1. 0. 0. 0. 1. /end COMPU_METHOD
/begin COMPU_METHOD _CNV_R_R_nmot_ub_q1_370_CM "" RAT_FUNC "%6.3" "[-]" COEFFS 0. 1. 0. 0. 0. 10. /end COMPU_METHOD
/begin COMPU_METHOD _CNV_R_R_t100msxs_u_371_CM "" RAT_FUNC "%6.3" "[-]" COEFFS 0. 1. 0. 0. 0. 0.1 /end COMPU_METHOD
/begin COMPU_METHOD _CNV_A_R_nmot_ub_q4_372_CM "" RAT_FUNC "%6.3" "[-]" COEFFS 0 2.5e-002 0. 0 0 1 /end COMPU_METHOD
/begin COMPU_METHOD _CNV_A_R_rel_ub_q0p_373_CM "" RAT_FUNC "%6.3" "[-]" COEFFS 0 1.333333333333333 0. 0 0 1 /end COMPU_METHOD
/begin RECORD_LAYOUT _REC_VAL_20_u2 FNC_VALUES 1 UWORD COLUMN_DIR DIRECT /end RECORD_LAYOUT
/begin RECORD_LAYOUT _REC_VAL_20_u1 FNC_VALUES 1 UBYTE COLUMN_DIR DIRECT /end RECORD_LAYOUT
/begin RECORD_LAYOUT _REC_AXS_20_u2 NO_AXIS_PTS_X 1 UWORD AXIS_PTS_X 2 UWORD INDEX_INCR DIRECT /end RECORD_LAYOUT
/begin RECORD_LAYOUT _REC_AXS_20_u1 NO_AXIS_PTS_X 1 UBYTE AXIS_PTS_X 2 UBYTE INDEX_INCR DIRECT /end RECORD_LAYOUT
/begin RECORD_LAYOUT _REC_CUR_20_u2_u2 FNC_VALUES 1 UWORD COLUMN_DIR DIRECT /end RECORD_LAYOUT
/begin RECORD_LAYOUT _REC_CUR_20_u2_u1 FNC_VALUES 1 UWORD COLUMN_DIR DIRECT /end RECORD_LAYOUT
/begin RECORD_LAYOUT _REC_CUR_20_u1_u1 FNC_VALUES 1 UBYTE COLUMN_DIR DIRECT /end RECORD_LAYOUT
/begin RECORD_LAYOUT _REC_CUR_20_u1_u2 FNC_VALUES 1 UBYTE COLUMN_DIR DIRECT /end RECORD_LAYOUT
/begin RECORD_LAYOUT _REC_MAP_20_u2_u1_u1 FNC_VALUES 1 UWORD COLUMN_DIR DIRECT /end RECORD_LAYOUT
/begin RECORD_LAYOUT _REC_MAP_20_u2_u1_u2 FNC_VALUES 1 UWORD COLUMN_DIR DIRECT /end RECORD_LAYOUT
/begin RECORD_LAYOUT _REC_CUR_32_u2_u2 NO_AXIS_PTS_X 1 UWORD AXIS_PTS_X 2 UWORD INDEX_INCR DIRECT FNC_VALUES 3 UWORD COLUMN_DIR DIRECT /end RECORD_LAYOUT
/begin RECORD_LAYOUT _REC_CUR_32_u1_u1 NO_AXIS_PTS_X 1 UBYTE AXIS_PTS_X 2 UBYTE INDEX_INCR DIRECT FNC_VALUES 3 UBYTE COLUMN_DIR DIRECT /end RECORD_LAYOUT
/begin RECORD_LAYOUT _REC_MAP_32_u1_u1_u1 NO_AXIS_PTS_X 1 UBYTE NO_AXIS_PTS_Y 2 UBYTE AXIS_PTS_X 3 UBYTE INDEX_INCR DIRECT AXIS_PTS_Y 4 UBYTE INDEX_INCR DIRECT FNC_VALUES 5 UBYTE COLUMN_DIR DIRECT /end RECORD_LAYOUT
/begin RECORD_LAYOUT _REC_MAP_32_u2_u2_u2 NO_AXIS_PTS_X 1 UWORD NO_AXIS_PTS_Y 2 UWORD AXIS_PTS_X 3 UWORD INDEX_INCR DIRECT AXIS_PTS_Y 4 UWORD INDEX_INCR DIRECT FNC_VALUES 5 UWORD COLUMN_DIR DIRECT /end RECORD_LAYOUT
/begin RECORD_LAYOUT _REC_VAL_20_S4 FNC_VALUES 1 FLOAT32_IEEE COLUMN_DIR DIRECT /end RECORD_LAYOUT
/begin RECORD_LAYOUT _REC_CUR_33_S4_S4 NO_AXIS_PTS_X 1 ULONG AXIS_PTS_X 2 FLOAT32_IEEE INDEX_INCR DIRECT FNC_VALUES 3 FLOAT32_IEEE COLUMN_DIR DIRECT /end RECORD_LAYOUT
/begin FUNCTION AUX_Determination_of_secondary_a "_Determination of secondary air mass flow"
 /begin DEF_CHARACTERISTIC C_T_DLY_SA_ACT C_CRLC_SAF_ST C_CRLC_SAF IP_SAF_MDL IP_SAF_COR_VB IP_SAF_COR_AMP IP_SAF_COR_TIA /end DEF_CHARACTERISTIC
 /begin OUT_MEASUREMENT SAF_KGH_CLC T_DLY_SA_ACT SAF_KGH /end OUT_MEASUREMENT
/end FUNCTION
/begin FUNCTION AUX_Port_Deactivation_Setpoint_C "_Port Deactivation Setpoint Calculation"
 /begin DEF_CHARACTERISTIC IP_PORT_SP_AFS IP_PORT_SP_AFL IP_FAC_TCO_PORT_SP IP_VLFT_SP__EXC_SP_REL IP_PORT_SP_PHY__PORTPWM IP_PORT_SP_S IP_PORT_SP_RGN_NT IP_PORT_AV__V_PORT C_TCO_MIN_PORT C_CRLC_PORT_SP LC_VVL_INH_AS LC_PORT_INH_AS C_EXC_SP_INI C_PORTPWM_INI /end DEF_CHARACTERISTIC
 /begin OUT_MEASUREMENT PORTPWM PORT_SP VLFT_SP PORT_SP_PHY PORT_AV FAC_PORT_DEAC PORT_SP_RAW EXC_SP_REL /end OUT_MEASUREMENT
/end FUNCTION
/begin FUNCTION AUX_Power_Management "_Power Management"
 /begin DEF_CHARACTERISTIC LC_POW_CORD_INH CRENGOF CRVVTOF KFELUPWM KLELTEMP KLELVFZG B_APIGDFN EN_MDGEN GEN_IG_OF GENDIFAK GENITYP GENMDOF GENRESTTYP GENRS0 GENSTFAK GENTEMPAPP GENTEMPMAN GENTYP GENUEBSETZ GENUMGTYP KFGENWETA KFIGDFNMOT KFIGENDF KFIGENKALT KFIGENT KLFPVDIODE KLGENEXP KLGENTEMPF KLGENTETA KLRTHGEN MESSBG400A TSTCNTEN TSTFIL_IN TSTFIL_INI UGDIODERMS ZMGENIG ZMGENSTHZ ZMGENSTKHL ZMTESTFIL APPTBATINI BATT_ALFAH BATT_ALFAV BATT_BETAV BATT_MR BATTHTAUVG BATTHTAUVK BATTVTAUVG BATTVTAUVK BATVFZGTAU KLBATTLSTR KLEXPALH KLEXPALV KLEXPBETAV LADEKENNL PLBATTUMG TBATINIMAN TBATTFTAUV TBATTTAUFH ULADE_TAU GENLDDFMAX KLGENLDST B_APP_LLAH GENLLAHAPP NSUBO NSUBU ENAPPLGOFF ENAPPLRESP KFLORESP KLLORESPM KLZLRESOF KLZLRESOFV LRESPAPP RLMXGENOF TGENOFVL TLORESPST TVLOFHYST VGENOFMN VGENOGMX B_APP_UGEN GENOFFTIME GENUMAX /end DEF_CHARACTERISTIC
 /begin OUT_MEASUREMENT B_KL15 B_MASTER BGCRLOC_1 FAKTTANSEL FAKTVFZGEL I_ELU_VVT I_ELUEFTER I_ELUPWM I_ELUVFZG ST_CRAWENG TAML TAML_TMP TANS TANS_TMP UB_TMP VFZG VFZG_TMP VVT_ES VVT_ES2 VVT_IB1_2 VVT_IGES B_FIRSTEMP B_GENE B_GENOFF B_HEIZEN B_STEND DFFGENTMP GEN_TETA GEN_WETA GENALFAK2 GENDELTAOF GENDI_SPV GENDTS GENDTS_S1 GENDTSVOR GENFETA GENI_DIFK GENI_END GENI_STFK GENI2_ST GENIG GENIKALTUN GENIMESS GENINAFIL GENITEMP GENIVORFIL GENRESTEMP GENRS GENSPV GENSPV_1 GENSPV_2 GENSTTEMP GENTEMP GENTEMPAB GENTEMPDT GENTEMPEND GENTEMPEXP GENTEMPFIL GENTEMPUMG GENTREST IGEN400A IGEN400FH IGEN40A IGEN40FH IGENMESS MD_GENLOC MD_GENNM MD_GENREL MDGENVF MDNORMTMP NGEN_W NMOTS PGENAB ST_I_GEN STIGEN_TMP TABST_W TSTCOUNTV TSTFIL_OUT TSTLOCINI UFGEN_TMP UFGENTMP B_INIBUMG B_TNS BATT_A1 BATT_A2 BATT_C10 BATT_C11 BATT_C12 BATT_C13 BATT_C14 BATT_C8 BATT_C9 BATT_D1 BATT_E1 BATT_E2 BATT_E3 BATT_E4 BATT_E5 BATT_E6 BATT_TFIL BATT_W0 BATTO_A BATTO_A1 BATTO_B BATTO_C BATTO_C1 BATTO_C2 BATTO_C3 BATTO_C4 BATTO_C6 BATTO_C7 CTRGENUTAR DBET_ALF DBETALF_T DT_TUMG END_INIT T_BATT_INI T_BATTABST T_UMGABST T_UMGABSTF TABST_FL TANSF TBATINMANF TBATSTINIV TUMGBATOLD TUMGBATTAB TUMGCAN TUMGCANF U_CHARGE U_CHARGE2 ST_LDSTGEN B_FS B_LL B_NSUB N_IDLGSPEC NSLB NSLLM B_GENOFFMD B_LLREIN B_VL LOADRESP TMST B_GENOFFOK GENTIMEROF TQ_LOSS_ALTER TQ_LOSS_ALTER_1 STATE_ALTER LV_N_SP_IS_POW_ACT N_SP_IS_POW_1 MDNORM /end OUT_MEASUREMENT
/end FUNCTION
/begin FUNCTION AUX_Heading "_Heading" /end FUNCTION
/begin FUNCTION BIO_Basic_SW_Inputs_and_Outputs "BIO"
 /begin SUB_FUNCTION BIO_Standard_analog_inputs BIO_Logic_outputs BIO_Keyword_Protocol_2000 BIO_PWM_outputs BIO_Logic_inputs BIO_Acquisition_of_after_ignitio BIO_MSW_interface /end SUB_FUNCTION
/end FUNCTION
/begin FUNCTION BIO_Standard_analog_inputs "_Standard analog inputs"
 /begin DEF_CHARACTERISTIC ID_CRK_TOOTH_PER_SP_FAC C_N_MIN_CRK_TOOTH_VLD ID_CRK_TOOTH_RATIO C_CAM_SYNC_DLY ID_CRK_GAP_RATIO ID_MAF_TAB ID_SAF_TAB /end DEF_CHARACTERISTIC
 /begin OUT_MEASUREMENT V_AMP V_TIA V_PVS_1 V_PVS_2 V_TCO V_TCO_EX V_TPS_1 V_TPS_2 VBR_MES V_TOIL V_MAF VBK VBR V_LS_UP_1 V_LS_UP_2 V_LS_DOWN_2 V_LS_DOWN_1 VCC_PVS_1 VCC_PVS_2 V_VIM_FB V_FPS V_SAF LV_MAF_SEG MAF_SUM MAF_SUM_1 MAF_CTR MAF_CTR_1 V_EGR V_DMTL V_PORT V_TEG_PCAT_DOWN_1 V_TEG_PCAT_DOWN_2 /end OUT_MEASUREMENT
/end FUNCTION
/begin FUNCTION BIO_Logic_outputs "_Logic outputs" /end FUNCTION
/begin FUNCTION BIO_Keyword_Protocol_2000 "_Keyword Protocol 2000"
 /begin OUT_MEASUREMENT V_DUR_IGC_0 V_DUR_IGC_1 V_DUR_IGC_2 V_DUR_IGC_3 V_DUR_IGC_4 V_DUR_IGC_5 LV_TD_IGC_CUT_0 LV_TD_IGC_CUT_1 LV_TD_IGC_CUT_2 LV_TD_IGC_CUT_3 LV_TD_IGC_CUT_4 LV_TD_IGC_CUT_5 /end OUT_MEASUREMENT
/end FUNCTION
/begin FUNCTION BIO_PWM_outputs "_PWM outputs"
 /begin DEF_CHARACTERISTIC C_SWI_CPP_AS C_SWI_EBOX_CFA_AS C_SWI_RLY_ACC_AS C_SWI_FTLDP_AS C_SWI_TLD_AS C_SWI_RLY_ST_AS C_SWI_VEPU_AS C_SWI_EF_AS C_VVTPWM_AS C_ISAPWM_AS /end DEF_CHARACTERISTIC
/end FUNCTION
/begin FUNCTION BIO_Logic_inputs "_Logic inputs"
 /begin OUT_MEASUREMENT LV_IM_BLS LV_IM_ST LV_IM_LOCK LV_IM_CRU_SET_AC LV_IM_CRU_RESU_DECE LV_IM_CRU_MAIN_OFF LV_IM_BTS LV_IM_CS_PN /end OUT_MEASUREMENT
/end FUNCTION
/begin FUNCTION BIO_Acquisition_of_after_ignitio "_Acquisition of after ignition key battery voltage" /begin OUT_MEASUREMENT LV_KEY_OFF VB_MES BIOS_T_SEG_MIS /end OUT_MEASUREMENT /end FUNCTION
/begin FUNCTION BIO_MSW_interface "_MSW interface" /begin OUT_MEASUREMENT BIOS_CRU_DATA /end OUT_MEASUREMENT /end FUNCTION
/begin FUNCTION DIA_Diagnosis_and_limp_home "DIA"
 /begin SUB_FUNCTION DIA_Mass_air_flow_meter DIA_Intake_air_temperature_senso DIA_Temperature_sensor___TCO_EX_ DIA_Temperature_sensor___TCO_Coo DIA_IVVT_diagnosis DIA_Fuel_pump_relay_RLY_EFP DIA_Ambient_pressure_sensor DIA_Lambda_control_diagnosis DIA_Upstream_oxygen_sensor_heate DIA_Downstream_oxygen_sensor_hea DIA_Oil_temperature_sensor_TOIL DIA_Electronically_controlled_th DIA_Temperature_exhaust_gas_sens DIA_Knock_sensor_diagnosis DIA_Vehicle_speed_signal_diagnos DIA_Ignition_system_diagnosis DIA_PVS_diagnosis DIA_Throttle_position_sensor_dia DIA_Injection_valves_IV_1_to_6 DIA_Error_memory_interface DIA_Canister_purge_valve_diagnos DIA_Engine_throttle_diagnosis_wi DIA_ETC_driver_diagnosis DIA_Lambda_sensor_upstream_heate DIA_Lambda_sensor_downstream_hea DIA_Generator_diagnosis DIA_Crankshaft_Signal_Diagnosis_ DIA_Camshaft_Sensor_Diagnosis_an DIA_Secondary_Air_Valve_Diagnosi DIA_Electronical_Cooling_Fan_Dia DIA_Secondary_Air_Pump_Diagnosis DIA_Air_Condition_Compressor_Con DIA_Main_Relay_Diagnosis__RLY_MA TPS_TPS___ETC_Limp_Home_Manager DIA_Coolant_Temperature_Sensor_D DIA_TCO_Sensor_Plausibility_Diag DIA_Idle_Speed_Control_Diagnosis DIA_CAN_diagnosis DIA_ETC_Actuator_diagnosis_and_a DIA_Multifunctional_steering_whe DIA_Pedal_value_sensor_diagnosis DIA_Brake_light_switch_diagnosis DIA_Idle_Speed_Actuator_Diagnosi DIA_Engine_roughness_idle_diagno DIA_Variable_Intake_Manifold__VI /end SUB_FUNCTION
/end FUNCTION
/begin FUNCTION DIA_Mass_air_flow_meter "_Mass air flow meter"
 /begin DEF_CHARACTERISTIC C_N_MIN_MAF_DIAG C_TPS_MIN_MAF_DIAG C_MAF_MIN_DIAG C_ABC_MAX_MAF C_ABC_INC_MAF C_MAF_MAX_DIAG /end DEF_CHARACTERISTIC
 /begin OUT_MEASUREMENT LV_ERR_MAF /end OUT_MEASUREMENT
/end FUNCTION
/begin FUNCTION DIA_Intake_air_temperature_senso "_Intake air temperature sensor"
 /begin DEF_CHARACTERISTIC C_TCO_DIAG C_TIA_MAX_DIAG C_TIA_MIN_DIAG C_TIA_SUB_BOL C_TIA_SUB_TOL C_ABC_MAX_TIA C_ABC_INC_TIA /end DEF_CHARACTERISTIC
 /begin OUT_MEASUREMENT LV_ERR_TIA /end OUT_MEASUREMENT
/end FUNCTION
/begin FUNCTION DIA_Temperature_sensor___TCO_EX_ "_Temperature sensor - TCO_EX Coolant" /begin DEF_CHARACTERISTIC C_ABC_INC_TCO_EX C_ABC_MAX_TCO_EX C_T_TIA_TCO_EX_DIAG /end DEF_CHARACTERISTIC /begin OUT_MEASUREMENT LV_ERR_TCO_EX /end OUT_MEASUREMENT /end FUNCTION
/begin FUNCTION DIA_Temperature_sensor___TCO_Coo "_Temperature sensor - TCO Coolant" /end FUNCTION
/begin FUNCTION DIA_IVVT_diagnosis "_IVVT diagnosis"
 /begin DEF_CHARACTERISTIC C_ABC_INC_IVVT C_IVVTPWM_MAX_DIAG C_ABC_MAX_IVVT IP_IVVTPWM_MIN_DIAG__VB /end DEF_CHARACTERISTIC
/end FUNCTION
/begin FUNCTION DIA_Fuel_pump_relay_RLY_EFP "_Fuel pump relay RLY_EFP" /begin DEF_CHARACTERISTIC C_ABC_MAX_RLY_EFP C_ABC_INC_RLY_EFP /end DEF_CHARACTERISTIC /begin OUT_MEASUREMENT LV_ERR_RLY_EFP /end OUT_MEASUREMENT /end FUNCTION
/begin FUNCTION DIA_Ambient_pressure_sensor "_Ambient pressure sensor"
 /begin DEF_CHARACTERISTIC C_AMP_REF C_V_AMP_MAX_DIAG C_V_AMP_MIN_DIAG C_ABC_MAX_AMP C_ABC_INC_AMP /end DEF_CHARACTERISTIC
 /begin OUT_MEASUREMENT LV_ERR_AMP /end OUT_MEASUREMENT
/end FUNCTION
/begin FUNCTION DIA_Lambda_control_diagnosis "_Lambda control diagnosis"
 /begin DEF_CHARACTERISTIC C_ABC_MAX_VLS_UP C_MAF_MIN_VLS_DIAG C_VLS_BOL_OPEN_DIAG C_T_VLS_OPEN_UP_DIAG C_T_DLY_LS_DIAG C_VLS_MAX_UP_DIAG C_ABC_INC_VLS_UP C_ABC_INC_VLS_DOWN C_VLS_MAX_DOWN_DIAG C_VLS_MIN_DOWN_DIAG C_T_VLS_GND_UP_DIAG C_T_VLS_GND_DOWN_DIAG C_VLS_TOL_OPEN_DIAG C_VLS_TOL_OPEN_DOWN_DIAG C_VLS_BOL_OPEN_DOWN_DIAG C_MAF_INT_VLS_CAT_PUC C_ABC_MAX_VLS_DOWN C_LAM_P_SUM_DIAG C_VLS_DIF_MAX_MIN_DIAG C_VLS_MIN_UP_DIAG C_LAM_CYCNR_DIAG C_R_LS_GND_DOWN_MAX_DIAG C_R_LS_GND_UP_MAX_DIAG C_R_LS_OPEN_DOWN_MAX_DIAG C_R_LS_OPEN_UP_MIN_DIAG C_R_LS_OPEN_DOWN_MIN_DIAG C_ABC_MAX_LAM_LIM /end DEF_CHARACTERISTIC
 /begin OUT_MEASUREMENT LV_ERR_VLS_UP_SCB_2 LV_ERR_VLS_UP_SCG_1 LV_ERR_VLS_UP_SCG_2 LV_ERR_VLS_UP_SCB_1 LV_ERR_VLS_DOWN_SCB_1 LV_ERR_VLS_DOWN_SCB_2 LV_ERR_VLS_DOWN_SCG_2 LV_ERR_VLS_DOWN_SCG_1 LV_ERR_VLS_UP_OL_2 LV_ERR_VLS_DOWN_OL_2 LV_ERR_VLS_DOWN_OL_1 LV_ERR_VLS_STK_2 LV_ERR_LAM_LIM_2 LV_ERR_LAM_LIM_1 LV_ERR_VLS_STK_1 LV_ERR_VLS_UP_OL_1 LV_ERR_VLS_UP_1 LV_ERR_VLS_UP_2 LV_ERR_VLS_DOWN_2 LV_ERR_VLS_DOWN_1 /end OUT_MEASUREMENT
/end FUNCTION
/begin FUNCTION DIA_Upstream_oxygen_sensor_heate "_Upstream oxygen sensor heater diagnosis"
 /begin DEF_CHARACTERISTIC C_ABC_INC_LSH_UP C_ABC_MAX_LSH_UP C_TEG_DYN_MIN_LSH_DIAG C_PWM_LSH_UP_MIN C_PWM_LSH_UP_MAX C_VB_MIN_LSH_DIAG C_VB_MAX_LSH_DIAG /end DEF_CHARACTERISTIC
/end FUNCTION
/begin FUNCTION DIA_Downstream_oxygen_sensor_hea "_Downstream oxygen sensor heater diagnosis"
 /begin DEF_CHARACTERISTIC C_ABC_MAX_LSH_DOWN C_ABC_INC_LSH_DOWN C_PWM_LSH_DOWN_MIN C_TEMP_CAT_MIN_LSH_DIAG C_PWM_LSH_DOWN_MAX /end DEF_CHARACTERISTIC
/end FUNCTION
/begin FUNCTION DIA_Oil_temperature_sensor_TOIL "_Oil temperature sensor TOIL"
 /begin DEF_CHARACTERISTIC C_TOIL_MIN_DIAG C_TCO_MAX_TOIL_DIAG C_TOIL_SUB_DIAG C_TOIL_MAX_DIAG C_ABC_INC_TOIL C_ABC_MAX_TOIL /end DEF_CHARACTERISTIC
 /begin OUT_MEASUREMENT LV_ERR_TOIL /end OUT_MEASUREMENT
/end FUNCTION
/begin FUNCTION DIA_Electronically_controlled_th "_Electronically controlled thermostat diagnosis (ECT)"
 /begin DEF_CHARACTERISTIC C_TCO_ST_ECT_PLAUS_DIAG C_TCO_TCO_EX_PLAUS_DIAG C_ABC_INC_ECT_EL C_ABC_INC_ECT_MEC C_ABC_MAX_ECT_EL C_ABC_MAX_ECT_MEC C_ECTPWM_MAX_DIAG C_ECTPWM_MIN_DIAG /end DEF_CHARACTERISTIC
 /begin OUT_MEASUREMENT LV_ERR_TD LV_ERR_ECT_MEC LV_ERR_ECT_EL LV_ERR_ECT /end OUT_MEASUREMENT
/end FUNCTION
/begin FUNCTION DIA_Temperature_exhaust_gas_sens "_Temperature exhaust gas sensor diagnosis (TEG)"
 /begin DEF_CHARACTERISTIC C_TEG_MES_GRD_MAX C_V_TEG_PCAT_DOWN_DIAG_MIN C_V_TEG_PCAT_DOWN_DIAG_MAX C_V_TEG_MES_GRD_MAX C_ABC_INC_TEG_PCAT_DOWN C_ABC_MAX_TEG_PCAT_DOWN /end DEF_CHARACTERISTIC
 /begin OUT_MEASUREMENT LV_ERR_TEG_PCAT_DOWN_1 LV_ERR_TEG_PCAT_DOWN_2 LV_ERR_PREL_TEG_PCAT_DOWN_2 LV_ERR_PREL_TEG_PCAT_DOWN_1 /end OUT_MEASUREMENT
/end FUNCTION
/begin FUNCTION DIA_Knock_sensor_diagnosis "_Knock sensor diagnosis"
 /begin DEF_CHARACTERISTIC C_N_MIN_KNKS_DIAG C_MAF_MIN_KNKS_DIAG C_NL_MIN_DIAG C_NL_MAX_DIAG C_ABC_INC_KNKS_DIAG C_ABC_MAX_KNKS_DIAG /end DEF_CHARACTERISTIC
/end FUNCTION
/begin FUNCTION DIA_Vehicle_speed_signal_diagnos "_Vehicle speed signal diagnosis" /begin DEF_CHARACTERISTIC C_MAF_VS_MIN_DIAG C_N_VS_MIN_DIAG C_T_VS_MIN_DIAG /end DEF_CHARACTERISTIC /begin OUT_MEASUREMENT T_VS_DIAG_CTR /end OUT_MEASUREMENT /end FUNCTION
/begin FUNCTION DIA_Ignition_system_diagnosis "_Ignition system diagnosis"
 /begin DEF_CHARACTERISTIC C_IGA_OFF_CYCNR_HLD C_ABC_TD_IGC_CUT C_ABC_MAX_TD_IGC_CUT C_SUM_TD_IGC_CUT C_TCO_MIN_DUR_IGC_DIAG C_ABC_INC_V_DUR_IGC C_ABC_MAX_V_DUR_IGC ID_V_DUR_IGC_MIN__N__MAF C_ABC_INC_TD_IGC_CUT C_ESB_IGN_CUT_DIAG /end DEF_CHARACTERISTIC
 /begin OUT_MEASUREMENT LV_INH_IGC_0 LV_INH_IGC_1 LV_INH_IGC_2 LV_INH_IGC_3 LV_INH_IGC_4 LV_INH_IGC_5 LV_ERR_TD_IGC_CUT_0 LV_ERR_TD_IGC_CUT_1 LV_ERR_TD_IGC_CUT_2 LV_ERR_TD_IGC_CUT_3 LV_ERR_TD_IGC_CUT_4 LV_ERR_TD_IGC_CUT_5 LV_ERR_DUR_IGC_1 LV_ERR_DUR_IGC_2 LV_ERR_DUR_IGC_3 LV_ERR_DUR_IGC_4 LV_ERR_DUR_IGC_5 LV_ERR_DUR_IGC_0 LV_ERR_IVVT_0 LV_ERR_IVVT_1 LV_ERR_IGC /end OUT_MEASUREMENT
/end FUNCTION
/begin FUNCTION DIA_PVS_diagnosis "_PVS diagnosis"
 /begin DEF_CHARACTERISTIC C_ABC_INC_VCC_POTI C_ABC_MAX_VCC_POTI C_ABC_MAX_PVS_SP_1 C_ABC_MAX_PVS_SP_2 C_ABC_INC_PVS_SP_2 C_ABC_INC_PVS_RATIO C_ABC_MAX_PVS_RATIO C_VCC_DIF_POTI C_V_PVS_MAX_DIAG_1 C_V_PVS_MAX_DIAG_2 C_V_PVS_MIN_DIAG_2 C_T_IS_PVS_ERR IP_PVS_RATIO_HYS C_ABC_INC_PVS_SP_1 C_V_PVS_MIN_DIAG_1 C_ABC_MAX_PVS_H_R_1 C_ABC_MAX_PVS_H_R_2 /end DEF_CHARACTERISTIC
 /begin OUT_MEASUREMENT LV_ERR_PVS_2 LV_PVS_H_R_1 LV_PVS_H_R_2 LV_ERR_PVS_PRED LV_ERR_V_REF_2 LV_ERR_PVS_RATIO LV_ERR_PVS_DOUBLE LV_ERR_V_REF_1 LV_DYN_LIM_1_ACT LV_DYN_LIM_2_ACT LV_ERR_PVS_1 STATE_PVS_DIAG LV_N_SP_IS_LIH_ACT LV_ERR_PVS /end OUT_MEASUREMENT
/end FUNCTION
/begin FUNCTION DIA_Throttle_position_sensor_dia "_Throttle position sensor diagnosis"
 /begin DEF_CHARACTERISTIC C_ABC_INC_TPS_1 C_ABC_INC_TPS_2 C_ABC_MAX_TPS_2 C_ABC_MAX_TPS_1 C_V_TPS_MIN_DIAG_1 C_V_TPS_MIN_DIAG_2 C_V_TPS_MAX_DIAG_2 C_V_TPS_MAX_DIAG_1 C_V_TPS_RATIO_HYS C_MAF_MES_MAX_TPS_DIAG IP_MAF_1_DIAG__N__TPS_AV IP_MAF_ADD_TIA_FAC__TIA IP_FAC_TCO_TQI__TCO C_TPS_MAF_DIF_INT_THD C_TPS_MAF_DIF_MMV_THD C_TPS_MAF_CRLC_DIF C_TPS_MAX IP_MAF_DIF_TPS_DIAG__MAF_MES C_T_TPS_DIF_INT /end DEF_CHARACTERISTIC
 /begin OUT_MEASUREMENT LV_ERR_TPS_2 TPS_MAF_DIF_2 TPS_MAF_DIF_INT_2 TPS_MAF_DIF_INT_1 MAF_SUB_1 MAF_SUB_2 LV_ERR_TPS_RATIO LV_ERR_TPS_MAF_1 LV_ERR_TPS_MAF_2 TPS_MAF_DIF_1 TPS_MAF_DIF_MMV_1 TPS_MAF_DIF_MMV_2 LV_ERR_TPS_1 /end OUT_MEASUREMENT
/end FUNCTION
/begin FUNCTION DIA_Injection_valves_IV_1_to_6 "_Injection valves IV 1 to 6" /begin DEF_CHARACTERISTIC C_ABC_INC_IV C_ABC_MAX_IV /end DEF_CHARACTERISTIC
 /begin OUT_MEASUREMENT LV_ERR_IV_0 LV_ERR_IV_1 LV_ERR_IV_2 LV_ERR_IV_3 LV_ERR_IV_4 LV_ERR_IV_5 /end OUT_MEASUREMENT
/end FUNCTION
/begin FUNCTION DIA_Error_memory_interface "_Error-memory interface"
 /begin OUT_MEASUREMENT CTR_ABC_TEG_PCAT_DOWN_1 ERR_INFO_STAT LV_ERR_DET_TEG_PCAT_DOWN_1 LV_ERR_SYM_CHG_TEG_PCAT_DOWN_1 LV_CDN_DIAG_TEG_PCAT_DOWN_1 ERR_SYM_TEG_PCAT_DOWN_1 LV_END_DIAG_TEG_PCAT_DOWN_1 CTR_ABC_END_TEG_PCAT_DOWN_1 CTR_ABC_TEG_PCAT_DOWN_2 ERR_INFO_STAT LV_ERR_DET_TEG_PCAT_DOWN_2 LV_ERR_SYM_CHG_TEG_PCAT_DOWN_2 LV_CDN_DIAG_TEG_PCAT_DOWN_2 ERR_SYM_TEG_PCAT_DOWN_2 LV_END_DIAG_TEG_PCAT_DOWN_2 CTR_ABC_END_DIAG_TEG_PCAT_DOWN_2 CTR_ABC_TCO_EX ERR_INFO_STAT LV_ERR_DET_TCO_EX LV_ERR_SYM_CHG_TCO_EX LV_CDN_DIAG_TCO_EX ERR_SYM_TCO_EX LV_END_DIAG_TCO_EX CTR_ABC_END_DIAG_TCO_EX CTR_ABC_TIA ERR_INFO_STAT LV_ERR_DET_TIA LV_ERR_SYM_CHG_TIA LV_CDN_DIAG_TIA ERR_SYM_TIA LV_END_DIAG_TIA CTR_ABC_END_DIAG_TIA CTR_ABC_AMP ERR_INFO_STAT LV_ERR_DET_AMP LV_ERR_SYM_CHG_AMP LV_CDN_DIAG_AMP ERR_SYM_AMP LV_END_DIAG_AMP CTR_ABC_END_DIAG_AMP CTR_ABC_MAF ERR_INFO_STAT LV_ERR_DET_MAF LV_ERR_SYM_CHG_MAF LV_CDN_DIAG_MAF ERR_SYM_MAF LV_END_DIAG_MAF CTR_ABC_END_DIAG_MAF CTR_ABC_VLS_UP_SCB_1 ERR_INFO_STAT LV_ERR_DET_VLS_UP_SCB_1 LV_ERR_SYM_CHG_VLS_UP_SCB_1 LV_CDN_DIAG_VLS_UP_SCB_1 ERR_SYM_VLS_UP_SCB_1 LV_END_DIAG_VLS_UP_SCB_1 CTR_ABC_END_DIAG_VLS_UP_SCB_1 CTR_ABC_VLS_UP_SCB_2 ERR_INFO_STAT LV_ERR_DET_VLS_UP_SCB_2 LV_ERR_SYM_CHG_VLS_UP_SCB_2 LV_CDN_DIAG_VLS_UP_SCB_2 ERR_SYM_VLS_UP_SCB_2 LV_END_DIAG_VLS_UP_SCB_2 CTR_ABC_END_DIAG_VLS_UP_SCB_2 CTR_ABC_VLS_UP_SCG_1 ERR_INFO_STAT LV_ERR_DET_VLS_UP_SCG_1 LV_ERR_SYM_CHG_VLS_UP_SCG_1 LV_CDN_DIAG_VLS_UP_SCG_1 ERR_SYM_VLS_UP_SCG_1 LV_END_DIAG_VLS_UP_SCG_1 CTR_ABC_END_DIAG_VLS_UP_SCG_1 CTR_ABC_VLS_UP_SCG_2 ERR_INFO_STAT LV_ERR_DET_VLS_UP_SCG_2 LV_ERR_SYM_CHG_VLS_UP_SCG_2 LV_CDN_DIAG_VLS_UP_SCG_2 ERR_SYM_VLS_UP_SCG_2 LV_END_DIAG_VLS_UP_SCG_2 CTR_ABC_END_DIAG_VLS_UP_SCG_2 CTR_ABC_VLS_UP_OL_1 ERR_INFO_STAT LV_ERR_DET_VLS_UP_OL_1 LV_ERR_SYM_CHG_VLS_UP_OL_1 LV_CDN_DIAG_VLS_UP_OL_1 ERR_SYM_VLS_UP_OL_1 LV_END_DIAG_VLS_UP_OL_1 CTR_ABC_END_DIAG_OL_1 CTR_ABC_VLS_UP_OL_2 ERR_INFO_STAT LV_ERR_DET_VLS_UP_OL_2 LV_ERR_SYM_CHG_VLS_UP_OL_2 LV_CDN_DIAG_VLS_UP_OL_2 ERR_SYM_VLS_UP_OL_2 LV_END_DIAG_VLS_UP_OL_2 CTR_ABC_END_DIAG_OL_2 CTR_ABC_VLS_DOWN_SCB_1 ERR_INFO_STAT LV_ERR_DET_VLS_DOWN_SCB_1 LV_ERR_SYM_CHG_VLS_DOWN_SCB_1 LV_CDN_DIAG_VLS_DOWN_SCB_1 ERR_SYM_VLS_DOWN_SCB_1 LV_END_DIAG_VLS_DOWN_SCB_1 CTR_ABC_END_DIAG_DOWN_SCB_1 CTR_ABC_VLS_DOWN_SCB_2 ERR_INFO_STAT LV_ERR_DET_VLS_DOWN_SCB_2 LV_ERR_SYM_CHG_VLS_DOWN_SCB_2 LV_CDN_DIAG_VLS_DOWN_SCB_2 ERR_SYM_VLS_DOWN_SCB_2 LV_END_DIAG_VLS_DOWN_SCB_2 CTR_ABC_END_DIAG_VLS_DOWN_SCB_2 CTR_ABC_VLS_DOWN_SCG_1 ERR_INFO_STAT LV_ERR_DET_VLS_DOWN_SCG_1 LV_ERR_SYM_CHG_VLS_DOWN_SCG_1 LV_CDN_DIAG_VLS_DOWN_SCG_1 ERR_SYM_VLS_DOWN_SCG_1 LV_END_DIAG_VLS_DOWN_SCG_1 CTR_ABC_END_DIAG_VLS_DOWN_SCG_1 CTR_ABC_VLS_DOWN_SCG_2 ERR_INFO_STAT LV_ERR_DET_VLS_DOWN_SCG_2 LV_ERR_SYM_CHG_VLS_DOWN_SCG_2 LV_CDN_DIAG_VLS_DOWN_SCG_2 ERR_SYM_VLS_DOWN_SCG_2 LV_END_DIAG_VLS_DOWN_SCG_2 CTR_ABC_END_DIAG_VLS_DOWN_SCG_2 CTR_ABC_VLS_DOWN_OL_1 ERR_INFO_STAT LV_ERR_DET_VLS_DOWN_OL_1 LV_ERR_SYM_CHG_VLS_DOWN_OL_1 LV_CDN_DIAG_VLS_DOWN_OL_1 ERR_SYM_VLS_DOWN_OL_1 LV_END_DIAG_VLS_DOWN_OL_1 CTR_ABC_END_DIAG_VLS_DOWN_OL_1 CTR_ABC_VLS_DOWN_OL_2 ERR_INFO_STAT LV_ERR_DET_VLS_DOWN_OL_2 LV_ERR_SYM_CHG_VLS_DOWN_OL_2 LV_CDN_DIAG_VLS_DOWN_OL_2 ERR_SYM_VLS_DOWN_OL_2 LV_END_DIAG_VLS_DOWN_OL_2 CTR_ABC_END_DIAG_VLS_DOWN_OL_2 CTR_ABC_VLS_STK_1 ERR_INFO_STAT LV_ERR_DET_VLS_STK_1 LV_ERR_SYM_CHG_VLS_STK_1 LV_CDN_DIAG_VLS_STK_1 ERR_SYM_VLS_STK_1 LV_END_DIAG_VLS_STK_1 CTR_ABC_END_DIAG_VLS_STK_1 CTR_ABC_VLS_STK_2 ERR_INFO_STAT LV_ERR_DET_VLS_STK_2 LV_ERR_SYM_CHG_VLS_STK_2 LV_CDN_DIAG_VLS_STK_2 ERR_SYM_VLS_STK_2 LV_END_DIAG_VLS_STK_2 CTR_ABC_END_DIAG_VLS_STK_2 CTR_ABC_LAM_LIM_1 ERR_INFO_STAT LV_ERR_DET_LAM_LIM_1 LV_ERR_SYM_CHG_LAM_LIM_1 LV_CDN_DIAG_LAM_LIM_1 ERR_SYM_LAM_LIM_1 LV_END_DIAG_LAM_LIM_1 CTR_ABC_END_DIAG_LAM_LIM_1 CTR_ABC_LAM_LIM_2 ERR_INFO_STAT LV_ERR_DET_LAM_LIM_2 LV_ERR_SYM_CHG_LAM_LIM_2 LV_CDN_DIAG_LAM_LIM_2 ERR_SYM_LAM_LIM_2 LV_END_DIAG_LAM_LIM_2 CTR_ABC_END_DIAG_LAM_LIM_2 CTR_ABC_IV_0 ERR_INFO_STAT LV_ERR_DET_IV_0 LV_ERR_SYM_CHG_IV_0 LV_CDN_DIAG_IV_0 ERR_SYM_IV_0 LV_END_DIAG_IV_0 CTR_ABC_END_DIAG_IV_0 CTR_ABC_IV_1 ERR_INFO_STAT LV_ERR_DET_IV_1 LV_ERR_SYM_CHG_IV_1 LV_CDN_DIAG_IV_1 ERR_SYM_IV_1 LV_END_DIAG_IV_1 CTR_ABC_END_DIAG_IV_1 CTR_ABC_IV_2 ERR_INFO_STAT LV_ERR_DET_IV_2 LV_ERR_SYM_CHG_IV_2 LV_CDN_DIAG_IV_2 ERR_SYM_IV_2 LV_END_DIAG_IV_2 CTR_ABC_END_DIAG_IV_2 CTR_ABC_IV_3 ERR_INFO_STAT LV_ERR_DET_IV_3 LV_ERR_SYM_CHG_IV_3 LV_CDN_DIAG_IV_3 ERR_SYM_IV_3 LV_END_DIAG_IV_3 CTR_ABC_END_DIAG_IV_3 CTR_ABC_IV_4 ERR_INFO_STAT LV_ERR_DET_IV_4 LV_ERR_SYM_CHG_IV_4 LV_CDN_DIAG_IV_4 ERR_SYM_IV_4 LV_END_DIAG_IV_4 CTR_ABC_END_DIAG_IV_4 CTR_ABC_IV_5 ERR_INFO_STAT LV_ERR_DET_IV_5 LV_ERR_SYM_CHG_IV_5 LV_CDN_DIAG_IV_5 ERR_SYM_IV_5 LV_END_DIAG_IV_5 CTR_ABC_END_DIAG_IV_5 CTR_ABC_LSH_UP_1 ERR_INFO_STAT LV_ERR_DET_LSH_UP_1 LV_ERR_SYM_CHG_LSH_UP_1 LV_CDN_DIAG_LSH_UP_1 ERR_SYM_LSH_UP_1 LV_END_DIAG_LSH_UP_1 CTR_ABC_END_DIAG_LSH_UP_1 CTR_ABC_LSH_UP_2 ERR_INFO_STAT LV_ERR_DET_LSH_UP_2 LV_ERR_SYM_CHG_LSH_UP_2 LV_CDN_DIAG_LSH_UP_2 ERR_SYM_LSH_UP_2 LV_END_DIAG_LSH_UP_2 CTR_ABC_END_DIAG_LSH_UP_2 CTR_ABC_LSH_DOWN_1 ERR_INFO_STAT LV_ERR_DET_LSH_DOWN_1 LV_ERR_SYM_CHG_LSH_DOWN_1 LV_CDN_DIAG_LSH_DOWN_1 ERR_SYM_LSH_DOWN_1 LV_END_DIAG_LSH_DOWN_1 CTR_ABC_END_DIAG_LSH_DOWN_1 CTR_ABC_LSH_DOWN_2 ERR_INFO_STAT LV_ERR_DET_LSH_DOWN_2 LV_ERR_SYM_CHG_LSH_DOWN_2 LV_CDN_DIAG_LSH_DOWN_2 ERR_SYM_LSH_DOWN_2 LV_END_DIAG_LSH_DOWN_2 CTR_ABC_END_DIAG_LSH_DOWN_2 CTR_ABC_RLY_EFP ERR_INFO_STAT LV_ERR_DET_RLY_EFP LV_ERR_SYM_CHG_RLY_EFP LV_CDN_DIAG_RLY_EFP ERR_SYM_RLY_EFP LV_END_DIAG_RLY_EFP CTR_ABC_END_DIAG_RLY_EFP CTR_ABC_CPS ERR_INFO_STAT LV_ERR_DET_CPS /end OUT_MEASUREMENT
/end FUNCTION
/end MODULE
/end PROJECT
