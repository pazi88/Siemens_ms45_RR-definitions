ASAP2_VERSION 1 31
/begin PROJECT MS45 "Rover Motorsteuerung V6"
/begin HEADER "_default_HeaderComment" PROJECT_NO _50 /end HEADER
/begin MODULE _default_ModuleName "_default_ModuleLongIdentifier"
/begin MOD_COMMON "_default_ModCommonComment" DEPOSIT ABSOLUTE BYTE_ORDER MSB_FIRST ALIGNMENT_BYTE 1 ALIGNMENT_WORD 2 ALIGNMENT_LONG 4 ALIGNMENT_FLOAT32_IEEE 4 ALIGNMENT_FLOAT64_IEEE 8 /end MOD_COMMON
/begin MEASUREMENT FAC_TQ_REQ_CLU "Torque scaling factor for calculation requested torque at clutch" UWORD _CNV_A_R_LINEAR_____5_CM 1 100. 0. 1.99996948 ECU_ADDRESS 0x3fd046 FORMAT "%7.5" /end MEASUREMENT
/begin MEASUREMENT N_RATIO_CONV "" UBYTE _CNV_A_R_LINEAR_____44_CM 1 100. 0. 0.996094 ECU_ADDRESS 0x3fd99c FORMAT "%4.3" /end MEASUREMENT
/begin MEASUREMENT TCO_DIF "" SBYTE _CNV_A_R_LINEAR_____23_CM 1 100. -96. 95.25 ECU_ADDRESS 0x3fd9aa FORMAT "%3.1" /end MEASUREMENT
/begin MEASUREMENT TEMP_LS_INI "" UBYTE _CNV_A_R_LINEAR_____22_CM 1 100. -48. 142.5 ECU_ADDRESS 0x3fd934 FORMAT "%4.1" /end MEASUREMENT
/begin AXIS_PTS ldp_fac_tq_req_clu__tq_add_ch "" 0x614e8 FAC_TQ_REQ_CLU _REC_AXS_20_u2 1.99996948 _CNV_A_R_LINEAR_____5_CM 8 0. 1.99996948 FORMAT "%7.5" /end AXIS_PTS
/begin AXIS_PTS ldp_iga_dif_eff_iga "" 0x6155c IGA_DIF_REF _REC_AXS_20_u1 -95.625 _CNV_A_R_LINEAR_____49_CM 16 0. -95.625 FORMAT "%5.1" /end AXIS_PTS
/begin AXIS_PTS ldp_lamb_sp_iga_ref_lamb "" 0x615a2 LAMB_SP _REC_AXS_20_u2 31.99902344 _CNV_A_R_LINEAR_____50_CM 8 0. 31.99902344 FORMAT "%7.4" /end AXIS_PTS
/begin AXIS_PTS ldp_maf_iga_dif_min_bas "" 0x615f4 MAF _REC_AXS_20_u1 1389. _CNV_A_R_LINEAR_____51_CM 6 0. 1389. FORMAT "%4.0" /end AXIS_PTS
/begin AXIS_PTS ldp_maf_kgh_temp_sub_cat "" 0x61602 MAF_KGH _REC_AXS_20_u2 2047.96875 _CNV_A_R_LINEAR_____52_CM 6 0. 2047.96875 FORMAT "%6.2" /end AXIS_PTS
/begin AXIS_PTS ldp_n_32__tq_add_ch_is "" 0x6166d N_32 _REC_AXS_20_u1 8160. _CNV_A_R_LINEAR_____15_CM 8 0. 8160. FORMAT "%4.0" /end AXIS_PTS
/begin AXIS_PTS ldp_n_dif_cor__tq_i_dt_is "" 0x616da N_DIF_COR _REC_AXS_20_u2 65535. _CNV_A_R_LINEAR_____53_CM 12 -32768. 32767. FORMAT "%6.0" /end AXIS_PTS
/begin AXIS_PTS ldp_n_dif_cor_p_d_dt_is "" 0x616f4 N_DIF_COR _REC_AXS_20_u2 65535. _CNV_A_R_LINEAR_____53_CM 12 -32768. 32767. FORMAT "%6.0" /end AXIS_PTS
/begin AXIS_PTS ldp_n_dif_cor_p_d_is "" 0x6170e N_DIF_COR _REC_AXS_20_u2 65535. _CNV_A_R_LINEAR_____53_CM 12 -32768. 32767. FORMAT "%6.0" /end AXIS_PTS
/begin AXIS_PTS ldp_n_dif_cor_tq_i_is "" 0x61728 N_DIF_COR _REC_AXS_20_u2 65535. _CNV_A_R_LINEAR_____53_CM 12 -32768. 32767. FORMAT "%6.0" /end AXIS_PTS
/begin AXIS_PTS ldp_n_grd_p_d_dt_is "" 0x6175d N_GRD _REC_AXS_20_u1 8160. _CNV_A_R_LINEAR_____54_CM 8 -4096. 4064. FORMAT "%5.0" /end AXIS_PTS
/begin AXIS_PTS ldp_n_grd_p_d_is "" 0x61766 N_GRD _REC_AXS_20_u1 8160. _CNV_A_R_LINEAR_____54_CM 8 -4096. 4064. FORMAT "%5.0" /end AXIS_PTS
/begin AXIS_PTS ldp_n_grd_tq_i_is "" 0x6176f N_GRD _REC_AXS_20_u1 8160. _CNV_A_R_LINEAR_____54_CM 8 -4096. 4064. FORMAT "%5.0" /end AXIS_PTS
/begin AXIS_PTS ldp_n_iga_dif_min_bas "" 0x61781 N_32 _REC_AXS_20_u1 8160. _CNV_A_R_LINEAR_____15_CM 12 0. 8160. FORMAT "%4.0" /end AXIS_PTS
/begin AXIS_PTS ldp_n_ratio_conv_fac_tq_conv "" 0x61797 N_RATIO_CONV _REC_AXS_20_u1 0.9960940000000002 _CNV_A_R_LINEAR_____8_CM 8 0. 0.996094 FORMAT "%5.3" /end AXIS_PTS
/begin AXIS_PTS ldp_n_t_n_dif_ofs_pred "" 0x617b2 N _REC_AXS_20_u2 8160. _CNV_A_R_LINEAR_____0_CM 8 0. 8160. FORMAT "%4.0" /end AXIS_PTS
/begin AXIS_PTS ldp_n_tq_add_st "" 0x617c4 N_32 _REC_AXS_20_u1 8160. _CNV_A_R_LINEAR_____15_CM 8 0. 8160. FORMAT "%4.0" /end AXIS_PTS
/begin AXIS_PTS ldp_n_tq_add_tra "" 0x617cd N_32 _REC_AXS_20_u1 8160. _CNV_A_R_LINEAR_____15_CM 8 0. 8160. FORMAT "%4.0" /end AXIS_PTS
/begin AXIS_PTS ldp_nr_pat__pat_ind "" 0x617e4 NUMMER_DES_ABSCHALTPATTERNS _REC_AXS_20_u1 255. _CNV_A_R_LINEAR_____17_CM 7 0. 255. FORMAT "%3.0" /end AXIS_PTS
/begin AXIS_PTS ldp_seg_ctr_fac_wf "" 0x617f6 SEG_CTR_FAC_WF _REC_AXS_20_u2 65535. _CNV_A_R_LINEAR_____46_CM 4 0. 65535. FORMAT "%5.0" /end AXIS_PTS
/begin AXIS_PTS ldp_t_ast__fac_tq_add_ch "" 0x61824 T_AST _REC_AXS_20_u2 6553.5 _CNV_A_R_LINEAR_____18_CM 8 0. 6553.5 FORMAT "%5.1" /end AXIS_PTS
/begin AXIS_PTS ldp_tco__fac_tq_add_ch "" 0x61866 TCO _REC_AXS_20_u1 190.5 _CNV_A_R_LINEAR_____22_CM 8 -48. 142.5 FORMAT "%5.1" /end AXIS_PTS
/begin AXIS_PTS ldp_tco__fac_tq_add_ch_is "" 0x6186f TCO _REC_AXS_20_u1 190.5 _CNV_A_R_LINEAR_____22_CM 8 -48. 142.5 FORMAT "%5.1" /end AXIS_PTS
/begin AXIS_PTS ldp_tco_iga_dif_min_tco "" 0x618d3 TCO _REC_AXS_20_u1 190.5 _CNV_A_R_LINEAR_____22_CM 8 -48. 142.5 FORMAT "%5.1" /end AXIS_PTS
/begin AXIS_PTS ldp_tco_st_iga_t_ch "" 0x618f7 TCO_ST _REC_AXS_20_u1 28.575 _CNV_A_R_LINEAR_____22_CM 8 -48. 142.5 FORMAT "%5.1" /end AXIS_PTS
/begin AXIS_PTS ldp_tco_st_temp_mmv_ini_cat "" 0x61904 TCO_ST _REC_AXS_20_u1 190.5 _CNV_A_R_LINEAR_____22_CM 6 -48. 142.5 FORMAT "%5.1" /end AXIS_PTS
/begin AXIS_PTS ldp_tco_st_ti_fac_wf "" 0x6190b TCO_ST _REC_AXS_20_u1 190.5 _CNV_A_R_LINEAR_____22_CM 4 -48. 142.5 FORMAT "%5.1" /end AXIS_PTS
/begin AXIS_PTS ldp_tco_st_tqfr_st "" 0x61910 TCO_ST _REC_AXS_20_u1 190.5 _CNV_A_R_LINEAR_____22_CM 4 -48. 142.5 FORMAT "%5.1" /end AXIS_PTS
/begin AXIS_PTS ldp_tco_ti_wf_thd "" 0x61915 TCO _REC_AXS_20_u1 28.575 _CNV_A_R_LINEAR_____22_CM 4 -48. 142.5 FORMAT "%5.1" /end AXIS_PTS
/begin AXIS_PTS ldp_toil_fac_conv "" 0x61939 TOIL _REC_AXS_20_u1 200. _CNV_A_R_LINEAR_____32_CM 8 -40. 160. FORMAT "%3.0" /end AXIS_PTS
/begin AXIS_PTS ldp_toil_t_dly_conv "" 0x61942 TOIL _REC_AXS_20_u1 200. _CNV_A_R_LINEAR_____32_CM 8 -40. 160. FORMAT "%3.0" /end AXIS_PTS
/begin AXIS_PTS ldp_toil_t_dly_n_sp_is "" 0x6194b TOIL _REC_AXS_20_u1 200. _CNV_A_R_LINEAR_____32_CM 8 -40. 160. FORMAT "%3.0" /end AXIS_PTS
/begin AXIS_PTS ldp_toil_t_ramp_conv_neg "" 0x61954 TOIL _REC_AXS_20_u1 200. _CNV_A_R_LINEAR_____32_CM 8 -40. 160. FORMAT "%3.0" /end AXIS_PTS
/begin AXIS_PTS ldp_toil_t_ramp_conv_pos "" 0x6195d TOIL _REC_AXS_20_u1 200. _CNV_A_R_LINEAR_____32_CM 8 -40. 160. FORMAT "%3.0" /end AXIS_PTS
/begin AXIS_PTS ldp_toil_tqfr_add "" 0x61966 TOIL _REC_AXS_20_u1 200. _CNV_A_R_LINEAR_____32_CM 8 -40. 160. FORMAT "%3.0" /end AXIS_PTS
/begin AXIS_PTS ldp_v_amp__amp_raw "" 0x61a32 V_AMP _REC_AXS_20_u2 4.99511719 _CNV_A_R_LINEAR_____38_CM 8 0. 4.99511719 FORMAT "%5.3" /end AXIS_PTS
/begin AXIS_PTS ldp_v_tia_tia "" 0x61a88 V_TIA _REC_AXS_20_u1 4.447265625 _CNV_A_R_LINEAR_____40_CM 16 3.90625e-002 4.98046875 FORMAT "%5.3" /end AXIS_PTS
/begin AXIS_PTS ldp_v_toil__toil "" 0x61a99 V_TOIL _REC_AXS_20_u1 4.98046875 _CNV_A_R_LINEAR_____40_CM 16 0. 4.98046875 FORMAT "%5.3" /end AXIS_PTS
/begin AXIS_PTS ldp_vs__amp_raw_cor "" 0x61ac5 VS _REC_AXS_20_u1 255. _CNV_A_R_LINEAR_____43_CM 8 0. 255. FORMAT "%3.0" /end AXIS_PTS
/begin AXIS_PTS ldpm_gr_at_100 "" 0x61af6 GR_AT _REC_AXS_20_u1 255. _CNV_A_R_LINEAR_____13_CM 13 0. 255. FORMAT "%3.0" /end AXIS_PTS
/begin AXIS_PTS ldpm_gr_at_2 "" 0x61b04 GR_AT _REC_AXS_20_u1 255. _CNV_A_R_LINEAR_____13_CM 13 0. 255. FORMAT "%3.0" /end AXIS_PTS
/begin AXIS_PTS ldpm_gr_at_3 "" 0x61b12 GR_AT _REC_AXS_20_u1 255. _CNV_A_R_LINEAR_____13_CM 13 0. 255. FORMAT "%3.0" /end AXIS_PTS
/begin AXIS_PTS ldpm_gr_mt_100 "" 0x61b20 GR_MT _REC_AXS_20_u1 255. _CNV_A_R_LINEAR_____13_CM 13 0. 255. FORMAT "%3.0" /end AXIS_PTS
/begin AXIS_PTS ldpm_gr_mt_2 "" 0x61b2e GR_MT _REC_AXS_20_u1 255. _CNV_A_R_LINEAR_____13_CM 13 0. 255. FORMAT "%3.0" /end AXIS_PTS
/begin AXIS_PTS ldpm_gr_mt_3 "" 0x61b3c GR_MT _REC_AXS_20_u1 255. _CNV_A_R_LINEAR_____13_CM 13 0. 255. FORMAT "%3.0" /end AXIS_PTS
/begin AXIS_PTS ldpm_maf_100 "" 0x61b4a MAF _REC_AXS_20_u2 1389. _CNV_A_R_LINEAR_____56_CM 12 0. 1389. FORMAT "%4.0" /end AXIS_PTS
/begin AXIS_PTS ldpm_maf_6 "" 0x61b95 MAF _REC_AXS_20_u1 1389. _CNV_A_R_LINEAR_____51_CM 8 0. 1389. FORMAT "%4.0" /end AXIS_PTS
/begin AXIS_PTS ldpm_n_110 "" 0x61bc3 N_32 _REC_AXS_20_u1 8160. _CNV_A_R_LINEAR_____15_CM 8 0. 8160. FORMAT "%4.0" /end AXIS_PTS
/begin AXIS_PTS ldpm_n_2_3 "" 0x61c0e N _REC_AXS_20_u2 816. _CNV_A_R_LINEAR_____0_CM 16 0. 8160. FORMAT "%4.0" /end AXIS_PTS
/begin AXIS_PTS ldpm_n_29 "" 0x61c04 N_32 _REC_AXS_20_u1 8160. _CNV_A_R_LINEAR_____15_CM 8 0. 8160. FORMAT "%4.0" /end AXIS_PTS
/begin AXIS_PTS ldpm_n_35 "" 0x61c7e N_32 _REC_AXS_20_u1 8160. _CNV_A_R_LINEAR_____15_CM 6 0. 8160. FORMAT "%4.0" /end AXIS_PTS
/begin AXIS_PTS ldpm_tco_1_6 "" 0x61cf4 TCO _REC_AXS_20_u1 28.575 _CNV_A_R_LINEAR_____22_CM 6 -48. 142.5 FORMAT "%5.1" /end AXIS_PTS
/begin AXIS_PTS ldpm_tco_15 "" 0x61ce4 TCO _REC_AXS_20_u1 190.5 _CNV_A_R_LINEAR_____22_CM 8 -48. 142.5 FORMAT "%5.1" /end AXIS_PTS
/begin AXIS_PTS ldpm_tco_3 "" 0x61cfb TCO _REC_AXS_20_u1 190.5 _CNV_A_R_LINEAR_____22_CM 8 -48. 142.5 FORMAT "%5.1" /end AXIS_PTS
/begin AXIS_PTS ldpm_tco_3_4 "" 0x61d04 TCO _REC_AXS_20_u1 190.5 _CNV_A_R_LINEAR_____22_CM 8 -48. 142.5 FORMAT "%5.1" /end AXIS_PTS
/begin AXIS_PTS ldpm_tib_ti_wf_thd "" 0x61d5c TIB _REC_AXS_20_u2 262.14 _CNV_A_R_LINEAR_____24_CM 4 0. 262.14 FORMAT "%7.3" /end AXIS_PTS
/begin MEASUREMENT DUMMY "" UWORD _CNV_A_R_LINEAR_____17_CM 1 100. 0. 65535. ECU_ADDRESS 0x3fd188 FORMAT "%5.0" /end MEASUREMENT
/begin MEASUREMENT CKS_CRC_ECU "" UWORD _CNV_A_R_LINEAR_____17_CM 1 100. 0. 65535. ECU_ADDRESS 0x3f982c FORMAT "%5.0" /end MEASUREMENT
/begin MEASUREMENT CYCNR_PUC "" UWORD _CNV_A_R_LINEAR_____17_CM 1 100. 0. 65535. ECU_ADDRESS 0x3fc7f2 FORMAT "%5.0" /end MEASUREMENT
/begin MEASUREMENT FAC_TQ_REQ_CRU "Torque factor request for cruise control" UWORD _CNV_A_R_LINEAR_____5_CM 1 100. 0. 1.99996948 ECU_ADDRESS 0x3fd030 FORMAT "%7.5" /end MEASUREMENT
/begin MEASUREMENT LV_CAT_DIAG_2 "" UBYTE _CNV_S_2_RANGE______74_CM 1 100. 0. 1. ECU_ADDRESS 0x3fd49e BIT_MASK 0x1 /end MEASUREMENT
/begin MEASUREMENT LV_FMY_EXIT_ST "" UBYTE _CNV_S_2_RANGE______76_CM 1 100. 0. 1. ECU_ADDRESS 0x3fd594 BIT_MASK 0x1 /end MEASUREMENT
/begin MEASUREMENT LV_FSD_DIAG_1 "" UBYTE _CNV_S_2_RANGE______74_CM 1 100. 0. 1. ECU_ADDRESS 0x3fd497 BIT_MASK 0x1 /end MEASUREMENT
/begin MEASUREMENT LV_FSD_DIAG_2 "" UBYTE _CNV_S_2_RANGE______74_CM 1 100. 0. 1. ECU_ADDRESS 0x3fd49f BIT_MASK 0x1 /end MEASUREMENT
/begin MEASUREMENT LV_LS_DIAG_2 "" UBYTE _CNV_S_2_RANGE______74_CM 1 100. 0. 1. ECU_ADDRESS 0x3fd49d BIT_MASK 0x1 /end MEASUREMENT
/begin MEASUREMENT LV_MAX_ERR_FSD_1 "" UBYTE _CNV_S_2_RANGE______77_R_CM 1 100. 0. 255. ECU_ADDRESS 0x3fd59b /end MEASUREMENT
/begin MEASUREMENT LV_MIN_ERR_FSD_1 "" UBYTE _CNV_S_2_RANGE______77_R_CM 1 100. 0. 255. ECU_ADDRESS 0x3fd59a /end MEASUREMENT
/begin MEASUREMENT LV_MIS_STATE_A "Misfire status A detectec" UBYTE _CNV_S_2_RANGE______74_CM 1 100. 0. 1. ECU_ADDRESS 0x3fd4fe BIT_MASK 0x1 /end MEASUREMENT
/begin MEASUREMENT LV_MIS_STATE_B "Misfire status B detectec" UBYTE _CNV_S_2_RANGE______74_CM 1 100. 0. 1. ECU_ADDRESS 0x3fd4ff BIT_MASK 0x1 /end MEASUREMENT
/begin MEASUREMENT LV_TQ_CRU_ACT "Logical variable cruise control active" UBYTE _CNV_S_2_RANGE______74_CM 1 100. 0. 1. ECU_ADDRESS 0x3fd55c /end MEASUREMENT
/begin MEASUREMENT N_HYS_PUC "" UBYTE _CNV_A_R_LINEAR_____15_CM 1 100. 0. 8160. ECU_ADDRESS 0x3fd849 FORMAT "%4.0" /end MEASUREMENT
/begin MEASUREMENT N_MIN_PUC "" UBYTE _CNV_A_R_LINEAR_____15_CM 1 100. 0. 8160. ECU_ADDRESS 0x3fd848 FORMAT "%4.0" /end MEASUREMENT
/begin MEASUREMENT TQ_DIF_TRA "" SWORD _CNV_A_R_LINEAR_____37_CM 1 100. -1024. 1023.96875 ECU_ADDRESS 0x3fd0da FORMAT "%6.2" /end MEASUREMENT
/begin MEASUREMENT TQ_REQ_CLU "Requested torque at clutch" SWORD _CNV_A_R_LINEAR_____37_CM 1 100. -1024. 1023.96875 ECU_ADDRESS 0x3fd040 FORMAT "%6.2" /end MEASUREMENT
/begin MEASUREMENT TQI "" UBYTE _CNV_A_R_LINEAR_____86_CM 1 100. 0. 255. ECU_ADDRESS 0x3fd9b0 FORMAT "%3.0" /end MEASUREMENT
/begin MEASUREMENT TQI_INTER_FAST "Intermitted value fast torque request after minimum selection" SWORD _CNV_A_R_LINEAR_____37_CM 1 100. -1024. 1023.96875 ECU_ADDRESS 0x3fd0cc FORMAT "%6.2" /end MEASUREMENT
/begin MEASUREMENT TQI_INTER_SLOW "Intermitted value slow torque request after minimum selection" SWORD _CNV_A_R_LINEAR_____37_CM 1 100. -1024. 1023.96875 ECU_ADDRESS 0x3fd0ca FORMAT "%6.2" /end MEASUREMENT
/begin MEASUREMENT TQI_MIN_REQ "Minimum indicated engine torque which can be requested from driver or cruise control" UWORD _CNV_A_R_LINEAR_____37_CM 1 100. 0. 1023.96875 ECU_ADDRESS 0x3fd042 FORMAT "%7.2" /end MEASUREMENT
/begin MEASUREMENT TQI_REQ_FAST_DEC "Fast torque decrease request" SWORD _CNV_A_R_LINEAR_____37_CM 1 100. -1024. 1023.96875 ECU_ADDRESS 0x3fd0d0 FORMAT "%6.2" /end MEASUREMENT
/begin MEASUREMENT TQI_REQ_FAST_INC "Fast torque increase request" SWORD _CNV_A_R_LINEAR_____37_CM 1 100. -1024. 1023.96875 ECU_ADDRESS 0x3fd0ce FORMAT "%6.2" /end MEASUREMENT
/begin AXIS_PTS ldpm_n_id_crk_acq "" 0x61cae N _REC_AXS_20_u2 8160. _CNV_A_R_LINEAR_____0_CM 6 0. 8160. FORMAT "%4.0" /end AXIS_PTS
/begin MEASUREMENT LV_MTC_LIH_ACT "LV limp home request main throttle" UBYTE _CNV_S_2_RANGE______74_CM 1 100. 0. 1. ECU_ADDRESS 0x3fd51b BIT_MASK 0x1 /end MEASUREMENT
/begin MEASUREMENT ENG_STATE "" UBYTE _CNV_S_6_RANGE_ENG__91_CM 1 100. 0. 5. ECU_ADDRESS 0x3fd847 /end MEASUREMENT
/begin MEASUREMENT TIA_SUB "" UBYTE _CNV_A_R_LINEAR_____22_CM 1 100. -48. 142.5 ECU_ADDRESS 0x3fd981 FORMAT "%3.0" /end MEASUREMENT
/begin MEASUREMENT TQI_EMS "Requested indicated engine torque without external interventions" SWORD _CNV_A_R_LINEAR_____37_CM 1 100. -1024. 1023.96875 ECU_ADDRESS 0x3fd0c4 FORMAT "%6.2" /end MEASUREMENT
/begin MEASUREMENT LV_LS_DIAG_1 "" UBYTE _CNV_S_2_RANGE______74_CM 1 100. 0. 1. ECU_ADDRESS 0x3fd495 BIT_MASK 0x1 /end MEASUREMENT
/begin AXIS_PTS ldp_n__tq_loss_acc "" 0x616d2 N_32 _REC_AXS_20_u1 8160. _CNV_A_R_LINEAR_____15_CM 6 0. 8160. FORMAT "%7.4" /end AXIS_PTS
/begin AXIS_PTS ldp_t_acc__fac_tq_loss_acc_on "" 0x61809 T_ACC _REC_AXS_20_u1 2.55 _CNV_A_R_LINEAR_____21_CM 8 0. 2.55 FORMAT "%4.2" /end AXIS_PTS
/begin AXIS_PTS ldp_t_acc__fac_tq_loss_acc_off "" 0x61800 T_ACC _REC_AXS_20_u1 2.55 _CNV_A_R_LINEAR_____21_CM 8 0. 2.55 FORMAT "%4.2" /end AXIS_PTS
/begin MEASUREMENT LV_AT "LV automatic transmission recognized" UBYTE _CNV_S_2_RANGE______76_CM 1 100. 0. 1. ECU_ADDRESS 0x3fd426 BIT_MASK 0x1 /end MEASUREMENT
/begin MEASUREMENT LV_VAR_ACIN "LV air conditioning recognized" UBYTE _CNV_S_2_RANGE______76_CM 1 100. 0. 1. ECU_ADDRESS 0x3fd447 BIT_MASK 0x1 /end MEASUREMENT
/begin MEASUREMENT LV_VAR_ICL "LV CAN-Kombi recognized" UBYTE _CNV_S_2_RANGE______76_CM 1 100. 0. 1. ECU_ADDRESS 0x3fd446 BIT_MASK 0x1 /end MEASUREMENT
/begin MEASUREMENT ENV_TD_ERR_TD "" UWORD _CNV_A_R_LINEAR_____24_CM 1 100. 0. 50. ECU_ADDRESS 0x3fd89c FORMAT "%7.4" /end MEASUREMENT
/begin MEASUREMENT ENV_TD_ERR_LV_MPL_IGA_ACT "" UBYTE _CNV_S_2_RANGE______75_R_CM 1 100. 0. 255. ECU_ADDRESS 0x3fd89e /end MEASUREMENT
/begin MEASUREMENT ENV_TD_ERR_TD_MPL_DLY "" UBYTE _CNV_A_R_LINEAR_____24_CM 1 100. 0. 1.02 ECU_ADDRESS 0x3fd89f FORMAT "%5.3" /end MEASUREMENT
/begin MEASUREMENT ENV_TD_ERR_VB "" UBYTE _CNV_A_R_LINEAR_____42_CM 1 100. 0. 25.8984 ECU_ADDRESS 0x3fd8a1 FORMAT "%3.1" /end MEASUREMENT
/begin MEASUREMENT ENV_TD_ERR_TMP_TD__VB "" UWORD _CNV_A_R_LINEAR_____24_CM 1 100. 0. 50. ECU_ADDRESS 0x3fd8a2 FORMAT "%7.4" /end MEASUREMENT
/begin MEASUREMENT ENV_TD_ERR_N_32 "" UBYTE _CNV_A_R_LINEAR_____15_CM 1 100. 0. 8160. ECU_ADDRESS 0x3fd8a4 FORMAT "%4.0" /end MEASUREMENT
/begin MEASUREMENT ENV_TD_ERR_LV_IGK "" UBYTE _CNV_S_2_RANGE______75_R_CM 1 100. 0. 255. ECU_ADDRESS 0x3fd8a5 /end MEASUREMENT
/begin MEASUREMENT ENV_TD_ERR_ECU_STATE "" UBYTE _CNV_S_6_RANGE_ECU__100_CM 1 100. 0. 5. ECU_ADDRESS 0x3fd8a6 /end MEASUREMENT
/begin MEASUREMENT ENV_TD_ERR_ENG_STATE "" UBYTE _CNV_S_6_RANGE_ENG__101_CM 1 100. 0. 5. ECU_ADDRESS 0x3fd8a7 /end MEASUREMENT
/begin MEASUREMENT ENV_TD_ERR_C_TD_AS "" SBYTE _CNV_A_R_LINEAR_____102_CM 1 100. -8.192 8.128 ECU_ADDRESS 0x3fd8a0 FORMAT "%6.2" /end MEASUREMENT
/begin MEASUREMENT CTR_TD_ERR "" UWORD _CNV_A_R_LINEAR_____17_CM 1 100. 0. 65535. ECU_ADDRESS 0x3fc8ea FORMAT "%5.0" /end MEASUREMENT
/begin MEASUREMENT LV_CAT_DIAG_1 "" UBYTE _CNV_S_2_RANGE______74_CM 1 100. 0. 1. ECU_ADDRESS 0x3fd496 BIT_MASK 0x1 /end MEASUREMENT
/begin AXIS_PTS ldp_maf_cyl_stk__tqfr "" 0x615ea MAF _REC_AXS_20_u2 1389. _CNV_A_R_LINEAR_____56_CM 4 0. 1389. FORMAT "%7.2" /end AXIS_PTS
/begin AXIS_PTS ldp_n_sp_is_ratio "" 0x617a0 N_SP_IS_RATIO _REC_AXS_20_u2 7.99987793 _CNV_A_R_LINEAR_____104_CM 8 0. 7.99987793 FORMAT "%6.4" /end AXIS_PTS
/begin AXIS_PTS ldp_tco__tqfr_add "" 0x618b3 TCO _REC_AXS_20_u1 190.5 _CNV_A_R_LINEAR_____22_CM 8 -48. 142.5 FORMAT "%5.1" /end AXIS_PTS
/begin AXIS_PTS ldp_tco__lamb_ref_add "" 0x61898 TCO _REC_AXS_20_u1 190.5 _CNV_A_R_LINEAR_____22_CM 6 -48. 142.5 FORMAT "%5.1" /end AXIS_PTS
/begin AXIS_PTS ldp_lamb_dif__eff_lamb "" 0x6156e LAMB_DIF _REC_AXS_20_u2 63.99902344 _CNV_A_R_LINEAR_____105_CM 16 -32. 31.99902344 FORMAT "%8.4" /end AXIS_PTS
/begin CHARACTERISTIC C_FAC_TQE "Effective engine torque at clutch" VALUE 0x67b94 _REC_VAL_20_u1 0.24902344 _CNV_A_R_LINEAR_____107_CM 0. 0.24902344 FORMAT "%6.4" /end CHARACTERISTIC
/begin MEASUREMENT TQI_AV_S "Actual indicated engine torque for stratified mode" SWORD _CNV_A_R_LINEAR_____37_CM 1 100. -1024. 1023.96875 ECU_ADDRESS 0x3fd0a0 FORMAT "%6.2" /end MEASUREMENT
/begin MEASUREMENT EFF_TOT_AV_S "Total actual efficiency in stratified mode" UWORD _CNV_A_R_LINEAR_____5_CM 1 100. 0. 1.99996948 ECU_ADDRESS 0x3fd0a2 FORMAT "%7.5" /end MEASUREMENT
/begin AXIS_PTS ldp_n__lamb_ref "" 0x616a1 N_32 _REC_AXS_20_u1 816. _CNV_A_R_LINEAR_____15_CM 6 0. 8160. FORMAT "%4.0" /end AXIS_PTS
/begin MEASUREMENT FAC_TQ_REQ "Torque factor from pedal value interpretation and cruise control" UWORD _CNV_A_R_LINEAR_____5_CM 1 100. 0. 1.99996948 ECU_ADDRESS 0x3fd044 FORMAT "%7.5" /end MEASUREMENT
/begin AXIS_PTS ldp_tco__mff_lgrd_ast "" 0x618a4 TCO _REC_AXS_20_u1 190.5 _CNV_A_R_LINEAR_____22_CM 8 -48. 142.5 FORMAT "%5.1" /end AXIS_PTS
/begin AXIS_PTS ldpm_tco__eoi_tco "" 0x61d27 TCO _REC_AXS_20_u1 19.05 _CNV_A_R_LINEAR_____22_CM 8 -48. 142.5 FORMAT "%5.1" /end AXIS_PTS
/begin AXIS_PTS ldpm_tco__mff_cst "" 0x61d30 TCO _REC_AXS_20_u1 19.05 _CNV_A_R_LINEAR_____22_CM 8 -48. 142.5 FORMAT "%5.1" /end AXIS_PTS
/begin AXIS_PTS ldp_cyc__mff_cst "" 0x614a4 CYC _REC_AXS_20_u1 255. _CNV_A_R_LINEAR_____13_CM 4 0. 255. FORMAT "%3.0" /end AXIS_PTS
/begin AXIS_PTS ldp_vb__ti_add_dly "" 0x61ab3 VB _REC_AXS_20_u1 3.107808 _CNV_A_R_LINEAR_____42_CM 8 0. 25.8984 FORMAT "%3.1" /end AXIS_PTS
/begin AXIS_PTS ldp_tco_st_ip_ti_tco_wup "" 0x61900 TCO _REC_AXS_20_u1 190.5 _CNV_A_R_LINEAR_____22_CM 3 -48. 142.5 FORMAT "%5.1" /end AXIS_PTS
/begin AXIS_PTS ldp_tqi_sp_maf__maf_sp "" 0x61a18 TQI_SP_MAF _REC_AXS_20_u2 1023.96875 _CNV_A_R_LINEAR_____37_CM 12 0. 1023.96875 FORMAT "%7.2" /end AXIS_PTS
/begin AXIS_PTS ldpm_tco_7 "" 0x61d14 TCO _REC_AXS_20_u1 190.5 _CNV_A_R_LINEAR_____22_CM 8 -48. 142.5 FORMAT "%5.1" /end AXIS_PTS
/begin AXIS_PTS ldp_n__lamb_fl "" 0x61694 N_32 _REC_AXS_20_u1 8160. _CNV_A_R_LINEAR_____15_CM 12 0. 8160. FORMAT "%4.0" /end AXIS_PTS
/begin AXIS_PTS ldp_n_32__lamb_bas "" 0x61637 N_32 _REC_AXS_20_u1 8160. _CNV_A_R_LINEAR_____15_CM 8 0. 8160. FORMAT "%4.0" /end AXIS_PTS
/begin AXIS_PTS ldp_tco__lamb_add_afl_ch "" 0x61886 TCO _REC_AXS_20_u1 190.5 _CNV_A_R_LINEAR_____22_CM 8 -48. 142.5 FORMAT "%5.1" /end AXIS_PTS
/begin AXIS_PTS ldp_n_32__lamb_hom_afl "" 0x61652 N_32 _REC_AXS_20_u1 8160. _CNV_A_R_LINEAR_____15_CM 8 0. 8160. FORMAT "%4.0" /end AXIS_PTS
/begin AXIS_PTS ldpm_n_19 "" 0x61bfb N_32 _REC_AXS_20_u1 8160. _CNV_A_R_LINEAR_____15_CM 8 0. 8160. FORMAT "%4.0" /end AXIS_PTS
/begin AXIS_PTS ldp_n_32__fac_lamb_wup "" 0x61627 N_32 _REC_AXS_20_u1 8160. _CNV_A_R_LINEAR_____15_CM 6 0. 8160. FORMAT "%4.0" /end AXIS_PTS
/begin AXIS_PTS ldp_tqi_req_slow__lamb_hom_afl "" 0x619f4 TQI_REQ_SLOW _REC_AXS_20_u2 2047.96875 _CNV_A_R_LINEAR_____65_CM 8 -1024. 1023.96875 FORMAT "%6.2" /end AXIS_PTS
/begin AXIS_PTS ldp_tqi_req_slow__fac_lamb_wup "" 0x619b0 TQI_REQ_SLOW _REC_AXS_20_u2 2047.96875 _CNV_A_R_LINEAR_____65_CM 6 -1024. 1023.96875 FORMAT "%6.2" /end AXIS_PTS
/begin AXIS_PTS ldp_amp_mes_ti_st_amp_fac "" 0x61488 AMP _REC_AXS_20_u2 5434. _CNV_A_R_LINEAR_____1_CM 6 0. 5434. FORMAT "%7.2" /end AXIS_PTS
/begin AXIS_PTS ldp_ti_hom__eoi_bas "" 0x6191a TI_HOM _REC_AXS_20_u2 26.214 _CNV_A_R_LINEAR_____24_CM 6 0. 262.14 FORMAT "%7.3" /end AXIS_PTS
/begin AXIS_PTS ldpm_maf_4 "" 0x61b8c MAF _REC_AXS_20_u1 1389. _CNV_A_R_LINEAR_____51_CM 8 0. 1389. FORMAT "%4.0" /end AXIS_PTS
/begin AXIS_PTS ldp_t_ast__lamb_add_afl_ch "" 0x61836 T_AST _REC_AXS_20_u2 983.025 _CNV_A_R_LINEAR_____18_CM 8 0. 6553.5 FORMAT "%5.1" /end AXIS_PTS
/begin AXIS_PTS ldp_tco__lamb_bas_wup_cor "" 0x6188f TCO _REC_AXS_20_u1 190.5 _CNV_A_R_LINEAR_____22_CM 8 -48. 142.5 FORMAT "%5.1" /end AXIS_PTS
/begin AXIS_PTS ldp_tco_st__lamb_bas_wup_cor "" 0x618ee TCO _REC_AXS_20_u1 190.5 _CNV_A_R_LINEAR_____22_CM 8 -48. 142.5 FORMAT "%5.1" /end AXIS_PTS
/begin AXIS_PTS ldp_fup_bas__fup_mes "" 0x61508 FUP _REC_AXS_20_u2 4.99511719 _CNV_A_R_LINEAR_____38_CM 8 0. 4.99511719 FORMAT "%5.3" /end AXIS_PTS
/begin AXIS_PTS ldp_n_iga_ref_temp "" 0x6178e N_32 _REC_AXS_20_u1 8160. _CNV_A_R_LINEAR_____15_CM 8 0. 8160. FORMAT "%4.0" /end AXIS_PTS
/begin AXIS_PTS ldp_maf_iga_ref_temp "" 0x615fb MAF _REC_AXS_20_u1 1389. _CNV_A_R_LINEAR_____51_CM 6 0. 1389. FORMAT "%4.0" /end AXIS_PTS
/begin AXIS_PTS ldp_tia__iga_ref_temp_fac "" 0x6192f TIA _REC_AXS_20_u1 190.5 _CNV_A_R_LINEAR_____22_CM 6 -48. 142.5 FORMAT "%5.1" /end AXIS_PTS
/begin AXIS_PTS ldp_n__iga_ref_vvt "" 0x61683 N_32 _REC_AXS_20_u1 8160. _CNV_A_R_LINEAR_____15_CM 16 0. 8160. FORMAT "%4.0" /end AXIS_PTS
/begin AXIS_PTS ldp_maf__iga_ref_vvt "" 0x615bb MAF _REC_AXS_20_u1 1389. _CNV_A_R_LINEAR_____51_CM 12 0. 1389. FORMAT "%4.0" /end AXIS_PTS
/begin AXIS_PTS ldpm_maf_ip_egr_ratio "" 0x61ba6 MAF _REC_AXS_20_u2 1389. _CNV_A_R_LINEAR_____56_CM 12 0. 1389. FORMAT "%7.2" /end AXIS_PTS
/begin AXIS_PTS ldpm_n_17 "" 0x61bf6 N_32 _REC_AXS_20_u1 8160. _CNV_A_R_LINEAR_____15_CM 4 0. 8160. FORMAT "%4.0" /end AXIS_PTS
/begin MEASUREMENT STATE_SAV_DIAG "status of secondary air monitoring" ULONG _CNV_S_8_RANGE_STAT_134_CM 1 100. 0. 7. ECU_ADDRESS 0x3fc1e8 /end MEASUREMENT
/begin AXIS_PTS ldp_lamb_sp__iga_bas_lamb "" 0x61590 LAMB_SP _REC_AXS_20_u2 31.99902344 _CNV_A_R_LINEAR_____50_CM 8 0. 31.99902344 FORMAT "%7.4" /end AXIS_PTS
/begin AXIS_PTS ldpm_n_st "" 0x61cd2 N_32 _REC_AXS_20_u2 8160. _CNV_A_R_LINEAR_____0_CM 8 0. 8160. FORMAT "%4.0" /end AXIS_PTS
/begin AXIS_PTS ldpm_n_h_prs_st "" 0x61c9c N_32 _REC_AXS_20_u2 8160. _CNV_A_R_LINEAR_____0_CM 8 0. 8160. FORMAT "%4.0" /end AXIS_PTS
/begin AXIS_PTS ldpm_tco_h_prs "" 0x61d39 TCO _REC_AXS_20_u1 190.5 _CNV_A_R_LINEAR_____22_CM 6 -48. 142.5 FORMAT "%5.1" /end AXIS_PTS
/begin AXIS_PTS ldp_tco__n_sp_add_cat "" 0x618ad TCO _REC_AXS_20_u1 190.5 _CNV_A_R_LINEAR_____22_CM 5 -48. 142.5 FORMAT "%5.1" /end AXIS_PTS
/begin AXIS_PTS ldp_t_ast__n_sp_add_cat "" 0x61848 T_AST _REC_AXS_20_u2 6553.5 _CNV_A_R_LINEAR_____18_CM 5 0. 6553.5 FORMAT "%5.1" /end AXIS_PTS
/begin MEASUREMENT LV_TQ_INC "Logical variable torque increase active" UBYTE _CNV_S_2_RANGE______74_CM 1 100. 0. 1. ECU_ADDRESS 0x3fd572 BIT_MASK 0x1 /end MEASUREMENT
/begin MEASUREMENT LV_HOM_AFL_ACT "" UBYTE _CNV_S_2_RANGE______74_CM 1 100. 0. 1. ECU_ADDRESS 0x3fd3e4 BIT_MASK 0x1 /end MEASUREMENT
/begin AXIS_PTS ldpm_n_32__fup_sp "" 0x61c5f N_32 _REC_AXS_20_u1 8160. _CNV_A_R_LINEAR_____15_CM 8 0. 8160. FORMAT "%4.0" /end AXIS_PTS
/begin AXIS_PTS ldpm_n_32__fup_sp_s "" 0x61c68 N_32 _REC_AXS_20_u1 8160. _CNV_A_R_LINEAR_____15_CM 8 0. 8160. FORMAT "%4.0" /end AXIS_PTS
/begin AXIS_PTS ldp_fup_sp__fpapwm_bas "" 0x6151a FUP_SP _REC_AXS_20_u2 173888. _CNV_A_R_LINEAR_____114_CM 8 0. 173888. FORMAT "%6.0" /end AXIS_PTS
/begin AXIS_PTS ldpm_fup_dif__fpapwm "" 0x61ae4 FUP_DIF _REC_AXS_20_u2 173888. _CNV_A_R_LINEAR_____141_CM 8 -86945.33 86942.67 FORMAT "%9.2" /end AXIS_PTS
/begin AXIS_PTS ldp_eff_iga_sp_iga_dif_sp "" 0x614b8 EFF_IGA_SP _REC_AXS_20_u2 1.99996948 _CNV_A_R_LINEAR_____5_CM 16 0. 1.99996948 FORMAT "%7.5" /end AXIS_PTS
/begin AXIS_PTS ldp_egr_ratio_sp__iga_ref_egr "" 0x614da EGR_RATIO _REC_AXS_20_u2 99.99847412 _CNV_A_R_LINEAR_____144_CM 6 0. 99.99847412 /end AXIS_PTS
/begin AXIS_PTS ldpm_tco_is_1 "" 0x61d40 TCO _REC_AXS_20_u1 190.5 _CNV_A_R_LINEAR_____22_CM 8 -48. 142.5 FORMAT "%5.1" /end AXIS_PTS
/begin AXIS_PTS ldpm_maf_1_9 "" 0x61b64 MAF_KNK _REC_AXS_20_u1 69.45 _CNV_A_R_LINEAR_____51_CM 4 0. 1389. FORMAT "%4.0" /end AXIS_PTS
/begin AXIS_PTS ldpm_n_2_9 "" 0x61c30 N _REC_AXS_20_u1 8160. _CNV_A_R_LINEAR_____15_CM 16 0. 8160. FORMAT "%4.0" /end AXIS_PTS
/begin AXIS_PTS ldpm_n_4_9 "" 0x61c8e N_KNK _REC_AXS_20_u1 8160. _CNV_A_R_LINEAR_____15_CM 3 0. 8160. FORMAT "%4.0" /end AXIS_PTS
/begin AXIS_PTS ldpm_vb_td "" 0x61d78 VB _REC_AXS_20_u1 25.8984 _CNV_A_R_LINEAR_____42_CM 8 0. 25.8984 FORMAT "%3.1" /end AXIS_PTS
/begin AXIS_PTS ldpm_n_32_ip_egr_ratio "" 0x61c71 N_32 _REC_AXS_20_u1 8160. _CNV_A_R_LINEAR_____15_CM 12 0. 8160. FORMAT "%4.0" /end AXIS_PTS
/begin AXIS_PTS ldpm_tqi_sp__fup_sp "" 0x61d66 TQI_SP _REC_AXS_20_u2 1023.96875 _CNV_A_R_LINEAR_____37_CM 8 0. 1023.96875 FORMAT "%7.2" /end AXIS_PTS
/begin AXIS_PTS ldpm_fpa_mff__fpapwm "" 0x61ad2 FPA_MFF _REC_AXS_20_u2 1511.232 _CNV_A_R_LINEAR_____139_CM 8 0. 1511.232 FORMAT "%7.2" /end AXIS_PTS
/begin AXIS_PTS ldp_tqi_req_slow__lamb_ch_rgl "" 0x619e2 TQI_REQ_SLOW _REC_AXS_20_u2 2047.96875 _CNV_A_R_LINEAR_____65_CM 8 -1024. 1023.96875 FORMAT "%6.2" /end AXIS_PTS
/begin AXIS_PTS ldp_n_32__lamb_ch_rgl "" 0x61649 N_32 _REC_AXS_20_u1 8160. _CNV_A_R_LINEAR_____15_CM 8 0. 8160. FORMAT "%4.0" /end AXIS_PTS
/begin AXIS_PTS ldp_tqi_req_slow__lamb_ch_is "" 0x619d0 TQI_REQ_SLOW _REC_AXS_20_u2 2047.96875 _CNV_A_R_LINEAR_____65_CM 8 -1024. 1023.96875 FORMAT "%6.2" /end AXIS_PTS
/begin AXIS_PTS ldp_n_32__lamb_ch_is "" 0x61640 N_32 _REC_AXS_20_u1 8160. _CNV_A_R_LINEAR_____15_CM 8 0. 8160. FORMAT "%4.0" /end AXIS_PTS
/begin AXIS_PTS ldpm_vo_1 "" 0x61d81 VO _REC_AXS_20_u1 95.625 _CNV_A_R_LINEAR_____6_CM 8 0. 95.625 FORMAT "%4.1" /end AXIS_PTS
/begin AXIS_PTS ldpm_n_14 "" 0x61bcc N _REC_AXS_20_u2 8160. _CNV_A_R_LINEAR_____0_CM 20 0. 8160. FORMAT "%4.0" /end AXIS_PTS
/begin AXIS_PTS ldpm_tco_st_5 "" 0x61d49 TCO_ST _REC_AXS_20_u1 190.5 _CNV_A_R_LINEAR_____22_CM 8 -48. 142.5 FORMAT "%5.1" /end AXIS_PTS
/begin MEASUREMENT LV_CBK_MPL "LV  multiple cylinder banks (0 = single bank, 1 = multiple banks) " UBYTE _CNV_S_2_RANGE______76_CM 1 100. 0. 1. ECU_ADDRESS 0x3fd587 /end MEASUREMENT
/begin MEASUREMENT LV_IVVT_IN_AND_EX "LV  IVVT inlet and exhaust cam (0 = inlet cam variable, 1 = inlet & exhaust cam variable) " UBYTE _CNV_S_2_RANGE______74_CM 1 100. 0. 1. ECU_ADDRESS 0x3fd588 /end MEASUREMENT
/begin CHARACTERISTIC C_ENG_CONF "engine configuration code" VALUE 0x67b7a _REC_VAL_20_u1 2. _CNV_S_3_RANGE_ENG__148_CM 0. 2. /end CHARACTERISTIC
/begin MEASUREMENT CYCNR_ST "" UWORD _CNV_A_R_LINEAR_____17_CM 1 100. 0. 65535. ECU_ADDRESS 0x3fd180 FORMAT "%5.0" /end MEASUREMENT
/begin AXIS_PTS ldp_tia_ip_ti_cast "" 0x61936 TIA _REC_AXS_20_u1 28.575 _CNV_A_R_LINEAR_____22_CM 2 -48. 142.5 FORMAT "%5.1" /end AXIS_PTS
/begin AXIS_PTS ldp_cyc_cast_ip_ti_deac_cast "" 0x614aa CYC_CAST _REC_AXS_20_u2 65535. _CNV_A_R_LINEAR_____17_CM 6 0. 65535. FORMAT "%5.0" /end AXIS_PTS
/begin MEASUREMENT TQI_AV_HOM "Actual indicated engine torque for homogeneous mode" SWORD _CNV_A_R_LINEAR_____37_CM 1 100. -1024. 1023.96875 ECU_ADDRESS 0x3fd09c FORMAT "%6.2" /end MEASUREMENT
/begin MEASUREMENT TQ_AV "Actual engine torque static at clutch" SWORD _CNV_A_R_LINEAR_____37_CM 1 100. -1024. 1023.96875 ECU_ADDRESS 0x3fd096 FORMAT "%6.2" /end MEASUREMENT
/begin MEASUREMENT TQE "Effective engine torque at clutch" SWORD _CNV_A_R_LINEAR_____37_CM 1 100. -1024. 1023.96875 ECU_ADDRESS 0x3fd098 FORMAT "%6.2" /end MEASUREMENT
/begin MEASUREMENT TQI_AV "Actual indicated engine torque" SWORD _CNV_A_R_LINEAR_____37_CM 1 100. -1024. 1023.96875 ECU_ADDRESS 0x3fd094 FORMAT "%6.2" /end MEASUREMENT
/begin MEASUREMENT TQE_DIF "Difference effective engine torque at clutch" SWORD _CNV_A_R_LINEAR_____37_CM 1 100. -1024. 1023.96875 ECU_ADDRESS 0x3fd09e FORMAT "%6.2" /end MEASUREMENT
/begin MEASUREMENT EFF_TOT_AV "Total actual efficiency (in homogeneous mode)" UWORD _CNV_A_R_LINEAR_____5_CM 1 100. 0. 1.99996948 ECU_ADDRESS 0x3fd09a FORMAT "%7.5" /end MEASUREMENT
/begin MEASUREMENT TQI_REF_S "Indicated  reference engine torque for stratified mode" SWORD _CNV_A_R_LINEAR_____37_CM 1 100. -1024. 1023.96875 ECU_ADDRESS 0x3fd0a8 FORMAT "%7.1" /end MEASUREMENT
/begin MEASUREMENT TQI_SP_S "Torque setpoint for stratified combustion mode" UWORD _CNV_A_R_LINEAR_____37_CM 1 100. 0. 1023.96875 ECU_ADDRESS 0x3fd07e FORMAT "%7.2" /end MEASUREMENT
/begin AXIS_PTS ldp_tqi_req_slow__lamb_afl_1 "" 0x61a06 TQI_REQ_SLOW _REC_AXS_20_u2 2047.96875 _CNV_A_R_LINEAR_____65_CM 8 -1024. 1023.96875 FORMAT "%6.2" /end AXIS_PTS
/begin CHARACTERISTIC IP_TQI_REF_S "Referenced indicated engine torque for stratified mode" MAP 0x67d9a _REC_MAP_20_u2_u1_u2 2047.96875 _CNV_A_R_LINEAR_____65_CM -1024. 1023.96875 FORMAT "%6.2"
 /begin AXIS_DESCR COM_AXIS N_32 _CNV_A_R_LINEAR_____15_CM 16 0. 8160. FORMAT "%4.0" AXIS_PTS_REF ldpm_n_32_s /end AXIS_DESCR
 /begin AXIS_DESCR COM_AXIS MFF_SP_S _CNV_A_R_LINEAR_____56_CM 12 0. 1389. FORMAT "%7.2" AXIS_PTS_REF ldp_mff_sp_s__tqi_ref_s /end AXIS_DESCR
/end CHARACTERISTIC
/begin AXIS_PTS ldp_vb_mmv_dri_n_sp_min_vb "" 0x61d8a VB_MMV _REC_AXS_20_u1 28.8 _CNV_A_R_LINEAR_____157_CM 2 0. 28.8 FORMAT "%3.1" /end AXIS_PTS
/begin AXIS_PTS ldp_vb_mmv_n_sp_min_vb "" 0x61d8d VB_MMV _REC_AXS_20_u1 28.8 _CNV_A_R_LINEAR_____157_CM 2 0. 28.8 FORMAT "%3.1" /end AXIS_PTS
/begin AXIS_PTS ldp_n__v_dur_igc_min "" 0x61d90 N_32 _REC_AXS_20_u1 816. _CNV_A_R_LINEAR_____15_CM 6 0. 8160. FORMAT "%4.0" /end AXIS_PTS
/begin AXIS_PTS ldp_maf__v_dur_igc_min "" 0x61d97 MAF _REC_AXS_20_u1 138.9 _CNV_A_R_LINEAR_____51_CM 4 0. 1389. FORMAT "%4.0" /end AXIS_PTS
/begin AXIS_PTS ldp_v_pvs_min "" 0x61dcc V_PVS_MIN _REC_AXS_20_u2 4.99511719 _CNV_A_R_LINEAR_____38_CM 2 0. 4.99511719 FORMAT "%5.3" /end AXIS_PTS
/begin AXIS_PTS ldp_maf_mes__maf_dif_tps_diag "" 0x61dfa MAF_MES _REC_AXS_20_u2 1389. _CNV_A_R_LINEAR_____56_CM 4 0. 1389. FORMAT "%7.2" /end AXIS_PTS
/begin AXIS_PTS ldpm_n_32_28 "" 0x61c52 N_32 _REC_AXS_20_u1 8160. _CNV_A_R_LINEAR_____15_CM 12 0. 8160. FORMAT "%4.0" /end AXIS_PTS
/begin AXIS_PTS ldp_tps_av__maf_1_diag "" 0x61e16 TPS_AV _REC_AXS_20_u2 119.5 _CNV_A_R_LINEAR_____164_CM 16 0. 119.5 FORMAT "%7.3" /end AXIS_PTS
/begin AXIS_PTS ldpm_tia_maf_mdl_con_1 "" 0x61d52 TIA _REC_AXS_20_u1 190.5 _CNV_A_R_LINEAR_____22_CM 8 -48. 142.5 FORMAT "%5.1" /end AXIS_PTS
/begin AXIS_PTS ldpm_tia_1 "" 0x61e38 TIA _REC_AXS_20_u1 190.5 _CNV_A_R_LINEAR_____22_CM 6 -48. 142.5 FORMAT "%5.1" /end AXIS_PTS
/begin AXIS_PTS ldpm_tco__fac_tco_tqi "" 0x61e3f TCO _REC_AXS_20_u1 190.5 _CNV_A_R_LINEAR_____22_CM 6 -48. 142.5 FORMAT "%5.1" /end AXIS_PTS
/begin MEASUREMENT SEG_NR "" UBYTE _CNV_A_R_LINEAR_____17_CM 1 100. 0. 255. ECU_ADDRESS 0x3fd945 FORMAT "%3.0" /end MEASUREMENT
/begin AXIS_PTS ldpm_n_32_6 "" 0x61e04 N_32 _REC_AXS_20_u1 8160. _CNV_A_R_LINEAR_____15_CM 16 0. 8160. FORMAT "%4.0" /end AXIS_PTS
/begin AXIS_PTS ldpm_n_32__drv2_er "" 0x61e46 N_32 _REC_AXS_20_u1 8160. _CNV_A_R_LINEAR_____15_CM 4 0. 8160. FORMAT "%4.0" /end AXIS_PTS
/begin AXIS_PTS ldpm_tqi_av__thd_er "" 0x61e5a TQI_AV _REC_AXS_20_u2 1023.96875 _CNV_A_R_LINEAR_____37_CM 6 0. 1023.96875 FORMAT "%7.2" /end AXIS_PTS
/begin AXIS_PTS ldpm_maf__thd_er "" 0x61e4c MAF _REC_AXS_20_u2 1389. _CNV_A_R_LINEAR_____56_CM 6 0. 1389. FORMAT "%4.0" /end AXIS_PTS
/begin MEASUREMENT STK_AV_EGR "Actual value of the stroke of EGR valve" UBYTE _CNV_A_R_LINEAR_____16_CM 1 100. 0. 99.609375 ECU_ADDRESS 0x3fd84e FORMAT "%3.1" /end MEASUREMENT
/begin AXIS_PTS ldpm_tco_4 "" 0x61d0d TCO _REC_AXS_20_u1 190.5 _CNV_A_R_LINEAR_____22_CM 6 -48. 142.5 FORMAT "%5.1" /end AXIS_PTS
/begin AXIS_PTS ldpm_tco_4_rng_l "" 0x61e76 TCO _REC_AXS_20_u1 190.5 _CNV_A_R_LINEAR_____22_CM 6 -48. 142.5 FORMAT "%5.1" /end AXIS_PTS
/begin AXIS_PTS ldp_vb_mmv_dri_n_sp_vb_rng_l "" 0x61e7d VB_MMV _REC_AXS_20_u1 28.8 _CNV_A_R_LINEAR_____157_CM 2 0. 28.8 FORMAT "%3.1" /end AXIS_PTS
/begin AXIS_PTS ldp_vb_mmv_n_sp_min_vb_rng_l "" 0x61e80 VB_MMV _REC_AXS_20_u1 28.8 _CNV_A_R_LINEAR_____157_CM 2 0. 28.8 FORMAT "%3.1" /end AXIS_PTS
/begin AXIS_PTS ldp_n_ecf__n_ecf_min_accin "" 0x61e91 N_ECF _REC_AXS_20_u1 15. _CNV_A_R_LINEAR_____17_CM 16 0. 15. FORMAT "%2.0" /end AXIS_PTS
/begin AXIS_PTS ldp_vs__n_ecf_vs_cor "" 0x61ea2 VS _REC_AXS_20_u1 255. _CNV_A_R_LINEAR_____43_CM 5 0. 255. FORMAT "%3.0" /end AXIS_PTS
/begin AXIS_PTS ldp_tco__temp_sub_ecf_ini "" 0x61eaf TCO _REC_AXS_20_u1 190.5 _CNV_A_R_LINEAR_____22_CM 6 -48. 142.5 FORMAT "%5.1" /end AXIS_PTS
/begin AXIS_PTS ldp_n_ecf_cor_fil__n_perc_ecf "" 0x61eb6 N_ECF_COR_FIL _REC_AXS_20_u1 15.9375 _CNV_A_R_LINEAR_____87_CM 6 0. 15.9375 FORMAT "%5.2" /end AXIS_PTS
/begin AXIS_PTS ldp_tco_ex__n_ecf "" 0x61e8a TCO_EX _REC_AXS_20_u1 190.5 _CNV_A_R_LINEAR_____22_CM 6 -48. 142.5 FORMAT "%5.1" /end AXIS_PTS
/begin AXIS_PTS ldp_ecfpwm_ecf__pow_loss_ecf "" 0x6203c ECFPWM_ECF _REC_AXS_20_u1 99.609375 _CNV_A_R_LINEAR_____16_CM 8 0. 99.609375 FORMAT "%4.1" /end AXIS_PTS
/begin AXIS_PTS ldp_acp__tq_loss_acc "" 0x61480 ACP _REC_AXS_20_u1 127.5 _CNV_A_R_LINEAR_____93_CM 6 0. 127.5 FORMAT "%6.2" /end AXIS_PTS
/begin AXIS_PTS ldp_pv_av__n_max_mtc_cur_off "" 0x61ebd PV_AV _REC_AXS_20_u1 99.609375 _CNV_A_R_LINEAR_____16_CM 4 0. 99.609375 FORMAT "%5.2" /end AXIS_PTS
/begin AXIS_PTS ldp_vb__fpapwm_fac "" 0x61aaa VB _REC_AXS_20_u1 25.8984 _CNV_A_R_LINEAR_____42_CM 8 0. 25.8984 FORMAT "%3.1" /end AXIS_PTS
/begin AXIS_PTS ldp_vb__ivvtpwm "" 0x61ec2 VB _REC_AXS_20_u1 25.8984 _CNV_A_R_LINEAR_____42_CM 4 0. 25.8984 FORMAT "%3.1" /end AXIS_PTS
/begin AXIS_PTS ldpm_gear "" 0x61ec7 GEAR _REC_AXS_20_u1 255. _CNV_A_R_LINEAR_____13_CM 9 0. 255. FORMAT "%3.0" /end AXIS_PTS
/begin AXIS_PTS ldp_n_32_n_grd_thd "" 0x61ed1 N_32 _REC_AXS_20_u1 8160. _CNV_A_R_LINEAR_____15_CM 8 0. 8160. FORMAT "%4.0" /end AXIS_PTS
/begin AXIS_PTS ldpm_tco__tqi_min_pu "" 0x618bc TCO _REC_AXS_20_u1 190.5 _CNV_A_R_LINEAR_____22_CM 4 -48. 142.5 FORMAT "%5.1" /end AXIS_PTS
/begin AXIS_PTS ldpm_n_fac_tq_req_driv "" 0x61754 N_32 _REC_AXS_20_u1 8160. _CNV_A_R_LINEAR_____15_CM 8 0. 8160. FORMAT "%4.0" /end AXIS_PTS
/begin AXIS_PTS ldpm_pv_av_fac_tq_req_driv "" 0x617ec PV_AV _REC_AXS_20_u1 99.609375 _CNV_A_R_LINEAR_____16_CM 8 0. 99.609375 FORMAT "%5.2" /end AXIS_PTS
/begin AXIS_PTS ldp_n_vs_ratio_gr_mt "" 0x617d6 N_VS_RATIO _REC_AXS_20_u1 255. _CNV_A_R_LINEAR_____13_CM 13 0. 255. FORMAT "%3.0" /end AXIS_PTS
/begin AXIS_PTS ldp_n_32__port_sp_afs "" 0x61eda N_32 _REC_AXS_20_u1 816. _CNV_A_R_LINEAR_____15_CM 6 0. 8160. FORMAT "%4.0" /end AXIS_PTS
/begin AXIS_PTS ldp_n_32__port_sp_afl "" 0x61ee1 N_32 _REC_AXS_20_u1 816. _CNV_A_R_LINEAR_____15_CM 6 0. 8160. FORMAT "%4.0" /end AXIS_PTS
/begin AXIS_PTS ldp_n_32__port_sp_s "" 0x61ee8 N_32 _REC_AXS_20_u1 816. _CNV_A_R_LINEAR_____15_CM 6 0. 8160. FORMAT "%4.0" /end AXIS_PTS
/begin AXIS_PTS ldp_fac_tq_req__port_sp_afs "" 0x61ef0 FAC_TQ_REQ _REC_AXS_20_u2 1.99996948 _CNV_A_R_LINEAR_____5_CM 6 0. 1.99996948 FORMAT "%7.5" /end AXIS_PTS
/begin AXIS_PTS ldp_tco__tcoport_sp "" 0x61f0c TCO _REC_AXS_20_u1 190.5 _CNV_A_R_LINEAR_____22_CM 8 -48. 142.5 FORMAT "%5.1" /end AXIS_PTS
/begin AXIS_PTS ldp_exc_sp_rel__vlft_sp "" 0x61f16 EXC_SP_REL _REC_AXS_20_u2 99.99847412 _CNV_A_R_LINEAR_____144_CM 12 0. 99.99847412 /end AXIS_PTS
/begin AXIS_PTS ldp_portpwm__port_sp_phy "" 0x61f30 PORTPWM _REC_AXS_20_u2 99.99847412 _CNV_A_R_LINEAR_____144_CM 12 0. 99.99847412 /end AXIS_PTS
/begin AXIS_PTS ldp_fac_tq_req__port_sp_afl "" 0x61efe FAC_TQ_REQ _REC_AXS_20_u2 1.99996948 _CNV_A_R_LINEAR_____5_CM 6 0. 1.99996948 FORMAT "%7.5" /end AXIS_PTS
/begin AXIS_PTS ldp_fac_tq_req__port_sp_s "" 0x61f4a FAC_TQ_REQ _REC_AXS_20_u2 1.99996948 _CNV_A_R_LINEAR_____5_CM 6 0. 1.99996948 FORMAT "%7.5" /end AXIS_PTS
/begin AXIS_PTS ldp_v_port__port_av "" 0x61f58 V_PORT _REC_AXS_20_u2 4.99511719 _CNV_A_R_LINEAR_____38_CM 12 0. 4.99511719 FORMAT "%5.3" /end AXIS_PTS
/begin AXIS_PTS ldpm_maf_2 "" 0x61b6a MAF _REC_AXS_20_u2 69.45 _CNV_A_R_LINEAR_____56_CM 16 0. 1389. FORMAT "%4.0" /end AXIS_PTS
/begin CHARACTERISTIC LC_TQI_P_MAX_INH_AS "Logical constant for torque limitation ON/OFF (0=ON)" VALUE 0x68c2a _REC_VAL_20_u1 1. _CNV_A_R_LINEAR_____13_CM 0. 1. FORMAT "%1.0" /end CHARACTERISTIC
/begin AXIS_PTS ldp_gr_at_n_tur "" 0x6152c GR_AT _REC_AXS_20_u1 8. _CNV_A_R_LINEAR_____17_CM 13 0. 8. FORMAT "%1.0" /end AXIS_PTS
/begin MEASUREMENT STATE_IV "" UWORD _CNV_A_R_LINEAR_____17_CM 1 100. 0. 65535. ECU_ADDRESS 0x3faa4e FORMAT "%5.0" /end MEASUREMENT
/begin AXIS_PTS ldpm_tco_1 "" 0x61ced TCO _REC_AXS_20_u1 190.5 _CNV_A_R_LINEAR_____22_CM 6 -48. 142.5 FORMAT "%5.1" /end AXIS_PTS
/begin AXIS_PTS ldp_n_32__lamb_afl_1 "" 0x6165b N_32 _REC_AXS_20_u1 8160. _CNV_A_R_LINEAR_____15_CM 8 0. 8160. FORMAT "%4.0" /end AXIS_PTS
/begin AXIS_PTS ldp_n_32__lamb_iga_afl "" 0x61f80 N_32 _REC_AXS_20_u1 8160. _CNV_A_R_LINEAR_____15_CM 16 0. 8160. FORMAT "%4.0" /end AXIS_PTS
/begin AXIS_PTS ldp_maf_hb__lamb_iga_afl "" 0x61f91 MAF_HB _REC_AXS_20_u1 1389. _CNV_A_R_LINEAR_____51_CM 12 0. 1389. FORMAT "%4.0" /end AXIS_PTS
/begin AXIS_PTS ldp_tam__temp_sub_ecf_ini "" 0x61ea8 TAM _REC_AXS_20_u1 190.5 _CNV_A_R_LINEAR_____22_CM 6 -48. 142.5 FORMAT "%5.1" /end AXIS_PTS
/begin AXIS_PTS ldp_tqi_req_slow__lamb_bas "" 0x619be TQI_REQ_SLOW _REC_AXS_20_u2 2047.96875 _CNV_A_R_LINEAR_____65_CM 8 -1024. 1023.96875 FORMAT "%6.2" /end AXIS_PTS
/begin AXIS_PTS ldp_tqi_req_slow__lamb_sawup "" 0x61f9e TQI_REQ_SLOW _REC_AXS_20_u2 2047.96875 _CNV_A_R_LINEAR_____65_CM 8 -1024. 1023.96875 FORMAT "%6.2" /end AXIS_PTS
/begin AXIS_PTS ldp_tqi_req_slow__lamb_sawup_is "" 0x61fba TQI_REQ_SLOW _REC_AXS_20_u2 2047.96875 _CNV_A_R_LINEAR_____65_CM 8 -1024. 1023.96875 FORMAT "%6.2" /end AXIS_PTS
/begin AXIS_PTS ldp_n_32__lamb_sawup "" 0x61fb0 N_32 _REC_AXS_20_u1 8160. _CNV_A_R_LINEAR_____15_CM 8 0. 8160. FORMAT "%4.0" /end AXIS_PTS
/begin AXIS_PTS ldp_n_32__lamb_sawup_is "" 0x61fcc N_32 _REC_AXS_20_u1 8160. _CNV_A_R_LINEAR_____15_CM 8 0. 8160. FORMAT "%4.0" /end AXIS_PTS
/begin AXIS_PTS ldp_t_ast__lamb_add_sawup "" 0x61fd6 T_AST _REC_AXS_20_u2 6553.5 _CNV_A_R_LINEAR_____18_CM 8 0. 6553.5 FORMAT "%6.1" /end AXIS_PTS
/begin AXIS_PTS ldp_tco__lamb_add_sawup "" 0x61fe8 TCO _REC_AXS_20_u1 190.5 _CNV_A_R_LINEAR_____22_CM 8 -48. 142.5 FORMAT "%5.1" /end AXIS_PTS
/begin AXIS_PTS ldp_vs_n_tur "" 0x61ace VS _REC_AXS_20_u1 255. _CNV_A_R_LINEAR_____43_CM 2 0. 255. FORMAT "%3.0" /end AXIS_PTS
/begin AXIS_PTS ldp_vlft_av__cam_op_in_vvl "" 0x61ff2 VLFT_AV _REC_AXS_20_u2 65.535 _CNV_A_R_LINEAR_____182_CM 6 0. 65.535 /end AXIS_PTS
/begin AXIS_PTS ldp_maf__mff_cor_1 "" 0x62000 MAF _REC_AXS_20_u2 138.9 _CNV_A_R_LINEAR_____56_CM 12 0. 1389. FORMAT "%7.2" /end AXIS_PTS
/begin AXIS_PTS ldp_maf__mff_cor_2 "" 0x615d0 MAF _REC_AXS_20_u2 138.9 _CNV_A_R_LINEAR_____56_CM 12 0. 1389. FORMAT "%7.2" /end AXIS_PTS
/begin AXIS_PTS ldp_n__mff_cor_1 "" 0x6201a N _REC_AXS_20_u2 816. _CNV_A_R_LINEAR_____0_CM 16 0. 8160. FORMAT "%4.0" /end AXIS_PTS
/begin AXIS_PTS ldp_n__mff_cor_2 "" 0x616a8 N _REC_AXS_20_u2 816. _CNV_A_R_LINEAR_____0_CM 16 0. 8160. FORMAT "%4.0" /end AXIS_PTS
/begin AXIS_PTS ldpm_cam_edge_nr_0__win_chk "" 0x62045 CAM_EDGE_NR_0 _REC_AXS_20_u1 3. _CNV_A_R_LINEAR_____17_CM 4 0. 3. FORMAT "%2.0" /end AXIS_PTS
/begin AXIS_PTS ldpm_cam_edge_nr_1__win_chk "" 0x6204a CAM_EDGE_NR_1 _REC_AXS_20_u1 3. _CNV_A_R_LINEAR_____17_CM 4 0. 3. FORMAT "%2.0" /end AXIS_PTS
/begin AXIS_PTS ldp_tps_av__tps_grd_max_er "" 0x61e68 TPS_AV _REC_AXS_20_u2 119.5 _CNV_A_R_LINEAR_____34_CM 6 0. 119.5 FORMAT "%7.3" /end AXIS_PTS
/begin AXIS_PTS ldp_tps_av_id_tps_grd_bol_ae "" 0x619a6 TPS_AV _REC_AXS_20_u2 11.95 _CNV_A_R_LINEAR_____34_CM 4 0. 119.5 FORMAT "%7.3" /end AXIS_PTS
/begin AXIS_PTS ldp_v_teg__teg "" 0x61a66 V_TEG _REC_AXS_20_u2 4.99511719 _CNV_A_R_LINEAR_____38_CM 16 0. 4.99511719 FORMAT "%5.3" /end AXIS_PTS
/begin AXIS_PTS ldp_n_dif_st "" 0x61742 N_DIF_ST _REC_AXS_20_u2 65535. _CNV_A_R_LINEAR_____53_CM 8 -32768. 32767. FORMAT "%6.0" /end AXIS_PTS
/begin AXIS_PTS ldp_n_dif_pred_tq_add_is_bol "" 0x62056 N_DIF_PREF _REC_AXS_20_u2 65535. _CNV_A_R_LINEAR_____53_CM 8 -32768. 32767. FORMAT "%6.0" /end AXIS_PTS
/begin AXIS_PTS ldpm_tco_st__tco_dif_diag "" 0x62068 TCO_ST _REC_AXS_20_u1 190.5 _CNV_A_R_LINEAR_____22_CM 6 -48. 142.5 FORMAT "%5.1" /end AXIS_PTS
/begin AXIS_PTS ldp_v_tco__tco "" 0x61a44 V_TCO _REC_AXS_20_u2 4.425292971 _CNV_A_R_LINEAR_____196_CM 16 7.8125e-002 4.99511719 FORMAT "%5.3" /end AXIS_PTS
/begin AXIS_PTS ldp_maf_kgh__tco_sub_inc "" 0x62070 MAF_KGH _REC_AXS_20_u2 2047.96875 _CNV_A_R_LINEAR_____52_CM 4 0. 2047.96875 FORMAT "%7.2" /end AXIS_PTS
/begin MEASUREMENT LV_TCS_DISABLE "Logical variable for disabling TCS intervention due to EMS error" UBYTE _CNV_S_2_RANGE______74_CM 1 100. 0. 1. ECU_ADDRESS 0x3fd4a8 BIT_MASK 0x1 /end MEASUREMENT
/begin MEASUREMENT TQI_ASR_SLOW "slow torque intervention due to ASR" UWORD _CNV_A_R_LINEAR_____37_CM 1 100. 0. 1023.96875 ECU_ADDRESS 0x3fc8cc FORMAT "%7.2" /end MEASUREMENT
/begin MEASUREMENT TQI_ASR_FAST_REQ "fast torque intervention due to ASR" UWORD _CNV_A_R_LINEAR_____37_CM 1 100. 0. 1023.96875 ECU_ADDRESS 0x3fc8c6 FORMAT "%7.2" /end MEASUREMENT
/begin MEASUREMENT TQI_ASR_FAST "fast torque intervention due to ASR" UWORD _CNV_A_R_LINEAR_____37_CM 1 100. 0. 1023.96875 ECU_ADDRESS 0x3fc8ca FORMAT "%7.2" /end MEASUREMENT
/begin MEASUREMENT LV_ASR_ENA "Logical variable for ASR intervention enabling" UBYTE _CNV_S_2_RANGE______74_CM 1 100. 0. 1. ECU_ADDRESS 0x3fd4a9 BIT_MASK 0x1 /end MEASUREMENT
/begin MEASUREMENT LV_MSR_ENA "Logical variable forMSR intervention enabling" UBYTE _CNV_S_2_RANGE______74_CM 1 100. 0. 1. ECU_ADDRESS 0x3fd4ab BIT_MASK 0x1 /end MEASUREMENT
/begin CHARACTERISTIC C_VS_MIN_MSR "Minimum vehicle speed for MSR activation" VALUE 0x691d1 _REC_VAL_20_u1 255. _CNV_A_R_LINEAR_____43_CM 0. 255. FORMAT "%3.0" /end CHARACTERISTIC
/begin MEASUREMENT TQI_ASR_SLOW_REQ "slow torque intervention due to ASR" UWORD _CNV_A_R_LINEAR_____37_CM 1 100. 0. 1023.96875 ECU_ADDRESS 0x3fc8c8 FORMAT "%7.2" /end MEASUREMENT
/begin MEASUREMENT TQI_MSR_REQ "fast torque intervention due to MSR previous limp home check" UWORD _CNV_A_R_LINEAR_____37_CM 1 100. 0. 1023.96875 ECU_ADDRESS 0x3fc8ce FORMAT "%7.2" /end MEASUREMENT
/begin MEASUREMENT TQI_MSR_FAST "fast torque intervention due to MSR" UWORD _CNV_A_R_LINEAR_____37_CM 1 100. 0. 1023.96875 ECU_ADDRESS 0x3fc8d0 FORMAT "%7.2" /end MEASUREMENT
/begin MEASUREMENT TQI_MSR_SLOW "slow torque intervention due to MSR" UWORD _CNV_A_R_LINEAR_____37_CM 1 100. 0. 1023.96875 ECU_ADDRESS 0x3fc8d2 FORMAT "%7.2" /end MEASUREMENT
/begin MEASUREMENT LV_MSR_LIH "Logical variable fortorque intervention limp home due toMSR" UBYTE _CNV_S_2_RANGE______74_CM 1 100. 0. 1. ECU_ADDRESS 0x3fd4ad BIT_MASK 0x1 /end MEASUREMENT
/begin MEASUREMENT LV_ASR_ACT "Logical variable fortorque intervention due to ASR" UBYTE _CNV_S_2_RANGE______74_CM 1 100. 0. 1. ECU_ADDRESS 0x3fd4aa BIT_MASK 0x1 /end MEASUREMENT
/begin MEASUREMENT LV_MSR_ACT "Logical variable fortorque intervention due to MSR" UBYTE _CNV_S_2_RANGE______74_CM 1 100. 0. 1. ECU_ADDRESS 0x3fd4a4 BIT_MASK 0x1 /end MEASUREMENT
/begin CHARACTERISTIC C_LGRD_LIH_ASR "Limiting gradient for ASR emergency ramp function (default 0.6 Nm/10ms)" VALUE 0x691ce _REC_VAL_20_u2 1023.96875 _CNV_A_R_LINEAR_____197_CM 0. 1023.96875 FORMAT "%7.2" /end CHARACTERISTIC
/begin CHARACTERISTIC C_LGRD_LIH_MSR "Limiting gradient for MSR emergency ramp function (default 0.6 Nm/10ms)" VALUE 0x691d2 _REC_VAL_20_u2 1023.96875 _CNV_A_R_LINEAR_____197_CM 0. 1023.96875 FORMAT "%7.2" /end CHARACTERISTIC
/begin CHARACTERISTIC C_T_DLY_LIH_ASR "Delay time for activation of ASR emergency ramp function (default 0 s)" VALUE 0x691d0 _REC_VAL_20_u1 2.55 _CNV_A_R_LINEAR_____21_CM 0. 2.55 FORMAT "%4.2" /end CHARACTERISTIC
/begin CHARACTERISTIC C_T_DLY_LIH_MSR "Delay time for activation of MSR emergency ramp function (default 0 s)" VALUE 0x691d4 _REC_VAL_20_u1 2.55 _CNV_A_R_LINEAR_____21_CM 0. 2.55 FORMAT "%4.2" /end CHARACTERISTIC
/begin MEASUREMENT TQI_REQ_FAST "Fast indicated engine torque request" SWORD _CNV_A_R_LINEAR_____37_CM 1 100. -1024. 1023.96875 ECU_ADDRESS 0x3fd0c0 FORMAT "%6.2" /end MEASUREMENT
/begin MEASUREMENT TQI_REQ_FAST_1 "Preliminary Fast indicated engine torque request" SWORD _CNV_A_R_LINEAR_____37_CM 1 100. -1024. 1023.96875 ECU_ADDRESS 0x3fd0c6 FORMAT "%6.2" /end MEASUREMENT
/begin MEASUREMENT TQI_REQ_SLOW "Slow indicated engine torque request" SWORD _CNV_A_R_LINEAR_____37_CM 1 100. -1024. 1023.96875 ECU_ADDRESS 0x3fd0c2 FORMAT "%6.2" /end MEASUREMENT
/begin MEASUREMENT TQI_REQ_SLOW_1 "Preliminary Slow indicated engine torque request" SWORD _CNV_A_R_LINEAR_____37_CM 1 100. -1024. 1023.96875 ECU_ADDRESS 0x3fd0c8 FORMAT "%6.2" /end MEASUREMENT
/begin AXIS_PTS ldp_n_32__fac_tq_aj "" 0x6162e N_32 _REC_AXS_20_u1 8160. _CNV_A_R_LINEAR_____15_CM 8 0. 8160. FORMAT "%4.0" /end AXIS_PTS
/begin AXIS_PTS ldp_n_32__fac_tq_req_clu_is "" 0x6207a N_32 _REC_AXS_20_u1 8160. _CNV_A_R_LINEAR_____15_CM 3 0. 8160. FORMAT "%4.0" /end AXIS_PTS
/begin MEASUREMENT LV_ERR_VS "Error currently present on vehicle speed signal" UBYTE _CNV_S_2_RANGE______77_R_CM 1 100. 0. 255. ECU_ADDRESS 0x3fd387 /end MEASUREMENT
/begin AXIS_PTS ldp_n_32__tq_add_ch "" 0x61664 N_32 _REC_AXS_20_u1 8160. _CNV_A_R_LINEAR_____15_CM 8 0. 8160. FORMAT "%4.0" /end AXIS_PTS
/begin AXIS_PTS ldp_n_32__tq_loss_acc "" 0x6207e N_32 _REC_AXS_20_u1 8160. _CNV_A_R_LINEAR_____15_CM 6 0. 8160. FORMAT "%4.0" /end AXIS_PTS
/begin AXIS_PTS ldp_tq_accin_can__tq_loss_acc "" 0x62085 TQ_ACCIN_CAN _REC_AXS_20_u1 31. _CNV_A_R_LINEAR_____86_CM 6 0. 31. FORMAT "%3.0" /end AXIS_PTS
/begin CHARACTERISTIC LC_ASR_DISABLE "logical constant to disable ASR interventions" VALUE 0x6922b _REC_VAL_20_u1 1. _CNV_S_2_RANGE______74_CM 0. 1. /end CHARACTERISTIC
/begin MEASUREMENT LV_ASR_LIH "Logical variable fortorque intervention limp home due to ASR" UBYTE _CNV_S_2_RANGE______74_CM 1 100. 0. 1. ECU_ADDRESS 0x3fd4ac BIT_MASK 0x1 /end MEASUREMENT
/begin AXIS_PTS ldp_tps_dif__mtcpwm_p "" 0x61994 TPS_DIF _REC_AXS_20_u2 239. _CNV_A_R_LINEAR_____47_CM 8 -119.5 119.5 FORMAT "%8.3" /end AXIS_PTS
/begin AXIS_PTS ldp_tps_dif__mtcpwm_i "" 0x61982 TPS_DIF _REC_AXS_20_u2 239. _CNV_A_R_LINEAR_____47_CM 8 -119.5 119.5 FORMAT "%8.3" /end AXIS_PTS
/begin AXIS_PTS ldp_tps_av_lih_dif_mtcpwm_i "" 0x61dd6 TPS_AV_LIH_DIF _REC_AXS_20_u2 239. _CNV_A_R_LINEAR_____47_CM 8 -119.5 119.5 FORMAT "%8.3" /end AXIS_PTS
/begin AXIS_PTS ldp_tps_dif_grd__mtcpwm_d "" 0x61970 TPS_DIF_GRD _REC_AXS_20_u2 239. _CNV_A_R_LINEAR_____47_CM 8 -119.5 119.5 FORMAT "%8.3" /end AXIS_PTS
/begin AXIS_PTS ldp_tps_sp_lih_dif__mtcpwm_add "" 0x61de8 TPS_SP_LIH_DIF _REC_AXS_20_u2 239. _CNV_A_R_LINEAR_____47_CM 8 -119.5 119.5 FORMAT "%8.3" /end AXIS_PTS
/begin AXIS_PTS ldp_vb__mtcpwm_vb_fac "" 0x61abc VB _REC_AXS_20_u1 25.8984 _CNV_A_R_LINEAR_____42_CM 8 0. 25.8984 FORMAT "%3.1" /end AXIS_PTS
/begin AXIS_PTS ldpm_n_32_100 "" 0x61c41 N_32 _REC_AXS_20_u1 8160. _CNV_A_R_LINEAR_____15_CM 16 0. 8160. FORMAT "%4.0" /end AXIS_PTS
/begin AXIS_PTS ldpm_n_32_30 "" 0x6208c N_32 _REC_AXS_20_u1 8160. _CNV_A_R_LINEAR_____15_CM 6 0. 8160. FORMAT "%4.0" /end AXIS_PTS
/begin AXIS_PTS ldp_n_23 "" 0x61610 N_32 _REC_AXS_20_u1 816. _CNV_A_R_LINEAR_____15_CM 6 0. 8160. FORMAT "%4.0" /end AXIS_PTS
/begin CHARACTERISTIC LC_AD_CLR_NVMY "Logical constant for initializing AD + FMY" VALUE 0x68980 _REC_VAL_20_u1 1. _CNV_A_R_LINEAR_____13_CM 0. 1. FORMAT "%1.0" /end CHARACTERISTIC
/begin CHARACTERISTIC LC_AD_CLR "Logical constant for initializing AD" VALUE 0x68981 _REC_VAL_20_u1 1. _CNV_A_R_LINEAR_____13_CM 0. 1. FORMAT "%1.0" /end CHARACTERISTIC
/begin CHARACTERISTIC LC_AD_CLR_KNK "Logical constant for initializing KNK" VALUE 0x68983 _REC_VAL_20_u1 1. _CNV_A_R_LINEAR_____13_CM 0. 1. FORMAT "%1.0" /end CHARACTERISTIC
/begin CHARACTERISTIC LC_AD_CLR_LAM "Logical constant for initializing LAM" VALUE 0x68984 _REC_VAL_20_u1 1. _CNV_A_R_LINEAR_____13_CM 0. 1. FORMAT "%1.0" /end CHARACTERISTIC
/begin CHARACTERISTIC LC_AD_CLR_EGR "Logical constant for initializing EGR" VALUE 0x68985 _REC_VAL_20_u1 1. _CNV_A_R_LINEAR_____13_CM 0. 1. FORMAT "%1.0" /end CHARACTERISTIC
/begin CHARACTERISTIC LC_AD_CLR_TCO "Logical constant for initializing TCO" VALUE 0x68986 _REC_VAL_20_u1 1. _CNV_A_R_LINEAR_____13_CM 0. 1. FORMAT "%1.0" /end CHARACTERISTIC
/begin CHARACTERISTIC LC_AD_CLR_TPS "Logical constant for initializing TPS" VALUE 0x68987 _REC_VAL_20_u1 1. _CNV_A_R_LINEAR_____13_CM 0. 1. FORMAT "%1.0" /end CHARACTERISTIC
/begin CHARACTERISTIC LC_AD_CLR_MIS "Logical constant for initializing MIS" VALUE 0x68988 _REC_VAL_20_u1 1. _CNV_A_R_LINEAR_____13_CM 0. 1. FORMAT "%1.0" /end CHARACTERISTIC
/begin CHARACTERISTIC LC_AD_CLR_IVVT "Logical constant for initializing IVVT" VALUE 0x68989 _REC_VAL_20_u1 1. _CNV_A_R_LINEAR_____13_CM 0. 1. FORMAT "%1.0" /end CHARACTERISTIC
/begin CHARACTERISTIC LC_AD_CLR_IMM "Logical constant for initializing IMM" VALUE 0x6898a _REC_VAL_20_u1 1. _CNV_A_R_LINEAR_____13_CM 0. 1. FORMAT "%1.0" /end CHARACTERISTIC
/begin CHARACTERISTIC LC_AD_CLR_IDLE "Logical constant for initializing IDLE" VALUE 0x6898b _REC_VAL_20_u1 1. _CNV_A_R_LINEAR_____13_CM 0. 1. FORMAT "%1.0" /end CHARACTERISTIC
/begin CHARACTERISTIC LC_AD_CLR_ATI "Logical constant for initializing ATI" VALUE 0x6898c _REC_VAL_20_u1 1. _CNV_A_R_LINEAR_____13_CM 0. 1. FORMAT "%1.0" /end CHARACTERISTIC
/begin CHARACTERISTIC LC_AD_CLR_ECF "Logical constant for initializing ECF" VALUE 0x6898e _REC_VAL_20_u1 1. _CNV_A_R_LINEAR_____13_CM 0. 1. FORMAT "%1.0" /end CHARACTERISTIC
/begin CHARACTERISTIC LC_AD_CLR_TOIL "Logical constant for initializing TOIL" VALUE 0x6898f _REC_VAL_20_u1 1. _CNV_A_R_LINEAR_____13_CM 0. 1. FORMAT "%1.0" /end CHARACTERISTIC
/begin CHARACTERISTIC LC_AD_CLR_CCP "Logical constant for initializing CCP" VALUE 0x68990 _REC_VAL_20_u1 1. _CNV_A_R_LINEAR_____13_CM 0. 1. FORMAT "%1.0" /end CHARACTERISTIC
/begin CHARACTERISTIC LC_AD_CLR_DISA "Logical constant for initializing DISA" VALUE 0x68991 _REC_VAL_20_u1 1. _CNV_A_R_LINEAR_____13_CM 0. 1. FORMAT "%1.0" /end CHARACTERISTIC
/begin CHARACTERISTIC LC_AD_CLR_N_SP_IS "Logical constant for initializing KWP" VALUE 0x68992 _REC_VAL_20_u1 1. _CNV_A_R_LINEAR_____13_CM 0. 1. FORMAT "%1.0" /end CHARACTERISTIC
/begin CHARACTERISTIC LC_AD_CLR_SA "Logical constant for initializing SA" VALUE 0x68993 _REC_VAL_20_u1 1. _CNV_A_R_LINEAR_____13_CM 0. 1. FORMAT "%1.0" /end CHARACTERISTIC
/begin CHARACTERISTIC LC_AD_CLR_CAN "Logical constant for initializing CAN nvmy datas" VALUE 0x68994 _REC_VAL_20_u1 1. _CNV_A_R_LINEAR_____13_CM 0. 1. FORMAT "%1.0" /end CHARACTERISTIC
/begin CHARACTERISTIC LC_AD_CLR_CRU "Logical constant for initializing the MSW recognition" VALUE 0x68995 _REC_VAL_20_u1 1. _CNV_A_R_LINEAR_____13_CM 0. 1. FORMAT "%1.0" /end CHARACTERISTIC
/begin CHARACTERISTIC LC_AD_CLR_RON "Logical constant for initializing FAC_AD_RON" VALUE 0x68996 _REC_VAL_20_u1 1. _CNV_A_R_LINEAR_____13_CM 0. 1. FORMAT "%1.0" /end CHARACTERISTIC
/begin CHARACTERISTIC LC_AD_CLR_POW "Logical constant for initializing POW nvmy datas" VALUE 0x68997 _REC_VAL_20_u1 1. _CNV_A_R_LINEAR_____13_CM 0. 1. FORMAT "%1.0" /end CHARACTERISTIC
/begin CHARACTERISTIC LC_CRU_REQ_SWI "Configuration switch between MSW and steering lever" VALUE 0x69247 _REC_VAL_20_u1 1. _CNV_A_R_LINEAR_____13_CM 0. 1. FORMAT "%1.0" /end CHARACTERISTIC
/begin AXIS_PTS ldp_eff_scc_sp__nr_pat_scc "" 0x62094 EFF_SCC_SP _REC_AXS_20_u2 1.99996948 _CNV_A_R_LINEAR_____5_CM 13 0. 1.99996948 FORMAT "%7.5" /end AXIS_PTS
/begin AXIS_PTS ldp_cl_mmv "" 0x61496 CL_MMV _REC_AXS_20_u2 7.99987793 _CNV_A_R_LINEAR_____104_CM 6 0. 7.99987793 FORMAT "%6.4" /end AXIS_PTS
/begin AXIS_PTS ldp_tco__iga_bas_temp_cor "" 0x61878 TCO _REC_AXS_20_u1 190.5 _CNV_A_R_LINEAR_____22_CM 6 -48. 142.5 FORMAT "%5.1" /end AXIS_PTS
/begin AXIS_PTS ldp_tia__iga_bas_temp_cor "" 0x61928 TIA _REC_AXS_20_u1 28.575 _CNV_A_R_LINEAR_____22_CM 6 -48. 142.5 FORMAT "%5.1" /end AXIS_PTS
/begin AXIS_PTS ldpm_n_32_fac_iga_pos_neg "" 0x61778 N_32 _REC_AXS_20_u1 8160. _CNV_A_R_LINEAR_____15_CM 8 0. 8160. FORMAT "%4.0" /end AXIS_PTS
/begin AXIS_PTS ldp_maf_fac_iga_pos_neg "" 0x615b4 MAF _REC_AXS_20_u1 1389. _CNV_A_R_LINEAR_____51_CM 6 0. 1389. FORMAT "%4.0" /end AXIS_PTS
/begin AXIS_PTS ldpm_n_32 "" 0x620b0 N_32 _REC_AXS_20_u1 8160. _CNV_A_R_LINEAR_____15_CM 4 0. 8160. FORMAT "%4.0" /end AXIS_PTS
/begin AXIS_PTS ldp_n_32__maf_min_knk_ad_2 "" 0x620b5 N_32 _REC_AXS_20_u1 8160. _CNV_A_R_LINEAR_____15_CM 16 0. 8160. FORMAT "%4.0" /end AXIS_PTS
/begin AXIS_PTS ldp_tia__ip_fac_ron_ad_max "" 0x620c6 TIA _REC_AXS_20_u1 190.5 _CNV_A_R_LINEAR_____22_CM 4 -48. 142.5 FORMAT "%5.1" /end AXIS_PTS
/begin AXIS_PTS ldp_tco__ip_fac_ron_ad_max "" 0x620cb TCO _REC_AXS_20_u1 190.5 _CNV_A_R_LINEAR_____22_CM 4 -48. 142.5 FORMAT "%5.1" /end AXIS_PTS
/begin AXIS_PTS ldp_teg_dyn_hys "" 0x620d0 TEG_DYN_HYS _REC_AXS_20_u2 2047. _CNV_A_R_LINEAR_____94_CM 16 0. 2047. FORMAT "%7.2" /end AXIS_PTS
/begin AXIS_PTS ldp_tco__fac_thd_er "" 0x620f2 TCO _REC_AXS_20_u1 190.5 _CNV_A_R_LINEAR_____22_CM 8 -48. 142.5 FORMAT "%5.1" /end AXIS_PTS
/begin AXIS_PTS ldpm_n__thd_er "" 0x62114 N _REC_AXS_20_u2 8159. _CNV_A_R_LINEAR_____0_CM 10 1. 8160. FORMAT "%4.0" /end AXIS_PTS
/begin AXIS_PTS ldpm_tco__tqi_av_min_er "" 0x62131 TCO _REC_AXS_20_u1 190.5 _CNV_A_R_LINEAR_____22_CM 6 -48. 142.5 FORMAT "%5.1" /end AXIS_PTS
/begin AXIS_PTS ldpm_n_32__tqi_av_min_er "" 0x6212a N_32 _REC_AXS_20_u1 8160. _CNV_A_R_LINEAR_____15_CM 6 0. 8160. FORMAT "%4.0" /end AXIS_PTS
/begin AXIS_PTS ldpm_n_32__fac_er "" 0x62138 N_32 _REC_AXS_20_u1 8160. _CNV_A_R_LINEAR_____15_CM 8 0. 8160. FORMAT "%4.0" /end AXIS_PTS
/begin AXIS_PTS ldpm_tqi_av__fac_er "" 0x62142 TQI_AV _REC_AXS_20_u2 1023.96875 _CNV_A_R_LINEAR_____37_CM 8 0. 1023.96875 FORMAT "%7.2" /end AXIS_PTS
/begin MEASUREMENT LV_VAR_ASR "LV ASR device recognized" UBYTE _CNV_S_2_RANGE______76_CM 1 100. 0. 1. ECU_ADDRESS 0x3fd432 BIT_MASK 0x1 /end MEASUREMENT
/begin MEASUREMENT LV_VAR_MSW "LV MSW detected" UBYTE _CNV_S_2_RANGE______76_CM 1 100. 0. 1. ECU_ADDRESS 0x3fd347 BIT_MASK 0x1 /end MEASUREMENT
/begin AXIS_PTS ldpm_gear__tq_p_max "" 0x61f72 GEAR _REC_AXS_20_u1 12. _CNV_A_R_LINEAR_____17_CM 13 0. 12. /end AXIS_PTS
/begin CHARACTERISTIC ID_TQ_P_MAX "Maximum allowed torque at clutch due to torque limitation depending on gear ratio" CURVE 0x68c2c _REC_CUR_20_u2_u1 1023.96875 _CNV_A_R_LINEAR_____37_CM 0. 1023.96875 FORMAT "%7.2"
 /begin AXIS_DESCR COM_AXIS GEAR _CNV_A_R_LINEAR_____17_CM 13 0. 12. AXIS_PTS_REF ldpm_gear__tq_p_max /end AXIS_DESCR
/end CHARACTERISTIC
/begin CHARACTERISTIC ID_TQ_P_MAX_MT "Maximum allowed torque at clutch due to torque limitation depending on gear ratio" CURVE 0x69b1e _REC_CUR_20_u2_u1 1023.96875 _CNV_A_R_LINEAR_____37_CM 0. 1023.96875 FORMAT "%7.2"
 /begin AXIS_DESCR COM_AXIS GEAR _CNV_A_R_LINEAR_____17_CM 13 0. 12. AXIS_PTS_REF ldpm_gear__tq_p_max /end AXIS_DESCR
/end CHARACTERISTIC
/begin CHARACTERISTIC ID_TQ_P_MAX_AT "Minimum allowed torque at clutch due to torque limitation depending on gear ratio" CURVE 0x69b38 _REC_CUR_20_u2_u1 1023.96875 _CNV_A_R_LINEAR_____37_CM 0. 1023.96875 FORMAT "%7.2"
 /begin AXIS_DESCR COM_AXIS GEAR _CNV_A_R_LINEAR_____17_CM 13 0. 12. AXIS_PTS_REF ldpm_gear__tq_p_max /end AXIS_DESCR
/end CHARACTERISTIC
/begin AXIS_PTS ldpm_vs_wheel_grd_mmv_thd "" 0x62154 VS _REC_AXS_20_u1 255. _CNV_A_R_LINEAR_____43_CM 9 0. 255. FORMAT "%3.0" /end AXIS_PTS
/begin AXIS_PTS ldp_n_32__mis_fac_thd_iv_er "" 0x620fb N_32 _REC_AXS_20_u1 8160. _CNV_A_R_LINEAR_____15_CM 10 0. 8160. FORMAT "%4.0" /end AXIS_PTS
/begin AXIS_PTS ldp_n_32__mis__a_fac "" 0x6215e N_32 _REC_AXS_20_u1 8160. _CNV_A_R_LINEAR_____15_CM 6 0. 8160. FORMAT "%4.0" /end AXIS_PTS
/begin AXIS_PTS ldp_tqi_av__mis_fac_thd_iv_er "" 0x62106 TQI_AV _REC_AXS_20_u2 1023.96875 _CNV_A_R_LINEAR_____37_CM 6 0. 1023.96875 FORMAT "%7.2" /end AXIS_PTS
/begin AXIS_PTS ldp_tqi_av__mis_a_fac "" 0x62166 TQI_AV _REC_AXS_20_u2 2047.96875 _CNV_A_R_LINEAR_____65_CM 6 -1024. 1023.96875 FORMAT "%6.2" /end AXIS_PTS
/begin AXIS_PTS ldp_maf__lamb_ref "" 0x615c8 MAF _REC_AXS_20_u1 1389. _CNV_A_R_LINEAR_____51_CM 6 0. 1389. FORMAT "%4.0" /end AXIS_PTS
/begin AXIS_PTS ldp_maf__thd_is_er_diag "" 0x62174 MAF _REC_AXS_20_u1 1389. _CNV_A_R_LINEAR_____51_CM 4 0. 1389. FORMAT "%4.0" /end AXIS_PTS
/begin AXIS_PTS ldp_n__mff_cst "" 0x616ca N _REC_AXS_20_u2 816. _CNV_A_R_LINEAR_____0_CM 3 0. 8160. FORMAT "%4.0" /end AXIS_PTS
/begin AXIS_PTS ldp_n__thd_is_er_diag "" 0x6217a N _REC_AXS_20_u2 816. _CNV_A_R_LINEAR_____0_CM 4 0. 8160. FORMAT "%4.0" /end AXIS_PTS
/begin AXIS_PTS ldp_tco__iga_ref_temp_fac "" 0x6187f TCO _REC_AXS_20_u1 190.5 _CNV_A_R_LINEAR_____22_CM 6 -48. 142.5 FORMAT "%5.1" /end AXIS_PTS
/begin AXIS_PTS ldp_tco__fac_thd_is_er_diag "" 0x62184 TCO _REC_AXS_20_u1 190.5 _CNV_A_R_LINEAR_____22_CM 8 -48. 142.5 FORMAT "%5.1" /end AXIS_PTS
/begin MEASUREMENT CAM_TYPE "CAM type" UBYTE _CNV_S_3_RANGE_CAM__218_CM 1 100. 0. 2. ECU_ADDRESS 0x3fd99f /end MEASUREMENT
/begin MEASUREMENT ENG_CONF "state of engine configuration code" UBYTE _CNV_S_3_RANGE_ENG__148_CM 1 100. 0. 2. ECU_ADDRESS 0x3fd9a0 /end MEASUREMENT
/begin MEASUREMENT LV_INJ_CONF "LV injection configuration (0 = intake manifold injection, 1 = direct injection) " UBYTE _CNV_S_2_RANGE______76_CM 1 100. 0. 1. ECU_ADDRESS 0x3fd589 /end MEASUREMENT
/begin MEASUREMENT LV_ISA_CONF "logical variable idle speed actuator configuration (0=no idle speed actuator, 1=idle speed actuator)" UBYTE _CNV_S_2_RANGE______76_CM 1 100. 0. 1. ECU_ADDRESS 0x3fd58a /end MEASUREMENT
/begin AXIS_PTS ldpm_temp_mmv_sub_cat_ecf_1 "" 0x61e83 TEMP_MMV_SUB_CAT_ECF _REC_AXS_20_u1 1020. _CNV_A_R_LINEAR_____26_CM 6 -33. 987. FORMAT "%3.0" /end AXIS_PTS
/begin AXIS_PTS ldp_id_maf_tab_1 "" 0x6153a INDEX_1 _REC_AXS_20_u1 255. _CNV_A_R_LINEAR_____13_CM 16 0. 255. FORMAT "%3.0" /end AXIS_PTS
/begin AXIS_PTS ldp_id_saf_tab_1 "" 0x6218d INDEX_1 _REC_AXS_20_u1 255. _CNV_A_R_LINEAR_____13_CM 16 0. 255. FORMAT "%3.0" /end AXIS_PTS
/begin AXIS_PTS ldp_id_maf_tab_2 "" 0x6154b INDEX_2 _REC_AXS_20_u1 255. _CNV_A_R_LINEAR_____13_CM 16 0. 255. FORMAT "%3.0" /end AXIS_PTS
/begin AXIS_PTS ldp_id_saf_tab_2 "" 0x6219e INDEX_2 _REC_AXS_20_u1 255. _CNV_A_R_LINEAR_____13_CM 16 0. 255. FORMAT "%3.0" /end AXIS_PTS
/begin AXIS_PTS ldpm_n_32__tqi_min_pu "" 0x61676 N_32 _REC_AXS_20_u1 8160. _CNV_A_R_LINEAR_____15_CM 12 0. 8160. FORMAT "%4.0" /end AXIS_PTS
/begin AXIS_PTS ldp_n_32__eoi_bas "" 0x61620 N_32 _REC_AXS_20_u1 816. _CNV_A_R_LINEAR_____15_CM 6 0. 8160. FORMAT "%4.0" /end AXIS_PTS
/begin MEASUREMENT SF_TQD "Status flag driving toque at clutch" UBYTE _CNV_A_R_LINEAR_____17_CM 1 100. 0. 3. ECU_ADDRESS 0x3fd864 FORMAT "%2.0" /end MEASUREMENT
/begin AXIS_PTS ldpm_tco_st_tco_lam_min "" 0x60d4e TCO_ST _REC_AXS_20_u1 190.5 _CNV_A_R_LINEAR_____22_CM 6 -48. 142.5 FORMAT "%5.1" /end AXIS_PTS
/begin AXIS_PTS ldp_tco_st_t_dly_ls_ready "" 0x60cc5 TCO_ST _REC_AXS_20_u1 190.5 _CNV_A_R_LINEAR_____22_CM 8 -48. 142.5 FORMAT "%5.1" /end AXIS_PTS
/begin AXIS_PTS ldp_tco_temp_ls_ini "" 0x60cce TCO _REC_AXS_20_u1 190.5 _CNV_A_R_LINEAR_____22_CM 6 -48. 142.5 FORMAT "%5.1" /end AXIS_PTS
/begin AXIS_PTS ldp_tia_temp_ls_ini "" 0x60d0b TIA _REC_AXS_20_u1 190.5 _CNV_A_R_LINEAR_____22_CM 6 -48. 142.5 FORMAT "%5.1" /end AXIS_PTS
/begin AXIS_PTS ldp_vs_fac_v_efc_teg "" 0x60d12 VS _REC_AXS_20_u1 255. _CNV_A_R_LINEAR_____43_CM 6 0. 255. FORMAT "%3.0" /end AXIS_PTS
/begin AXIS_PTS ldp_tco_st_int_teg_maf_thd "" 0x60cbe TCO_ST _REC_AXS_20_u1 190.5 _CNV_A_R_LINEAR_____22_CM 6 -48. 142.5 FORMAT "%5.1" /end AXIS_PTS
/begin AXIS_PTS ldp_tia_int_teg_maf_thd "" 0x60d04 TIA _REC_AXS_20_u1 190.5 _CNV_A_R_LINEAR_____22_CM 6 -48. 142.5 FORMAT "%5.1" /end AXIS_PTS
/begin AXIS_PTS ldp_ctr_cold_st_fac_ctr_cold_st "" 0x60bff CTR_COLD_ST _REC_AXS_20_u1 255. _CNV_A_R_LINEAR_____13_CM 6 0. 255. FORMAT "%3.0" /end AXIS_PTS
/begin AXIS_PTS ldp_pow_dif_add_teg_iga "" 0x60c9e POW_DIF _REC_AXS_20_u2 69.0826 _CNV_A_R_LINEAR_____238_CM 6 0. 69.0826 FORMAT "%5.3" /end AXIS_PTS
/begin AXIS_PTS ldp_nr_pat__fac_scc_teg "" 0x60c8f NR_PAT _REC_AXS_20_u1 13. _CNV_A_R_LINEAR_____17_CM 13 0. 13. FORMAT "%2.0" /end AXIS_PTS
/begin AXIS_PTS ldp_maf_kgh_add_teg_stat_scc "" 0x60c30 MAF_KGH _REC_AXS_20_u2 2047.96875 _CNV_A_R_LINEAR_____52_CM 6 0. 2047.96875 FORMAT "%6.2" /end AXIS_PTS
/begin AXIS_PTS ldp_vs_fac_vs_teg "" 0x60d19 VS _REC_AXS_20_u1 255. _CNV_A_R_LINEAR_____43_CM 6 0. 255. FORMAT "%3.0" /end AXIS_PTS
/begin AXIS_PTS ldpm_maf_kgh_crlc_teg "" 0x60d2a MAF_KGH _REC_AXS_20_u2 2047.96875 _CNV_A_R_LINEAR_____52_CM 6 0. 2047.96875 FORMAT "%6.2" /end AXIS_PTS
/begin AXIS_PTS ldp_n_ip_vls_sp_dly "" 0x60c7c N_32 _REC_AXS_20_u1 8160. _CNV_A_R_LINEAR_____15_CM 4 0. 8160. FORMAT "%4.0" /end AXIS_PTS
/begin AXIS_PTS ldp_maf_ip_vls_sp_dly "" 0x60c2b MAF _REC_AXS_20_u1 1389. _CNV_A_R_LINEAR_____51_CM 4 0. 1389. FORMAT "%4.0" /end AXIS_PTS
/begin AXIS_PTS ldp_n_ip_fac_lam_dly "" 0x60c73 N_32 _REC_AXS_20_u1 8160. _CNV_A_R_LINEAR_____15_CM 8 0. 8160. FORMAT "%4.0" /end AXIS_PTS
/begin AXIS_PTS ldp_maf_ip_fac_lam_dly "" 0x60c22 MAF _REC_AXS_20_u1 1389. _CNV_A_R_LINEAR_____51_CM 8 0. 1389. FORMAT "%4.0" /end AXIS_PTS
/begin AXIS_PTS ldp_ti_fac_ti_ad_fac_fac "" 0x60cf8 TI_AD_FAC_MMV _REC_AXS_20_u2 99.99847412 _CNV_A_R_LINEAR_____248_CM 5 -50. 49.99847412 FORMAT "%5.3" /end AXIS_PTS
/begin AXIS_PTS ldp_ti_add_ti_ad_add_fac "" 0x60cec TI_AD_ADD_MMV _REC_AXS_20_u2 262.14 _CNV_A_R_LINEAR_____115_CM 5 -131.072 131.068 FORMAT "%6.2" /end AXIS_PTS
/begin AXIS_PTS ldp_n_lshpwm_down "" 0x60c81 N_32 _REC_AXS_20_u1 8160. _CNV_A_R_LINEAR_____15_CM 6 0. 8160. FORMAT "%4.0" /end AXIS_PTS
/begin AXIS_PTS ldp_maf_lshpwm_down "" 0x60c5a MAF _REC_AXS_20_u1 1389. _CNV_A_R_LINEAR_____51_CM 6 0. 1389. FORMAT "%4.0" /end AXIS_PTS
/begin AXIS_PTS ldp_cat_ip_fac_cat_dly "" 0x60bf8 CAT_DIAG_1 _REC_AXS_20_u1 1.9968 _CNV_A_R_LINEAR_____70_CM 6 0. 1.9968 FORMAT "%4.2" /end AXIS_PTS
/begin AXIS_PTS ldp_maf_kgh_ip_fac_dly_p "" 0x60c4c MAF_KGH _REC_AXS_20_u2 2047.96875 _CNV_A_R_LINEAR_____52_CM 6 0. 2047.96875 FORMAT "%6.2" /end AXIS_PTS
/begin AXIS_PTS ldp_maf_kgh_ip_crlc_dly_i "" 0x60c3e MAF_KGH _REC_AXS_20_u2 2047.96875 _CNV_A_R_LINEAR_____52_CM 6 0. 2047.96875 FORMAT "%6.2" /end AXIS_PTS
/begin AXIS_PTS ldpm_n_26 "" 0x60d38 N_32 _REC_AXS_20_u1 8160. _CNV_A_R_LINEAR_____15_CM 6 0. 8160. FORMAT "%4.0" /end AXIS_PTS
/begin AXIS_PTS ldpm_n_9 "" 0x60d3f N_32 _REC_AXS_20_u1 8160. _CNV_A_R_LINEAR_____15_CM 8 0. 8160. FORMAT "%4.0" /end AXIS_PTS
/begin AXIS_PTS ldp_lamb_sp__fac_lam_teg "" 0x60c14 LAMB_SP _REC_AXS_20_u2 2. _CNV_A_R_LINEAR_____250_CM 6 0. 2. FORMAT "%5.4" /end AXIS_PTS
/begin AXIS_PTS ldpm_tco_10 "" 0x60d48 TCO _REC_AXS_20_u1 190.5 _CNV_A_R_LINEAR_____22_CM 5 -48. 142.5 FORMAT "%5.1" /end AXIS_PTS
/begin AXIS_PTS ldpm_maf_3 "" 0x60d20 MAF _REC_AXS_20_u1 1389. _CNV_A_R_LINEAR_____51_CM 8 0. 1389. FORMAT "%4.0" /end AXIS_PTS
/begin AXIS_PTS ldp_maf_teg "" 0x60c61 MAF _REC_AXS_20_u1 1389. _CNV_A_R_LINEAR_____51_CM 8 0. 1389. FORMAT "%4.0" /end AXIS_PTS
/begin AXIS_PTS ldp_n__v_efc_lsh_ctl "" 0x60c88 N_32 _REC_AXS_20_u1 8160. _CNV_A_R_LINEAR_____15_CM 6 0. 8160. FORMAT "%4.0" /end AXIS_PTS
/begin AXIS_PTS ldp_n_32_teg "" 0x60c6a N_32 _REC_AXS_20_u1 8160. _CNV_A_R_LINEAR_____15_CM 8 0. 8160. FORMAT "%4.0" /end AXIS_PTS
/begin AXIS_PTS ldpm_n_32__ti_lam "" 0x60d70 N_32 _REC_AXS_20_u1 8160. _CNV_A_R_LINEAR_____15_CM 8 0. 8160. FORMAT "%4.0" /end AXIS_PTS
/begin AXIS_PTS ldpm_maf__ti_lam "" 0x60d7a MAF _REC_AXS_20_u2 1389. _CNV_A_R_LINEAR_____56_CM 8 0. 1389. FORMAT "%7.2" /end AXIS_PTS
/begin AXIS_PTS ldpm_vls_dif_dly "" 0x60d56 VLS_DIF_DLY _REC_AXS_20_u2 9.99034 _CNV_A_R_LINEAR_____246_CM 12 -4.99517 4.99517 FORMAT "%5.3" /end AXIS_PTS
/begin AXIS_PTS ldpm_t_vls_cyc_afl_hld "" 0x60d8c T_VLS_CYC_AFL_HLD _REC_AXS_20_u1 2.55 _CNV_A_R_LINEAR_____21_CM 8 0. 2.55 FORMAT "%4.2" /end AXIS_PTS
/begin AXIS_PTS ldp_r_dif_down_ls_lshpwm_i "" 0x60cac R_DIF_DOWN_LS _REC_AXS_20_u2 9830.25 _CNV_A_R_LINEAR_____255_CM 8 -4915.2 4915.05 FORMAT "%5.1" /end AXIS_PTS
/begin AXIS_PTS ldp_r_up_ls_ip_ttip_ls_up "" 0x60d96 R_UP_LS _REC_AXS_20_u2 65535. _CNV_A_R_LINEAR_____163_CM 8 0. 65535. FORMAT "%5.0" /end AXIS_PTS
/begin AXIS_PTS ldp_r_down_ls_ip_ttip_ls_down "" 0x60da8 R_DOWN_LS _REC_AXS_20_u2 65535. _CNV_A_R_LINEAR_____163_CM 8 0. 65535. FORMAT "%5.0" /end AXIS_PTS
/begin AXIS_PTS ldp_eff_iga_av__fac_iga "" 0x60c06 EFF_IGA_AV _REC_AXS_20_u2 1.99996948 _CNV_A_R_LINEAR_____5_CM 6 0. 1.99996948 FORMAT "%7.5" /end AXIS_PTS
/begin AXIS_PTS ldp_temp_ls_ini_v_efc_lsh_up "" 0x60ce4 TEMP_LS_INI _REC_AXS_20_u1 190.5 _CNV_A_R_LINEAR_____22_CM 6 -48. 142.5 FORMAT "%5.1" /end AXIS_PTS
/begin AXIS_PTS ldp_teg_dyn__v_efc_lsh_up_ctl "" 0x60cd6 TEG_DYN _REC_AXS_20_u2 2047. _CNV_A_R_LINEAR_____94_CM 6 0. 2047. FORMAT "%7.2" /end AXIS_PTS
/begin MEASUREMENT LV_VLS_NOT_VLD_DOWN_1 "Boolean flag indicating that VLS_DOWN_i signal not valid, i.e. masked due to Ri determination" UWORD _CNV_S_2_RANGE______74_CM 1 100. 0. 1. ECU_ADDRESS 0x3fcab4 BIT_MASK 0x2 /end MEASUREMENT
/begin MEASUREMENT LV_VLS_NOT_VLD_UP_1 "Boolean flag indicating that VLS_UP_i signal not valid, i.e. masked due to Ri determination" UWORD _CNV_S_2_RANGE______74_CM 1 100. 0. 1. ECU_ADDRESS 0x3fca8c BIT_MASK 0x2 /end MEASUREMENT
/begin MEASUREMENT LV_DOWN_LS_1 "Logical variable for operative readiness of downstream oxygen sensor(s)" UWORD _CNV_S_2_RANGE______74_CM 1 100. 0. 1. ECU_ADDRESS 0x3fcbcc BIT_MASK 0x1 /end MEASUREMENT
/begin MEASUREMENT LV_VLS_DOWN_MMV_ACT_1 "Boolean flag indicating calibrateable delay since PUC deactivation passed" UWORD _CNV_S_2_RANGE______74_CM 1 100. 0. 1. ECU_ADDRESS 0x3fcbcc BIT_MASK 0x4 /end MEASUREMENT
/begin MEASUREMENT LV_VLS_DOWN_MMV_LMT_1 "Boolean flag indicating VLS_DOWN_MMV_xxx_i signals being limited when set" UWORD _CNV_S_2_RANGE______74_CM 1 100. 0. 1. ECU_ADDRESS 0x3fcbcc BIT_MASK 0x2 /end MEASUREMENT
/begin MEASUREMENT LV_VLS_NOT_VLD_DOWN_2 "Boolean flag indicating that VLS_DOWN_i signal not valid, i.e. masked due to Ri determination" UWORD _CNV_S_2_RANGE______74_CM 1 100. 0. 1. ECU_ADDRESS 0x3fcc20 BIT_MASK 0x2 /end MEASUREMENT
/begin MEASUREMENT LV_VLS_NOT_VLD_UP_2 "Boolean flag indicating that VLS_UP_i signal not valid, i.e. masked due to Ri determination" UWORD _CNV_S_2_RANGE______74_CM 1 100. 0. 1. ECU_ADDRESS 0x3fcbf8 BIT_MASK 0x2 /end MEASUREMENT
/begin AXIS_PTS ldp_maf_int_puc__1 "" 0x60dba MAF_INT_PUC _REC_AXS_20_u2 1820.398 _CNV_A_R_LINEAR_____98_CM 6 0. 1820.398 FORMAT "%7.2" /end AXIS_PTS
/begin AXIS_PTS ldp_cat_diag__fac_cat_eff_puc "" 0x60dc8 CAT_DIAG _REC_AXS_20_u1 1.9968 _CNV_A_R_LINEAR_____70_CM 6 0. 1.9968 FORMAT "%4.2" /end AXIS_PTS
/begin AXIS_PTS ldp_maf_cyl__delta_lamb_sp_puc "" 0x60dd0 MAF_CYL _REC_AXS_20_u2 2047.96875 _CNV_A_R_LINEAR_____52_CM 6 0. 2047.96875 FORMAT "%7.2" /end AXIS_PTS
/begin AXIS_PTS ldpm_temp_cat_fac_pcat_main_cat "" 0x60dde TEMP_CAT _REC_AXS_20_u2 1023.984375 _CNV_A_R_LINEAR_____95_CM 6 -33. 990.984375 FORMAT "%6.2" /end AXIS_PTS
/begin AXIS_PTS ldp_cl_mmv_ip_t_max_cp "" 0x60b08 CL_MMV _REC_AXS_20_u2 7.99987793 _CNV_A_R_LINEAR_____104_CM 6 0. 7.99987793 FORMAT "%6.4" /end AXIS_PTS
/begin AXIS_PTS ldpm_maf_cyl_ip_ti_lam_cor_crlc "" 0x60b16 MAF_CYL _REC_AXS_20_u2 2047.96875 _CNV_A_R_LINEAR_____52_CM 6 0. 2047.96875 FORMAT "%6.2" /end AXIS_PTS
/begin AXIS_PTS ldp_cl_mmv_ip_rel_flow_fac_cp "" 0x60b24 CL_MMV _REC_AXS_20_u2 7.99987793 _CNV_A_R_LINEAR_____104_CM 6 0. 7.99987793 FORMAT "%6.4" /end AXIS_PTS
/begin AXIS_PTS ldpm_maf_cyl_ip_rel_flow_inc_cp "" 0x60b32 MAF_CYL _REC_AXS_20_u2 2047.96875 _CNV_A_R_LINEAR_____52_CM 6 0. 2047.96875 FORMAT "%6.2" /end AXIS_PTS
/begin AXIS_PTS ldpm_maf_cyl_ip_rel_flow_max_cp "" 0x60b40 MAF_CYL _REC_AXS_20_u1 1389. _CNV_A_R_LINEAR_____51_CM 12 0. 1389. FORMAT "%4.0" /end AXIS_PTS
/begin AXIS_PTS ldpm_n_32_ip_rel_flow_max_cps "" 0x60b4d N_32 _REC_AXS_20_u1 8160. _CNV_A_R_LINEAR_____15_CM 12 0. 8160. FORMAT "%4.0" /end AXIS_PTS
/begin AXIS_PTS ldpm_n_32_ip_rel_flow_cps_s "" 0x60b5a N_32 _REC_AXS_20_u1 8160. _CNV_A_R_LINEAR_____15_CM 6 0. 8160. FORMAT "%4.0" /end AXIS_PTS
/begin AXIS_PTS ldpm_maf_ip_rel_flow_max_cps "" 0x60b61 MAF _REC_AXS_20_u1 69.45 _CNV_A_R_LINEAR_____51_CM 12 0. 1389. FORMAT "%4.0" /end AXIS_PTS
/begin AXIS_PTS ldpm_maf_ip_rel_flow_cps_s "" 0x60b6e MAF _REC_AXS_20_u1 69.45 _CNV_A_R_LINEAR_____51_CM 6 0. 1389. FORMAT "%4.0" /end AXIS_PTS
/begin AXIS_PTS ldp_flow_cor_cps_ip_cppwm "" 0x60b76 FLOW_COR_CPS _REC_AXS_20_u2 7.99987793 _CNV_A_R_LINEAR_____272_CM 12 0. 7.99987793 FORMAT "%7.4" /end AXIS_PTS
/begin AXIS_PTS ldpm_prs_cps_ip_cppwm "" 0x60b90 PRS_CPS _REC_AXS_20_u2 1200. _CNV_A_R_LINEAR_____277_CM 12 0. 1200. FORMAT "%7.2" /end AXIS_PTS
/begin AXIS_PTS ldp_tia_ip_fac_tia_cp "" 0x60baa TIA _REC_AXS_20_u1 190.5 _CNV_A_R_LINEAR_____22_CM 6 -48. 142.5 FORMAT "%5.1" /end AXIS_PTS
/begin AXIS_PTS ldpm_vb_ip_cppwm_vb "" 0x60bb1 VB _REC_AXS_20_u1 28.8 _CNV_A_R_LINEAR_____157_CM 8 0. 28.8 FORMAT "%3.1" /end AXIS_PTS
/begin AXIS_PTS ldp_cppwm_ref_ip_cppwm_cor_frq "" 0x60bba CPPWM_REF _REC_AXS_20_u1 99.609375 _CNV_A_R_LINEAR_____16_CM 8 0. 99.609375 FORMAT "%5.1" /end AXIS_PTS
/begin AXIS_PTS ldpm_n_32_ip_fuel_dly_cps "" 0x60bc3 N_32 _REC_AXS_20_u1 8160. _CNV_A_R_LINEAR_____15_CM 6 0. 8160. FORMAT "%4.0" /end AXIS_PTS
/begin AXIS_PTS ldp_amp_ip_fac_amp_cp "" 0x60bea AMP _REC_AXS_20_u2 2400. _CNV_A_R_LINEAR_____278_CM 6 -1200. 1200. FORMAT "%8.2" /end AXIS_PTS
/begin MEASUREMENT MFF_ADD_CP "fuel feed by canister purge" UWORD _CNV_A_R_LINEAR_____56_CM 1 100. 0. 1389. ECU_ADDRESS 0x3fc76a FORMAT "%7.2" /end MEASUREMENT
/begin MEASUREMENT TI_LAM_COR "Lambda controller output cylinderbank" SWORD _CNV_A_R_LINEAR_____149_CM 1 100. -50. 49.99847412 ECU_ADDRESS 0x3fc758 FORMAT "%7.3" /end MEASUREMENT
/begin AXIS_PTS ldpm_tqi_sp_s_cp "" 0x60bca TQI_SP _REC_AXS_20_u2 1023.96875 _CNV_A_R_LINEAR_____37_CM 12 0. 1023.96875 FORMAT "%7.2" /end AXIS_PTS
/begin AXIS_PTS ldpm_frq_req_cp "" 0x60be4 FRQ_REQ_CP _REC_AXS_20_u1 255. _CNV_A_R_LINEAR_____271_CM 4 0. 255. FORMAT "%3.0" /end AXIS_PTS
/begin AXIS_PTS ldp_n_32_ar_red_egr "" 0x60f96 N_32 _REC_AXS_20_u1 816. _CNV_A_R_LINEAR_____15_CM 6 0. 8160. FORMAT "%4.0" /end AXIS_PTS
/begin AXIS_PTS ldp_stk_av_egr_ar_red_egr "" 0x60fa4 STK_AV_EGR _REC_AXS_20_u1 99.609375 _CNV_A_R_LINEAR_____16_CM 8 0. 99.609375 FORMAT "%5.2" /end AXIS_PTS
/begin AXIS_PTS ldp_pq__fac_ar_red_cor "" 0x60fae PQ _REC_AXS_20_u2 0.99998474 _CNV_A_R_LINEAR_____2_CM 8 0. 0.99998474 FORMAT "%7.5" /end AXIS_PTS
/begin AXIS_PTS ldpm_pq_ar_red "" 0x60fc8 PQ _REC_AXS_20_u2 0.99998474 _CNV_A_R_LINEAR_____2_CM 4 0. 0.99998474 FORMAT "%7.5" /end AXIS_PTS
/begin AXIS_PTS ldp_t_seg_t_1_ratio_crlc_hfm "" 0x60fd2 T_SEG_T_1_RATIO _REC_AXS_20_u2 7.99987793 _CNV_A_R_LINEAR_____104_CM 6 0. 7.99987793 FORMAT "%6.4" /end AXIS_PTS
/begin AXIS_PTS ldpm_maf_kgh_t_1_hfm "" 0x60fe0 MAF_KGH _REC_AXS_20_u2 204.796875 _CNV_A_R_LINEAR_____52_CM 4 0. 2047.96875 FORMAT "%7.2" /end AXIS_PTS
/begin AXIS_PTS ldpm_n_eff_vol "" 0x61028 N _REC_AXS_20_u2 8160. _CNV_A_R_LINEAR_____0_CM 12 0. 8160. FORMAT "%4.0" /end AXIS_PTS
/begin AXIS_PTS ldpm_amp__eff_vol_ofs_amp "" 0x61042 AMP _REC_AXS_20_u2 5434. _CNV_A_R_LINEAR_____1_CM 6 0. 5434. FORMAT "%7.2" /end AXIS_PTS
/begin AXIS_PTS ldpm_maf_cyl_ex "" 0x6105a MAF_CYL _REC_AXS_20_u2 2047.96875 _CNV_A_R_LINEAR_____52_CM 8 0. 2047.96875 FORMAT "%6.2" /end AXIS_PTS
/begin AXIS_PTS ldp_teg_egr_maf_egr_con_1 "" 0x6100c TEG_EGR _REC_AXS_20_u2 2047. _CNV_A_R_LINEAR_____94_CM 8 0. 2047. FORMAT "%7.2" /end AXIS_PTS
/begin AXIS_PTS ldp_maf_cyl_amp_dec "" 0x61050 MAF_CYL _REC_AXS_20_u2 2047.96875 _CNV_A_R_LINEAR_____52_CM 4 0. 2047.96875 FORMAT "%6.2" /end AXIS_PTS
/begin AXIS_PTS ldp_n_32__tps_sp_mdl_max "" 0x61098 N_32 _REC_AXS_20_u1 816. _CNV_A_R_LINEAR_____15_CM 8 0. 8160. FORMAT "%4.0" /end AXIS_PTS
/begin AXIS_PTS ldpm_vo__eff_vol "" 0x6101e VO _REC_AXS_20_u1 95.625 _CNV_A_R_LINEAR_____6_CM 8 0. 95.625 FORMAT "%5.2" /end AXIS_PTS
/begin AXIS_PTS ldp_n_32__pq_egr_sp "" 0x610be N_32 _REC_AXS_20_u1 816. _CNV_A_R_LINEAR_____15_CM 8 0. 8160. FORMAT "%4.0" /end AXIS_PTS
/begin AXIS_PTS ldp_n_32__fac_maf_max_s "" 0x610c7 N_32 _REC_AXS_20_u1 816. _CNV_A_R_LINEAR_____15_CM 8 0. 8160. FORMAT "%4.0" /end AXIS_PTS
/begin AXIS_PTS ldp_mff_sp_s__fac_maf_max_s "" 0x610de MFF_SP_S _REC_AXS_20_u2 1389. _CNV_A_R_LINEAR_____56_CM 6 0. 1389. FORMAT "%7.2" /end AXIS_PTS
/begin AXIS_PTS ldp_maf_dif_s__eff_maf_s "" 0x610ec MAF_DIF_S _REC_AXS_20_u2 1389.97 _CNV_A_R_LINEAR_____301_CM 16 -695. 694.97 FORMAT "%7.2" /end AXIS_PTS
/begin AXIS_PTS ldp_mff_sp_s__pq_egr_sp "" 0x610d0 MFF_SP_S _REC_AXS_20_u2 1389. _CNV_A_R_LINEAR_____56_CM 6 0. 1389. FORMAT "%7.2" /end AXIS_PTS
/begin AXIS_PTS ldp_mff_sp_s__tqi_ref_s "" 0x6110e MFF_SP_S _REC_AXS_20_u2 1389. _CNV_A_R_LINEAR_____56_CM 12 0. 1389. FORMAT "%7.2" /end AXIS_PTS
/begin AXIS_PTS ldp_ar_red_sp_mmv "" 0x61076 AR_RED_SP_MMV _REC_AXS_20_u2 58.592855 _CNV_A_R_LINEAR_____286_CM 16 0. 58.592855 FORMAT "%7.4" /end AXIS_PTS
/begin AXIS_PTS ldp_maf_kgh_sp__amp_dec "" 0x6106c MAF_KGH_SP _REC_AXS_20_u2 2047.96875 _CNV_A_R_LINEAR_____52_CM 4 0. 2047.96875 FORMAT "%6.2" /end AXIS_PTS
/begin MEASUREMENT MAF_CYL "Mass air flow out of intake manifold" UWORD _CNV_A_R_LINEAR_____52_CM 1 100. 0. 2047.96875 ECU_ADDRESS 0x3fccde FORMAT "%7.2" /end MEASUREMENT
/begin AXIS_PTS ldpm_disa_ist__eff_vol "" 0x6114a DISA_IST _REC_AXS_20_u2 199.9969 _CNV_A_R_LINEAR_____299_CM 8 0. 199.9969 FORMAT "%7.3" /end AXIS_PTS
/begin AXIS_PTS ldpm_fac_port_deac__eff_vol "" 0x6115c FAC_PORT_DEAC _REC_AXS_20_u2 0.99998474 _CNV_A_R_LINEAR_____2_CM 8 0. 0.99998474 FORMAT "%7.5" /end AXIS_PTS
/begin AXIS_PTS ldpm_exc_av_rel__eff_vol "" 0x6116e EXV_AV_REL _REC_AXS_20_u2 99.99847412 _CNV_A_R_LINEAR_____144_CM 8 0. 99.99847412 /end AXIS_PTS
/begin AXIS_PTS ldpm_n_32_ar_red "" 0x60f9d N_32 _REC_AXS_20_u1 816. _CNV_A_R_LINEAR_____15_CM 6 0. 8160. FORMAT "%4.0" /end AXIS_PTS
/begin AXIS_PTS ldp_v_map_map_mes_bas "" 0x61180 V_MAP _REC_AXS_20_u2 4.5 _CNV_A_R_LINEAR_____158_CM 2 0. 5. FORMAT "%5.3" /end AXIS_PTS
/begin AXIS_PTS ldp_maf_kgh_mes_bas "" 0x61128 MAF_KGH_MES_BAS _REC_AXS_20_u2 2047.96875 _CNV_A_R_LINEAR_____52_CM 16 0. 2047.96875 FORMAT "%7.2" /end AXIS_PTS
/begin AXIS_PTS ldp_pq_sp_fil__crlc_ar_red_sp "" 0x610ac CRLC_AR_RED_SP _REC_AXS_20_u2 0.99998474 _CNV_A_R_LINEAR_____2_CM 8 0. 0.99998474 FORMAT "%7.5" /end AXIS_PTS
/begin AXIS_PTS ldp_maf_sp__tps_sp_mdl_max "" 0x610a2 MAF_SP _REC_AXS_20_u2 1389. _CNV_A_R_LINEAR_____56_CM 4 0. 1389. FORMAT "%7.2" /end AXIS_PTS
/begin AXIS_PTS ldpm_n_ar_red "" 0x60fc0 N_32 _REC_AXS_20_u1 8160. _CNV_A_R_LINEAR_____15_CM 6 0. 8160. FORMAT "%4.0" /end AXIS_PTS
/begin AXIS_PTS ldp_tps_seg_ar_red_thr "" 0x60fea TPS_SEG _REC_AXS_20_u2 119.5 _CNV_A_R_LINEAR_____34_CM 16 0. 119.5 /end AXIS_PTS
/begin AXIS_PTS ldpm_pq_estim_id_maf_fac_ofs "" 0x60f74 PQ_ESTIM _REC_AXS_20_u2 0.99998474 _CNV_A_R_LINEAR_____2_CM 16 0. 0.99998474 FORMAT "%7.5" /end AXIS_PTS
/begin AXIS_PTS ldpm_n_32__eff_vol_cor "" 0x61186 N_32 _REC_AXS_20_u1 8160. _CNV_A_R_LINEAR_____15_CM 8 0. 8160. FORMAT "%4.0" /end AXIS_PTS
/begin AXIS_PTS ldpm_maf__eff_vol_cor "" 0x61190 MAF _REC_AXS_20_u2 1389. _CNV_A_R_LINEAR_____56_CM 8 0. 1389. FORMAT "%7.2" /end AXIS_PTS
/begin AXIS_PTS ldp_n_32__crlc_eff_vol_cor "" 0x611a2 N_32 _REC_AXS_20_u1 8160. _CNV_A_R_LINEAR_____15_CM 6 0. 8160. FORMAT "%4.0" /end AXIS_PTS
/begin MEASUREMENT CQ_S_RAW "Raw characteristic quantity in stratified combustion" UBYTE _CNV_A_R_LINEAR_____16_CM 1 100. 0. 99.609375 ECU_ADDRESS 0x3fd7eb FORMAT "%5.1" /end MEASUREMENT
/begin MEASUREMENT MAF_MIN_S "Minimum mass air flow required for stratified combustion" UWORD _CNV_A_R_LINEAR_____56_CM 1 100. 0. 1389. ECU_ADDRESS 0x3fc6b4 FORMAT "%7.2" /end MEASUREMENT
/begin MEASUREMENT CQ_S "Characteristic quantity in stratified combustion" UBYTE _CNV_A_R_LINEAR_____16_CM 1 100. 0. 99.609375 ECU_ADDRESS 0x3fd7ea FORMAT "%5.1" /end MEASUREMENT
/begin MEASUREMENT CQ_HOM "Characteristic quantity in homogeneous combustion." UBYTE _CNV_A_R_LINEAR_____16_CM 1 100. 0. 99.609375 ECU_ADDRESS 0x3fd7e9 FORMAT "%5.1" /end MEASUREMENT
/begin AXIS_PTS ldp_n_32__fac_maf_afl "" 0x60dec N_32 _REC_AXS_20_u1 8160. _CNV_A_R_LINEAR_____15_CM 6 0. 8160. FORMAT "%4.0" /end AXIS_PTS
/begin AXIS_PTS ldp_n_32__eff_iga_afl "" 0x60df3 N_32 _REC_AXS_20_u1 8160. _CNV_A_R_LINEAR_____15_CM 8 0. 8160. FORMAT "%4.0" /end AXIS_PTS
/begin AXIS_PTS ldp_tqi_req_slow__eff_iga_afl "" 0x60dfc TQI_REQ_SLOW _REC_AXS_20_u2 2047.96875 _CNV_A_R_LINEAR_____65_CM 8 -1024. 1023.96875 FORMAT "%6.2" /end AXIS_PTS
/begin AXIS_PTS ldp_egr_ratio_prev_s "" 0x60e0e EGR_RATIO_PREV_S _REC_AXS_20_u2 99.99847412 _CNV_A_R_LINEAR_____144_CM 6 0. 99.99847412 /end AXIS_PTS
/begin AXIS_PTS ldp_tco__tqi_thd_s_afl "" 0x60e29 TCO _REC_AXS_20_u1 190.5 _CNV_A_R_LINEAR_____22_CM 4 -48. 142.5 FORMAT "%5.1" /end AXIS_PTS
/begin AXIS_PTS ldp_tco__tqi_thd_afl_afs "" 0x60e2e TCO _REC_AXS_20_u1 190.5 _CNV_A_R_LINEAR_____22_CM 4 -48. 142.5 FORMAT "%5.1" /end AXIS_PTS
/begin AXIS_PTS ldp_n_hys_afs__tqi_thd_afl_afs "" 0x60e33 N_HYS_AFS _REC_AXS_20_u1 8160. _CNV_A_R_LINEAR_____15_CM 12 0. 8160. FORMAT "%4.0" /end AXIS_PTS
/begin AXIS_PTS ldp_tqi_req_fast__lamb_min_s "" 0x60e4a TQI_REQ_FAST _REC_AXS_20_u2 2047.96875 _CNV_A_R_LINEAR_____65_CM 8 -1024. 1023.96875 FORMAT "%6.2" /end AXIS_PTS
/begin AXIS_PTS ldp_n__eoi_dif_s "" 0x60e5c N_32 _REC_AXS_20_u1 8160. _CNV_A_R_LINEAR_____15_CM 6 0. 8160. FORMAT "%4.0" /end AXIS_PTS
/begin AXIS_PTS ldp_eoi__prs_inc_cmp "" 0x60e84 EOI_HOM _REC_AXS_20_u2 -30. _CNV_A_R_LINEAR_____308_CM 12 420. -180. FORMAT "%6.1" /end AXIS_PTS
/begin AXIS_PTS ldp_crk_inj__prs_inc_cmp "" 0x60e9e CRK_INJ _REC_AXS_20_u2 30. _CNV_A_R_LINEAR_____6_CM 16 0. 600. FORMAT "%5.1" /end AXIS_PTS
/begin AXIS_PTS ldpm_prs_dec_inj__fac_ti_prs "" 0x60ec0 FUP _REC_AXS_20_u2 173888. _CNV_A_R_LINEAR_____114_CM 12 0. 173888. FORMAT "%6.0" /end AXIS_PTS
/begin AXIS_PTS ldp_n_32_ip_lamb_rgn_afr "" 0x60e7b N_32 _REC_AXS_20_u1 8160. _CNV_A_R_LINEAR_____15_CM 8 0. 8160. FORMAT "%4.0" /end AXIS_PTS
/begin AXIS_PTS ldpm_n_32_s "" 0x60eda N_32 _REC_AXS_20_u1 8160. _CNV_A_R_LINEAR_____15_CM 16 0. 8160. FORMAT "%4.0" /end AXIS_PTS
/begin AXIS_PTS ldpm_tqi_sp_mff_s "" 0x60eec TQI_SP_MFF _REC_AXS_20_u2 1023.96875 _CNV_A_R_LINEAR_____37_CM 12 0. 1023.96875 FORMAT "%7.2" /end AXIS_PTS
/begin AXIS_PTS ldpm_tqi_sp_s "" 0x60f06 TQI_SP_S _REC_AXS_20_u2 1023.96875 _CNV_A_R_LINEAR_____37_CM 12 0. 1023.96875 FORMAT "%7.2" /end AXIS_PTS
/begin AXIS_PTS ldp_cq_s_raw__cq_s "" 0x60f20 CQ_S_RAW _REC_AXS_20_u1 99.609375 _CNV_A_R_LINEAR_____16_CM 8 0. 99.609375 FORMAT "%5.1" /end AXIS_PTS
/begin CHARACTERISTIC IP_CQ_S "Characteristic quantity table in stratified mode" CURVE 0x636d8 _REC_CUR_20_u1_u1 99.609375 _CNV_A_R_LINEAR_____16_CM 0. 99.609375 FORMAT "%5.1"
 /begin AXIS_DESCR COM_AXIS CQ_S_RAW _CNV_A_R_LINEAR_____16_CM 8 0. 99.609375 FORMAT "%5.1" AXIS_PTS_REF ldp_cq_s_raw__cq_s /end AXIS_DESCR
/end CHARACTERISTIC
/begin CHARACTERISTIC IP_MAF_MIN_S "Minimum mass air flow for stratified combustion stratified mode" MAP 0x636e0 _REC_MAP_20_u2_u1_u2 1389. _CNV_A_R_LINEAR_____56_CM 0. 1389. FORMAT "%7.2"
 /begin AXIS_DESCR COM_AXIS N_32 _CNV_A_R_LINEAR_____15_CM 16 0. 8160. FORMAT "%4.0" AXIS_PTS_REF ldpm_n_32_s /end AXIS_DESCR
 /begin AXIS_DESCR COM_AXIS TQI_SP_S _CNV_A_R_LINEAR_____37_CM 12 0. 1023.96875 FORMAT "%7.2" AXIS_PTS_REF ldpm_tqi_sp_s /end AXIS_DESCR
/end CHARACTERISTIC
/begin AXIS_PTS ldp_mff_sp__iga_bas_s "" 0x60f3a MFF_SP _REC_AXS_20_u2 1389. _CNV_A_R_LINEAR_____56_CM 12 0. 1389. FORMAT "%7.2" /end AXIS_PTS
/begin MEASUREMENT NTL "NOX trap absolute loading" UWORD _CNV_A_R_LINEAR_____310_CM 1 100. 0. 10485.6 ECU_ADDRESS 0x3fd066 FORMAT "%7.1" /end MEASUREMENT
/begin CHARACTERISTIC LC_INH_S_MAN "Logical constant for inhibit stratified injection" VALUE 0x63962 _REC_VAL_20_u1 1. _CNV_A_R_LINEAR_____13_CM 0. 1. FORMAT "%1.0" /end CHARACTERISTIC
/begin AXIS_PTS ldp_mff_sp_s__eoi_dif_s "" 0x60e64 MFF_SP_S _REC_AXS_20_u2 1389. _CNV_A_R_LINEAR_____56_CM 6 0. 1389. FORMAT "%7.2" /end AXIS_PTS
/begin AXIS_PTS ldp_n_hys_afl__tqi_thd_s_afl "" 0x60e1c N_HYS_AFL _REC_AXS_20_u1 8160. _CNV_A_R_LINEAR_____15_CM 12 0. 8160. FORMAT "%4.0" /end AXIS_PTS
/begin AXIS_PTS ldp_n_32__iga_bas_s "" 0x60f29 N_32 _REC_AXS_20_u1 816. _CNV_A_R_LINEAR_____15_CM 16 0. 8160. FORMAT "%4.0" /end AXIS_PTS
/begin AXIS_PTS ldpm_mff_mmv "" 0x60f54 MFF_MMV _REC_AXS_20_u2 1389. _CNV_A_R_LINEAR_____56_CM 6 0. 1389. FORMAT "%7.2" /end AXIS_PTS
/begin AXIS_PTS ldp_ntl_ip_lamb_rgn_fac_mdl "" 0x63964 NTL _REC_AXS_20_u2 10485.6 _CNV_A_R_LINEAR_____310_CM 8 0. 10485.6 FORMAT "%7.1" /end AXIS_PTS
/begin AXIS_PTS ldp_n_32__lamb_min_s "" 0x60e40 N_32 _REC_AXS_20_u1 8160. _CNV_A_R_LINEAR_____15_CM 8 0. 8160. FORMAT "%4.0" /end AXIS_PTS
/begin AXIS_PTS ldp_vls_down_ip_lamb_rgn "" 0x60f62 VLS_DOWN _REC_AXS_20_u2 4.99511719 _CNV_A_R_LINEAR_____38_CM 8 0. 4.99511719 FORMAT "%5.3" /end AXIS_PTS
/begin AXIS_PTS ldp_maf_ip_lamb_rgn_afr "" 0x60e72 MAF _REC_AXS_20_u1 1389. _CNV_A_R_LINEAR_____51_CM 8 0. 1389. FORMAT "%4.0" /end AXIS_PTS
/begin AXIS_PTS ldpm_n_32__egr_ratio_s "" 0x611d1 N_32 _REC_AXS_20_u1 8160. _CNV_A_R_LINEAR_____15_CM 12 0. 8160. FORMAT "%4.0" /end AXIS_PTS
/begin AXIS_PTS ldpm_mff_sp_s__egr_ratio_s "" 0x611de MFF_SP_S _REC_AXS_20_u2 1389. _CNV_A_R_LINEAR_____56_CM 12 0. 1389. FORMAT "%7.2" /end AXIS_PTS
/begin AXIS_PTS ldpm_maf__egr_ratio_hom "" 0x611aa MAF _REC_AXS_20_u2 1389. _CNV_A_R_LINEAR_____56_CM 12 0. 1389. FORMAT "%7.2" /end AXIS_PTS
/begin AXIS_PTS ldp_maf_ip_egr_ratio_min "" 0x611f8 MAF _REC_AXS_20_u2 1389. _CNV_A_R_LINEAR_____56_CM 4 0. 1389. FORMAT "%7.2" /end AXIS_PTS
/begin AXIS_PTS ldpm_n_32__egr_ratio_hom "" 0x611c4 N_32 _REC_AXS_20_u1 8160. _CNV_A_R_LINEAR_____15_CM 12 0. 8160. FORMAT "%4.0" /end AXIS_PTS
/begin AXIS_PTS ldp_maf_ip_er_std_thd "" 0x6121c MAF _REC_AXS_20_u2 1389. _CNV_A_R_LINEAR_____56_CM 2 0. 1389. FORMAT "%7.2" /end AXIS_PTS
/begin AXIS_PTS ldp_n_32_ip_egr_ratio_min "" 0x61202 N_32 _REC_AXS_20_u1 8160. _CNV_A_R_LINEAR_____15_CM 4 0. 8160. FORMAT "%4.0" /end AXIS_PTS
/begin AXIS_PTS ldp_n_32_ip_er_std_thd "" 0x61222 N_32 _REC_AXS_20_u1 8160. _CNV_A_R_LINEAR_____15_CM 2 0. 8160. FORMAT "%4.0" /end AXIS_PTS
/begin AXIS_PTS ldp_maf_cyl__egr_ratio_inc "" 0x6120e MAF_CYL _REC_AXS_20_u2 2047.96875 _CNV_A_R_LINEAR_____52_CM 6 0. 2047.96875 FORMAT "%7.2" /end AXIS_PTS
/begin AXIS_PTS ldp_ar_red_sp_egr_stk_sp_egr "" 0x61234 AR_RED_SP_EGR _REC_AXS_20_u2 58.592855 _CNV_A_R_LINEAR_____286_CM 12 0. 58.592855 FORMAT "%7.4" /end AXIS_PTS
/begin AXIS_PTS ldpm_stk_dif_egr "" 0x6124e STK_DIF_EGR _REC_AXS_20_u1 99.609375 _CNV_A_R_LINEAR_____279_CM 9 -50. 49.609375 FORMAT "%6.2" /end AXIS_PTS
/begin AXIS_PTS ldp_stk_sp_egr__egrpwm_prev "" 0x61258 STK_SP_EGR _REC_AXS_20_u1 99.609375 _CNV_A_R_LINEAR_____16_CM 12 0. 99.609375 FORMAT "%4.1" /end AXIS_PTS
/begin AXIS_PTS ldpm_er_egr "" 0x61226 ER_EGR _REC_AXS_20_u2 651.55 _CNV_A_R_LINEAR_____318_CM 6 -325.78 325.77 FORMAT "%8.3" /end AXIS_PTS
/begin AXIS_PTS ldpm_lamb_ratio "" 0x61286 LAMB_RATIO _REC_AXS_20_u2 4. _CNV_A_R_LINEAR_____185_CM 8 -2. 2. FORMAT "%8.5" /end AXIS_PTS
/begin AXIS_PTS ldpm_tco__iga_egr "" 0x61265 TCO _REC_AXS_20_u1 190.5 _CNV_A_R_LINEAR_____22_CM 8 -48. 142.5 FORMAT "%5.1" /end AXIS_PTS
/begin AXIS_PTS ldp_n_32__iga_egr_afr "" 0x6126e N_32 _REC_AXS_20_u1 8160. _CNV_A_R_LINEAR_____15_CM 5 0. 8160. FORMAT "%4.0" /end AXIS_PTS
/begin AXIS_PTS ldpm_maf__iga_egr "" 0x6127a MAF _REC_AXS_20_u2 1389. _CNV_A_R_LINEAR_____56_CM 5 0. 1389. FORMAT "%7.2" /end AXIS_PTS
/begin AXIS_PTS ldp_n_32__iga_egr_afl "" 0x61274 N_32 _REC_AXS_20_u1 8160. _CNV_A_R_LINEAR_____15_CM 5 0. 8160. FORMAT "%4.0" /end AXIS_PTS
/begin AXIS_PTS ldp_n_32__iga_egr_s "" 0x612a4 N_32 _REC_AXS_20_u1 8160. _CNV_A_R_LINEAR_____15_CM 5 0. 8160. FORMAT "%4.0" /end AXIS_PTS
/begin AXIS_PTS ldp_mff_sp_s__egr_iga "" 0x61298 MFF_SP_S _REC_AXS_20_u2 1389. _CNV_A_R_LINEAR_____56_CM 5 0. 1389. FORMAT "%7.2" /end AXIS_PTS
/begin AXIS_PTS ldp_tco__fac_tco_egr "" 0x61207 TCO _REC_AXS_20_u1 190.5 _CNV_A_R_LINEAR_____22_CM 6 -48. 142.5 FORMAT "%5.1" /end AXIS_PTS
/begin AXIS_PTS ldpm_n_32_maf_sa_deac "" 0x612aa N_32 _REC_AXS_20_u1 8160. _CNV_A_R_LINEAR_____15_CM 8 0. 8160. FORMAT "%4.0" /end AXIS_PTS
/begin AXIS_PTS ldpm_n_32_maf_sa_act "" 0x612b3 N_32 _REC_AXS_20_u1 8160. _CNV_A_R_LINEAR_____15_CM 8 0. 8160. FORMAT "%4.0" /end AXIS_PTS
/begin AXIS_PTS ldp_maf_cyl__saf_mdl "secondary air mass flow depending of MAF_CYL" 0x612bc MAF_CYL _REC_AXS_20_u2 2047.96875 _CNV_A_R_LINEAR_____52_CM 8 0. 2047.96875 FORMAT "%7.2" /end AXIS_PTS
/begin AXIS_PTS ldp_amp__saf_cor_amp "correction of secondary air mass flow depending of ambient pressure" 0x612d8 AMP _REC_AXS_20_u2 5434. _CNV_A_R_LINEAR_____1_CM 8 0. 5434. FORMAT "%7.2" /end AXIS_PTS
/begin AXIS_PTS ldp_vb__saf_cor_vb "correction of secondary air mass flow depending of battery voltage" 0x612ce VB _REC_AXS_20_u1 26. _CNV_A_R_LINEAR_____188_CM 8 0. 26. FORMAT "%4.1" /end AXIS_PTS
/begin AXIS_PTS ldp_tia__saf_cor_tia "correction of secondary air mass flow depending of ambient temperature" 0x612ea TIA _REC_AXS_20_u1 190.5 _CNV_A_R_LINEAR_____22_CM 8 -48. 142.5 FORMAT "%5.1" /end AXIS_PTS
/begin AXIS_PTS ldp_fmy_dtc "" 0x69b92 DTC _REC_AXS_20_u2 5. _CNV_S_6_RANGE_FMY__320_CM 6 0. 5. /end AXIS_PTS
/begin MEASUREMENT ERR_INFO_STAT "" UWORD _CNV_S_2_RANGE______77_R_CM 1 100. 0. 255. ECU_ADDRESS 0x3fc2e2 /end MEASUREMENT
/begin MEASUREMENT ERR_INFO_STAT "" UWORD _CNV_S_2_RANGE______77_R_CM 1 100. 0. 255. ECU_ADDRESS 0x3fc2ee /end MEASUREMENT
/begin MEASUREMENT ERR_INFO_STAT "" UWORD _CNV_S_2_RANGE______77_R_CM 1 100. 0. 255. ECU_ADDRESS 0x3fc2f4 /end MEASUREMENT
/begin MEASUREMENT ERR_INFO_STAT "" UWORD _CNV_S_2_RANGE______77_R_CM 1 100. 0. 255. ECU_ADDRESS 0x3fc2fa /end MEASUREMENT
/begin MEASUREMENT ERR_INFO_STAT "" UWORD _CNV_S_2_RANGE______77_R_CM 1 100. 0. 255. ECU_ADDRESS 0x3fc300 /end MEASUREMENT
/begin MEASUREMENT ERR_INFO_STAT "" UWORD _CNV_S_2_RANGE______77_R_CM 1 100. 0. 255. ECU_ADDRESS 0x3fc306 /end MEASUREMENT
/begin MEASUREMENT ERR_INFO_STAT "" UWORD _CNV_S_2_RANGE______77_R_CM 1 100. 0. 255. ECU_ADDRESS 0x3fc30c /end MEASUREMENT
/begin MEASUREMENT ERR_INFO_STAT "" UWORD _CNV_S_2_RANGE______77_R_CM 1 100. 0. 255. ECU_ADDRESS 0x3fc312 /end MEASUREMENT
/begin MEASUREMENT ERR_INFO_STAT "" UWORD _CNV_S_2_RANGE______77_R_CM 1 100. 0. 255. ECU_ADDRESS 0x3fc318 /end MEASUREMENT
/begin MEASUREMENT ERR_INFO_STAT "" UWORD _CNV_S_2_RANGE______77_R_CM 1 100. 0. 255. ECU_ADDRESS 0x3fc31e /end MEASUREMENT
/begin MEASUREMENT ERR_INFO_STAT "" UWORD _CNV_S_2_RANGE______77_R_CM 1 100. 0. 255. ECU_ADDRESS 0x3fc324 /end MEASUREMENT
/begin MEASUREMENT ERR_INFO_STAT "" UWORD _CNV_S_2_RANGE______77_R_CM 1 100. 0. 255. ECU_ADDRESS 0x3fc32a /end MEASUREMENT
/begin MEASUREMENT ERR_INFO_STAT "" UWORD _CNV_S_2_RANGE______77_R_CM 1 100. 0. 255. ECU_ADDRESS 0x3fc330 /end MEASUREMENT
/begin MEASUREMENT ERR_INFO_STAT "" UWORD _CNV_S_2_RANGE______77_R_CM 1 100. 0. 255. ECU_ADDRESS 0x3fc336 /end MEASUREMENT
/begin MEASUREMENT ERR_INFO_STAT "" UWORD _CNV_S_2_RANGE______77_R_CM 1 100. 0. 255. ECU_ADDRESS 0x3fc33c /end MEASUREMENT
/begin MEASUREMENT ERR_INFO_STAT "" UWORD _CNV_S_2_RANGE______77_R_CM 1 100. 0. 255. ECU_ADDRESS 0x3fc342 /end MEASUREMENT
/begin MEASUREMENT ERR_INFO_STAT "" UWORD _CNV_S_2_RANGE______77_R_CM 1 100. 0. 255. ECU_ADDRESS 0x3fc348 /end MEASUREMENT
/begin MEASUREMENT ERR_INFO_STAT "" UWORD _CNV_S_2_RANGE______77_R_CM 1 100. 0. 255. ECU_ADDRESS 0x3fc34e /end MEASUREMENT
/begin MEASUREMENT ERR_INFO_STAT "" UWORD _CNV_S_2_RANGE______77_R_CM 1 100. 0. 255. ECU_ADDRESS 0x3fc354 /end MEASUREMENT
/begin MEASUREMENT ERR_INFO_STAT "" UWORD _CNV_S_2_RANGE______77_R_CM 1 100. 0. 255. ECU_ADDRESS 0x3fc35a /end MEASUREMENT
/begin MEASUREMENT ERR_INFO_STAT "" UWORD _CNV_S_2_RANGE______77_R_CM 1 100. 0. 255. ECU_ADDRESS 0x3fc360 /end MEASUREMENT
/begin MEASUREMENT ERR_INFO_STAT "" UWORD _CNV_S_2_RANGE______77_R_CM 1 100. 0. 255. ECU_ADDRESS 0x3fc366 /end MEASUREMENT
/begin MEASUREMENT ERR_INFO_STAT "" UWORD _CNV_S_2_RANGE______77_R_CM 1 100. 0. 255. ECU_ADDRESS 0x3fc36c /end MEASUREMENT
/begin MEASUREMENT ERR_INFO_STAT "" UWORD _CNV_S_2_RANGE______77_R_CM 1 100. 0. 255. ECU_ADDRESS 0x3fc372 /end MEASUREMENT
/begin MEASUREMENT ERR_INFO_STAT "" UWORD _CNV_S_2_RANGE______77_R_CM 1 100. 0. 255. ECU_ADDRESS 0x3fc378 /end MEASUREMENT
/begin MEASUREMENT ERR_INFO_STAT "" UWORD _CNV_S_2_RANGE______77_R_CM 1 100. 0. 255. ECU_ADDRESS 0x3fc37e /end MEASUREMENT
/begin MEASUREMENT ERR_INFO_STAT "" UWORD _CNV_S_2_RANGE______77_R_CM 1 100. 0. 255. ECU_ADDRESS 0x3fc384 /end MEASUREMENT
/begin MEASUREMENT ERR_INFO_STAT "" UWORD _CNV_S_2_RANGE______77_R_CM 1 100. 0. 255. ECU_ADDRESS 0x3fc38a /end MEASUREMENT
/begin MEASUREMENT ERR_INFO_STAT "" UWORD _CNV_S_2_RANGE______77_R_CM 1 100. 0. 255. ECU_ADDRESS 0x3fc390 /end MEASUREMENT
/begin MEASUREMENT ERR_INFO_STAT "" UWORD _CNV_S_2_RANGE______77_R_CM 1 100. 0. 255. ECU_ADDRESS 0x3fc396 /end MEASUREMENT
/begin MEASUREMENT ERR_INFO_STAT "" UWORD _CNV_S_2_RANGE______77_R_CM 1 100. 0. 255. ECU_ADDRESS 0x3fc39c /end MEASUREMENT
/begin MEASUREMENT ERR_INFO_STAT "" UWORD _CNV_S_2_RANGE______77_R_CM 1 100. 0. 255. ECU_ADDRESS 0x3fc3a2 /end MEASUREMENT
/begin MEASUREMENT ERR_INFO_STAT "" UWORD _CNV_S_2_RANGE______77_R_CM 1 100. 0. 255. ECU_ADDRESS 0x3fc3a8 /end MEASUREMENT
/begin MEASUREMENT ERR_INFO_STAT "" UWORD _CNV_S_2_RANGE______77_R_CM 1 100. 0. 255. ECU_ADDRESS 0x3fc3ae /end MEASUREMENT
/begin MEASUREMENT ERR_INFO_STAT "" UWORD _CNV_S_2_RANGE______77_R_CM 1 100. 0. 255. ECU_ADDRESS 0x3fc3b4 /end MEASUREMENT
/begin MEASUREMENT ERR_INFO_STAT "" UWORD _CNV_S_2_RANGE______77_R_CM 1 100. 0. 255. ECU_ADDRESS 0x3fc3ba /end MEASUREMENT
/begin MEASUREMENT ERR_INFO_STAT "" UWORD _CNV_S_2_RANGE______77_R_CM 1 100. 0. 255. ECU_ADDRESS 0x3fc3c0 /end MEASUREMENT
/begin MEASUREMENT ERR_INFO_STAT "" UWORD _CNV_S_2_RANGE______77_R_CM 1 100. 0. 255. ECU_ADDRESS 0x3fc3c6 /end MEASUREMENT
/begin MEASUREMENT ERR_INFO_STAT "" UWORD _CNV_S_2_RANGE______77_R_CM 1 100. 0. 255. ECU_ADDRESS 0x3fc3cc /end MEASUREMENT
/begin MEASUREMENT ERR_INFO_STAT "" UWORD _CNV_S_2_RANGE______77_R_CM 1 100. 0. 255. ECU_ADDRESS 0x3fc3d2 /end MEASUREMENT
/begin MEASUREMENT ERR_INFO_STAT "" UWORD _CNV_S_2_RANGE______77_R_CM 1 100. 0. 255. ECU_ADDRESS 0x3fc3d8 /end MEASUREMENT
/begin MEASUREMENT ERR_INFO_STAT "" UWORD _CNV_S_2_RANGE______77_R_CM 1 100. 0. 255. ECU_ADDRESS 0x3fc3de /end MEASUREMENT
/begin MEASUREMENT ERR_INFO_STAT "" UWORD _CNV_S_2_RANGE______77_R_CM 1 100. 0. 255. ECU_ADDRESS 0x3fc3e4 /end MEASUREMENT
/begin MEASUREMENT ERR_INFO_STAT "" UWORD _CNV_S_2_RANGE______77_R_CM 1 100. 0. 255. ECU_ADDRESS 0x3fc3ea /end MEASUREMENT
/begin MEASUREMENT ERR_INFO_STAT "" UWORD _CNV_S_2_RANGE______77_R_CM 1 100. 0. 255. ECU_ADDRESS 0x3fc3f0 /end MEASUREMENT
/begin MEASUREMENT ERR_INFO_STAT "" UWORD _CNV_S_2_RANGE______77_R_CM 1 100. 0. 255. ECU_ADDRESS 0x3fc3f6 /end MEASUREMENT
/begin MEASUREMENT ERR_INFO_STAT "" UWORD _CNV_S_2_RANGE______77_R_CM 1 100. 0. 255. ECU_ADDRESS 0x3fc3fc /end MEASUREMENT
/begin MEASUREMENT ERR_INFO_STAT "" UWORD _CNV_S_2_RANGE______77_R_CM 1 100. 0. 255. ECU_ADDRESS 0x3fc402 /end MEASUREMENT
/begin MEASUREMENT ERR_INFO_STAT "" UWORD _CNV_S_2_RANGE______77_R_CM 1 100. 0. 255. ECU_ADDRESS 0x3fc408 /end MEASUREMENT
/begin MEASUREMENT ERR_INFO_STAT "" UWORD _CNV_S_2_RANGE______77_R_CM 1 100. 0. 255. ECU_ADDRESS 0x3fc40e /end MEASUREMENT
/begin MEASUREMENT ERR_INFO_STAT "" UWORD _CNV_S_2_RANGE______77_R_CM 1 100. 0. 255. ECU_ADDRESS 0x3fc414 /end MEASUREMENT
/begin MEASUREMENT ERR_INFO_STAT "" UWORD _CNV_S_2_RANGE______77_R_CM 1 100. 0. 255. ECU_ADDRESS 0x3fc41a /end MEASUREMENT
/begin MEASUREMENT ERR_INFO_STAT "" UWORD _CNV_S_2_RANGE______77_R_CM 1 100. 0. 255. ECU_ADDRESS 0x3fc420 /end MEASUREMENT
/begin MEASUREMENT ERR_INFO_STAT "" UWORD _CNV_S_2_RANGE______77_R_CM 1 100. 0. 255. ECU_ADDRESS 0x3fc426 /end MEASUREMENT
/begin MEASUREMENT ERR_INFO_STAT "" UWORD _CNV_S_2_RANGE______77_R_CM 1 100. 0. 255. ECU_ADDRESS 0x3fc42c /end MEASUREMENT
/begin MEASUREMENT ERR_INFO_STAT "" UWORD _CNV_S_2_RANGE______77_R_CM 1 100. 0. 255. ECU_ADDRESS 0x3fc432 /end MEASUREMENT
/begin MEASUREMENT ERR_INFO_STAT "" UWORD _CNV_S_2_RANGE______77_R_CM 1 100. 0. 255. ECU_ADDRESS 0x3fc438 /end MEASUREMENT
/begin MEASUREMENT ERR_INFO_STAT "" UWORD _CNV_S_2_RANGE______77_R_CM 1 100. 0. 255. ECU_ADDRESS 0x3fc43e /end MEASUREMENT
/begin MEASUREMENT ERR_INFO_STAT "" UWORD _CNV_S_2_RANGE______77_R_CM 1 100. 0. 255. ECU_ADDRESS 0x3fc444 /end MEASUREMENT
/begin MEASUREMENT ERR_INFO_STAT "" UWORD _CNV_S_2_RANGE______77_R_CM 1 100. 0. 255. ECU_ADDRESS 0x3fc44a /end MEASUREMENT
/begin MEASUREMENT ERR_INFO_STAT "" UWORD _CNV_S_2_RANGE______77_R_CM 1 100. 0. 255. ECU_ADDRESS 0x3fc450 /end MEASUREMENT
/begin MEASUREMENT ERR_INFO_STAT "" UWORD _CNV_S_2_RANGE______77_R_CM 1 100. 0. 255. ECU_ADDRESS 0x3fc456 /end MEASUREMENT
/begin MEASUREMENT ERR_INFO_STAT "" UWORD _CNV_S_2_RANGE______77_R_CM 1 100. 0. 255. ECU_ADDRESS 0x3fc45c /end MEASUREMENT
/begin MEASUREMENT ERR_INFO_STAT "" UWORD _CNV_S_2_RANGE______77_R_CM 1 100. 0. 255. ECU_ADDRESS 0x3fc462 /end MEASUREMENT
/begin MEASUREMENT ERR_INFO_STAT "" UWORD _CNV_S_2_RANGE______77_R_CM 1 100. 0. 255. ECU_ADDRESS 0x3fc468 /end MEASUREMENT
/begin MEASUREMENT ERR_INFO_STAT "" UWORD _CNV_S_2_RANGE______77_R_CM 1 100. 0. 255. ECU_ADDRESS 0x3fc46e /end MEASUREMENT
/begin MEASUREMENT ERR_INFO_STAT "" UWORD _CNV_S_2_RANGE______77_R_CM 1 100. 0. 255. ECU_ADDRESS 0x3fc474 /end MEASUREMENT
/begin MEASUREMENT ERR_INFO_STAT "" UWORD _CNV_S_2_RANGE______77_R_CM 1 100. 0. 255. ECU_ADDRESS 0x3fc47a /end MEASUREMENT
/begin MEASUREMENT ERR_INFO_STAT "" UWORD _CNV_S_2_RANGE______77_R_CM 1 100. 0. 255. ECU_ADDRESS 0x3fc480 /end MEASUREMENT
/begin MEASUREMENT ERR_INFO_STAT "" UWORD _CNV_S_2_RANGE______77_R_CM 1 100. 0. 255. ECU_ADDRESS 0x3fc486 /end MEASUREMENT
/begin MEASUREMENT ERR_INFO_STAT "" UWORD _CNV_S_2_RANGE______77_R_CM 1 100. 0. 255. ECU_ADDRESS 0x3fc48c /end MEASUREMENT
/begin MEASUREMENT ERR_INFO_STAT "" UWORD _CNV_S_2_RANGE______77_R_CM 1 100. 0. 255. ECU_ADDRESS 0x3fc492 /end MEASUREMENT
/begin MEASUREMENT ERR_INFO_STAT "" UWORD _CNV_S_2_RANGE______77_R_CM 1 100. 0. 255. ECU_ADDRESS 0x3fc498 /end MEASUREMENT
/begin MEASUREMENT ERR_INFO_STAT "" UWORD _CNV_S_2_RANGE______77_R_CM 1 100. 0. 255. ECU_ADDRESS 0x3fc49e /end MEASUREMENT
/begin MEASUREMENT ERR_INFO_STAT "" UWORD _CNV_S_2_RANGE______77_R_CM 1 100. 0. 255. ECU_ADDRESS 0x3fc4a4 /end MEASUREMENT
/begin MEASUREMENT ERR_INFO_STAT "" UWORD _CNV_S_2_RANGE______77_R_CM 1 100. 0. 255. ECU_ADDRESS 0x3fc4aa /end MEASUREMENT
/begin MEASUREMENT ERR_INFO_STAT "" UWORD _CNV_S_2_RANGE______77_R_CM 1 100. 0. 255. ECU_ADDRESS 0x3fc4b0 /end MEASUREMENT
/begin MEASUREMENT ERR_INFO_STAT "" UWORD _CNV_S_2_RANGE______77_R_CM 1 100. 0. 255. ECU_ADDRESS 0x3fc4b6 /end MEASUREMENT
/begin MEASUREMENT ERR_INFO_STAT "" UWORD _CNV_S_2_RANGE______77_R_CM 1 100. 0. 255. ECU_ADDRESS 0x3fc4bc /end MEASUREMENT
/begin MEASUREMENT ERR_INFO_STAT "" UWORD _CNV_S_2_RANGE______77_R_CM 1 100. 0. 255. ECU_ADDRESS 0x3fc4c2 /end MEASUREMENT
/begin MEASUREMENT ERR_INFO_STAT "" UWORD _CNV_S_2_RANGE______77_R_CM 1 100. 0. 255. ECU_ADDRESS 0x3fc4c8 /end MEASUREMENT
/begin MEASUREMENT ERR_INFO_STAT "" UWORD _CNV_S_2_RANGE______77_R_CM 1 100. 0. 255. ECU_ADDRESS 0x3fc4ce /end MEASUREMENT
/begin MEASUREMENT ERR_INFO_STAT "" UWORD _CNV_S_2_RANGE______77_R_CM 1 100. 0. 255. ECU_ADDRESS 0x3fc4d4 /end MEASUREMENT
/begin MEASUREMENT ERR_INFO_STAT "" UWORD _CNV_S_2_RANGE______77_R_CM 1 100. 0. 255. ECU_ADDRESS 0x3fc4da /end MEASUREMENT
/begin MEASUREMENT ERR_INFO_STAT "" UWORD _CNV_S_2_RANGE______77_R_CM 1 100. 0. 255. ECU_ADDRESS 0x3fc4e0 /end MEASUREMENT
/begin MEASUREMENT ERR_INFO_STAT "" UWORD _CNV_S_2_RANGE______77_R_CM 1 100. 0. 255. ECU_ADDRESS 0x3fc4e6 /end MEASUREMENT
/begin MEASUREMENT ERR_INFO_STAT "" UWORD _CNV_S_2_RANGE______77_R_CM 1 100. 0. 255. ECU_ADDRESS 0x3fc4ec /end MEASUREMENT
/begin MEASUREMENT ERR_INFO_STAT "" UWORD _CNV_S_2_RANGE______77_R_CM 1 100. 0. 255. ECU_ADDRESS 0x3fc4f2 /end MEASUREMENT
/begin MEASUREMENT ERR_INFO_STAT "" UWORD _CNV_S_2_RANGE______77_R_CM 1 100. 0. 255. ECU_ADDRESS 0x3fc4f8 /end MEASUREMENT
/begin MEASUREMENT ERR_INFO_STAT "" UWORD _CNV_S_2_RANGE______77_R_CM 1 100. 0. 255. ECU_ADDRESS 0x3fc4fe /end MEASUREMENT
/begin MEASUREMENT ERR_INFO_STAT "" UWORD _CNV_S_2_RANGE______77_R_CM 1 100. 0. 255. ECU_ADDRESS 0x3fc504 /end MEASUREMENT
/begin MEASUREMENT ERR_INFO_STAT "" UWORD _CNV_S_2_RANGE______77_R_CM 1 100. 0. 255. ECU_ADDRESS 0x3fc50a /end MEASUREMENT
/begin MEASUREMENT ERR_INFO_STAT "" UWORD _CNV_S_2_RANGE______77_R_CM 1 100. 0. 255. ECU_ADDRESS 0x3fc510 /end MEASUREMENT
/begin MEASUREMENT ERR_INFO_STAT "" UWORD _CNV_S_2_RANGE______77_R_CM 1 100. 0. 255. ECU_ADDRESS 0x3fc516 /end MEASUREMENT
/begin MEASUREMENT ERR_INFO_STAT "" UWORD _CNV_S_2_RANGE______77_R_CM 1 100. 0. 255. ECU_ADDRESS 0x3fc51c /end MEASUREMENT
/begin MEASUREMENT ERR_INFO_STAT "" UWORD _CNV_S_2_RANGE______77_R_CM 1 100. 0. 255. ECU_ADDRESS 0x3fc522 /end MEASUREMENT
/begin MEASUREMENT ERR_INFO_DYN "" UWORD _CNV_S_2_RANGE______77_R_CM 1 100. 0. 255. ECU_ADDRESS 0x3fc286 /end MEASUREMENT
/begin MEASUREMENT ERR_INFO_DYN "" UWORD _CNV_S_2_RANGE______77_R_CM 1 100. 0. 255. ECU_ADDRESS 0x3fc290 /end MEASUREMENT
/begin MEASUREMENT ERR_INFO_DYN "" UWORD _CNV_S_2_RANGE______77_R_CM 1 100. 0. 255. ECU_ADDRESS 0x3fc29a /end MEASUREMENT
/begin MEASUREMENT ERR_INFO_DYN "" UWORD _CNV_S_2_RANGE______77_R_CM 1 100. 0. 255. ECU_ADDRESS 0x3fc2a4 /end MEASUREMENT
/begin MEASUREMENT ERR_INFO_DYN "" UWORD _CNV_S_2_RANGE______77_R_CM 1 100. 0. 255. ECU_ADDRESS 0x3fc2ae /end MEASUREMENT
/begin MEASUREMENT ERR_INFO_DYN "" UWORD _CNV_S_2_RANGE______77_R_CM 1 100. 0. 255. ECU_ADDRESS 0x3fc2b8 /end MEASUREMENT
/begin MEASUREMENT ERR_INFO_DYN "" UWORD _CNV_S_2_RANGE______77_R_CM 1 100. 0. 255. ECU_ADDRESS 0x3fc2c2 /end MEASUREMENT
/begin MEASUREMENT ERR_INFO_DYN "" UWORD _CNV_S_2_RANGE______77_R_CM 1 100. 0. 255. ECU_ADDRESS 0x3fc2cc /end MEASUREMENT
/begin MEASUREMENT ERR_INFO_DYN "" UWORD _CNV_S_2_RANGE______77_R_CM 1 100. 0. 255. ECU_ADDRESS 0x3fc2d6 /end MEASUREMENT
/begin CHARACTERISTIC LC_FMY_CLR "logical constant to clear the error-memory" VALUE 0x69246 _REC_VAL_20_u1 1. _CNV_A_R_LINEAR_____17_CM 0. 1. FORMAT "%2.0" /end CHARACTERISTIC
/begin MEASUREMENT ERR_INFO_STAT "" UWORD _CNV_S_2_RANGE______77_R_CM 1 100. 0. 255. ECU_ADDRESS 0x3fc528 /end MEASUREMENT
/begin MEASUREMENT ERR_INFO_STAT "" UWORD _CNV_S_2_RANGE______77_R_CM 1 100. 0. 255. ECU_ADDRESS 0x3fc52e /end MEASUREMENT
/begin AXIS_PTS ldp_fmy_envd "" 0x69b8d ENVD _REC_AXS_20_u1 3. _CNV_S_4_RANGE_FMY__322_CM 4 0. 3. /end AXIS_PTS
/begin MEASUREMENT ERR_INFO_STAT "" UWORD _CNV_S_2_RANGE______77_R_CM 1 100. 0. 255. ECU_ADDRESS 0x3fc2e8 /end MEASUREMENT
/begin MEASUREMENT ERR_INFO_STAT "" UWORD _CNV_S_2_RANGE______77_R_CM 1 100. 0. 255. ECU_ADDRESS 0x3fc5b2 /end MEASUREMENT
/begin MEASUREMENT ERR_INFO_STAT "" UWORD _CNV_S_2_RANGE______77_R_CM 1 100. 0. 255. ECU_ADDRESS 0x3fc56a /end MEASUREMENT
/begin MEASUREMENT ERR_INFO_STAT "" UWORD _CNV_S_2_RANGE______77_R_CM 1 100. 0. 255. ECU_ADDRESS 0x3fc570 /end MEASUREMENT
/begin MEASUREMENT ERR_INFO_STAT "" UWORD _CNV_S_2_RANGE______77_R_CM 1 100. 0. 255. ECU_ADDRESS 0x3fc576 /end MEASUREMENT
/begin MEASUREMENT ERR_INFO_STAT "" UWORD _CNV_S_2_RANGE______77_R_CM 1 100. 0. 255. ECU_ADDRESS 0x3fc57c /end MEASUREMENT
/begin MEASUREMENT ERR_INFO_STAT "" UWORD _CNV_S_2_RANGE______77_R_CM 1 100. 0. 255. ECU_ADDRESS 0x3fc582 /end MEASUREMENT
/begin MEASUREMENT ERR_INFO_STAT "" UWORD _CNV_S_2_RANGE______77_R_CM 1 100. 0. 255. ECU_ADDRESS 0x3fc588 /end MEASUREMENT
/begin MEASUREMENT ERR_INFO_STAT "" UWORD _CNV_S_2_RANGE______77_R_CM 1 100. 0. 255. ECU_ADDRESS 0x3fc58e /end MEASUREMENT
/begin MEASUREMENT ERR_INFO_STAT "" UWORD _CNV_S_2_RANGE______77_R_CM 1 100. 0. 255. ECU_ADDRESS 0x3fc594 /end MEASUREMENT
/begin MEASUREMENT ERR_INFO_STAT "" UWORD _CNV_S_2_RANGE______77_R_CM 1 100. 0. 255. ECU_ADDRESS 0x3fc59a /end MEASUREMENT
/begin MEASUREMENT ERR_INFO_STAT "" UWORD _CNV_S_2_RANGE______77_R_CM 1 100. 0. 255. ECU_ADDRESS 0x3fc5a0 /end MEASUREMENT
/begin MEASUREMENT ERR_INFO_STAT "" UWORD _CNV_S_2_RANGE______77_R_CM 1 100. 0. 255. ECU_ADDRESS 0x3fc5a6 /end MEASUREMENT
/begin MEASUREMENT ERR_INFO_STAT "" UWORD _CNV_S_2_RANGE______77_R_CM 1 100. 0. 255. ECU_ADDRESS 0x3fc5ac /end MEASUREMENT
/begin MEASUREMENT ERR_INFO_STAT "" UWORD _CNV_S_2_RANGE______77_R_CM 1 100. 0. 255. ECU_ADDRESS 0x3fc564 /end MEASUREMENT
/begin MEASUREMENT ERR_INFO_STAT "" UWORD _CNV_S_2_RANGE______77_R_CM 1 100. 0. 255. ECU_ADDRESS 0x3fc558 /end MEASUREMENT
/begin MEASUREMENT ERR_INFO_STAT "" UWORD _CNV_S_2_RANGE______77_R_CM 1 100. 0. 255. ECU_ADDRESS 0x3fc55e /end MEASUREMENT
/begin MEASUREMENT ERR_INFO_STAT "" UWORD _CNV_S_2_RANGE______77_R_CM 1 100. 0. 255. ECU_ADDRESS 0x3fc552 /end MEASUREMENT
/begin MEASUREMENT ERR_INFO_STAT "" UWORD _CNV_S_2_RANGE______77_R_CM 1 100. 0. 255. ECU_ADDRESS 0x3fc54c /end MEASUREMENT
/begin MEASUREMENT ERR_INFO_STAT "" UWORD _CNV_S_2_RANGE______77_R_CM 1 100. 0. 255. ECU_ADDRESS 0x3fc546 /end MEASUREMENT
/begin MEASUREMENT ERR_INFO_STAT "" UWORD _CNV_S_2_RANGE______77_R_CM 1 100. 0. 255. ECU_ADDRESS 0x3fc540 /end MEASUREMENT
/begin MEASUREMENT ERR_INFO_STAT "" UWORD _CNV_S_2_RANGE______77_R_CM 1 100. 0. 255. ECU_ADDRESS 0x3fc53a /end MEASUREMENT
/begin MEASUREMENT ERR_INFO_STAT "" UWORD _CNV_S_2_RANGE______77_R_CM 1 100. 0. 255. ECU_ADDRESS 0x3fc534 /end MEASUREMENT
/begin CHARACTERISTIC C_N_OFS_ACC_DRI_MAX "idle speed setpoint offset maximum threshold at LV_ACIN = 1 and LV_DRI = 1" VALUE 0x6464c _REC_VAL_20_s2 65535. _CNV_A_R_LINEAR_____0_CM -32768. 32767. FORMAT "%6.0" /end CHARACTERISTIC
/begin CHARACTERISTIC C_N_OFS_ACC_DRI_MIN "idle speed setpoint offset minimum threshold at LV_ACIN = 1 and LV_DRI = 1" VALUE 0x6464e _REC_VAL_20_s2 65535. _CNV_A_R_LINEAR_____0_CM -32768. 32767. FORMAT "%6.0" /end CHARACTERISTIC
/begin CHARACTERISTIC C_N_OFS_DRI_MAX "idle speed setpoint offset maximum threshold at LV_ACIN = 0 and LV_DRI = 1" VALUE 0x64650 _REC_VAL_20_s2 65535. _CNV_A_R_LINEAR_____0_CM -32768. 32767. FORMAT "%6.0" /end CHARACTERISTIC
/begin CHARACTERISTIC C_N_OFS_DRI_MIN "idle speed setpoint offset minimum threshold at LV_ACIN = 0 and LV_DRI = 1" VALUE 0x64652 _REC_VAL_20_s2 65535. _CNV_A_R_LINEAR_____0_CM -32768. 32767. FORMAT "%6.0" /end CHARACTERISTIC
/begin CHARACTERISTIC C_N_OFS_MAX "idle speed setpoint offset maximum threshold at LV_ACIN = 0 and LV_DRI = 0" VALUE 0x64654 _REC_VAL_20_s2 65535. _CNV_A_R_LINEAR_____0_CM -32768. 32767. FORMAT "%6.0" /end CHARACTERISTIC
/begin CHARACTERISTIC C_N_OFS_MIN "idle speed setpoint offset minimum threshold at LV_ACIN = 0 and LV_DRI = 0" VALUE 0x64656 _REC_VAL_20_s2 65535. _CNV_A_R_LINEAR_____0_CM -32768. 32767. FORMAT "%6.0" /end CHARACTERISTIC
/begin CHARACTERISTIC C_N_OFS_ACC_MAX "idle speed setpoint offset maximum threshold at LV_ACIN = 1 and LV_DRI = 0" VALUE 0x64658 _REC_VAL_20_s2 65535. _CNV_A_R_LINEAR_____0_CM -32768. 32767. FORMAT "%6.0" /end CHARACTERISTIC
/begin CHARACTERISTIC C_N_OFS_ACC_MIN "idle speed setpoint offset minimum threshold at LV_ACIN = 1 and LV_DRI = 0" VALUE 0x6465a _REC_VAL_20_s2 65535. _CNV_A_R_LINEAR_____0_CM -32768. 32767. FORMAT "%6.0" /end CHARACTERISTIC
/begin CHARACTERISTIC C_N_OFS_VB_MAX "idle speed setpoint offset maximum threshold at battery charging is active" VALUE 0x6465c _REC_VAL_20_s2 65535. _CNV_A_R_LINEAR_____0_CM -32768. 32767. FORMAT "%6.0" /end CHARACTERISTIC
/begin MEASUREMENT LV_KWP_ENA "logical variable for idle speed setpoint offset by tester enabled" UBYTE _CNV_S_2_RANGE______74_CM 1 100. 0. 1. ECU_ADDRESS 0x3fd509 /end MEASUREMENT
/begin MEASUREMENT N_KWP_OFS_ACC "idle speed setpoint offset at LV_ACIN = 1 and LV_DRI = 0" SWORD _CNV_A_R_LINEAR_____0_CM 1 100. -32768. 32767. ECU_ADDRESS 0x3fce28 FORMAT "%6.0" /end MEASUREMENT
/begin MEASUREMENT N_KWP_OFS "idle speed setpoint offset at LV_ACIN = 0 and LV_DRI = 0" SWORD _CNV_A_R_LINEAR_____0_CM 1 100. -32768. 32767. ECU_ADDRESS 0x3fce26 FORMAT "%6.0" /end MEASUREMENT
/begin MEASUREMENT N_KWP_OFS_DRI "idle speed setpoint offset at LV_ACIN = 0 and LV_DRI = 1" SWORD _CNV_A_R_LINEAR_____0_CM 1 100. -32768. 32767. ECU_ADDRESS 0x3fce24 FORMAT "%6.0" /end MEASUREMENT
/begin MEASUREMENT N_KWP_OFS_ACC_DRI "idle speed setpoint offset at LV_ACIN = 1 and LV_DRI = 1" SWORD _CNV_A_R_LINEAR_____0_CM 1 100. -32768. 32767. ECU_ADDRESS 0x3fce22 FORMAT "%6.0" /end MEASUREMENT
/begin MEASUREMENT N_KWP_OFS_VB_NVMY_ "idle speed setpoint offset at battery charging is active stored in non volatile memory" SWORD _CNV_A_R_LINEAR_____0_CM 1 100. -32768. 32767. ECU_ADDRESS 0x3fce20 FORMAT "%6.0" /end MEASUREMENT
/begin MEASUREMENT N_KWP_OFS_ACC_NVMY_ "idle speed setpoint offset at LV_ACIN = 1 and LV_DRI = 0 stored in non volatile memory" SWORD _CNV_A_R_LINEAR_____0_CM 1 100. -32768. 32767. ECU_ADDRESS 0x3fce1e FORMAT "%6.0" /end MEASUREMENT
/begin MEASUREMENT N_KWP_OFS_NVMY_ "idle speed setpoint offset at LV_ACIN = 0 and LV_DRI = 0 stored in non volatile memory" SWORD _CNV_A_R_LINEAR_____0_CM 1 100. -32768. 32767. ECU_ADDRESS 0x3fce1c FORMAT "%6.0" /end MEASUREMENT
/begin MEASUREMENT N_KWP_OFS_DRI_NVMY_ "idle speed setpoint offset at LV_ACIN = 0 and LV_DRI = 1 stored in non volatile memory" SWORD _CNV_A_R_LINEAR_____0_CM 1 100. -32768. 32767. ECU_ADDRESS 0x3fce1a FORMAT "%6.0" /end MEASUREMENT
/begin MEASUREMENT N_KWP_OFS_ACC_DRI_NVMY "idle speed setpoint offset at LV_ACIN = 1 and LV_DRI = 1 stored in non volatile memory" SWORD _CNV_A_R_LINEAR_____0_CM 1 100. -32768. 32767. ECU_ADDRESS 0x3fce18 FORMAT "%6.0" /end MEASUREMENT
/begin MEASUREMENT N_KWP_OFS_VB "idle speed setpoint offset at battery charging is active" SWORD _CNV_A_R_LINEAR_____0_CM 1 100. -32768. 32767. ECU_ADDRESS 0x3fce2a FORMAT "%6.0" /end MEASUREMENT
/begin MEASUREMENT N_SP_OFS_KWP "idle speed setpoint offset by tester" SWORD _CNV_A_R_LINEAR_____0_CM 1 100. -32768. 32767. ECU_ADDRESS 0x3fce2c FORMAT "%6.0" /end MEASUREMENT
/begin CHARACTERISTIC C_N_OFS_VB_MIN "idle speed setpoint offset minimum threshold at battery charging is active" VALUE 0x6465e _REC_VAL_20_s2 65535. _CNV_A_R_LINEAR_____0_CM -32768. 32767. FORMAT "%6.0" /end CHARACTERISTIC
/begin CHARACTERISTIC C_TCO_MIN_N_OFS_KWP "minimum TCO threshold for idle speed setpoint offset by tester" VALUE 0x64660 _REC_VAL_20_u1 190.5 _CNV_A_R_LINEAR_____22_CM -48. 142.5 FORMAT "%5.1" /end CHARACTERISTIC
/begin CHARACTERISTIC LC_N_OFS_KWP_DISABLE "disable bit for idle speed setpoint offset by tester" VALUE 0x64662 _REC_VAL_20_u1 1. _CNV_A_R_LINEAR_____17_CM 0. 1. FORMAT "%2.0" /end CHARACTERISTIC
/begin CHARACTERISTIC C_CHA_CDN_BAT_KWP_MIN "minimum threshold for active battery charging due to enable conditions of idle speed offset by tester" VALUE 0x64661 _REC_VAL_20_u1 127. _CNV_A_R_LINEAR_____324_CM 0. 127. FORMAT "%5.1" /end CHARACTERISTIC
/begin MEASUREMENT VS_DIF_CRU "Control deviation" SWORD _CNV_A_R_LINEAR_____325_CM 1 100. -256. 255.9921875 ECU_ADDRESS 0x3fc246 FORMAT "%7.3" /end MEASUREMENT
/begin MEASUREMENT VS_DIF_I_CRU "Sum of the control deviations" SWORD _CNV_A_R_LINEAR_____326_CM 1 100. -4096. 4095.875 ECU_ADDRESS 0x3fc248 FORMAT "%7.1" /end MEASUREMENT
/begin MEASUREMENT PV_CRU "CRU control variable" UBYTE _CNV_A_R_LINEAR_____16_CM 1 100. 0. 99.609375 ECU_ADDRESS 0x3fd5ff FORMAT "%4.1" /end MEASUREMENT
/begin MEASUREMENT T_CTL_CRU "Time of the controlled acceleration" UBYTE _CNV_A_R_LINEAR_____18_CM 1 100. 0. 25.5 ECU_ADDRESS 0x3fd60f FORMAT "%4.1" /end MEASUREMENT
/begin MEASUREMENT VS_SP_CRU "Reference input variable of the controller" UWORD _CNV_A_R_LINEAR_____153_CM 1 100. 0. 511.99218 ECU_ADDRESS 0x3fc242 FORMAT "%7.3" /end MEASUREMENT
/begin MEASUREMENT VS_SP_DIF_CRU "Target variable/reference input variable difference" SWORD _CNV_A_R_LINEAR_____325_CM 1 100. -256. 255.9921875 ECU_ADDRESS 0x3fc24c FORMAT "%7.3" /end MEASUREMENT
/begin MEASUREMENT VS_SP_INC_CRU "Increment for VS_SP_CRU" UWORD _CNV_A_R_LINEAR_____153_CM 1 100. 0. 511.99218 ECU_ADDRESS 0x3fc252 FORMAT "%7.3" /end MEASUREMENT
/begin MEASUREMENT VS_SP_DEC_CRU "Decrement for VS_SP_CRU" UWORD _CNV_A_R_LINEAR_____153_CM 1 100. 0. 511.99218 ECU_ADDRESS 0x3fc24e FORMAT "%7.3" /end MEASUREMENT
/begin MEASUREMENT VS_SP_DRIV_CRU_ "Driver wish target variable" UWORD _CNV_A_R_LINEAR_____153_CM 1 100. 0. 511.99218 ECU_ADDRESS 0x3fc24a FORMAT "%7.3" /end MEASUREMENT
/begin CHARACTERISTIC IP_T_RST_CRU__VS_SP_CRU "Integral action time of the PI controller" CURVE 0x64664 _REC_CUR_20_u2_u2 408. _CNV_A_R_LINEAR_____327_CM 0. 408. FORMAT "%6.2"
 /begin AXIS_DESCR COM_AXIS VS_SP_CRU _CNV_A_R_LINEAR_____153_CM 5 0. 511.99218 FORMAT "%7.3" AXIS_PTS_REF ldpm_vs_sp_cru_1 /end AXIS_DESCR
/end CHARACTERISTIC
/begin AXIS_PTS ldpm_t_ctl_cru_1 "" 0x61310 T_CTL_CRU _REC_AXS_20_u1 2.55 _CNV_A_R_LINEAR_____18_CM 5 0. 25.5 FORMAT "%4.1" /end AXIS_PTS
/begin AXIS_PTS ldp_vs_dif_cru__fac_prop_cru "" 0x61300 VS_DIF_CRU _REC_AXS_20_u2 511.9921875 _CNV_A_R_LINEAR_____328_CM 4 -256. 255.9921875 FORMAT "%7.3" /end AXIS_PTS
/begin AXIS_PTS ldpm_vs_sp_dif_cru_1 "" 0x61316 VS_SP_DIF_CRU _REC_AXS_20_u2 511.9921875 _CNV_A_R_LINEAR_____328_CM 5 -256. 255.9921875 FORMAT "%7.3" /end AXIS_PTS
/begin AXIS_PTS ldpm_pv_cru_1 "" 0x61322 PV_CRU _REC_AXS_20_u1 99.609375 _CNV_A_R_LINEAR_____16_CM 3 0. 99.609375 FORMAT "%4.1" /end AXIS_PTS
/begin CHARACTERISTIC C_FAC_VS_DIF_RNG_CRU "Reduction factor for the control deviation VS_DIF_CRU" VALUE 0x6466e _REC_VAL_20_u1 0.99610001 _CNV_A_R_LINEAR_____68_CM 0. 0.99610001 FORMAT "%5.3" /end CHARACTERISTIC
/begin CHARACTERISTIC C_AC_NEG_CRU_AC "Negative acceleration in setting/acceleration" VALUE 0x64672 _REC_VAL_20_u2 511.9789 _CNV_A_R_LINEAR_____329_CM 0. 511.9789 FORMAT "%6.2" /end CHARACTERISTIC
/begin CHARACTERISTIC C_VS_DIF_MIN_IS_CRU "Threshold of the control deviation for zero setting of PV_CRU" VALUE 0x64674 _REC_VAL_20_s2 511.9921875 _CNV_A_R_LINEAR_____325_CM -256. 255.9921875 FORMAT "%7.3" /end CHARACTERISTIC
/begin CHARACTERISTIC C_VS_DIF_MAX_IS_CRU "Threshold of the control deviation for PUC end" VALUE 0x64676 _REC_VAL_20_s2 511.9921875 _CNV_A_R_LINEAR_____325_CM -256. 255.9921875 FORMAT "%7.3" /end CHARACTERISTIC
/begin CHARACTERISTIC C_VS_DIF_MAX_AC_CRU "Condition for interrupting the incrementation or decrementation" VALUE 0x6467a _REC_VAL_20_s2 511.9921875 _CNV_A_R_LINEAR_____325_CM -256. 255.9921875 FORMAT "%7.3" /end CHARACTERISTIC
/begin CHARACTERISTIC C_VS_DIF_MIN_AC_CRU "Condition for interrupting the incrementation or decrementation" VALUE 0x6467c _REC_VAL_20_s2 511.9921875 _CNV_A_R_LINEAR_____325_CM -256. 255.9921875 FORMAT "%7.3" /end CHARACTERISTIC
/begin CHARACTERISTIC C_FAC_AC_POS_CRU "Maximum reduction of FAC_VS_LGRD_CRU" VALUE 0x6467f _REC_VAL_20_u1 0.9960940000000002 _CNV_A_R_LINEAR_____8_CM 0. 0.996094 FORMAT "%5.3" /end CHARACTERISTIC
/begin CHARACTERISTIC C_VS_AC_MIN_CRU "Vehicle speed threshold for acceleration valuation" VALUE 0x6467e _REC_VAL_20_u1 255. _CNV_A_R_LINEAR_____43_CM 0. 255. FORMAT "%3.0" /end CHARACTERISTIC
/begin CHARACTERISTIC C_VS_AC_MAX_CRU "Vehicle speed threshold for acceleration valuation" VALUE 0x64680 _REC_VAL_20_u1 255. _CNV_A_R_LINEAR_____43_CM 0. 255. FORMAT "%3.0" /end CHARACTERISTIC
/begin CHARACTERISTIC C_AC_POS_CRU_RESU "Positive acceleration at CRU resume" VALUE 0x64682 _REC_VAL_20_u2 511.9789 _CNV_A_R_LINEAR_____329_CM 0. 511.9789 FORMAT "%6.2" /end CHARACTERISTIC
/begin CHARACTERISTIC C_VS_I_FAC_MAX_CRU "Value for VS_I_FAC_CRU, if acceleration less than or equal to zero" VALUE 0x64684 _REC_VAL_20_u1 1.99220002 _CNV_A_R_LINEAR_____64_CM 0. 1.99220002 FORMAT "%5.3" /end CHARACTERISTIC
/begin CHARACTERISTIC C_VS_I_AC_MAX_CRU "Acceleration threshold for allocation of the factor VS_I_FAC_CRU" VALUE 0x64686 _REC_VAL_20_u2 7110.89 _CNV_A_R_LINEAR_____330_CM 0. 7110.89 FORMAT "%6.1" /end CHARACTERISTIC
/begin CHARACTERISTIC C_AC_POS_CRU_AC "Positive acceleration in setting/acceleration" VALUE 0x64688 _REC_VAL_20_u2 511.9789 _CNV_A_R_LINEAR_____329_CM 0. 511.9789 FORMAT "%6.2" /end CHARACTERISTIC
/begin CHARACTERISTIC C_VS_DIF_MAX_CRU "Control difference threshold for incrementing VS_SP_CRU" VALUE 0x6468e _REC_VAL_20_u1 31.875 _CNV_A_R_LINEAR_____326_CM 0. 31.875 /end CHARACTERISTIC
/begin CHARACTERISTIC C_AC_POS_CRU_TIP "Positive acceleration for Tip-up" VALUE 0x6468c _REC_VAL_20_u2 511.9789 _CNV_A_R_LINEAR_____329_CM 0. 511.9789 FORMAT "%6.2" /end CHARACTERISTIC
/begin CHARACTERISTIC C_AC_NEG_CRU_TIP "Negative acceleration for Tip-up" VALUE 0x64692 _REC_VAL_20_u2 511.9789 _CNV_A_R_LINEAR_____329_CM 0. 511.9789 FORMAT "%6.2" /end CHARACTERISTIC
/begin CHARACTERISTIC C_VS_SP_CRU_MAX "maximum limitation of cruise control" VALUE 0x64690 _REC_VAL_20_u2 511.99218 _CNV_A_R_LINEAR_____153_CM 0. 511.99218 FORMAT "%7.3" /end CHARACTERISTIC
/begin CHARACTERISTIC C_VS_MIN_CRU "lower limitation for C_VS_MIN_CRU" VALUE 0x64694 _REC_VAL_20_u2 511.99218 _CNV_A_R_LINEAR_____153_CM 0. 511.99218 FORMAT "%7.3" /end CHARACTERISTIC
/begin CHARACTERISTIC C_AC_NEG_CRU_DEACC "Negative acceleration in deceleration" VALUE 0x64696 _REC_VAL_20_u2 511.9789 _CNV_A_R_LINEAR_____329_CM 0. 511.9789 FORMAT "%6.2" /end CHARACTERISTIC
/begin CHARACTERISTIC C_AC_POS_CRU_DEACC "Positive acceleration" VALUE 0x64698 _REC_VAL_20_u2 511.9789 _CNV_A_R_LINEAR_____329_CM 0. 511.9789 FORMAT "%6.2" /end CHARACTERISTIC
/begin CHARACTERISTIC C_VS_DIF_DELTA_I "Difference from control deviation and I component" VALUE 0x6469a _REC_VAL_20_u1 63.75 _CNV_A_R_LINEAR_____331_CM 0. 63.75 /end CHARACTERISTIC
/begin CHARACTERISTIC IP_PVS_DEC_CRU__N_32 "Decrement of the PV_CRU" CURVE 0x6469b _REC_CUR_20_u1_u1 99.609375 _CNV_A_R_LINEAR_____16_CM 0. 99.609375 FORMAT "%4.1"
 /begin AXIS_DESCR COM_AXIS N_32 _CNV_A_R_LINEAR_____15_CM 5 0. 8160. FORMAT "%4.0" AXIS_PTS_REF ldp_n_32__pvs_dec_cru /end AXIS_DESCR
/end CHARACTERISTIC
/begin CHARACTERISTIC IP_FAC_CRU_REST__T_CTL_CRU "Correction factor of in/decrementing (xx = --, CC; yy = REST, AC, DEACC)" CURVE 0x646a0 _REC_CUR_20_u1_u1 1.99220002 _CNV_A_R_LINEAR_____64_CM 0. 1.99220002 FORMAT "%5.3"
 /begin AXIS_DESCR COM_AXIS T_CTL_CRU _CNV_A_R_LINEAR_____18_CM 5 0. 25.5 FORMAT "%4.1" AXIS_PTS_REF ldpm_t_ctl_cru_1 /end AXIS_DESCR
/end CHARACTERISTIC
/begin CHARACTERISTIC IP_FAC_CRU_AC__T_CTL_CRU "Correction factor of in/decrementing (xx = --, CC; yy = REST, AC, DEACC)" CURVE 0x646a5 _REC_CUR_20_u1_u1 1.99220002 _CNV_A_R_LINEAR_____64_CM 0. 1.99220002 FORMAT "%5.3"
 /begin AXIS_DESCR COM_AXIS T_CTL_CRU _CNV_A_R_LINEAR_____18_CM 5 0. 25.5 FORMAT "%4.1" AXIS_PTS_REF ldpm_t_ctl_cru_1 /end AXIS_DESCR
/end CHARACTERISTIC
/begin CHARACTERISTIC IP_FAC_CRU_DECE__T_CTL_CRU "Correction factor of in/decrementing (xx = --, CC; yy = REST, AC, DEACC)" CURVE 0x646aa _REC_CUR_20_u1_u1 1.99220002 _CNV_A_R_LINEAR_____64_CM 0. 1.99220002 FORMAT "%5.3"
 /begin AXIS_DESCR COM_AXIS T_CTL_CRU _CNV_A_R_LINEAR_____18_CM 5 0. 25.5 FORMAT "%4.1" AXIS_PTS_REF ldpm_t_ctl_cru_1 /end AXIS_DESCR
/end CHARACTERISTIC
/begin CHARACTERISTIC IP_FAC_LGRD_CRU_REST__VS_SP_DIF "Interception factor of the in/decrementing (xx = REST, TIP)" CURVE 0x646b9 _REC_CUR_20_u1_u2 0.9960940000000002 _CNV_A_R_LINEAR_____8_CM 0. 0.996094 FORMAT "%5.3"
 /begin AXIS_DESCR COM_AXIS VS_SP_DIF_CRU _CNV_A_R_LINEAR_____328_CM 5 -256. 255.9921875 FORMAT "%7.3" AXIS_PTS_REF ldpm_vs_sp_dif_cru_1 /end AXIS_DESCR
/end CHARACTERISTIC
/begin CHARACTERISTIC IP_FAC_LGRD_CRU_TIP__VS_SP_DIF "Interception factor of the in/decrementing (xx = REST, TIP)" CURVE 0x646be _REC_CUR_20_u1_u2 0.9960940000000002 _CNV_A_R_LINEAR_____8_CM 0. 0.996094 FORMAT "%5.3"
 /begin AXIS_DESCR COM_AXIS VS_SP_DIF_CRU _CNV_A_R_LINEAR_____328_CM 5 -256. 255.9921875 FORMAT "%7.3" AXIS_PTS_REF ldpm_vs_sp_dif_cru_1 /end AXIS_DESCR
/end CHARACTERISTIC
/begin CHARACTERISTIC IP_FAC_PROP_CRU__VS_SP_CRU "Proportional coefficient of the PI controller" MAP 0x646c4 _REC_MAP_20_u2_u2_u2 799.9751 _CNV_A_R_LINEAR_____332_CM 1.22e-002 799.9873 FORMAT "%6.2"
 /begin AXIS_DESCR COM_AXIS VS_SP_CRU _CNV_A_R_LINEAR_____153_CM 5 0. 511.99218 FORMAT "%7.3" AXIS_PTS_REF ldpm_vs_sp_cru_1 /end AXIS_DESCR
 /begin AXIS_DESCR COM_AXIS VS_DIF_CRU _CNV_A_R_LINEAR_____328_CM 4 -256. 255.9921875 FORMAT "%7.3" AXIS_PTS_REF ldp_vs_dif_cru__fac_prop_cru /end AXIS_DESCR
/end CHARACTERISTIC
/begin CHARACTERISTIC IP_AC_NEG_CRU_RESU__N__PV_CRU "negative acceleration at CRU resume" MAP 0x646ec _REC_MAP_20_u2_u1_u1 511.9789 _CNV_A_R_LINEAR_____329_CM 0. 511.9789 FORMAT "%6.2"
 /begin AXIS_DESCR COM_AXIS N_32 _CNV_A_R_LINEAR_____15_CM 3 0. 8160. FORMAT "%4.0" AXIS_PTS_REF ldpm_n_21 /end AXIS_DESCR
 /begin AXIS_DESCR COM_AXIS PV_CRU _CNV_A_R_LINEAR_____16_CM 3 0. 99.609375 FORMAT "%4.1" AXIS_PTS_REF ldpm_pv_cru_1 /end AXIS_DESCR
/end CHARACTERISTIC
/begin CHARACTERISTIC IP_AC_NEG_CRU_AC__N__PV_CRU "Negative acceleration in setting/acceleration" MAP 0x646fe _REC_MAP_20_u2_u1_u1 511.9789 _CNV_A_R_LINEAR_____329_CM 0. 511.9789 FORMAT "%6.2"
 /begin AXIS_DESCR COM_AXIS N_32 _CNV_A_R_LINEAR_____15_CM 3 0. 8160. FORMAT "%4.0" AXIS_PTS_REF ldpm_n_21 /end AXIS_DESCR
 /begin AXIS_DESCR COM_AXIS PV_CRU _CNV_A_R_LINEAR_____16_CM 3 0. 99.609375 FORMAT "%4.1" AXIS_PTS_REF ldpm_pv_cru_1 /end AXIS_DESCR
/end CHARACTERISTIC
/begin CHARACTERISTIC C_T_MIN_CRU_CON "Time condition for controlled acceleration" VALUE 0x6468a _REC_VAL_20_u1 25.5 _CNV_A_R_LINEAR_____18_CM 0. 25.5 FORMAT "%4.1" /end CHARACTERISTIC
/begin CHARACTERISTIC C_T_READY_CRU "Delay time after control unit initialization" VALUE 0x64715 _REC_VAL_20_u1 1550. _CNV_A_R_LINEAR_____3_CM 1000. 2550. FORMAT "%5.0" /end CHARACTERISTIC
/begin CHARACTERISTIC C_T_CRUS_ON "Minimum recognition time on actuating the OFF button" VALUE 0x64716 _REC_VAL_20_u1 2550. _CNV_A_R_LINEAR_____3_CM 0. 2550. FORMAT "%4.0" /end CHARACTERISTIC
/begin MEASUREMENT REQ_CRU "Request of cruise control functionality" UBYTE _CNV_S_8_RANGE_REQ__333_CM 1 100. 0. 7. ECU_ADDRESS 0x3fd60e /end MEASUREMENT
/begin MEASUREMENT STATE_MSW_CAN "Status of MSW to the CAN Message" UBYTE _CNV_S_8_RANGE_STAT_334_CM 1 100. 0. 7. ECU_ADDRESS 0x3fd600 /end MEASUREMENT
/begin MEASUREMENT LV_CRU_MAIN_SWI_ "indicate CRU readiness" UBYTE _CNV_S_2_RANGE______76_CM 1 100. 0. 1. ECU_ADDRESS 0x3fd342 /end MEASUREMENT
/begin MEASUREMENT LV_CRU_OFF_IRR "Irreversible cut off conditions for cruise control" UBYTE _CNV_S_2_RANGE______76_CM 1 100. 0. 1. ECU_ADDRESS 0x3fd345 /end MEASUREMENT
/begin CHARACTERISTIC C_T_CRUS "Minimum time between switch on ready and switch off ready" VALUE 0x64717 _REC_VAL_20_u1 2550. _CNV_A_R_LINEAR_____3_CM 0. 2550. FORMAT "%4.0" /end CHARACTERISTIC
/begin CHARACTERISTIC C_VS_MIN_PLAUS_CRU "Vehicle speed condition for VS_FIL" VALUE 0x64718 _REC_VAL_20_u2 511.99218 _CNV_A_R_LINEAR_____153_CM 0. 511.99218 FORMAT "%7.3" /end CHARACTERISTIC
/begin CHARACTERISTIC C_T_CRU_ESP_OFF "minimum time before cut-off CRU in case of ESP intervention" VALUE 0x6471a _REC_VAL_20_u1 25.5 _CNV_A_R_LINEAR_____18_CM 0. 25.5 FORMAT "%4.1" /end CHARACTERISTIC
/begin CHARACTERISTIC C_T_CRU_ASR_OFF "minimum time before cut-off CRU in case of ASR intervention" VALUE 0x6471b _REC_VAL_20_u1 25.5 _CNV_A_R_LINEAR_____18_CM 0. 25.5 FORMAT "%4.1" /end CHARACTERISTIC
/begin CHARACTERISTIC C_T_CRU_ESP_BRAKE_OFF "minimum time before cut-off CRU in case of ESP intervention only with brake" VALUE 0x6471c _REC_VAL_20_u1 25.5 _CNV_A_R_LINEAR_____18_CM 0. 25.5 FORMAT "%4.1" /end CHARACTERISTIC
/begin MEASUREMENT REQ_MSW "Evaluated Status of MSW request module" UBYTE _CNV_S_8_RANGE_REQ__333_CM 1 100. 0. 7. ECU_ADDRESS 0x3fd605 /end MEASUREMENT
/begin MEASUREMENT T_DLY_CRU "Time counter overtaking" UWORD _CNV_A_R_LINEAR_____21_CM 1 100. 0. 655.35 ECU_ADDRESS 0x3fc254 FORMAT "%5.2" /end MEASUREMENT
/begin MEASUREMENT N_VS_CRU "Ratio between engine speed and vehicle speed" UWORD _CNV_A_R_LINEAR_____335_CM 1 100. 0. 16320. ECU_ADDRESS 0x3fc25e FORMAT "%5.0" /end MEASUREMENT
/begin MEASUREMENT VS_FIL "Filtered vehicle speed" UWORD _CNV_A_R_LINEAR_____153_CM 1 100. 0. 511.99218 ECU_ADDRESS 0x3fc25a FORMAT "%7.3" /end MEASUREMENT
/begin MEASUREMENT AC_CRU "Vehicle acceleration in CRU" SWORD _CNV_A_R_LINEAR_____336_CM 1 100. -1777.777752 1777.723498 ECU_ADDRESS 0x3fc25c FORMAT "%8.2" /end MEASUREMENT
/begin MEASUREMENT LV_CRU_OVER_ACT "Overtaking function active" UBYTE _CNV_S_2_RANGE______76_CM 1 100. 0. 1. ECU_ADDRESS 0x3fd346 /end MEASUREMENT
/begin CHARACTERISTIC C_T_DLY_VS_SP_CRU_MAX "Max .time for VS more than  VS max at CRU" VALUE 0x6471d _REC_VAL_20_u1 255. _CNV_A_R_LINEAR_____20_CM 0. 255. FORMAT "%3.0" /end CHARACTERISTIC
/begin CHARACTERISTIC C_PVS_HYS_CRU "PVS hysteresis for start of the restart function" VALUE 0x6471e _REC_VAL_20_u1 99.609375 _CNV_A_R_LINEAR_____16_CM 0. 99.609375 FORMAT "%5.2" /end CHARACTERISTIC
/begin CHARACTERISTIC C_T_DLY_MAX_CRU "Delay threshold for start of the restart function" VALUE 0x64720 _REC_VAL_20_u2 655.35 _CNV_A_R_LINEAR_____21_CM 0. 655.35 FORMAT "%6.2" /end CHARACTERISTIC
/begin CHARACTERISTIC C_VS_DIF_DLY_CRU "Max. difference from VS_SP_DRIV_CRU and C_VS_DIF_DLY_CRU" VALUE 0x64722 _REC_VAL_20_u2 255.9921875 _CNV_A_R_LINEAR_____325_CM 0. 255.9921875 FORMAT "%7.3" /end CHARACTERISTIC
/begin CHARACTERISTIC C_N_VS_MAX_CRU "Threshold value for hard cut-off" VALUE 0x64724 _REC_VAL_20_u1 99.609375 _CNV_A_R_LINEAR_____16_CM 0. 99.609375 FORMAT "%4.1" /end CHARACTERISTIC
/begin CHARACTERISTIC C_FAC_VS_FIL "Filter factor" VALUE 0x64725 _REC_VAL_20_u1 255. _CNV_A_R_LINEAR_____13_CM 0. 255. FORMAT "%3.0" /end CHARACTERISTIC
/begin CHARACTERISTIC C_VS_SP_DIF_MIN_CRU "Min. deviation between target and actual speed" VALUE 0x64726 _REC_VAL_20_s2 511.9921875 _CNV_A_R_LINEAR_____325_CM -256. 255.9921875 FORMAT "%7.3" /end CHARACTERISTIC
/begin CHARACTERISTIC C_VS_SP_DIF_MAX_CRU "Max. deviation between target and actual speed" VALUE 0x64728 _REC_VAL_20_s2 511.9921875 _CNV_A_R_LINEAR_____325_CM -256. 255.9921875 FORMAT "%7.3" /end CHARACTERISTIC
/begin CHARACTERISTIC C_AC_MAX_CRU "Max. acceleration" VALUE 0x6472a _REC_VAL_20_u2 7110.89 _CNV_A_R_LINEAR_____330_CM 0. 7110.89 FORMAT "%6.1" /end CHARACTERISTIC
/begin CHARACTERISTIC C_VS_MAX_DIAG "Max. allowed deviation between VS_FIL and VS" VALUE 0x6472c _REC_VAL_20_u1 255. _CNV_A_R_LINEAR_____43_CM 0. 255. FORMAT "%3.0" /end CHARACTERISTIC
/begin MEASUREMENT LV_VS_DIAG_NOT_PLAUS "VS_FIL not plausible" UBYTE _CNV_S_2_RANGE______76_CM 1 100. 0. 1. ECU_ADDRESS 0x3fd351 /end MEASUREMENT
/begin AXIS_PTS ldpm_n_21 "" 0x61326 N_32 _REC_AXS_20_u1 8160. _CNV_A_R_LINEAR_____15_CM 3 0. 8160. FORMAT "%4.0" /end AXIS_PTS
/begin CHARACTERISTIC IP_PVS_MIN_SET_CRU__VS_SP_CRU "Minimum charge requirement; setting for vehicle deceleration" CURVE 0x64710 _REC_CUR_20_u1_u2 99.609375 _CNV_A_R_LINEAR_____16_CM 0. 99.609375 FORMAT "%4.1"
 /begin AXIS_DESCR COM_AXIS VS_SP_CRU _CNV_A_R_LINEAR_____153_CM 5 0. 511.99218 FORMAT "%7.3" AXIS_PTS_REF ldpm_vs_sp_cru_1 /end AXIS_DESCR
/end CHARACTERISTIC
/begin CHARACTERISTIC IP_FAC_CC_CRU_AC__T_CTL_CRU "Correction factor of in/decrementing (xx = --, CC; yy = REST, AC, DEACC)" CURVE 0x646b4 _REC_CUR_20_u1_u1 1.99220002 _CNV_A_R_LINEAR_____64_CM 0. 1.99220002 FORMAT "%5.3"
 /begin AXIS_DESCR COM_AXIS T_CTL_CRU _CNV_A_R_LINEAR_____18_CM 5 0. 25.5 FORMAT "%4.1" AXIS_PTS_REF ldpm_t_ctl_cru_1 /end AXIS_DESCR
/end CHARACTERISTIC
/begin CHARACTERISTIC IP_FAC_CC_CRU_DECE__T_CTL_CRU "Correction factor of in/decrementing (xx = --, CC; yy = REST, AC, DEACC)" CURVE 0x646af _REC_CUR_20_u1_u1 1.99220002 _CNV_A_R_LINEAR_____64_CM 0. 1.99220002 FORMAT "%5.3"
 /begin AXIS_DESCR COM_AXIS T_CTL_CRU _CNV_A_R_LINEAR_____18_CM 5 0. 25.5 FORMAT "%4.1" AXIS_PTS_REF ldpm_t_ctl_cru_1 /end AXIS_DESCR
/end CHARACTERISTIC
/begin CHARACTERISTIC C_VS_DIF_RNG_CRU "Bandwidth for reducing the control deviation" VALUE 0x64670 _REC_VAL_20_u2 511.99218 _CNV_A_R_LINEAR_____153_CM 0. 511.99218 FORMAT "%7.3" /end CHARACTERISTIC
/begin CHARACTERISTIC C_PVS_LGRD_CRU "Control variable limitation gradient" VALUE 0x64736 _REC_VAL_20_u1 99.609375 _CNV_A_R_LINEAR_____338_CM 0. 99.609375 FORMAT "%4.1" /end CHARACTERISTIC
/begin MEASUREMENT STATE_CRU_CAN "Status of cruise control to the CAN- Message" UBYTE _CNV_S_8_RANGE_STAT_339_CM 1 100. 0. 7. ECU_ADDRESS 0x3fd606 /end MEASUREMENT
/begin MEASUREMENT STATE_CRU "Status of cruise control to the CAN- Message" UBYTE _CNV_S_6_RANGE_STAT_340_CM 1 100. 0. 9. ECU_ADDRESS 0x3fd609 /end MEASUREMENT
/begin MEASUREMENT FAC_VS_LGRD_CRU "Factor for intercepting the reference input variable" UBYTE _CNV_A_R_LINEAR_____68_CM 1 100. 0. 0.99610001 ECU_ADDRESS 0x3fd60b FORMAT "%5.3" /end MEASUREMENT
/begin MEASUREMENT FAC_VS_CTL_CRU "Correction factor for actuating the reference input variable" UBYTE _CNV_A_R_LINEAR_____67_CM 1 100. 0. 1.9921875 ECU_ADDRESS 0x3fd60c FORMAT "%5.3" /end MEASUREMENT
/begin MEASUREMENT LV_CRU_OFF_BY_ASR_ESP_CTL "Soft off condition depending on ASC interventions" UBYTE _CNV_S_2_RANGE______76_CM 1 100. 0. 1. ECU_ADDRESS 0x3fd34a /end MEASUREMENT
/begin MEASUREMENT LV_CRU_ACT "Intervention of cruise control" UBYTE _CNV_S_2_RANGE______76_CM 1 100. 0. 1. ECU_ADDRESS 0x3fd343 /end MEASUREMENT
/begin AXIS_PTS ldp_n_32__pvs_dec_cru "" 0x6130a N_32 _REC_AXS_20_u1 816. _CNV_A_R_LINEAR_____15_CM 5 0. 8160. FORMAT "%4.0" /end AXIS_PTS
/begin AXIS_PTS ldpm_vs_sp_cru_1 "" 0x612f4 VS_SP_CRU _REC_AXS_20_u2 511.99218 _CNV_A_R_LINEAR_____153_CM 5 0. 511.99218 FORMAT "%7.3" /end AXIS_PTS
/begin CHARACTERISTIC C_T_MIN_PUC_CRU "Time after entry into controlled constant drive" VALUE 0x64678 _REC_VAL_20_u1 25.5 _CNV_A_R_LINEAR_____18_CM 0. 25.5 FORMAT "%4.1" /end CHARACTERISTIC
/begin AXIS_PTS ldpm_pq_estim_id_maf_isa_fac_ofs "" 0x6132a PQ_ESTIM _REC_AXS_20_u2 0.99998474 _CNV_A_R_LINEAR_____2_CM 16 0. 0.99998474 FORMAT "%7.5" /end AXIS_PTS
/begin AXIS_PTS ldp_pq_sp_isa "" 0x6134c PQ_SP_ISA _REC_AXS_20_u2 0.99998474 _CNV_A_R_LINEAR_____2_CM 8 0. 0.99998474 FORMAT "%7.5" /end AXIS_PTS
/begin AXIS_PTS ldp_ar_red_isa_sp_mmv "" 0x6135e AR_RED_ISA_SP_MMV _REC_AXS_20_u2 58.592855 _CNV_A_R_LINEAR_____286_CM 16 0. 58.592855 FORMAT "%7.4" /end AXIS_PTS
/begin AXIS_PTS ldpm_vb_1 "" 0x61380 VB _REC_AXS_20_u1 25.8984 _CNV_A_R_LINEAR_____42_CM 8 0. 25.8984 FORMAT "%3.1" /end AXIS_PTS
/begin AXIS_PTS ldp_n_32__maf_sp_isa "" 0x61389 N_32 _REC_AXS_20_u1 816. _CNV_A_R_LINEAR_____15_CM 16 0. 8160. FORMAT "%4.0" /end AXIS_PTS
/begin AXIS_PTS ldp_maf_sp_tqi__maf_sp_isa "" 0x6139a MAF_SP_TQI _REC_AXS_20_u2 1389. _CNV_A_R_LINEAR_____56_CM 12 0. 1389. FORMAT "%7.2" /end AXIS_PTS
/begin AXIS_PTS ldp_maf_turb_ratio "" 0x613b4 MAF_TURB_RATIO _REC_AXS_20_u1 0.99610001 _CNV_A_R_LINEAR_____68_CM 8 0. 0.99610001 FORMAT "%5.3" /end AXIS_PTS
/begin AXIS_PTS ldp_isapwm_mmv "" 0x613be ISAPWM_MMV _REC_AXS_20_u2 99.99847412 _CNV_A_R_LINEAR_____144_CM 16 0. 99.99847412 /end AXIS_PTS
/begin AXIS_PTS ldp_vo_fac_ivvt "" 0x613e0 VO _REC_AXS_20_u1 95.625 _CNV_A_R_LINEAR_____6_CM 8 0. 95.625 FORMAT "%5.2" /end AXIS_PTS
/begin AXIS_PTS ldpm_n_13 "" 0x613ea N _REC_AXS_20_u2 8160. _CNV_A_R_LINEAR_____0_CM 6 0. 8160. FORMAT "%4.0" /end AXIS_PTS
/begin AXIS_PTS ldpm_maf_ivvt_1 "" 0x613f8 MAF _REC_AXS_20_u2 1389. _CNV_A_R_LINEAR_____56_CM 6 0. 1389. FORMAT "%7.2" /end AXIS_PTS
/begin AXIS_PTS ldpm_n_5 "" 0x61406 N _REC_AXS_20_u2 8160. _CNV_A_R_LINEAR_____0_CM 16 0. 8160. FORMAT "%4.0" /end AXIS_PTS
/begin AXIS_PTS ldpm_maf_ivvt_2 "" 0x61428 MAF _REC_AXS_20_u2 1389. _CNV_A_R_LINEAR_____56_CM 12 0. 1389. FORMAT "%7.2" /end AXIS_PTS
/begin AXIS_PTS ldpm_tco_17 "" 0x61442 TCO _REC_AXS_20_u1 190.5 _CNV_A_R_LINEAR_____22_CM 8 -48. 142.5 FORMAT "%5.1" /end AXIS_PTS
/begin AXIS_PTS ldpm_tco_st_4 "" 0x6144b TCO_ST _REC_AXS_20_u1 190.5 _CNV_A_R_LINEAR_____22_CM 8 -48. 142.5 FORMAT "%5.1" /end AXIS_PTS
/begin AXIS_PTS ldpm_tco_st_6 "" 0x61454 TCO_ST _REC_AXS_20_u1 190.5 _CNV_A_R_LINEAR_____22_CM 8 -48. 142.5 FORMAT "%6.2" /end AXIS_PTS
/begin AXIS_PTS ldpm_n_11 "ldpm 6 points N for IGA" 0x6145e N _REC_AXS_20_u2 8160. _CNV_A_R_LINEAR_____0_CM 16 0. 8160. FORMAT "%4.0" /end AXIS_PTS
/begin COMPU_METHOD _CNV_A_R_LINEAR_____0_CM "" RAT_FUNC "%6.3" "rpm" COEFFS 0 1. 0. 0 0 1 /end COMPU_METHOD
/begin COMPU_METHOD _CNV_A_R_LINEAR_____1_CM "" RAT_FUNC "%6.3" "hPa" COEFFS 0 12.06017666543982 0. 0 0 1 /end COMPU_METHOD
/begin COMPU_METHOD _CNV_A_R_LINEAR_____2_CM "" RAT_FUNC "%6.3" "-" COEFFS 0 65536.00007936121 0. 0 0 1 /end COMPU_METHOD
/begin COMPU_METHOD _CNV_A_R_LINEAR_____3_CM "" RAT_FUNC "%6.3" "ms" COEFFS 0 0.1 0. 0 0 1 /end COMPU_METHOD
/begin COMPU_METHOD _CNV_A_R_LINEAR_____5_CM "" RAT_FUNC "%6.3" "-" COEFFS 0 32768.00003968061 0. 0 0 1 /end COMPU_METHOD
/begin COMPU_METHOD _CNV_A_R_LINEAR_____6_CM "" RAT_FUNC "%6.3" "°CRK" COEFFS 0 2.666666666666667 0. 0 0 1 /end COMPU_METHOD
/begin COMPU_METHOD _CNV_A_R_LINEAR_____8_CM "" RAT_FUNC "%6.3" "[-]" COEFFS 0 255.9999357490357 0. 0 0 1 /end COMPU_METHOD
/begin COMPU_METHOD _CNV_A_R_LINEAR_____13_CM "" RAT_FUNC "%6.3" "[-]" COEFFS 0 1. 0. 0 0 1 /end COMPU_METHOD
/begin COMPU_METHOD _CNV_A_R_LINEAR_____15_CM "" RAT_FUNC "%6.3" "rpm" COEFFS 0 3.125e-002 0. 0 0 1 /end COMPU_METHOD
/begin COMPU_METHOD _CNV_A_R_LINEAR_____16_CM "" RAT_FUNC "%6.3" "%" COEFFS 0 2.56 0. 0 0 1 /end COMPU_METHOD
/begin COMPU_METHOD _CNV_A_R_LINEAR_____17_CM "" RAT_FUNC "%6.3" "-" COEFFS 0 1. 0. 0 0 1 /end COMPU_METHOD
/begin COMPU_METHOD _CNV_A_R_LINEAR_____18_CM "" RAT_FUNC "%6.3" "s" COEFFS 0 10. 0. 0 0 1 /end COMPU_METHOD
/begin COMPU_METHOD _CNV_A_R_LINEAR_____20_CM "" RAT_FUNC "%6.3" "s" COEFFS 0 1. 0. 0 0 1 /end COMPU_METHOD
/begin COMPU_METHOD _CNV_A_R_LINEAR_____21_CM "" RAT_FUNC "%6.3" "s" COEFFS 0 100. 0. 0 0 1 /end COMPU_METHOD
/begin COMPU_METHOD _CNV_A_R_LINEAR_____22_CM "" RAT_FUNC "%6.3" "°C" COEFFS 0 1.333333333333333 64. 0 0 1 /end COMPU_METHOD
/begin COMPU_METHOD _CNV_A_R_LINEAR_____23_CM "" RAT_FUNC "%6.3" "°C" COEFFS 0 1.333333333333333 0. 0 0 1 /end COMPU_METHOD
/begin COMPU_METHOD _CNV_A_R_LINEAR_____24_CM "" RAT_FUNC "%6.3" "ms" COEFFS 0 250. 0. 0 0 1 /end COMPU_METHOD
/begin COMPU_METHOD _CNV_A_R_LINEAR_____26_CM "" RAT_FUNC "%6.3" "°C" COEFFS 0 0.25 8.25 0 0 1 /end COMPU_METHOD
/begin COMPU_METHOD _CNV_A_R_LINEAR_____32_CM "" RAT_FUNC "%6.3" "°C" COEFFS 0 1. 40. 0 0 1 /end COMPU_METHOD
/begin COMPU_METHOD _CNV_A_R_LINEAR_____34_CM "" RAT_FUNC "%6.3" "°TPS" COEFFS 0 137.0962343096234 0. 0 0 1 /end COMPU_METHOD
/begin COMPU_METHOD _CNV_A_R_LINEAR_____37_CM "" RAT_FUNC "%6.3" "Nm" COEFFS 0 32. 0. 0 0 1 /end COMPU_METHOD
/begin COMPU_METHOD _CNV_A_R_LINEAR_____38_CM "" RAT_FUNC "%6.3" "V" COEFFS 0 204.7999998974999 0. 0 0 1 /end COMPU_METHOD
/begin COMPU_METHOD _CNV_A_R_LINEAR_____40_CM "" RAT_FUNC "%6.3" "V" COEFFS 0 51.2 0. 0 0 1 /end COMPU_METHOD
/begin COMPU_METHOD _CNV_A_R_LINEAR_____42_CM "" RAT_FUNC "%6.3" "V" COEFFS 0 9.846168103048838 0. 0 0 1 /end COMPU_METHOD
/begin COMPU_METHOD _CNV_A_R_LINEAR_____43_CM "" RAT_FUNC "%6.3" "km/h" COEFFS 0 1. 0. 0 0 1 /end COMPU_METHOD
/begin COMPU_METHOD _CNV_A_R_LINEAR_____44_CM "" RAT_FUNC "%6.3" "-" COEFFS 0 255.9999357490357 0. 0 0 1 /end COMPU_METHOD
/begin COMPU_METHOD _CNV_A_R_LINEAR_____46_CM "" RAT_FUNC "%6.3" "Seg" COEFFS 0 1. 0. 0 0 1 /end COMPU_METHOD
/begin COMPU_METHOD _CNV_A_R_LINEAR_____47_CM "" RAT_FUNC "%6.3" "°TPS" COEFFS 0 137.0962343096234 16383. 0 0 1 /end COMPU_METHOD
/begin COMPU_METHOD _CNV_A_R_LINEAR_____49_CM "" RAT_FUNC "%6.3" "°CRK" COEFFS 0 -2.666666666666667 0. 0 0 1 /end COMPU_METHOD
/begin COMPU_METHOD _CNV_A_R_LINEAR_____50_CM "" RAT_FUNC "%6.3" "-" COEFFS 0 1023.999999919998 0. 0 0 1 /end COMPU_METHOD
/begin COMPU_METHOD _CNV_A_R_LINEAR_____51_CM "" RAT_FUNC "%6.3" "mg/stk" COEFFS 0 0.183585313174946 0. 0 0 1 /end COMPU_METHOD
/begin COMPU_METHOD _CNV_A_R_LINEAR_____52_CM "" RAT_FUNC "%6.3" "kg/h" COEFFS 0 32. 0. 0 0 1 /end COMPU_METHOD
/begin COMPU_METHOD _CNV_A_R_LINEAR_____53_CM "" RAT_FUNC "%6.3" "rpm" COEFFS 0 1. 32768. 0 0 1 /end COMPU_METHOD
/begin COMPU_METHOD _CNV_A_R_LINEAR_____54_CM "" RAT_FUNC "%6.3" "rpm/s" COEFFS 0 3.125e-002 128. 0 0 1 /end COMPU_METHOD
/begin COMPU_METHOD _CNV_A_R_LINEAR_____56_CM "" RAT_FUNC "%6.3" "mg/stk" COEFFS 0 47.18142548596112 0. 0 0 1 /end COMPU_METHOD
/begin COMPU_METHOD _CNV_A_R_LINEAR_____64_CM "" RAT_FUNC "%6.3" "-" COEFFS 0 127.9991955827809 0. 0 0 1 /end COMPU_METHOD
/begin COMPU_METHOD _CNV_A_R_LINEAR_____65_CM "" RAT_FUNC "%6.3" "Nm" COEFFS 0 32. 32768. 0 0 1 /end COMPU_METHOD
/begin COMPU_METHOD _CNV_A_R_LINEAR_____67_CM "" RAT_FUNC "%6.3" "[-]" COEFFS 0 128. 0. 0 0 1 /end COMPU_METHOD
/begin COMPU_METHOD _CNV_A_R_LINEAR_____68_CM "" RAT_FUNC "%6.3" "-" COEFFS 0 255.9983911655618 0. 0 0 1 /end COMPU_METHOD
/begin COMPU_METHOD _CNV_A_R_LINEAR_____70_CM "" RAT_FUNC "%6.3" "-" COEFFS 0 63.60176282051283 0. 0 0 1 /end COMPU_METHOD
/begin COMPU_METHOD _CNV_S_2_RANGE______74_CM "" TAB_VERB "%6.3" "[-]" COMPU_TAB_REF _CNV_S_2_RANGE______74 /end COMPU_METHOD
/begin COMPU_VTAB _CNV_S_2_RANGE______74 "" TAB_VERB 2 0 "0" 1 "1" /end COMPU_VTAB
/begin COMPU_METHOD _CNV_S_2_RANGE______75_R_CM "" TAB_VERB "%6.3" "-" COMPU_TAB_REF _CNV_S_2_RANGE______75_R /end COMPU_METHOD
/begin COMPU_VTAB_RANGE _CNV_S_2_RANGE______75_R "" 2 0 0 "0" 1 255 "1" /end COMPU_VTAB_RANGE
/begin COMPU_METHOD _CNV_S_2_RANGE______76_CM "" TAB_VERB "%6.3" "-" COMPU_TAB_REF _CNV_S_2_RANGE______76 /end COMPU_METHOD
/begin COMPU_VTAB _CNV_S_2_RANGE______76 "" TAB_VERB 2 0 "0" 1 "1" /end COMPU_VTAB
/begin COMPU_METHOD _CNV_S_2_RANGE______77_R_CM "" TAB_VERB "%6.3" "[-]" COMPU_TAB_REF _CNV_S_2_RANGE______77_R /end COMPU_METHOD
/begin COMPU_VTAB_RANGE _CNV_S_2_RANGE______77_R "" 2 0 0 "0" 1 255 "1" /end COMPU_VTAB_RANGE
/begin COMPU_METHOD _CNV_A_R_LINEAR_____86_CM "" RAT_FUNC "%6.3" "Nm" COEFFS 0 1. 0. 0 0 1 /end COMPU_METHOD
/begin COMPU_METHOD _CNV_A_R_LINEAR_____87_CM "" RAT_FUNC "%6.3" "-" COEFFS 0 16. 0. 0 0 1 /end COMPU_METHOD
/begin COMPU_METHOD _CNV_S_6_RANGE_ENG__91_CM "" TAB_VERB "%6.3" "[-]" COMPU_TAB_REF _CNV_S_6_RANGE_ENG__91 /end COMPU_METHOD
/begin COMPU_VTAB _CNV_S_6_RANGE_ENG__91 "" TAB_VERB 6 0 "ES" 1 "ST" 2 "IS" 3 "PL" 4 "PU" 5 "PUC" /end COMPU_VTAB
/begin COMPU_METHOD _CNV_A_R_LINEAR_____93_CM "" RAT_FUNC "%6.3" "hPa" COEFFS 0 2. 0. 0 0 1 /end COMPU_METHOD
/begin COMPU_METHOD _CNV_A_R_LINEAR_____94_CM "" RAT_FUNC "%6.3" "°C" COEFFS 0 16. 0. 0 0 1 /end COMPU_METHOD
/begin COMPU_METHOD _CNV_A_R_LINEAR_____95_CM "" RAT_FUNC "%6.3" "°C" COEFFS 0 64. 2112. 0 0 1 /end COMPU_METHOD
/begin COMPU_METHOD _CNV_A_R_LINEAR_____98_CM "" RAT_FUNC "%6.3" "g" COEFFS 0 36.00036915004301 0. 0 0 1 /end COMPU_METHOD
/begin COMPU_METHOD _CNV_S_6_RANGE_ECU__100_CM "" TAB_VERB "%6.3" "-" COMPU_TAB_REF _CNV_S_6_RANGE_ECU__100 /end COMPU_METHOD
/begin COMPU_VTAB _CNV_S_6_RANGE_ECU__100 "" TAB_VERB 6 0 "ENG_STOP" 1 "RUN_ENG" 2 "SYN_ENG_IGK_ON" 3 "SYN_ENG_IGK_OFF" 4 "PWL" 5 "ENG_LOCK" /end COMPU_VTAB
/begin COMPU_METHOD _CNV_S_6_RANGE_ENG__101_CM "" TAB_VERB "%6.3" "-" COMPU_TAB_REF _CNV_S_6_RANGE_ENG__101 /end COMPU_METHOD
/begin COMPU_VTAB _CNV_S_6_RANGE_ENG__101 "" TAB_VERB 6 0 "ES" 1 "ST" 2 "IS" 3 "PL" 4 "PU" 5 "PUC" /end COMPU_VTAB
/begin COMPU_METHOD _CNV_A_R_LINEAR_____102_CM "" RAT_FUNC "%6.3" "ms" COEFFS 0 15.625 0. 0 0 1 /end COMPU_METHOD
/begin COMPU_METHOD _CNV_A_R_LINEAR_____104_CM "" RAT_FUNC "%6.3" "-" COEFFS 0 8191.999999679995 0. 0 0 1 /end COMPU_METHOD
/begin COMPU_METHOD _CNV_A_R_LINEAR_____105_CM "" RAT_FUNC "%6.3" "[-]" COEFFS 0 1023.999999959999 32767.99999871998 0 0 1 /end COMPU_METHOD
/begin COMPU_METHOD _CNV_A_R_LINEAR_____107_CM "" RAT_FUNC "%6.3" "[-]" COEFFS 0 1023.999989719843 0. 0 0 1 /end COMPU_METHOD
/begin COMPU_METHOD _CNV_A_R_LINEAR_____114_CM "" RAT_FUNC "%6.3" "hPa" COEFFS 0 0.3768805207949945 0. 0 0 1 /end COMPU_METHOD
/begin COMPU_METHOD _CNV_A_R_LINEAR_____115_CM "" RAT_FUNC "%6.3" "ms" COEFFS 0 250. 32768. 0 0 1 /end COMPU_METHOD
/begin COMPU_METHOD _CNV_S_8_RANGE_STAT_134_CM "" TAB_VERB "%6.3" "[-]" COMPU_TAB_REF _CNV_S_8_RANGE_STAT_134 /end COMPU_METHOD
/begin COMPU_VTAB _CNV_S_8_RANGE_STAT_134 "" TAB_VERB 8 0 "SAV_DIAG_NOT_ACTIVE" 1 "SAV_DIAG_DISABLED" 2 "SAV_DIAG_ABORTED" 3 "SAV_DIAG_FIN_NO_ERR_1" 4 "SAV_DIAG_FIN_NO_ERR_2" 5 "SAV_DIAG_FIN_ERR_SAV" 6 "SAV_DIAG_ACTIVE" 7 "SAV_DIAG_VERIFY" /end COMPU_VTAB
/begin COMPU_METHOD _CNV_A_R_LINEAR_____139_CM "" RAT_FUNC "%6.3" "g/s" COEFFS 0 43.3652807775378 0. 0 0 1 /end COMPU_METHOD
/begin COMPU_METHOD _CNV_A_R_LINEAR_____141_CM "" RAT_FUNC "%6.3" "hPa" COEFFS 0 0.3768805207949945 32768.00125109265 0 0 1 /end COMPU_METHOD
/begin COMPU_METHOD _CNV_A_R_LINEAR_____144_CM "" RAT_FUNC "%6.3" "%" COEFFS 0 655.3600000071681 0. 0 0 1 /end COMPU_METHOD
/begin COMPU_METHOD _CNV_S_3_RANGE_ENG__148_CM "" TAB_VERB "%6.3" "[-]" COMPU_TAB_REF _CNV_S_3_RANGE_ENG__148 /end COMPU_METHOD
/begin COMPU_VTAB _CNV_S_3_RANGE_ENG__148 "" TAB_VERB 3 0 "NG_V6" 1 "NG_R6" 2 "M_54" /end COMPU_VTAB
/begin COMPU_METHOD _CNV_A_R_LINEAR_____149_CM "" RAT_FUNC "%6.3" "%" COEFFS 0 655.3600000071681 3.584063961170614e-007 0 0 1 /end COMPU_METHOD
/begin COMPU_METHOD _CNV_A_R_LINEAR_____153_CM "" RAT_FUNC "%6.3" "km/h" COEFFS 0 128.0000018750286 0. 0 0 1 /end COMPU_METHOD
/begin COMPU_METHOD _CNV_A_R_LINEAR_____157_CM "" RAT_FUNC "%6.3" "V" COEFFS 0 8.854166666666666 0. 0 0 1 /end COMPU_METHOD
/begin COMPU_METHOD _CNV_A_R_LINEAR_____158_CM "" RAT_FUNC "%6.3" "V" COEFFS 0 204.8 0. 0 0 1 /end COMPU_METHOD
/begin COMPU_METHOD _CNV_A_R_LINEAR_____163_CM "" RAT_FUNC "%6.3" "ohm" COEFFS 0 1. 0. 0 0 1 /end COMPU_METHOD
/begin COMPU_METHOD _CNV_A_R_LINEAR_____164_CM "" RAT_FUNC "%6.3" "°TPS" COEFFS 0 548.4100418410042 0. 0 0 1 /end COMPU_METHOD
/begin COMPU_METHOD _CNV_A_R_LINEAR_____182_CM "" RAT_FUNC "%6.3" "mm" COEFFS 0 1000. 0. 0 0 1 /end COMPU_METHOD
/begin COMPU_METHOD _CNV_A_R_LINEAR_____185_CM "" RAT_FUNC "%6.3" "-" COEFFS 0 16383.75 32767.5 0 0 1 /end COMPU_METHOD
/begin COMPU_METHOD _CNV_A_R_LINEAR_____188_CM "" RAT_FUNC "%6.3" "V" COEFFS 0 9.807692307692308 0. 0 0 1 /end COMPU_METHOD
/begin COMPU_METHOD _CNV_A_R_LINEAR_____196_CM "" RAT_FUNC "%6.3" "V" COEFFS 0 204.7999998958713 8.135057072422569e-009 0 0 1 /end COMPU_METHOD
/begin COMPU_METHOD _CNV_A_R_LINEAR_____197_CM "" RAT_FUNC "%6.3" "Nm/10ms" COEFFS 0 32. 0. 0 0 1 /end COMPU_METHOD
/begin COMPU_METHOD _CNV_S_3_RANGE_CAM__218_CM "" TAB_VERB "%6.3" "[-]" COMPU_TAB_REF _CNV_S_3_RANGE_CAM__218 /end COMPU_METHOD
/begin COMPU_VTAB _CNV_S_3_RANGE_CAM__218 "" TAB_VERB 3 0 "two seg. disc" 1 "four seg. disc synchronous" 2 "four seg. disc asynchronous" /end COMPU_VTAB
/begin COMPU_METHOD _CNV_A_R_LINEAR_____238_CM "" RAT_FUNC "%6.3" "kNm/s" COEFFS 0 937.5877572644921 0. 0 0 1 /end COMPU_METHOD
/begin COMPU_METHOD _CNV_A_R_LINEAR_____246_CM "" RAT_FUNC "%6.3" "V" COEFFS 0 204.8979314017341 1023.5 0 0 1 /end COMPU_METHOD
/begin COMPU_METHOD _CNV_A_R_LINEAR_____248_CM "" RAT_FUNC "%6.3" "-" COEFFS 0 655.3600000071681 32768.00000035841 0 0 1 /end COMPU_METHOD
/begin COMPU_METHOD _CNV_A_R_LINEAR_____250_CM "" RAT_FUNC "%6.3" "-" COEFFS 0 1024. 0. 0 0 1 /end COMPU_METHOD
/begin COMPU_METHOD _CNV_A_R_LINEAR_____255_CM "" RAT_FUNC "%6.3" "ohm" COEFFS 0 6.666666666666667 32768. 0 0 1 /end COMPU_METHOD
/begin COMPU_METHOD _CNV_A_R_LINEAR_____271_CM "" RAT_FUNC "%6.3" "Hz" COEFFS 0 1. 0. 0 0 1 /end COMPU_METHOD
/begin COMPU_METHOD _CNV_A_R_LINEAR_____272_CM "" RAT_FUNC "%6.3" "kg/h" COEFFS 0 8191.999999679995 0. 0 0 1 /end COMPU_METHOD
/begin COMPU_METHOD _CNV_A_R_LINEAR_____277_CM "" RAT_FUNC "%6.3" "hPa" COEFFS 0 54.6125 0. 0 0 1 /end COMPU_METHOD
/begin COMPU_METHOD _CNV_A_R_LINEAR_____278_CM "" RAT_FUNC "%6.3" "hPa" COEFFS 0 27.30625 32767.5 0 0 1 /end COMPU_METHOD
/begin COMPU_METHOD _CNV_A_R_LINEAR_____279_CM "" RAT_FUNC "%6.3" "%" COEFFS 0 2.56 128. 0 0 1 /end COMPU_METHOD
/begin COMPU_METHOD _CNV_A_R_LINEAR_____286_CM "" RAT_FUNC "%6.3" "cm²" COEFFS 0 1118.481084425738 0. 0 0 1 /end COMPU_METHOD
/begin COMPU_METHOD _CNV_A_R_LINEAR_____299_CM "" RAT_FUNC "%6.3" "%" COEFFS 0 327.6800790412251 0. 0 0 1 /end COMPU_METHOD
/begin COMPU_METHOD _CNV_A_R_LINEAR_____301_CM "" RAT_FUNC "%6.3" "mg/stk" COEFFS 0 47.14849960790521 32768.20722749412 0 0 1 /end COMPU_METHOD
/begin COMPU_METHOD _CNV_A_R_LINEAR_____308_CM "" RAT_FUNC "%6.3" "°CRK" COEFFS 0 -2.666666666666667 1120. 0 0 1 /end COMPU_METHOD
/begin COMPU_METHOD _CNV_A_R_LINEAR_____310_CM "" RAT_FUNC "%6.3" "mg" COEFFS 0 6.25 0. 0 0 1 /end COMPU_METHOD
/begin COMPU_METHOD _CNV_A_R_LINEAR_____318_CM "" RAT_FUNC "%6.3" "1/s^2" COEFFS 0 100.5832246182181 32768.00291612309 0 0 1 /end COMPU_METHOD
/begin COMPU_METHOD _CNV_S_6_RANGE_FMY__320_CM "" TAB_VERB "%6.3" "[-]" COMPU_TAB_REF _CNV_S_6_RANGE_FMY__320 /end COMPU_METHOD
/begin COMPU_VTAB _CNV_S_6_RANGE_FMY__320 "" TAB_VERB 6 0 "0" 1 "1" 2 "2" 3 "3" 4 "global" 5 "cus" /end COMPU_VTAB
/begin COMPU_METHOD _CNV_S_4_RANGE_FMY__322_CM "" TAB_VERB "%6.3" "[-]" COMPU_TAB_REF _CNV_S_4_RANGE_FMY__322 /end COMPU_METHOD
/begin COMPU_VTAB _CNV_S_4_RANGE_FMY__322 "" TAB_VERB 4 0 "0" 1 "1" 2 "2" 3 "3" /end COMPU_VTAB
/begin COMPU_METHOD _CNV_A_R_LINEAR_____324_CM "" RAT_FUNC "%6.3" "Ah" COEFFS 0 2.007874015748032 0. 0 0 1 /end COMPU_METHOD
/begin COMPU_METHOD _CNV_A_R_LINEAR_____325_CM "" RAT_FUNC "%6.3" "km/h" COEFFS 0 128. 0. 0 0 1 /end COMPU_METHOD
/begin COMPU_METHOD _CNV_A_R_LINEAR_____326_CM "" RAT_FUNC "%6.3" "km/h" COEFFS 0 8. 0. 0 0 1 /end COMPU_METHOD
/begin COMPU_METHOD _CNV_A_R_LINEAR_____327_CM "" RAT_FUNC "%6.3" "s" COEFFS 0 20. 0. 0 0 1 /end COMPU_METHOD
/begin COMPU_METHOD _CNV_A_R_LINEAR_____328_CM "" RAT_FUNC "%6.3" "km/h" COEFFS 0 128. 32768. 0 0 1 /end COMPU_METHOD
/begin COMPU_METHOD _CNV_A_R_LINEAR_____329_CM "" RAT_FUNC "%6.3" "m/s²" COEFFS 0 46.08002400098911 0. 0 0 1 /end COMPU_METHOD
/begin COMPU_METHOD _CNV_A_R_LINEAR_____330_CM "" RAT_FUNC "%6.3" "m/s²" COEFFS 0 4.608002655082556 0. 0 0 1 /end COMPU_METHOD
/begin COMPU_METHOD _CNV_A_R_LINEAR_____331_CM "" RAT_FUNC "%6.3" "km/h" COEFFS 0 4. 0. 0 0 1 /end COMPU_METHOD
/begin COMPU_METHOD _CNV_A_R_LINEAR_____332_CM "" RAT_FUNC "%6.3" "%/(km/h)" COEFFS 0 81.92004976154883 5.753929091042442e-004 0 0 1 /end COMPU_METHOD
/begin COMPU_METHOD _CNV_S_8_RANGE_REQ__333_CM "" TAB_VERB "%6.3" "[-]" COMPU_TAB_REF _CNV_S_8_RANGE_REQ__333 /end COMPU_METHOD
/begin COMPU_VTAB _CNV_S_8_RANGE_REQ__333 "" TAB_VERB 8 0 "Hard_off" 1 "Soft_off" 2 "TIP up" 3 "TIP Down " 4 "Set / Accelerate" 5 "Resume" 6 "Decelerate" 7 "None" /end COMPU_VTAB
/begin COMPU_METHOD _CNV_S_8_RANGE_STAT_334_CM "" TAB_VERB "%6.3" "[-]" COMPU_TAB_REF _CNV_S_8_RANGE_STAT_334 /end COMPU_METHOD
/begin COMPU_VTAB _CNV_S_8_RANGE_STAT_334 "" TAB_VERB 8 0 "None" 1 "Set-Acc-TipUp" 2 "Decelerate-TipDown" 3 "Resume" 4 "Off" 5 "-" 6 "-" 7 "Error" /end COMPU_VTAB
/begin COMPU_METHOD _CNV_A_R_LINEAR_____335_CM "" RAT_FUNC "%6.3" "rpm/(km/h)" COEFFS 0 0.5 0. 0 0 1 /end COMPU_METHOD
/begin COMPU_METHOD _CNV_A_R_LINEAR_____336_CM "" RAT_FUNC "%6.3" "m/s²" COEFFS 0 18.43200027000412 4.871326382271946e-006 0 0 1 /end COMPU_METHOD
/begin COMPU_METHOD _CNV_A_R_LINEAR_____338_CM "" RAT_FUNC "%6.3" "%/100ms" COEFFS 0 2.56 0. 0 0 1 /end COMPU_METHOD
/begin COMPU_METHOD _CNV_S_8_RANGE_STAT_339_CM "" TAB_VERB "%6.3" "[-]" COMPU_TAB_REF _CNV_S_8_RANGE_STAT_339 /end COMPU_METHOD
/begin COMPU_VTAB _CNV_S_8_RANGE_STAT_339 "" TAB_VERB 8 0 "PASSIVE" 1 "CONST/TIP " 2 "-" 3 "RES" 4 "-" 5 "SET_ACC" 6 "-" 7 "DEC" /end COMPU_VTAB
/begin COMPU_METHOD _CNV_S_6_RANGE_STAT_340_CM "" TAB_VERB "%6.3" "[-]" COMPU_TAB_REF _CNV_S_6_RANGE_STAT_340 /end COMPU_METHOD
/begin COMPU_VTAB _CNV_S_6_RANGE_STAT_340 "" TAB_VERB 6 0 "PASSIVE" 1 "CONST_DRIVE" 3 "RESUME" 5 "SET_ACC" 7 "RETARD" 9 "TIP" /end COMPU_VTAB
/begin RECORD_LAYOUT _REC_VAL_20_u2 FNC_VALUES 1 UWORD COLUMN_DIR DIRECT /end RECORD_LAYOUT
/begin RECORD_LAYOUT _REC_VAL_20_s2 FNC_VALUES 1 SWORD COLUMN_DIR DIRECT /end RECORD_LAYOUT
/begin RECORD_LAYOUT _REC_VAL_20_u1 FNC_VALUES 1 UBYTE COLUMN_DIR DIRECT /end RECORD_LAYOUT
/begin RECORD_LAYOUT _REC_AXS_20_u2 NO_AXIS_PTS_X 1 UWORD AXIS_PTS_X 2 UWORD INDEX_INCR DIRECT /end RECORD_LAYOUT
/begin RECORD_LAYOUT _REC_AXS_20_u1 NO_AXIS_PTS_X 1 UBYTE AXIS_PTS_X 2 UBYTE INDEX_INCR DIRECT /end RECORD_LAYOUT
/begin RECORD_LAYOUT _REC_CUR_20_u2_u2 FNC_VALUES 1 UWORD COLUMN_DIR DIRECT /end RECORD_LAYOUT
/begin RECORD_LAYOUT _REC_CUR_20_u2_u1 FNC_VALUES 1 UWORD COLUMN_DIR DIRECT /end RECORD_LAYOUT
/begin RECORD_LAYOUT _REC_CUR_20_u1_u1 FNC_VALUES 1 UBYTE COLUMN_DIR DIRECT /end RECORD_LAYOUT
/begin RECORD_LAYOUT _REC_CUR_20_u1_u2 FNC_VALUES 1 UBYTE COLUMN_DIR DIRECT /end RECORD_LAYOUT
/begin RECORD_LAYOUT _REC_MAP_20_u2_u1_u1 FNC_VALUES 1 UWORD COLUMN_DIR DIRECT /end RECORD_LAYOUT
/begin RECORD_LAYOUT _REC_MAP_20_u2_u1_u2 FNC_VALUES 1 UWORD COLUMN_DIR DIRECT /end RECORD_LAYOUT
/begin RECORD_LAYOUT _REC_MAP_20_u2_u2_u2 FNC_VALUES 1 UWORD COLUMN_DIR DIRECT /end RECORD_LAYOUT
/begin FUNCTION TQM_Characteristic_quantity_stra "_Characteristic quantity stratified mode" /begin DEF_CHARACTERISTIC IP_CQ_S IP_MAF_MIN_S LC_INH_S_MAN /end DEF_CHARACTERISTIC /begin OUT_MEASUREMENT CQ_S_RAW MAF_MIN_S CQ_S /end OUT_MEASUREMENT /end FUNCTION
/begin FUNCTION TQM_Reference_and_basic_torque_f "_Reference and basic torque for stratified mode" /begin DEF_CHARACTERISTIC IP_TQI_REF_S /end DEF_CHARACTERISTIC /begin OUT_MEASUREMENT TQI_REF_S /end OUT_MEASUREMENT /end FUNCTION
/begin FUNCTION TQM_Torque_Request_at_Clutch_Gen "_Torque Request at Clutch General"
 /begin OUT_MEASUREMENT FAC_TQ_REQ_CLU LV_TQ_CRU_ACT TQ_REQ_CLU TQI_MIN_REQ FAC_TQ_REQ /end OUT_MEASUREMENT
/end FUNCTION
/begin FUNCTION TQM_Minimum_Maximum_Torque_Reque "_Minimum/Maximum Torque Request Selection"
 /begin OUT_MEASUREMENT TQI_INTER_FAST TQI_INTER_SLOW TQI_REQ_FAST_DEC TQI_REQ_FAST_INC TQI_EMS LV_TQ_INC TQI_REQ_FAST TQI_REQ_FAST_1 TQI_REQ_SLOW TQI_REQ_SLOW_1 /end OUT_MEASUREMENT
/end FUNCTION
/begin FUNCTION TQM_Torque_setpoint_for_stratifi "_Torque setpoint for stratified mode" /begin OUT_MEASUREMENT TQI_SP_S /end OUT_MEASUREMENT /end FUNCTION
/begin FUNCTION TQM_Actual_Engine_Torque "_Actual Engine Torque" /begin DEF_CHARACTERISTIC C_FAC_TQE /end DEF_CHARACTERISTIC /begin OUT_MEASUREMENT TQI_AV_HOM TQ_AV TQE TQI_AV TQE_DIF EFF_TOT_AV /end OUT_MEASUREMENT /end FUNCTION
/begin FUNCTION TQM_Actual_indicated_engine_torq "_Actual indicated engine torque for stratified" /begin OUT_MEASUREMENT TQI_AV_S EFF_TOT_AV_S /end OUT_MEASUREMENT /end FUNCTION
/begin FUNCTION TQM_Characteristic_quantity_homo "_Characteristic quantity homogeneous mode" /begin OUT_MEASUREMENT CQ_HOM /end OUT_MEASUREMENT /end FUNCTION
/begin FUNCTION TQM_Engine_torque_limitation "_Engine torque limitation"
 /begin DEF_CHARACTERISTIC LC_TQI_P_MAX_INH_AS ID_TQ_P_MAX ID_TQ_P_MAX_MT ID_TQ_P_MAX_AT /end DEF_CHARACTERISTIC
/end FUNCTION
/begin FUNCTION TQM_Torque_Request_for_Traction_ "_Torque Request for Traction Control (ASR)" /begin DEF_CHARACTERISTIC C_LGRD_LIH_ASR C_T_DLY_LIH_ASR LC_ASR_DISABLE /end DEF_CHARACTERISTIC
 /begin OUT_MEASUREMENT LV_TCS_DISABLE TQI_ASR_SLOW TQI_ASR_FAST_REQ TQI_ASR_FAST LV_ASR_ENA TQI_ASR_SLOW_REQ LV_ASR_ACT LV_ASR_LIH SF_TQD /end OUT_MEASUREMENT
/end FUNCTION
/begin FUNCTION TQM_Torque_Request_for_MSR "_Torque Request for MSR" /begin DEF_CHARACTERISTIC C_VS_MIN_MSR C_LGRD_LIH_MSR C_T_DLY_LIH_MSR /end DEF_CHARACTERISTIC
 /begin OUT_MEASUREMENT LV_MSR_ENA TQI_MSR_REQ TQI_MSR_FAST TQI_MSR_SLOW LV_MSR_LIH LV_MSR_ACT /end OUT_MEASUREMENT
/end FUNCTION
/begin FUNCTION TQM_Torque_Request_for_Cruise_Co "_Torque Request for Cruise Control" /begin OUT_MEASUREMENT FAC_TQ_REQ_CRU /end OUT_MEASUREMENT /end FUNCTION
/begin FUNCTION GEN_General "GEN" /begin SUB_FUNCTION GEN_Variant_coding GEN_Initialisation_of_variables_ /end SUB_FUNCTION /end FUNCTION
/begin FUNCTION GEN_Variant_coding "_Variant coding" /begin DEF_CHARACTERISTIC C_ENG_CONF /end DEF_CHARACTERISTIC
 /begin OUT_MEASUREMENT LV_AT LV_VAR_ACIN LV_VAR_ICL LV_CBK_MPL LV_IVVT_IN_AND_EX LV_VAR_ASR LV_VAR_MSW CAM_TYPE ENG_CONF LV_INJ_CONF LV_ISA_CONF /end OUT_MEASUREMENT
/end FUNCTION
/begin FUNCTION GEN_Initialisation_of_variables_ "_Initialisation of variables from non implemented functions"
 /begin OUT_MEASUREMENT DUMMY LV_MIS_STATE_A LV_MIS_STATE_B LV_MTC_LIH_ACT STATE_SAV_DIAG STK_AV_EGR LV_ERR_VS MFF_ADD_CP TI_LAM_COR NTL /end OUT_MEASUREMENT
/end FUNCTION
/begin FUNCTION SEC_Serial_Communication "SEC" /begin SUB_FUNCTION SEC_Idle_Speed_Setpoint_offset_b /end SUB_FUNCTION /end FUNCTION
/begin FUNCTION SEC_Idle_Speed_Setpoint_offset_b "_Idle Speed Setpoint offset by tester (KWP)"
 /begin DEF_CHARACTERISTIC C_N_OFS_ACC_DRI_MAX C_N_OFS_ACC_DRI_MIN C_N_OFS_DRI_MAX C_N_OFS_DRI_MIN C_N_OFS_MAX C_N_OFS_MIN C_N_OFS_ACC_MAX C_N_OFS_ACC_MIN C_N_OFS_VB_MAX C_N_OFS_VB_MIN C_TCO_MIN_N_OFS_KWP LC_N_OFS_KWP_DISABLE C_CHA_CDN_BAT_KWP_MIN /end DEF_CHARACTERISTIC
 /begin OUT_MEASUREMENT LV_KWP_ENA N_KWP_OFS_ACC N_KWP_OFS N_KWP_OFS_DRI N_KWP_OFS_ACC_DRI N_KWP_OFS_VB_NVMY_ N_KWP_OFS_ACC_NVMY_ N_KWP_OFS_NVMY_ N_KWP_OFS_DRI_NVMY_ N_KWP_OFS_ACC_DRI_NVMY N_KWP_OFS_VB N_SP_OFS_KWP /end OUT_MEASUREMENT
/end FUNCTION
/begin FUNCTION CRU_Cruise_control "CRU"
 /begin SUB_FUNCTION CRU_General__calculation_of_crui CRU_Controlled_acceleration CRU_Actuating_the_reference_inpu CRU_Intercepting_the_reference_i CRU_Interventions CRU_Ready_state_and_display CRU_Evaluation_serial_data_line_ CRU_Conditions_for_cruise_contro CRU_Additional_functions /end SUB_FUNCTION
/end FUNCTION
/begin FUNCTION CRU_General__calculation_of_crui "_General  calculation of cruise control and constant drive"
 /begin DEF_CHARACTERISTIC IP_T_RST_CRU__VS_SP_CRU C_FAC_VS_DIF_RNG_CRU C_AC_NEG_CRU_AC C_VS_DIF_MIN_IS_CRU C_VS_DIF_MAX_IS_CRU IP_PVS_DEC_CRU__N_32 IP_FAC_PROP_CRU__VS_SP_CRU IP_PVS_MIN_SET_CRU__VS_SP_CRU C_VS_DIF_RNG_CRU C_PVS_LGRD_CRU C_T_MIN_PUC_CRU /end DEF_CHARACTERISTIC
 /begin OUT_MEASUREMENT VS_DIF_CRU VS_DIF_I_CRU PV_CRU /end OUT_MEASUREMENT
/end FUNCTION
/begin FUNCTION CRU_Controlled_acceleration "_Controlled acceleration" /begin DEF_CHARACTERISTIC C_VS_DIF_MAX_AC_CRU C_VS_DIF_MIN_AC_CRU /end DEF_CHARACTERISTIC /begin OUT_MEASUREMENT T_CTL_CRU VS_SP_CRU VS_SP_DIF_CRU /end OUT_MEASUREMENT /end FUNCTION
/begin FUNCTION CRU_Actuating_the_reference_inpu "_Actuating the reference input variable"
 /begin DEF_CHARACTERISTIC IP_FAC_CRU_REST__T_CTL_CRU IP_FAC_CRU_AC__T_CTL_CRU IP_FAC_CRU_DECE__T_CTL_CRU IP_FAC_CC_CRU_AC__T_CTL_CRU IP_FAC_CC_CRU_DECE__T_CTL_CRU /end DEF_CHARACTERISTIC
 /begin OUT_MEASUREMENT FAC_VS_CTL_CRU /end OUT_MEASUREMENT
/end FUNCTION
/begin FUNCTION CRU_Intercepting_the_reference_i "_Intercepting the reference input variable target acceleration"
 /begin DEF_CHARACTERISTIC C_FAC_AC_POS_CRU C_VS_AC_MIN_CRU C_VS_AC_MAX_CRU IP_FAC_LGRD_CRU_REST__VS_SP_DIF IP_FAC_LGRD_CRU_TIP__VS_SP_DIF /end DEF_CHARACTERISTIC
 /begin OUT_MEASUREMENT FAC_VS_LGRD_CRU /end OUT_MEASUREMENT
/end FUNCTION
/begin FUNCTION CRU_Interventions "_Interventions"
 /begin DEF_CHARACTERISTIC C_AC_POS_CRU_RESU C_VS_I_FAC_MAX_CRU C_VS_I_AC_MAX_CRU C_AC_POS_CRU_AC C_VS_DIF_MAX_CRU C_AC_POS_CRU_TIP C_AC_NEG_CRU_TIP C_VS_SP_CRU_MAX C_AC_NEG_CRU_DEACC C_AC_POS_CRU_DEACC C_VS_DIF_DELTA_I IP_AC_NEG_CRU_RESU__N__PV_CRU IP_AC_NEG_CRU_AC__N__PV_CRU C_T_MIN_CRU_CON /end DEF_CHARACTERISTIC
 /begin OUT_MEASUREMENT VS_SP_INC_CRU VS_SP_DEC_CRU VS_SP_DRIV_CRU_ /end OUT_MEASUREMENT
/end FUNCTION
/begin FUNCTION CRU_Ready_state_and_display "_Ready state and display" /begin DEF_CHARACTERISTIC LC_CRU_REQ_SWI C_T_READY_CRU C_T_CRUS_ON C_T_CRUS /end DEF_CHARACTERISTIC /begin OUT_MEASUREMENT LV_CRU_MAIN_SWI_ /end OUT_MEASUREMENT /end FUNCTION
/begin FUNCTION CRU_Evaluation_serial_data_line_ "_Evaluation serial data line from the MSW" /begin OUT_MEASUREMENT STATE_MSW_CAN REQ_MSW /end OUT_MEASUREMENT /end FUNCTION
/begin FUNCTION CRU_Conditions_for_cruise_contro "_Conditions for cruise control"
 /begin DEF_CHARACTERISTIC C_VS_MIN_CRU C_VS_MIN_PLAUS_CRU C_T_CRU_ESP_OFF C_T_CRU_ASR_OFF C_T_CRU_ESP_BRAKE_OFF C_T_DLY_VS_SP_CRU_MAX /end DEF_CHARACTERISTIC
 /begin OUT_MEASUREMENT REQ_CRU LV_CRU_OFF_IRR STATE_CRU_CAN STATE_CRU LV_CRU_OFF_BY_ASR_ESP_CTL LV_CRU_ACT /end OUT_MEASUREMENT
/end FUNCTION
/begin FUNCTION CRU_Additional_functions "_Additional functions"
 /begin DEF_CHARACTERISTIC C_PVS_HYS_CRU C_T_DLY_MAX_CRU C_VS_DIF_DLY_CRU C_N_VS_MAX_CRU C_FAC_VS_FIL C_VS_SP_DIF_MIN_CRU C_VS_SP_DIF_MAX_CRU C_AC_MAX_CRU C_VS_MAX_DIAG /end DEF_CHARACTERISTIC
 /begin OUT_MEASUREMENT T_DLY_CRU N_VS_CRU VS_FIL AC_CRU LV_CRU_OVER_ACT LV_VS_DIAG_NOT_PLAUS /end OUT_MEASUREMENT
/end FUNCTION
/begin FUNCTION BGO_Basic_SW_General_Operation "BGO" /begin SUB_FUNCTION BGO_Non_volatile_datas /end SUB_FUNCTION /end FUNCTION
/begin FUNCTION BGO_Non_volatile_datas "_Non volatile datas"
 /begin DEF_CHARACTERISTIC LC_AD_CLR_NVMY LC_AD_CLR LC_AD_CLR_KNK LC_AD_CLR_LAM LC_AD_CLR_EGR LC_AD_CLR_TCO LC_AD_CLR_TPS LC_AD_CLR_MIS LC_AD_CLR_IVVT LC_AD_CLR_IMM LC_AD_CLR_IDLE LC_AD_CLR_ATI LC_AD_CLR_ECF LC_AD_CLR_TOIL LC_AD_CLR_CCP LC_AD_CLR_DISA LC_AD_CLR_N_SP_IS LC_AD_CLR_SA LC_AD_CLR_CAN LC_AD_CLR_CRU LC_AD_CLR_RON LC_AD_CLR_POW LC_FMY_CLR /end DEF_CHARACTERISTIC
/end FUNCTION
/begin FUNCTION X__HP_DDS_EXPA2_DEFAULT_FUNC__ "X__HP_DDS_EXPA2_DEFAULT_FUNC__"
 /begin DEF_CHARACTERISTIC ldp_fac_tq_req_clu__tq_add_ch ldp_iga_dif_eff_iga ldp_lamb_sp_iga_ref_lamb ldp_maf_iga_dif_min_bas ldp_maf_kgh_temp_sub_cat ldp_n_32__tq_add_ch_is ldp_n_dif_cor__tq_i_dt_is ldp_n_dif_cor_p_d_dt_is ldp_n_dif_cor_p_d_is ldp_n_dif_cor_tq_i_is ldp_n_grd_p_d_dt_is ldp_n_grd_p_d_is ldp_n_grd_tq_i_is ldp_n_iga_dif_min_bas ldp_n_ratio_conv_fac_tq_conv ldp_n_t_n_dif_ofs_pred ldp_n_tq_add_st ldp_n_tq_add_tra ldp_nr_pat__pat_ind ldp_seg_ctr_fac_wf ldp_t_ast__fac_tq_add_ch ldp_tco__fac_tq_add_ch ldp_tco__fac_tq_add_ch_is ldp_tco_iga_dif_min_tco ldp_tco_st_iga_t_ch ldp_tco_st_temp_mmv_ini_cat ldp_tco_st_ti_fac_wf ldp_tco_st_tqfr_st ldp_tco_ti_wf_thd ldp_toil_fac_conv ldp_toil_t_dly_conv ldp_toil_t_dly_n_sp_is ldp_toil_t_ramp_conv_neg ldp_toil_t_ramp_conv_pos ldp_toil_tqfr_add ldp_v_amp__amp_raw ldp_v_tia_tia ldp_v_toil__toil ldp_vs__amp_raw_cor ldpm_gr_at_100 ldpm_gr_at_2 ldpm_gr_at_3 ldpm_gr_mt_100 ldpm_gr_mt_2 ldpm_gr_mt_3 ldpm_maf_100 ldpm_maf_6 ldpm_n_110 ldpm_n_2_3 ldpm_n_29 ldpm_n_35 ldpm_tco_1_6 ldpm_tco_15 ldpm_tco_3 ldpm_tco_3_4 ldpm_tib_ti_wf_thd ldpm_n_id_crk_acq ldp_n__tq_loss_acc ldp_t_acc__fac_tq_loss_acc_on ldp_t_acc__fac_tq_loss_acc_off ldp_maf_cyl_stk__tqfr ldp_n_sp_is_ratio ldp_tco__tqfr_add ldp_tco__lamb_ref_add ldp_lamb_dif__eff_lamb ldp_n__lamb_ref ldp_tco__mff_lgrd_ast ldpm_tco__eoi_tco ldpm_tco__mff_cst ldp_cyc__mff_cst ldp_vb__ti_add_dly ldp_tco_st_ip_ti_tco_wup ldp_tqi_sp_maf__maf_sp ldpm_tco_7 ldp_n__lamb_fl ldp_n_32__lamb_bas ldp_tco__lamb_add_afl_ch ldp_n_32__lamb_hom_afl ldpm_n_19 ldp_n_32__fac_lamb_wup ldp_tqi_req_slow__lamb_hom_afl ldp_tqi_req_slow__fac_lamb_wup ldp_amp_mes_ti_st_amp_fac ldp_ti_hom__eoi_bas ldpm_maf_4 ldp_t_ast__lamb_add_afl_ch ldp_tco__lamb_bas_wup_cor ldp_tco_st__lamb_bas_wup_cor ldp_fup_bas__fup_mes ldp_n_iga_ref_temp ldp_maf_iga_ref_temp ldp_tia__iga_ref_temp_fac ldp_n__iga_ref_vvt ldp_maf__iga_ref_vvt ldpm_maf_ip_egr_ratio ldpm_n_17 ldp_lamb_sp__iga_bas_lamb ldpm_n_st ldpm_n_h_prs_st ldpm_tco_h_prs ldp_tco__n_sp_add_cat ldp_t_ast__n_sp_add_cat ldpm_n_32__fup_sp ldpm_n_32__fup_sp_s ldp_fup_sp__fpapwm_bas ldpm_fup_dif__fpapwm ldp_eff_iga_sp_iga_dif_sp ldp_egr_ratio_sp__iga_ref_egr ldpm_tco_is_1 ldpm_maf_1_9 ldpm_n_2_9 ldpm_n_4_9 ldpm_vb_td ldpm_n_32_ip_egr_ratio ldpm_tqi_sp__fup_sp ldpm_fpa_mff__fpapwm ldp_tqi_req_slow__lamb_ch_rgl ldp_n_32__lamb_ch_rgl ldp_tqi_req_slow__lamb_ch_is ldp_n_32__lamb_ch_is ldpm_vo_1 ldpm_n_14 ldpm_tco_st_5 ldp_tia_ip_ti_cast ldp_cyc_cast_ip_ti_deac_cast ldp_tqi_req_slow__lamb_afl_1 ldp_vb_mmv_dri_n_sp_min_vb ldp_vb_mmv_n_sp_min_vb ldp_n__v_dur_igc_min ldp_maf__v_dur_igc_min ldp_v_pvs_min ldp_maf_mes__maf_dif_tps_diag ldpm_n_32_28 ldp_tps_av__maf_1_diag ldpm_tia_maf_mdl_con_1 ldpm_tia_1 ldpm_tco__fac_tco_tqi ldpm_n_32_6 ldpm_n_32__drv2_er ldpm_tqi_av__thd_er ldpm_maf__thd_er ldpm_tco_4 ldpm_tco_4_rng_l ldp_vb_mmv_dri_n_sp_vb_rng_l ldp_vb_mmv_n_sp_min_vb_rng_l ldp_n_ecf__n_ecf_min_accin ldp_vs__n_ecf_vs_cor ldp_tco__temp_sub_ecf_ini ldp_n_ecf_cor_fil__n_perc_ecf ldp_tco_ex__n_ecf ldp_ecfpwm_ecf__pow_loss_ecf ldp_acp__tq_loss_acc ldp_pv_av__n_max_mtc_cur_off ldp_vb__fpapwm_fac ldp_vb__ivvtpwm ldpm_gear ldp_n_32_n_grd_thd ldpm_tco__tqi_min_pu ldpm_n_fac_tq_req_driv ldpm_pv_av_fac_tq_req_driv ldp_n_vs_ratio_gr_mt ldp_n_32__port_sp_afs ldp_n_32__port_sp_afl ldp_n_32__port_sp_s ldp_fac_tq_req__port_sp_afs ldp_tco__tcoport_sp ldp_exc_sp_rel__vlft_sp ldp_portpwm__port_sp_phy ldp_fac_tq_req__port_sp_afl ldp_fac_tq_req__port_sp_s ldp_v_port__port_av ldpm_maf_2 ldp_gr_at_n_tur ldpm_tco_1 ldp_n_32__lamb_afl_1 ldp_n_32__lamb_iga_afl ldp_maf_hb__lamb_iga_afl ldp_tam__temp_sub_ecf_ini ldp_tqi_req_slow__lamb_bas ldp_tqi_req_slow__lamb_sawup ldp_tqi_req_slow__lamb_sawup_is ldp_n_32__lamb_sawup ldp_n_32__lamb_sawup_is ldp_t_ast__lamb_add_sawup ldp_tco__lamb_add_sawup ldp_vs_n_tur ldp_vlft_av__cam_op_in_vvl ldp_maf__mff_cor_1 ldp_maf__mff_cor_2 ldp_n__mff_cor_1 ldp_n__mff_cor_2 ldpm_cam_edge_nr_0__win_chk ldpm_cam_edge_nr_1__win_chk ldp_tps_av__tps_grd_max_er ldp_tps_av_id_tps_grd_bol_ae ldp_v_teg__teg ldp_n_dif_st ldp_n_dif_pred_tq_add_is_bol ldpm_tco_st__tco_dif_diag ldp_v_tco__tco ldp_maf_kgh__tco_sub_inc ldp_n_32__fac_tq_aj ldp_n_32__fac_tq_req_clu_is ldp_n_32__tq_add_ch ldp_n_32__tq_loss_acc ldp_tq_accin_can__tq_loss_acc ldp_tps_dif__mtcpwm_p ldp_tps_dif__mtcpwm_i ldp_tps_av_lih_dif_mtcpwm_i ldp_tps_dif_grd__mtcpwm_d ldp_tps_sp_lih_dif__mtcpwm_add ldp_vb__mtcpwm_vb_fac ldpm_n_32_100 ldpm_n_32_30 ldp_n_23 ldp_eff_scc_sp__nr_pat_scc ldp_cl_mmv ldp_tco__iga_bas_temp_cor ldp_tia__iga_bas_temp_cor ldpm_n_32_fac_iga_pos_neg ldp_maf_fac_iga_pos_neg ldpm_n_32 ldp_n_32__maf_min_knk_ad_2 ldp_tia__ip_fac_ron_ad_max ldp_tco__ip_fac_ron_ad_max ldp_teg_dyn_hys ldp_tco__fac_thd_er ldpm_n__thd_er ldpm_tco__tqi_av_min_er ldpm_n_32__tqi_av_min_er ldpm_n_32__fac_er ldpm_tqi_av__fac_er ldpm_gear__tq_p_max ldpm_vs_wheel_grd_mmv_thd ldp_n_32__mis_fac_thd_iv_er ldp_n_32__mis__a_fac ldp_tqi_av__mis_fac_thd_iv_er ldp_tqi_av__mis_a_fac ldp_maf__lamb_ref ldp_maf__thd_is_er_diag ldp_n__mff_cst ldp_n__thd_is_er_diag ldp_tco__iga_ref_temp_fac ldp_tco__fac_thd_is_er_diag ldpm_temp_mmv_sub_cat_ecf_1 ldp_id_maf_tab_1 ldp_id_saf_tab_1 ldp_id_maf_tab_2 ldp_id_saf_tab_2 ldpm_n_32__tqi_min_pu ldp_n_32__eoi_bas ldpm_tco_st_tco_lam_min ldp_tco_st_t_dly_ls_ready ldp_tco_temp_ls_ini ldp_tia_temp_ls_ini ldp_vs_fac_v_efc_teg ldp_tco_st_int_teg_maf_thd ldp_tia_int_teg_maf_thd ldp_ctr_cold_st_fac_ctr_cold_st ldp_pow_dif_add_teg_iga ldp_nr_pat__fac_scc_teg ldp_maf_kgh_add_teg_stat_scc ldp_vs_fac_vs_teg ldpm_maf_kgh_crlc_teg ldp_n_ip_vls_sp_dly ldp_maf_ip_vls_sp_dly ldp_n_ip_fac_lam_dly ldp_maf_ip_fac_lam_dly ldp_ti_fac_ti_ad_fac_fac ldp_ti_add_ti_ad_add_fac ldp_n_lshpwm_down ldp_maf_lshpwm_down ldp_cat_ip_fac_cat_dly ldp_maf_kgh_ip_fac_dly_p ldp_maf_kgh_ip_crlc_dly_i ldpm_n_26 ldpm_n_9 ldp_lamb_sp__fac_lam_teg ldpm_tco_10 ldpm_maf_3 ldp_maf_teg ldp_n__v_efc_lsh_ctl ldp_n_32_teg ldpm_n_32__ti_lam ldpm_maf__ti_lam ldpm_vls_dif_dly ldpm_t_vls_cyc_afl_hld ldp_r_dif_down_ls_lshpwm_i ldp_r_up_ls_ip_ttip_ls_up ldp_r_down_ls_ip_ttip_ls_down ldp_eff_iga_av__fac_iga ldp_temp_ls_ini_v_efc_lsh_up ldp_teg_dyn__v_efc_lsh_up_ctl ldp_maf_int_puc__1 ldp_cat_diag__fac_cat_eff_puc ldp_maf_cyl__delta_lamb_sp_puc ldpm_temp_cat_fac_pcat_main_cat ldp_cl_mmv_ip_t_max_cp ldpm_maf_cyl_ip_ti_lam_cor_crlc ldp_cl_mmv_ip_rel_flow_fac_cp ldpm_maf_cyl_ip_rel_flow_inc_cp ldpm_maf_cyl_ip_rel_flow_max_cp ldpm_n_32_ip_rel_flow_max_cps ldpm_n_32_ip_rel_flow_cps_s ldpm_maf_ip_rel_flow_max_cps ldpm_maf_ip_rel_flow_cps_s ldp_flow_cor_cps_ip_cppwm ldpm_prs_cps_ip_cppwm ldp_tia_ip_fac_tia_cp ldpm_vb_ip_cppwm_vb ldp_cppwm_ref_ip_cppwm_cor_frq ldpm_n_32_ip_fuel_dly_cps ldp_amp_ip_fac_amp_cp ldpm_tqi_sp_s_cp ldpm_frq_req_cp ldp_n_32_ar_red_egr ldp_stk_av_egr_ar_red_egr ldp_pq__fac_ar_red_cor ldpm_pq_ar_red ldp_t_seg_t_1_ratio_crlc_hfm ldpm_maf_kgh_t_1_hfm ldpm_n_eff_vol ldpm_amp__eff_vol_ofs_amp ldpm_maf_cyl_ex ldp_teg_egr_maf_egr_con_1 ldp_maf_cyl_amp_dec ldp_n_32__tps_sp_mdl_max ldpm_vo__eff_vol ldp_n_32__pq_egr_sp ldp_n_32__fac_maf_max_s ldp_mff_sp_s__fac_maf_max_s ldp_maf_dif_s__eff_maf_s ldp_mff_sp_s__pq_egr_sp ldp_mff_sp_s__tqi_ref_s ldp_ar_red_sp_mmv ldp_maf_kgh_sp__amp_dec ldpm_disa_ist__eff_vol ldpm_fac_port_deac__eff_vol ldpm_exc_av_rel__eff_vol ldpm_n_32_ar_red ldp_v_map_map_mes_bas ldp_maf_kgh_mes_bas ldp_pq_sp_fil__crlc_ar_red_sp ldp_maf_sp__tps_sp_mdl_max ldpm_n_ar_red ldp_tps_seg_ar_red_thr ldpm_pq_estim_id_maf_fac_ofs ldpm_n_32__eff_vol_cor ldpm_maf__eff_vol_cor ldp_n_32__crlc_eff_vol_cor ldp_n_32__fac_maf_afl ldp_n_32__eff_iga_afl ldp_tqi_req_slow__eff_iga_afl ldp_egr_ratio_prev_s ldp_tco__tqi_thd_s_afl ldp_tco__tqi_thd_afl_afs ldp_n_hys_afs__tqi_thd_afl_afs ldp_tqi_req_fast__lamb_min_s ldp_n__eoi_dif_s ldp_eoi__prs_inc_cmp ldp_crk_inj__prs_inc_cmp ldpm_prs_dec_inj__fac_ti_prs ldp_n_32_ip_lamb_rgn_afr ldpm_n_32_s ldpm_tqi_sp_mff_s ldpm_tqi_sp_s ldp_cq_s_raw__cq_s ldp_mff_sp__iga_bas_s ldp_mff_sp_s__eoi_dif_s ldp_n_hys_afl__tqi_thd_s_afl ldp_n_32__iga_bas_s ldpm_mff_mmv ldp_ntl_ip_lamb_rgn_fac_mdl ldp_n_32__lamb_min_s ldp_vls_down_ip_lamb_rgn ldp_maf_ip_lamb_rgn_afr ldpm_n_32__egr_ratio_s ldpm_mff_sp_s__egr_ratio_s ldpm_maf__egr_ratio_hom ldp_maf_ip_egr_ratio_min ldpm_n_32__egr_ratio_hom ldp_maf_ip_er_std_thd ldp_n_32_ip_egr_ratio_min ldp_n_32_ip_er_std_thd ldp_maf_cyl__egr_ratio_inc ldp_ar_red_sp_egr_stk_sp_egr ldpm_stk_dif_egr ldp_stk_sp_egr__egrpwm_prev ldpm_er_egr ldpm_lamb_ratio ldpm_tco__iga_egr ldp_n_32__iga_egr_afr ldpm_maf__iga_egr ldp_n_32__iga_egr_afl ldp_n_32__iga_egr_s ldp_mff_sp_s__egr_iga ldp_tco__fac_tco_egr ldpm_n_32_maf_sa_deac ldpm_n_32_maf_sa_act ldp_maf_cyl__saf_mdl ldp_amp__saf_cor_amp ldp_vb__saf_cor_vb ldp_tia__saf_cor_tia ldp_fmy_dtc ldp_fmy_envd ldpm_t_ctl_cru_1 ldp_vs_dif_cru__fac_prop_cru ldpm_vs_sp_dif_cru_1 ldpm_pv_cru_1 ldpm_n_21 ldp_n_32__pvs_dec_cru ldpm_vs_sp_cru_1 ldpm_pq_estim_id_maf_isa_fac_ofs ldp_pq_sp_isa ldp_ar_red_isa_sp_mmv ldpm_vb_1 ldp_n_32__maf_sp_isa ldp_maf_sp_tqi__maf_sp_isa ldp_maf_turb_ratio ldp_isapwm_mmv ldp_vo_fac_ivvt ldpm_n_13 ldpm_maf_ivvt_1 ldpm_n_5 ldpm_maf_ivvt_2 ldpm_tco_17 ldpm_tco_st_4 ldpm_tco_st_6 ldpm_n_11 /end DEF_CHARACTERISTIC
 /begin OUT_MEASUREMENT N_RATIO_CONV TCO_DIF TEMP_LS_INI CKS_CRC_ECU CYCNR_PUC LV_CAT_DIAG_2 LV_FMY_EXIT_ST LV_FSD_DIAG_1 LV_FSD_DIAG_2 LV_LS_DIAG_2 LV_MAX_ERR_FSD_1 LV_MIN_ERR_FSD_1 N_HYS_PUC N_MIN_PUC TQ_DIF_TRA TQI ENG_STATE TIA_SUB LV_LS_DIAG_1 ENV_TD_ERR_TD ENV_TD_ERR_LV_MPL_IGA_ACT ENV_TD_ERR_TD_MPL_DLY ENV_TD_ERR_VB ENV_TD_ERR_TMP_TD__VB ENV_TD_ERR_N_32 ENV_TD_ERR_LV_IGK ENV_TD_ERR_ECU_STATE ENV_TD_ERR_ENG_STATE ENV_TD_ERR_C_TD_AS CTR_TD_ERR LV_CAT_DIAG_1 LV_HOM_AFL_ACT CYCNR_ST SEG_NR STATE_IV MAF_CYL /end OUT_MEASUREMENT
/end FUNCTION
/end MODULE
/end PROJECT
